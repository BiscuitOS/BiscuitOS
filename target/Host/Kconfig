## target/Host/Kconfig
```kconfig
#
# Host toolchain configure
#
menu "Host toolchain"

config DTC
	bool "DTC cover to DTB"
	help
	  DTC tools to describe hardware board.

endmenu
```

## target/Host/qemu/Kconfig
```kconfig
#
# Qeumu configration
#

menu "Qemu configuration"

config QEMU
	bool "Support qemu to emulate different CPU"
	default y
	help
	  Utilize qemu to emulate different hardware platform.
	  Support x86(Intel i386)

if QEMU

config QEMU_BOOT_FLOPPY
	bool "Boot from floppy"
	depends on QEMU
	help
	  Support system boot from floppy disk.

config QEMU_BOOT_HARDDISK
	bool "Boot from hard disk"
	depends on QEMU
	help
	  Support system boot from hard disk.

config QEMU_MEMORY_SIZE
	int "Memory size(M)"
	depends on QEMU
	help
	  Configure running memory of qmeu.

config QEMU_RTC
	bool "RTC on qemu"
	depends on QEMU
	help
	  Configure RTC format time on qmeu.

config QEMU_SERIAL_PTY
	bool "PTY serial"
	depends on QEMU
	help
	  Support pty serial.

endif

endmenu
```

## target/kernel/Kconfig
```kconfig
#
# Kernel configure
#
menu "Kernel"

config KERNEL
	bool "Kernel for BiscuitOS"

if KERNEL

### Kernel version
choice
	prompt "Select kernel version"
	default KERNEL_VERSION_NEWEST 

config KERNEL_VERSION_NEWEST
	bool "newest     kernel"
	help
	  The newest kernel

config KERNEL_VERSION_0_1_1
	bool "0.11       kernel"
	help
	  The kernel version is 0.11

config KERN_VERSION_0_2_0
	bool "0.22       kernel"
	help
	  The kernel version is 0.22


endchoice 

endif

endmenu
```

## toolchain/Kconfig
```kconfig
#
# Host Compiler toolchain
#
menuconfig TOOLCHAIN
	bool  "Compile toolchain"
	default y

if TOOLCHAIN

# ARM gnueabi
source toolchain/arm-linux-gnueabi/Kconfig

# ARM gnueabihf
source toolchain/arm-linux-gnueabihf/Kconfig

# ARM aarch64
source toolchain/aarch64-linux-gnu/Kconfig

# ARM none-gnueabi
source toolchain/arm-none-linux-gnueabi/Kconfig

# RISCV-64
source toolchain/riscv64-biscuitos-linux-gnu/Kconfig

# RISCV-32
source toolchain/riscv32-biscuitos-linux-gnu/Kconfig

endif # TOOLCHAIN
```

## toolchain/aarch64-linux-gnu/Kconfig
```kconfig
menuconfig TOOL_AARCH64
	bool "aarch64-linux-gnu"

if TOOL_AARCH64

choice
	prompt "Setup way to get aarch64-linux-gnu"

config TOOL_AARCH64_DL
	bool "aarch64-linux-gnu from external file"

config TOOL_AARCH64_WGET
	bool "aarch64-linux-gnu from wget"

endchoice

config TOOL_AARCH64_SRC
	int
	default 1 if TOOL_AARCH64_DL
	default 2 if TOOL_AARCH64_WGET

if TOOL_AARCH64_WGET

choice 
	prompt "Release version"

config AARCH64_V4.9-2016.02
	bool "v4.9-2016.02"
	
config AARCH64_V5.1-2015.08
	bool "v5.1-2015.08"

config AARCH64_V5.3-2016.02
	bool "v5.3-2016.02"

config AARCH64_V5.4-2017.01
	bool "v5.4-2017.01"

config AARCH64_V5.5-2017.10
	bool "v5.5-2017.10"

config AARCH64_V6.1-2016.08
	bool "v6.1-2017.10"

config AARCH64_V6.2-2016.11
	bool "v6.2-2016.11"

config AARCH64_V6.3-2017.02
	bool "v6.3-2017.02"

config AARCH64_V6.4-2018.05
	bool "v6.4-2018.05"

config AARCH64_V6.5-2018.12
	bool "v6.5-2018.12"

config AARCH64_V7.1-2017.08
	bool "v7.1-2017.08"

config AARCH64_V7.2-2017.11
	bool "v7.2-2017.11"

config AARCH64_V7.3-2018.05
	bool "v7.3-2018.05"

config AARCH64_V7.4-2019.02
	bool "v7.4-2019.02"

endchoice

config AARCH64_FULL_NAME
	string
	default "4.9-2016.02/aarch64-linux-gnu/gcc-linaro-4.9-2016.02-x86_64_aarch64-linux-gnu.tar.xz" if AARCH64_V4.9-2016.02
	default "5.1-2015.08/aarch64-linux-gnu/gcc-linaro-5.1-2015.08-x86_64_aarch64-linux-gnu.tar.xz" if AARCH64_V5.1-2015.08
	default "5.3-2016.02/aarch64-linux-gnu/gcc-linaro-5.3-2016.02-x86_64_aarch64-linux-gnu.tar.xz" if AARCH64_V5.3-2016.02
	default "5.4-2017.01/aarch64-linux-gnu/gcc-linaro-5.4.1-2017.01-x86_64_aarch64-linux-gnu.tar.xz" if AARCH64_V5.4-2017.01
	default "5.5-2017.10/aarch64-linux-gnu/gcc-linaro-5.5.0-2017.10-x86_64_aarch64-linux-gnu.tar.xz" if AARCH64_V5.5-2017.10
	default "6.1-2016.08/aarch64-linux-gnu/gcc-linaro-6.1.1-2016.08-x86_64_aarch64-linux-gnu.tar.xz" if AARCH64_V6.1-2016.08
	default "6.2-2016.11/aarch64-linux-gnu/gcc-linaro-6.2.1-2016.11-x86_64_aarch64-linux-gnu.tar.xz" if AARCH64_V6.2-2016.11
	default "6.3-2017.02/aarch64-linux-gnu/gcc-linaro-6.3.1-2017.02-x86_64_aarch64-linux-gnu.tar.xz" if AARCH64_V6.3-2017.02
	default "6.4-2018.05/aarch64-linux-gnu/gcc-linaro-6.4.1-2018.05-x86_64_aarch64-linux-gnu.tar.xz" if AARCH64_V6.4-2018.05
	default "6.5-2018.12/aarch64-linux-gnu/gcc-linaro-6.5.0-2018.12-x86_64_aarch64-linux-gnu.tar.xz" if AARCH64_V6.5-2018.12
	default "7.1-2017.08/aarch64-linux-gnu/gcc-linaro-7.1.1-2017.08-x86_64_aarch64-linux-gnu.tar.xz" if AARCH64_V7.1-2017.08
	default "7.2-2017.11/aarch64-linux-gnu/gcc-linaro-7.2.1-2017.11-x86_64_aarch64-linux-gnu.tar.xz" if AARCH64_V7.2-2017.11
	default "7.3-2018.05/aarch64-linux-gnu/gcc-linaro-7.3.1-2018.05-x86_64_aarch64-linux-gnu.tar.xz" if AARCH64_V7.3-2018.05
	default "7.4-2019.02/aarch64-linux-gnu/gcc-linaro-7.4.1-2019.02-x86_64_aarch64-linux-gnu.tar.xz" if AARCH64_V7.4-2019.02

config AARCH64_VERSION
	string
	default "v4.9-2016.02" if AARCH64_V4.9-2016.02
	default "v5.1-2015.08" if AARCH64_V5.1-2015.08
	default "v5.3-2016.02" if AARCH64_V5.3-2016.02
	default "v5.4-2017.01" if AARCH64_V5.4-2017.01
	default "v5.5-2017.10" if AARCH64_V5.5-2017.10
	default "v6.1-2016.08" if AARCH64_V6.1-2016.08
	default "v6.2-2016.11" if AARCH64_V6.2-2016.11
	default "v6.3-2017.02" if AARCH64_V6.3-2017.02
	default "v6.4-2018.05" if AARCH64_V6.4-2018.05
	default "v6.5-2018.12" if AARCH64_V6.5-2018.12
	default "v7.1-2017.08" if AARCH64_V7.1-2017.08
	default "v7.2-2017.11" if AARCH64_V7.2-2017.11
	default "v7.3-2018.05" if AARCH64_V7.3-2018.05
	default "v7.4-2019.02" if AARCH64_V7.4-2019.02
 
endif # TOOL_AARCH64_WGET

if TOOL_AARCH64_DL

config TOOL_AARCH64_DL_NAME
	string "aarch64-linux-gnu absolute path"

config AARCH64_VERSION
	string "aarch64-linux-gnu version"
	default "v7.4-2019.02"

endif # TOOL_AARCH64_DL

endif # TOOL_AARCH64
```

## toolchain/arm-linux-gnueabihf/Kconfig
```kconfig
menuconfig TOOL_ARM_GNUEABIHF
	bool "arm-linux-gnueabihf"

if TOOL_ARM_GNUEABIHF

choice
	prompt "Setup way to get arm-linux-gnueabihf"

config TOOL_ARM_GNUEABIHF_DL
	bool "arm-linux-gnueabihf from external file"

config TOOL_ARM_GNUEABIHF_WGET
	bool "arm-linux-gnueabihf from wget"

endchoice

config TOOL_ARM_GNUEABIHF_SRC
	int
	default 1 if TOOL_ARM_GNUEABIHF_DL
	default 2 if TOOL_ARM_GNUEABIHF_WGET

if TOOL_ARM_GNUEABIHF_WGET

choice 
	prompt "Release version"

config ARM_GNUEABIHF_V4.9-2016.02
	bool "v4.9-2016.02"
	
config ARM_GNUEABIHF_V5.1-2015.08
	bool "v5.1-2015.08"

config ARM_GNUEABIHF_V5.3-2016.02
	bool "v5.3-2016.02"

config ARM_GNUEABIHF_V5.4-2017.01
	bool "v5.4-2017.01"

config ARM_GNUEABIHF_V5.5-2017.10
	bool "v5.5-2017.10"

config ARM_GNUEABIHF_V6.1-2016.08
	bool "v6.1-2017.10"

config ARM_GNUEABIHF_V6.2-2016.11
	bool "v6.2-2016.11"

config ARM_GNUEABIHF_V6.3-2017.02
	bool "v6.3-2017.02"

config ARM_GNUEABIHF_V6.4-2018.05
	bool "v6.4-2018.05"

config ARM_GNUEABIHF_V6.5-2018.12
	bool "v6.5-2018.12"

config ARM_GNUEABIHF_V7.1-2017.08
	bool "v7.1-2017.08"

config ARM_GNUEABIHF_V7.2-2017.11
	bool "v7.2-2017.11"

config ARM_GNUEABIHF_V7.3-2018.05
	bool "v7.3-2018.05"

config ARM_GNUEABIHF_V7.4-2019.02
	bool "v7.4-2019.02"

endchoice

config ARM_GNUEABIHF_FULL_NAME
	string
	default "4.9-2016.02/arm-linux-gnueabihf/gcc-linaro-4.9-2016.02-x86_64_arm-linux-gnueabihf.tar.xz" if ARM_GNUEABIHF_V4.9-2016.02
	default "5.1-2015.08/arm-linux-gnueabihf/gcc-linaro-5.1-2015.08-x86_64_arm-linux-gnueabihf.tar.xz" if ARM_GNUEABIHF_V5.1-2015.08
	default "5.3-2016.02/arm-linux-gnueabihf/gcc-linaro-5.3-2016.02-x86_64_arm-linux-gnueabihf.tar.xz" if ARM_GNUEABIHF_V5.3-2016.02
	default "5.4-2017.01/arm-linux-gnueabihf/gcc-linaro-5.4.1-2017.01-x86_64_arm-linux-gnueabihf.tar.xz" if ARM_GNUEABIHF_V5.4-2017.01
	default "5.5-2017.10/arm-linux-gnueabihf/gcc-linaro-5.5.0-2017.10-x86_64_arm-linux-gnueabihf.tar.xz" if ARM_GNUEABIHF_V5.5-2017.10
	default "6.1-2016.08/arm-linux-gnueabihf/gcc-linaro-6.1.1-2016.08-x86_64_arm-linux-gnueabihf.tar.xz" if ARM_GNUEABIHF_V6.1-2016.08
	default "6.2-2016.11/arm-linux-gnueabihf/gcc-linaro-6.2.1-2016.11-x86_64_arm-linux-gnueabihf.tar.xz" if ARM_GNUEABIHF_V6.2-2016.11
	default "6.3-2017.02/arm-linux-gnueabihf/gcc-linaro-6.3.1-2017.02-x86_64_arm-linux-gnueabihf.tar.xz" if ARM_GNUEABIHF_V6.3-2017.02
	default "6.4-2018.05/arm-linux-gnueabihf/gcc-linaro-6.4.1-2018.05-x86_64_arm-linux-gnueabihf.tar.xz" if ARM_GNUEABIHF_V6.4-2018.05
	default "6.5-2018.12/arm-linux-gnueabihf/gcc-linaro-6.5.0-2018.12-x86_64_arm-linux-gnueabihf.tar.xz" if ARM_GNUEABIHF_V6.5-2018.12
	default "7.1-2017.08/arm-linux-gnueabihf/gcc-linaro-7.1.1-2017.08-x86_64_arm-linux-gnueabihf.tar.xz" if ARM_GNUEABIHF_V7.1-2017.08
	default "7.2-2017.11/arm-linux-gnueabihf/gcc-linaro-7.2.1-2017.11-x86_64_arm-linux-gnueabihf.tar.xz" if ARM_GNUEABIHF_V7.2-2017.11
	default "7.3-2018.05/arm-linux-gnueabihf/gcc-linaro-7.3.1-2018.05-x86_64_arm-linux-gnueabihf.tar.xz" if ARM_GNUEABIHF_V7.3-2018.05
	default "7.4-2019.02/arm-linux-gnueabihf/gcc-linaro-7.4.1-2019.02-x86_64_arm-linux-gnueabihf.tar.xz" if ARM_GNUEABIHF_V7.4-2019.02

config ARM_GNUEABIHF_VERSION
	string
	default "v4.9-2016.02" if ARM_GNUEABIHF_V4.9-2016.02
	default "v5.1-2015.08" if ARM_GNUEABIHF_V5.1-2015.08
	default "v5.3-2016.02" if ARM_GNUEABIHF_V5.3-2016.02
	default "v5.4-2017.01" if ARM_GNUEABIHF_V5.4-2017.01
	default "v5.5-2017.10" if ARM_GNUEABIHF_V5.5-2017.10
	default "v6.1-2016.08" if ARM_GNUEABIHF_V6.1-2016.08
	default "v6.2-2016.11" if ARM_GNUEABIHF_V6.2-2016.11
	default "v6.3-2017.02" if ARM_GNUEABIHF_V6.3-2017.02
	default "v6.4-2018.05" if ARM_GNUEABIHF_V6.4-2018.05
	default "v6.5-2018.12" if ARM_GNUEABIHF_V6.5-2018.12
	default "v7.1-2017.08" if ARM_GNUEABIHF_V7.1-2017.08
	default "v7.2-2017.11" if ARM_GNUEABIHF_V7.2-2017.11
	default "v7.3-2018.05" if ARM_GNUEABIHF_V7.3-2018.05
	default "v7.4-2019.02" if ARM_GNUEABIHF_V7.4-2019.02
 
endif # TOOL_ARM_GNUEABIHF_WGET

if TOOL_ARM_GNUEABIHF_DL

config TOOL_ARM_GNUEABIHF_DL_NAME
	string "arm-linux-gnueabihf absolute path"

config ARM_GNUEABIHF_VERSION
	string "arm-linux-gnueabihf version"
	default "v7.4-2019.02"

endif # TOOL_ARM_GNUEABIHF_DL

endif # TOOL_ARM_GNUEABIHF
```

## toolchain/riscv32-biscuitos-linux-gnu/Kconfig
```kconfig
menuconfig TOOL_RISCV32
	bool "riscv32-biscuitos-linux-gnu"

if TOOL_RISCV32

choice
	prompt "Setup way to get riscv32-biscuitos-linux-gnu"

config TOOL_RISCV32_SRC
	bool "riscv32-biscuitos-linux-gnu from Source Code"

config TOOL_RISCV32_APT
	bool "riscv32-biscuitos-linux-gnu from Debian(apt install)"

config TOOL_RISCV32_WGET
	bool "riscv32-biscuitos-linux-gnu from WGET"

config TOOL_RISCV32_EXT
	bool "riscv32-biscuitos-linux-gnu from External package"


endchoice

config TOOL_RISCV32_WAY
	int
	default 1 if TOOL_RISCV32_SRC
	default 2 if TOOL_RISCV32_APT
	default 3 if TOOL_RISCV32_WGET
	default 4 if TOOL_RISCV32_EXT

config TOOL_RISCV32_VERSION
	string "riscv32-biscuitos-linux-gnu Version"

config TOOL_RISCV32_TAR
	string "Tar-package type"

endif # TOOL_RISCV32
```

## toolchain/riscv64-biscuitos-linux-gnu/Kconfig
```kconfig
menuconfig TOOL_RISCV64
	bool "riscv64-biscuitos-linux-gnu"

if TOOL_RISCV64

choice
	prompt "Setup way to get riscv64-biscuitos-linux-gnu"

config TOOL_RISCV64_SRC
	bool "riscv64-biscuitos-linux-gnu from Source Code"

config TOOL_RISCV64_APT
	bool "riscv64-biscuitos-linux-gnu from Debian(apt install)"

config TOOL_RISCV64_WGET
	bool "riscv64-biscuitos-linux-gnu from WGET"

config TOOL_RISCV64_EXT
	bool "riscv64-biscuitos-linux-gnu from External package"


endchoice

config TOOL_RISCV64_WAY
	int
	default 1 if TOOL_RISCV64_SRC
	default 2 if TOOL_RISCV64_APT
	default 3 if TOOL_RISCV64_WGET
	default 4 if TOOL_RISCV64_EXT

config TOOL_RISCV64_VERSION
	string "riscv64-biscuitos-linux-gnu Version"

config TOOL_RISCV64_TAR
	string "Tar-package type"

endif # TOOL_RISCV64
```

## toolchain/riscv64-linux-gnu/Kconfig
```kconfig
menuconfig TOOL_RISCV64_GNU
	bool "riscv64-linux-gnu"

if TOOL_RISCV64_GNU

choice
	prompt "Setup way to get riscv64-linux-gnu"

config TOOL_RISCV64_GNU_SRC
	bool "riscv64-linux-gnu from Source Code"

config TOOL_RISCV64_GNU_APT
	bool "riscv64-linux-gnu from Debian(apt install)"

endchoice

config TOOL_RISCV64_WAY
	int
	default 1 if TOOL_RISCV64_GNU_SRC
	default 2 if TOOL_RISCV64_GNU_APT

endif # TOOL_RISCV64_GNU
```
