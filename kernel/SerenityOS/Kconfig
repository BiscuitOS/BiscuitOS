## package/BUDDY-ALLOCATOR/BiscuitOS-BUDDY-GFP-DMA32/Kconfig
```kconfig
menuconfig PK_BUDDY_GFP_DMA32
	bool "BUDDY GFP: GFP_DMA32"

if PK_BUDDY_GFP_DMA32

config PK_BUDDY_GFP_DMA32_VERSION
	default "default"
	string "verstion"

config PK_BUDDY_GFP_DMA32_TAR
	default "tar.gz"
	string "tar type"

config PK_BUDDY_GFP_DMA32_URL
	default "https://gitee.com/BiscuitOS_team/HardStack/raw/Gitee/Memory-Allocator/BUDDY-ALLOCATOR/BiscuitOS-BUDDY-GFP-DMA32"
	string "url"

config PK_BUDDY_GFP_DMA32_GITHUB
	string "GitHub"

config PK_BUDDY_GFP_DMA32_SRCFILE
	default "Kconfig  main.c  Makefile  Makefile.host  RunBiscuitOS.sh"
	string "Source code list"

config PK_BUDDY_GFP_DMA32_CSRCFILE
	string "Compile source code list"

config PK_BUDDY_GFP_DMA32_CONFIG
	string "CONFIG: Project Configure Options"

config PK_BUDDY_GFP_DMA32_LIBPATH
	string "LIBS: Libraries to pass to the linker, e.g. -l<library>"

config PK_BUDDY_GFP_DMA32_CPPFLAGS
	string "CPPFLAGS: C/C++ preprocessor flags, e.g. -I<include dir>"

config PK_BUDDY_GFP_DMA32_DPKCONFIG
	string "PKG_CONFIG_PATH: Directories to add to pkg-config's search path"

config PK_BUDDY_GFP_DMA32_CFLAGS
	string "CFLAGS: C compiler flags"

config PK_BUDDY_GFP_DMA32_LDFLAGS
	string "LDFLAGS: Linker flags"

config PK_BUDDY_GFP_DMA32_CXXFLAGS
	string "CXXFLAGS: C++ compiler flags"

config PK_BUDDY_GFP_DMA32_ASFLAGS
	string "CCASFLAGS: assembler compiler flags (defaults to CFLAGS)"

config PK_BUDDY_GFP_DMA32_BUILDARCH
	string "--host options on configure for Architecture"

endif # PK_BUDDY_GFP_DMA32
```

## package/BUDDY-ALLOCATOR/BiscuitOS-BUDDY-GFP-HIGHMEM/Kconfig
```kconfig
menuconfig PK_BUDDY_GFP_HIGHMEM
	bool "BUDDY GFP: GFP_HIGHMEM"

if PK_BUDDY_GFP_HIGHMEM

config PK_BUDDY_GFP_HIGHMEM_VERSION
	default "default"
	string "verstion"

config PK_BUDDY_GFP_HIGHMEM_TAR
	default "tar.gz"
	string "tar type"

config PK_BUDDY_GFP_HIGHMEM_URL
	default "https://gitee.com/BiscuitOS_team/HardStack/raw/Gitee/Memory-Allocator/BUDDY-ALLOCATOR/BiscuitOS-BUDDY-GFP-HIGHMEM"
	string "url"

config PK_BUDDY_GFP_HIGHMEM_GITHUB
	string "GitHub"

config PK_BUDDY_GFP_HIGHMEM_SRCFILE
	default "Kconfig  main.c  Makefile  Makefile.host  RunBiscuitOS.sh"
	string "Source code list"

config PK_BUDDY_GFP_HIGHMEM_CSRCFILE
	string "Compile source code list"

config PK_BUDDY_GFP_HIGHMEM_CONFIG
	string "CONFIG: Project Configure Options"

config PK_BUDDY_GFP_HIGHMEM_LIBPATH
	string "LIBS: Libraries to pass to the linker, e.g. -l<library>"

config PK_BUDDY_GFP_HIGHMEM_CPPFLAGS
	string "CPPFLAGS: C/C++ preprocessor flags, e.g. -I<include dir>"

config PK_BUDDY_GFP_HIGHMEM_DPKCONFIG
	string "PKG_CONFIG_PATH: Directories to add to pkg-config's search path"

config PK_BUDDY_GFP_HIGHMEM_CFLAGS
	string "CFLAGS: C compiler flags"

config PK_BUDDY_GFP_HIGHMEM_LDFLAGS
	string "LDFLAGS: Linker flags"

config PK_BUDDY_GFP_HIGHMEM_CXXFLAGS
	string "CXXFLAGS: C++ compiler flags"

config PK_BUDDY_GFP_HIGHMEM_ASFLAGS
	string "CCASFLAGS: assembler compiler flags (defaults to CFLAGS)"

config PK_BUDDY_GFP_HIGHMEM_BUILDARCH
	string "--host options on configure for Architecture"

endif # PK_BUDDY_GFP_HIGHMEM
```

## package/BUDDY-ALLOCATOR/BiscuitOS-BUDDY-GFP-HIGHUSER-MOVABLE/Kconfig
```kconfig
menuconfig PK_BUDDY_GFP_HIGHUSER_MOVABLE
	bool "BUDDY GFP: GFP_HIGHUSER_MOVABLE"

if PK_BUDDY_GFP_HIGHUSER_MOVABLE

config PK_BUDDY_GFP_HIGHUSER_MOVABLE_VERSION
	default "default"
	string "verstion"

config PK_BUDDY_GFP_HIGHUSER_MOVABLE_TAR
	default "tar.gz"
	string "tar type"

config PK_BUDDY_GFP_HIGHUSER_MOVABLE_URL
	default "https://gitee.com/BiscuitOS_team/HardStack/raw/Gitee/Memory-Allocator/BUDDY-ALLOCATOR/BiscuitOS-BUDDY-GFP-HIGHUSER-MOVABLE"
	string "url"

config PK_BUDDY_GFP_HIGHUSER_MOVABLE_GITHUB
	string "GitHub"

config PK_BUDDY_GFP_HIGHUSER_MOVABLE_SRCFILE
	default "main.c  Makefile  RunBiscuitOS.sh"
	string "Source code list"

config PK_BUDDY_GFP_HIGHUSER_MOVABLE_CSRCFILE
	string "Compile source code list"

config PK_BUDDY_GFP_HIGHUSER_MOVABLE_CONFIG
	string "CONFIG: Project Configure Options"

config PK_BUDDY_GFP_HIGHUSER_MOVABLE_LIBPATH
	string "LIBS: Libraries to pass to the linker, e.g. -l<library>"

config PK_BUDDY_GFP_HIGHUSER_MOVABLE_CPPFLAGS
	string "CPPFLAGS: C/C++ preprocessor flags, e.g. -I<include dir>"

config PK_BUDDY_GFP_HIGHUSER_MOVABLE_DPKCONFIG
	string "PKG_CONFIG_PATH: Directories to add to pkg-config's search path"

config PK_BUDDY_GFP_HIGHUSER_MOVABLE_CFLAGS
	string "CFLAGS: C compiler flags"

config PK_BUDDY_GFP_HIGHUSER_MOVABLE_LDFLAGS
	string "LDFLAGS: Linker flags"

config PK_BUDDY_GFP_HIGHUSER_MOVABLE_CXXFLAGS
	string "CXXFLAGS: C++ compiler flags"

config PK_BUDDY_GFP_HIGHUSER_MOVABLE_ASFLAGS
	string "CCASFLAGS: assembler compiler flags (defaults to CFLAGS)"

config PK_BUDDY_GFP_HIGHUSER_MOVABLE_BUILDARCH
	string "--host options on configure for Architecture"

endif # PK_BUDDY_GFP_HIGHUSER_MOVABLE
```

## package/BUDDY-ALLOCATOR/BiscuitOS-BUDDY-GFP-KERNEL/Kconfig
```kconfig
menuconfig PK_BUDDY_GFP_KERNEL
	bool "BUDDY GFP: GFP_KERNEL"

if PK_BUDDY_GFP_KERNEL

config PK_BUDDY_GFP_KERNEL_VERSION
	default "default"
	string "verstion"

config PK_BUDDY_GFP_KERNEL_TAR
	default "tar.gz"
	string "tar type"

config PK_BUDDY_GFP_KERNEL_URL
	default "https://gitee.com/BiscuitOS_team/HardStack/raw/Gitee/Memory-Allocator/BUDDY-ALLOCATOR/BiscuitOS-BUDDY-GFP-KERNEL"
	string "url"

config PK_BUDDY_GFP_KERNEL_GITHUB
	string "GitHub"

config PK_BUDDY_GFP_KERNEL_SRCFILE
	default "Kconfig  main.c  Makefile  Makefile.host  RunBiscuitOS.sh"
	string "Source code list"

config PK_BUDDY_GFP_KERNEL_CSRCFILE
	string "Compile source code list"

config PK_BUDDY_GFP_KERNEL_CONFIG
	string "CONFIG: Project Configure Options"

config PK_BUDDY_GFP_KERNEL_LIBPATH
	string "LIBS: Libraries to pass to the linker, e.g. -l<library>"

config PK_BUDDY_GFP_KERNEL_CPPFLAGS
	string "CPPFLAGS: C/C++ preprocessor flags, e.g. -I<include dir>"

config PK_BUDDY_GFP_KERNEL_DPKCONFIG
	string "PKG_CONFIG_PATH: Directories to add to pkg-config's search path"

config PK_BUDDY_GFP_KERNEL_CFLAGS
	string "CFLAGS: C compiler flags"

config PK_BUDDY_GFP_KERNEL_LDFLAGS
	string "LDFLAGS: Linker flags"

config PK_BUDDY_GFP_KERNEL_CXXFLAGS
	string "CXXFLAGS: C++ compiler flags"

config PK_BUDDY_GFP_KERNEL_ASFLAGS
	string "CCASFLAGS: assembler compiler flags (defaults to CFLAGS)"

config PK_BUDDY_GFP_KERNEL_BUILDARCH
	string "--host options on configure for Architecture"

endif # PK_BUDDY_GFP_KERNEL
```

## package/BUDDY-ALLOCATOR/BiscuitOS-BUDDY-GFP-PGTABLE-USER/Kconfig
```kconfig
menuconfig PK_BUDDY_GFP_PGTABLE_USER
	bool "BUDDY GFP: GFP_PGTABLE_USER"

if PK_BUDDY_GFP_PGTABLE_USER

config PK_BUDDY_GFP_PGTABLE_USER_VERSION
	default "default"
	string "verstion"

config PK_BUDDY_GFP_PGTABLE_USER_TAR
	default "tar.gz"
	string "tar type"

config PK_BUDDY_GFP_PGTABLE_USER_URL
	default "https://gitee.com/BiscuitOS_team/HardStack/raw/Gitee/Memory-Allocator/BUDDY-ALLOCATOR/BiscuitOS-BUDDY-GFP-PGTABLE-USER"
	string "url"

config PK_BUDDY_GFP_PGTABLE_USER_GITHUB
	string "GitHub"

config PK_BUDDY_GFP_PGTABLE_USER_SRCFILE
	default "main.c  Makefile  RunBiscuitOS.sh"
	string "Source code list"

config PK_BUDDY_GFP_PGTABLE_USER_CSRCFILE
	string "Compile source code list"

config PK_BUDDY_GFP_PGTABLE_USER_CONFIG
	string "CONFIG: Project Configure Options"

config PK_BUDDY_GFP_PGTABLE_USER_LIBPATH
	string "LIBS: Libraries to pass to the linker, e.g. -l<library>"

config PK_BUDDY_GFP_PGTABLE_USER_CPPFLAGS
	string "CPPFLAGS: C/C++ preprocessor flags, e.g. -I<include dir>"

config PK_BUDDY_GFP_PGTABLE_USER_DPKCONFIG
	string "PKG_CONFIG_PATH: Directories to add to pkg-config's search path"

config PK_BUDDY_GFP_PGTABLE_USER_CFLAGS
	string "CFLAGS: C compiler flags"

config PK_BUDDY_GFP_PGTABLE_USER_LDFLAGS
	string "LDFLAGS: Linker flags"

config PK_BUDDY_GFP_PGTABLE_USER_CXXFLAGS
	string "CXXFLAGS: C++ compiler flags"

config PK_BUDDY_GFP_PGTABLE_USER_ASFLAGS
	string "CCASFLAGS: assembler compiler flags (defaults to CFLAGS)"

config PK_BUDDY_GFP_PGTABLE_USER_BUILDARCH
	string "--host options on configure for Architecture"

endif # PK_BUDDY_GFP_PGTABLE_USER
```

## package/BUDDY-ALLOCATOR/BiscuitOS-BUDDY-GFP-USER/Kconfig
```kconfig
menuconfig PK_BUDDY_GFP_USER
	bool "BUDDY GFP: GFP_USER"

if PK_BUDDY_GFP_USER

config PK_BUDDY_GFP_USER_VERSION
	default "default"
	string "verstion"

config PK_BUDDY_GFP_USER_TAR
	default "tar.gz"
	string "tar type"

config PK_BUDDY_GFP_USER_URL
	default "https://gitee.com/BiscuitOS_team/HardStack/raw/Gitee/Memory-Allocator/BUDDY-ALLOCATOR/BiscuitOS-BUDDY-GFP-USER"
	string "url"

config PK_BUDDY_GFP_USER_GITHUB
	string "GitHub"

config PK_BUDDY_GFP_USER_SRCFILE
	default "app.c  Kconfig  main.c  Makefile  Makefile.host  RunBiscuitOS.sh"
	string "Source code list"

config PK_BUDDY_GFP_USER_CSRCFILE
	string "Compile source code list"

config PK_BUDDY_GFP_USER_CONFIG
	string "CONFIG: Project Configure Options"

config PK_BUDDY_GFP_USER_LIBPATH
	string "LIBS: Libraries to pass to the linker, e.g. -l<library>"

config PK_BUDDY_GFP_USER_CPPFLAGS
	string "CPPFLAGS: C/C++ preprocessor flags, e.g. -I<include dir>"

config PK_BUDDY_GFP_USER_DPKCONFIG
	string "PKG_CONFIG_PATH: Directories to add to pkg-config's search path"

config PK_BUDDY_GFP_USER_CFLAGS
	string "CFLAGS: C compiler flags"

config PK_BUDDY_GFP_USER_LDFLAGS
	string "LDFLAGS: Linker flags"

config PK_BUDDY_GFP_USER_CXXFLAGS
	string "CXXFLAGS: C++ compiler flags"

config PK_BUDDY_GFP_USER_ASFLAGS
	string "CCASFLAGS: assembler compiler flags (defaults to CFLAGS)"

config PK_BUDDY_GFP_USER_BUILDARCH
	string "--host options on configure for Architecture"

endif # PK_BUDDY_GFP_USER
```

## package/BUDDY-ALLOCATOR/BiscuitOS-BUDDY-MEMORY-POLICY/Kconfig
```kconfig
menuconfig PK_BUDDY_MEMORY_POLICY
	select PK_NUMA
	select PK_NUMACTL_LIBNUMA
	bool "BUDDY: MEMORY POLICY"

if PK_BUDDY_MEMORY_POLICY

config PK_BUDDY_MEMORY_POLICY_VERSION
	default "default"
	string "verstion"

config PK_BUDDY_MEMORY_POLICY_TAR
	default "tar.gz"
	string "tar type"

config PK_BUDDY_MEMORY_POLICY_URL
	default "https://gitee.com/BiscuitOS_team/HardStack/raw/Gitee/Memory-Allocator/BUDDY-ALLOCATOR/BiscuitOS-BUDDY-MEMORY-POLICY"
	string "url"

config PK_BUDDY_MEMORY_POLICY_GITHUB
	string "GitHub"

config PK_BUDDY_MEMORY_POLICY_SRCFILE
	default "main.c  Makefile  RunBiscuitOS.sh"
	string "Source code list"

config PK_BUDDY_MEMORY_POLICY_CSRCFILE
	string "Compile source code list"

config PK_BUDDY_MEMORY_POLICY_CONFIG
	string "CONFIG: Project Configure Options"

config PK_BUDDY_MEMORY_POLICY_LIBPATH
	string "LIBS: Libraries to pass to the linker, e.g. -l<library>"

config PK_BUDDY_MEMORY_POLICY_CPPFLAGS
	string "CPPFLAGS: C/C++ preprocessor flags, e.g. -I<include dir>"

config PK_BUDDY_MEMORY_POLICY_DPKCONFIG
	string "PKG_CONFIG_PATH: Directories to add to pkg-config's search path"

config PK_BUDDY_MEMORY_POLICY_CFLAGS
	string "CFLAGS: C compiler flags"

config PK_BUDDY_MEMORY_POLICY_LDFLAGS
	string "LDFLAGS: Linker flags"

config PK_BUDDY_MEMORY_POLICY_CXXFLAGS
	string "CXXFLAGS: C++ compiler flags"

config PK_BUDDY_MEMORY_POLICY_ASFLAGS
	string "CCASFLAGS: assembler compiler flags (defaults to CFLAGS)"

config PK_BUDDY_MEMORY_POLICY_BUILDARCH
	string "--host options on configure for Architecture"

endif # PK_BUDDY_MEMORY_POLICY
```

## package/BUDDY-ALLOCATOR/BiscuitOS-BUDDY/Kconfig
```kconfig
menuconfig PK_BUDDY_DEMO
	bool "BUDDY ALLOCATOR"

if PK_BUDDY_DEMO

config PK_BUDDY_DEMO_VERSION
	default "default"
	string "verstion"

config PK_BUDDY_DEMO_TAR
	default "tar.gz"
	string "tar type"

config PK_BUDDY_DEMO_URL
	default "https://gitee.com/BiscuitOS_team/HardStack/raw/Gitee/Memory-Allocator/BUDDY-ALLOCATOR/BiscuitOS-BUDDY"
	string "url"

config PK_BUDDY_DEMO_GITHUB
	string "GitHub"

config PK_BUDDY_DEMO_SRCFILE
	default "Kconfig  main.c  Makefile  Makefile.host  RunBiscuitOS.sh"
	string "Source code list"

config PK_BUDDY_DEMO_CSRCFILE
	string "Compile source code list"

config PK_BUDDY_DEMO_CONFIG
	string "CONFIG: Project Configure Options"

config PK_BUDDY_DEMO_LIBPATH
	string "LIBS: Libraries to pass to the linker, e.g. -l<library>"

config PK_BUDDY_DEMO_CPPFLAGS
	string "CPPFLAGS: C/C++ preprocessor flags, e.g. -I<include dir>"

config PK_BUDDY_DEMO_DPKCONFIG
	string "PKG_CONFIG_PATH: Directories to add to pkg-config's search path"

config PK_BUDDY_DEMO_CFLAGS
	string "CFLAGS: C compiler flags"

config PK_BUDDY_DEMO_LDFLAGS
	string "LDFLAGS: Linker flags"

config PK_BUDDY_DEMO_CXXFLAGS
	string "CXXFLAGS: C++ compiler flags"

config PK_BUDDY_DEMO_ASFLAGS
	string "CCASFLAGS: assembler compiler flags (defaults to CFLAGS)"

config PK_BUDDY_DEMO_BUILDARCH
	string "--host options on configure for Architecture"

endif # PK_BUDDY_DEMO
```

## package/BUDDY-ALLOCATOR/Kconfig
```kconfig
menuconfig PK_BUDDY
	bool "BUDDY ALLOCATOR(ZONE ALLOCATOR)"

if PK_BUDDY

# BUDDY
source package/BUDDY-ALLOCATOR/BiscuitOS-BUDDY/Kconfig

# BUDDY: MEMORY POLICY
source package/BUDDY-ALLOCATOR/BiscuitOS-BUDDY-MEMORY-POLICY/Kconfig

# BUDDY GFP: GFP_KERNEL
source package/BUDDY-ALLOCATOR/BiscuitOS-BUDDY-GFP-KERNEL/Kconfig

# BUDDY GFP: GFP_DMA
source package/BUDDY-ALLOCATOR/BiscuitOS-BUDDY-GFP-DMA/Kconfig

# BUDDY GFP: GFP_DMA32
source package/BUDDY-ALLOCATOR/BiscuitOS-BUDDY-GFP-DMA32/Kconfig

# BUDDY GFP: GFP_HIGHMEM
source package/BUDDY-ALLOCATOR/BiscuitOS-BUDDY-GFP-HIGHMEM/Kconfig

# BUDDY GFP: GFP_HIGHUSER_MOVABLE
source package/BUDDY-ALLOCATOR/BiscuitOS-BUDDY-GFP-HIGHUSER-MOVABLE/Kconfig

# BUDDY GFP: GFP_PGTABLE_USER
source package/BUDDY-ALLOCATOR/BiscuitOS-BUDDY-GFP-PGTABLE-USER/Kconfig

# BUDDY GFP: GFP_PGTABLE_KERNEL
source package/BUDDY-ALLOCATOR/BiscuitOS-BUDDY-GFP-PGTABLE-KERNEL/Kconfig

endif # PK_BUDDY
```

## package/BiscuitOS-debug-stub/BiscuitOS-MEMORY-FLUID-KERNEL/Kconfig
```kconfig
menuconfig PK_DEBUG_MEMORY_FLUID_KERNEL
	bool "BiscuitOS MEMORY FLUID on Kernel"

if PK_DEBUG_MEMORY_FLUID_KERNEL

config PK_DEBUG_MEMORY_FLUID_KERNEL_VERSION
	default "default"
	string "verstion"

config PK_DEBUG_MEMORY_FLUID_KERNEL_TAR
	default "tar.gz"
	string "tar type"

config PK_DEBUG_MEMORY_FLUID_KERNEL_URL
	default "https://gitee.com/BiscuitOS_team/HardStack/raw/Gitee/Debug-Stub/BiscuitOS-MEMORY-FLUID-KERNEL"
	string "url"

config PK_DEBUG_MEMORY_FLUID_KERNEL_GITHUB
	string "GitHub"

config PK_DEBUG_MEMORY_FLUID_KERNEL_SRCFILE
	default "main.c Makefile Makefile.host Kconfig RunBiscuitOS.sh"
	string "Source code list"

config PK_DEBUG_MEMORY_FLUID_KERNEL_CSRCFILE
	string "Compile source code list"

config PK_DEBUG_MEMORY_FLUID_KERNEL_CONFIG
	string "CONFIG: Project Configure Options"

config PK_DEBUG_MEMORY_FLUID_KERNEL_LIBPATH
	string "LIBS: Libraries to pass to the linker, e.g. -l<library>"

config PK_DEBUG_MEMORY_FLUID_KERNEL_CPPFLAGS
	string "CPPFLAGS: C/C++ preprocessor flags, e.g. -I<include dir>"

config PK_DEBUG_MEMORY_FLUID_KERNEL_DPKCONFIG
	string "PKG_CONFIG_PATH: Directories to add to pkg-config's search path"

config PK_DEBUG_MEMORY_FLUID_KERNEL_CFLAGS
	string "CFLAGS: C compiler flags"

config PK_DEBUG_MEMORY_FLUID_KERNEL_LDFLAGS
	string "LDFLAGS: Linker flags"

config PK_DEBUG_MEMORY_FLUID_KERNEL_CXXFLAGS
	string "CXXFLAGS: C++ compiler flags"

config PK_DEBUG_MEMORY_FLUID_KERNEL_ASFLAGS
	string "CCASFLAGS: assembler compiler flags (defaults to CFLAGS)"

config PK_DEBUG_MEMORY_FLUID_KERNEL_BUILDARCH
	string "--host options on configure for Architecture"

endif # PK_DEBUG_MEMORY_FLUID_KERNEL
```
