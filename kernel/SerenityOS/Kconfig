## package/BiscuitOS-debug-stub/BiscuitOS-MEMORY-FLUID/Kconfig
```kconfig
menuconfig PK_DEBUG_MEMORY_FLUID
	bool "BiscuitOS MEMORY FLUID"

if PK_DEBUG_MEMORY_FLUID

config PK_DEBUG_MEMORY_FLUID_VERSION
	default "default"
	string "verstion"

config PK_DEBUG_MEMORY_FLUID_TAR
	default "tar.gz"
	string "tar type"

config PK_DEBUG_MEMORY_FLUID_URL
	default "https://gitee.com/BiscuitOS_team/HardStack/raw/Gitee/Debug-Stub/BiscuitOS-MEMORY-FLUID"
	string "url"

config PK_DEBUG_MEMORY_FLUID_GITHUB
	string "GitHub"

config PK_DEBUG_MEMORY_FLUID_SRCFILE
	default "main.c Makefile RunBiscuitOS.sh"
	string "Source code list"

config PK_DEBUG_MEMORY_FLUID_CSRCFILE
	string "Compile source code list"

config PK_DEBUG_MEMORY_FLUID_CONFIG
	string "CONFIG: Project Configure Options"

config PK_DEBUG_MEMORY_FLUID_LIBPATH
	string "LIBS: Libraries to pass to the linker, e.g. -l<library>"

config PK_DEBUG_MEMORY_FLUID_CPPFLAGS
	string "CPPFLAGS: C/C++ preprocessor flags, e.g. -I<include dir>"

config PK_DEBUG_MEMORY_FLUID_DPKCONFIG
	string "PKG_CONFIG_PATH: Directories to add to pkg-config's search path"

config PK_DEBUG_MEMORY_FLUID_CFLAGS
	string "CFLAGS: C compiler flags"

config PK_DEBUG_MEMORY_FLUID_LDFLAGS
	string "LDFLAGS: Linker flags"

config PK_DEBUG_MEMORY_FLUID_CXXFLAGS
	string "CXXFLAGS: C++ compiler flags"

config PK_DEBUG_MEMORY_FLUID_ASFLAGS
	string "CCASFLAGS: assembler compiler flags (defaults to CFLAGS)"

config PK_DEBUG_MEMORY_FLUID_BUILDARCH
	string "--host options on configure for Architecture"

endif # PK_DEBUG_MEMORY_FLUID
```

## package/BiscuitOS-debug-stub/BiscuitOS-debug-stub-Kernel/Kconfig
```kconfig
menuconfig PK_DEBUG_STUB_KERNEL
	bool "BiscuitOS Kernel Debug Stub"

if PK_DEBUG_STUB_KERNEL

config PK_DEBUG_STUB_KERNEL_VERSION
	default "default"
	string "verstion"

config PK_DEBUG_STUB_KERNEL_TAR
	default "tar.gz"
	string "tar type"

config PK_DEBUG_STUB_KERNEL_URL
	default "https://gitee.com/BiscuitOS_team/HardStack/raw/Gitee/Debug-Stub/BiscuitOS-debug-stub-Kernel"
	string "url"

config PK_DEBUG_STUB_KERNEL_GITHUB
	string "GitHub"

config PK_DEBUG_STUB_KERNEL_SRCFILE
	default "BiscuitOS-stub.c BiscuitOS-stub.h README.md"
	string "Source code list"

config PK_DEBUG_STUB_KERNEL_CSRCFILE
	string "Compile source code list"

config PK_DEBUG_STUB_KERNEL_CONFIG
	string "CONFIG: Project Configure Options"

config PK_DEBUG_STUB_KERNEL_LIBPATH
	string "LIBS: Libraries to pass to the linker, e.g. -l<library>"

config PK_DEBUG_STUB_KERNEL_CPPFLAGS
	string "CPPFLAGS: C/C++ preprocessor flags, e.g. -I<include dir>"

config PK_DEBUG_STUB_KERNEL_DPKCONFIG
	string "PKG_CONFIG_PATH: Directories to add to pkg-config's search path"

config PK_DEBUG_STUB_KERNEL_CFLAGS
	string "CFLAGS: C compiler flags"

config PK_DEBUG_STUB_KERNEL_LDFLAGS
	string "LDFLAGS: Linker flags"

config PK_DEBUG_STUB_KERNEL_CXXFLAGS
	string "CXXFLAGS: C++ compiler flags"

config PK_DEBUG_STUB_KERNEL_ASFLAGS
	string "CCASFLAGS: assembler compiler flags (defaults to CFLAGS)"

config PK_DEBUG_STUB_KERNEL_BUILDARCH
	string "--host options on configure for Architecture"

endif # PK_DEBUG_STUB_KERNEL
```

## package/BiscuitOS-debug-stub/BiscuitOS-debug-stub-QEMU/Kconfig
```kconfig
menuconfig PK_DEBUG_STUB_QEMU
	bool "BiscuitOS QEMU Debug Stub"

if PK_DEBUG_STUB_QEMU

config PK_DEBUG_STUB_QEMU_VERSION
	default "default"
	string "verstion"

config PK_DEBUG_STUB_QEMU_TAR
	default "tar.gz"
	string "tar type"

config PK_DEBUG_STUB_QEMU_URL
	default "https://gitee.com/BiscuitOS_team/HardStack/raw/Gitee/Debug-Stub/BiscuitOS-debug-stub-QEMU"
	string "url"

config PK_DEBUG_STUB_QEMU_GITHUB
	string "GitHub"

config PK_DEBUG_STUB_QEMU_SRCFILE
	default "BiscuitOS-stub.c BiscuitOS-stub.h README.md"
	string "Source code list"

config PK_DEBUG_STUB_QEMU_CSRCFILE
	string "Compile source code list"

config PK_DEBUG_STUB_QEMU_CONFIG
	string "CONFIG: Project Configure Options"

config PK_DEBUG_STUB_QEMU_LIBPATH
	string "LIBS: Libraries to pass to the linker, e.g. -l<library>"

config PK_DEBUG_STUB_QEMU_CPPFLAGS
	string "CPPFLAGS: C/C++ preprocessor flags, e.g. -I<include dir>"

config PK_DEBUG_STUB_QEMU_DPKCONFIG
	string "PKG_CONFIG_PATH: Directories to add to pkg-config's search path"

config PK_DEBUG_STUB_QEMU_CFLAGS
	string "CFLAGS: C compiler flags"

config PK_DEBUG_STUB_QEMU_LDFLAGS
	string "LDFLAGS: Linker flags"

config PK_DEBUG_STUB_QEMU_CXXFLAGS
	string "CXXFLAGS: C++ compiler flags"

config PK_DEBUG_STUB_QEMU_ASFLAGS
	string "CCASFLAGS: assembler compiler flags (defaults to CFLAGS)"

config PK_DEBUG_STUB_QEMU_BUILDARCH
	string "--host options on configure for Architecture"

endif # PK_DEBUG_STUB_QEMU
```

## package/BiscuitOS-debug-stub/Kconfig
```kconfig
menuconfig PK_BISCUITOS_DEBUG
	bool "BiscuitOS Debug Stub Set"

if PK_BISCUITOS_DEBUG

# BiscuitOS QEMU debug stub
source package/BiscuitOS-debug-stub/BiscuitOS-debug-stub-QEMU/Kconfig

# BiscuitOS QEMU debug Kernel
source package/BiscuitOS-debug-stub/BiscuitOS-debug-stub-Kernel/Kconfig

# BiscuitOS MEMORY FLUID
source package/BiscuitOS-debug-stub/BiscuitOS-MEMORY-FLUID/Kconfig

# BiscuitOS MEMORY FLUID KERNEL
source package/BiscuitOS-debug-stub/BiscuitOS-MEMORY-FLUID-KERNEL/Kconfig

endif # PK_BISCUITOS_DEBUG
```

## package/BiscuitOS-demo/BiscuitOS-Platform/Kconfig
```kconfig
menuconfig PK_PLATFORM_DEMO
	bool "Platform Device Driver Demo"

if PK_PLATFORM_DEMO

config PK_PLATFORM_DEMO_VERSION
	default "default"
	string "verstion"

config PK_PLATFORM_DEMO_TAR
	default "tar.gz"
	string "tar type"

config PK_PLATFORM_DEMO_URL
	default "https://gitee.com/BiscuitOS_team/HardStack/raw/Gitee/Demo/BiscuitOS-Platform"
	string "url"

config PK_PLATFORM_DEMO_GITHUB
	string "GitHub"

config PK_PLATFORM_DEMO_SRCFILE
	default "main.c Kconfig Makefile RunBiscuitOS.sh Makefile.host"
	string "Source code list"

config PK_PLATFORM_DEMO_CSRCFILE
	string "Compile source code list"

config PK_PLATFORM_DEMO_CONFIG
	string "CONFIG: Project Configure Options"

config PK_PLATFORM_DEMO_LIBPATH
	string "LIBS: Libraries to pass to the linker, e.g. -l<library>"

config PK_PLATFORM_DEMO_CPPFLAGS
	string "CPPFLAGS: C/C++ preprocessor flags, e.g. -I<include dir>"

config PK_PLATFORM_DEMO_DPKCONFIG
	string "PKG_CONFIG_PATH: Directories to add to pkg-config's search path"

config PK_PLATFORM_DEMO_CFLAGS
	string "CFLAGS: C compiler flags"

config PK_PLATFORM_DEMO_LDFLAGS
	string "LDFLAGS: Linker flags"

config PK_PLATFORM_DEMO_CXXFLAGS
	string "CXXFLAGS: C++ compiler flags"

config PK_PLATFORM_DEMO_ASFLAGS
	string "CCASFLAGS: assembler compiler flags (defaults to CFLAGS)"

config PK_PLATFORM_DEMO_BUILDARCH
	string "--host options on configure for Architecture"

endif # PK_PLATFORM_DEMO
```

## package/BiscuitOS-demo/BiscuitOS-kernel-any/Kconfig
```kconfig
menuconfig PK_KERNEL_ANY_DEMO
	bool "Kernel Anywhere Demo Code on BiscuitOS"

if PK_KERNEL_ANY_DEMO

config PK_KERNEL_ANY_DEMO_VERSION
	default "default"
	string "verstion"

config PK_KERNEL_ANY_DEMO_TAR
	default "tar.gz"
	string "tar type"

config PK_KERNEL_ANY_DEMO_URL
	default "https://gitee.com/BiscuitOS_team/HardStack/raw/Gitee/Demo/kernel-any"
	string "url"

config PK_KERNEL_ANY_DEMO_GITHUB
	string "GitHub"

config PK_KERNEL_ANY_DEMO_SRCFILE
	default "main.c Kconfig Makefile BiscuitOS_Insert.bs"
	string "Source code list"

config PK_KERNEL_ANY_DEMO_CSRCFILE
	string "Compile source code list"

config PK_KERNEL_ANY_DEMO_CONFIG
	string "CONFIG: Project Configure Options"

config PK_KERNEL_ANY_DEMO_LIBPATH
	string "LIBS: Libraries to pass to the linker, e.g. -l<library>"

config PK_KERNEL_ANY_DEMO_CPPFLAGS
	string "CPPFLAGS: C/C++ preprocessor flags, e.g. -I<include dir>"

config PK_KERNEL_ANY_DEMO_DPKCONFIG
	string "PKG_CONFIG_PATH: Directories to add to pkg-config's search path"

config PK_KERNEL_ANY_DEMO_CFLAGS
	string "CFLAGS: C compiler flags"

config PK_KERNEL_ANY_DEMO_LDFLAGS
	string "LDFLAGS: Linker flags"

config PK_KERNEL_ANY_DEMO_CXXFLAGS
	string "CXXFLAGS: C++ compiler flags"

config PK_KERNEL_ANY_DEMO_ASFLAGS
	string "CCASFLAGS: assembler compiler flags (defaults to CFLAGS)"

config PK_KERNEL_ANY_DEMO_BUILDARCH
	string "--host options on configure for Architecture"

endif # PK_KERNEL_ANY_DEMO
```

## package/BiscuitOS-demo/BiscuitOS-modules-project/Kconfig
```kconfig
menuconfig PK_MODULES_PROJECT_DEMO
	bool "Module Project Demo on BiscuitOS"

if PK_MODULES_PROJECT_DEMO

config PK_MODULES_PROJECT_DEMO_VERSION
	default "0.0.1"
	string "verstion"

config PK_MODULES_PROJECT_DEMO_TAR
	default "tar.gz"
	string "tar type"

config PK_MODULES_PROJECT_DEMO_URL
	default "https://gitee.com/BiscuitOS_team/HardStack/raw/Gitee/Demo/modules-project"
	string "url"

config PK_MODULES_PROJECT_DEMO_GITHUB
	string "GitHub"

config PK_MODULES_PROJECT_DEMO_SRCFILE
	default "main.c Kconfig Makefile include/linux/demo.h src/demo.c"
	string "Source code list"

config PK_MODULES_PROJECT_DEMO_CSRCFILE
	string "Compile source code list"

config PK_MODULES_PROJECT_DEMO_CONFIG
	string "CONFIG: Project Configure Options"

config PK_MODULES_PROJECT_DEMO_LIBPATH
	string "LIBS: Libraries to pass to the linker, e.g. -l<library>"

config PK_MODULES_PROJECT_DEMO_CPPFLAGS
	string "CPPFLAGS: C/C++ preprocessor flags, e.g. -I<include dir>"

config PK_MODULES_PROJECT_DEMO_DPKCONFIG
	string "PKG_CONFIG_PATH: Directories to add to pkg-config's search path"

config PK_MODULES_PROJECT_DEMO_CFLAGS
	string "CFLAGS: C compiler flags"

config PK_MODULES_PROJECT_DEMO_LDFLAGS
	string "LDFLAGS: Linker flags"

config PK_MODULES_PROJECT_DEMO_CXXFLAGS
	string "CXXFLAGS: C++ compiler flags"

config PK_MODULES_PROJECT_DEMO_ASFLAGS
	string "CCASFLAGS: assembler compiler flags (defaults to CFLAGS)"

config PK_MODULES_PROJECT_DEMO_BUILDARCH
	string "--host options on configure for Architecture"

endif # PK_MODULES_PROJECT_DEMO
```

## package/BiscuitOS-demo/BiscuitOS-modules/Kconfig
```kconfig
menuconfig PK_MODULES_DEMO
	bool "Module Demo Code on BiscuitOS"

if PK_MODULES_DEMO

config PK_MODULES_DEMO_VERSION
	default "default"
	string "verstion"

config PK_MODULES_DEMO_TAR
	default "tar.gz"
	string "tar type"

config PK_MODULES_DEMO_URL
	default "https://gitee.com/BiscuitOS_team/HardStack/raw/Gitee/Demo/modules"
	string "url"

config PK_MODULES_DEMO_GITHUB
	string "GitHub"

config PK_MODULES_DEMO_SRCFILE
	default "main.c Kconfig Makefile"
	string "Source code list"

config PK_MODULES_DEMO_CSRCFILE
	string "Compile source code list"

config PK_MODULES_DEMO_CONFIG
	string "CONFIG: Project Configure Options"

config PK_MODULES_DEMO_LIBPATH
	string "LIBS: Libraries to pass to the linker, e.g. -l<library>"

config PK_MODULES_DEMO_CPPFLAGS
	string "CPPFLAGS: C/C++ preprocessor flags, e.g. -I<include dir>"

config PK_MODULES_DEMO_DPKCONFIG
	string "PKG_CONFIG_PATH: Directories to add to pkg-config's search path"

config PK_MODULES_DEMO_CFLAGS
	string "CFLAGS: C compiler flags"

config PK_MODULES_DEMO_LDFLAGS
	string "LDFLAGS: Linker flags"

config PK_MODULES_DEMO_CXXFLAGS
	string "CXXFLAGS: C++ compiler flags"

config PK_MODULES_DEMO_ASFLAGS
	string "CCASFLAGS: assembler compiler flags (defaults to CFLAGS)"

config PK_MODULES_DEMO_BUILDARCH
	string "--host options on configure for Architecture"

endif # PK_MODULES_DEMO
```

## package/BiscuitOS-demo/Kconfig
```kconfig
menuconfig PK_BISCUITOS_DEMO
	bool "BiscuitOS Demo Code"

if PK_BISCUITOS_DEMO

# Kernel Demo 
source package/BiscuitOS-demo/BiscuitOS-kernel/Kconfig

# Modules Demo 
source package/BiscuitOS-demo/BiscuitOS-modules/Kconfig

# Modules Project Demo 
source package/BiscuitOS-demo/BiscuitOS-modules-project/Kconfig

# Application Demo 
source package/BiscuitOS-demo/BiscuitOS-Application/Kconfig

# Application Project Demo 
source package/BiscuitOS-demo/BiscuitOS-Application-project/Kconfig

# Char-DD Demo
source package/BiscuitOS-demo/BiscuitOS-Char/Kconfig

# Char-DD Application Demo
source package/BiscuitOS-demo/BiscuitOS-Char-Application/Kconfig

# MISC-DD Demo
source package/BiscuitOS-demo/BiscuitOS-MISC/Kconfig

# MISC-DD Application Demo
source package/BiscuitOS-demo/BiscuitOS-MISC-Application/Kconfig

endif # PK_BISCUITOS_DEMO
```
