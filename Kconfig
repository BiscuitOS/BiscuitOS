## Kconfig
```kconfig
#
# For a description of the syntax of this configuration file,
#
mainmenu "Buildroot for BiscuitOS Configuration"

config MAIN_PROJ_NAME
	string "Porject Name"
	default "BiscuitOS"
	help
	  Must be indicated project name.

# Architecture
source arch/Kconfig

# Board
source board/Kconfig

# Bootloader
source boot/Kconfig

# Package
source package/Kconfig

# Filesystem
source fs/Kconfig

# Toolchain
source toolchain/Kconfig

# Kernel
source kernel/linux/Kconfig

# XV6
source kernel/xv6/Kconfig

# Apollo
source kernel/Apollo/Kconfig
```

## arch/Kconfig
```kconfig
menu "Architecture configure"

choice
	prompt "Setup Machine Architecture"

config x86
	bool "Intel x86 board (Compat: i386,486 etc)"

config ARM
	bool "ARM 32-bit"

config ARM64
	bool "ARM 64-bit"

config RISCV32
	bool "RISC-V 32-bit"

config RISCV64
	bool "RISC-V 64-bit"

config X86_64
	bool "X86_84 (AMD)"

endchoice

config ARCH_MAGIC
	string
	default "1" if x86
	default "2" if ARM
	default "3" if ARM64
	default "4" if RISCV32
	default "5" if RISCV64
	default "6" if X86_64

endmenu
```

## board/BiscuitOS/Kconfig
```kconfig
menuconfig SUPPORT_DIY
	bool "DIY BiscuitOS/Broiler Hardware"

if SUPPORT_DIY

config DIY_MEMORY
	int "Memory Size(MiB)"
	default "512"

config DIY_MEMORY_SLOTS
	int "Memory Slots"
	default 0

config DIY_MEMORY_MAX
	int "Memory MAX Size(Gig)"
	default 8

config DIY_ROOTFS_SIZE
	int "Rootfs Size(MiB)"
	default "300"

config DIY_CPU_NUMBER
	int "CPU Number"
	default 2

config DIY_CMDLINE
	string "CMDLINE on Kernel"

config DIY_DEMSG_LOGLEVEL
	int "Demsg Loglevel(0-8)"
	default "8"

config DIY_NUMA
	bool "Support NUMA Topology"
        select PK_NUMA
	default N

config DIY_CPU_SOCKET
	int "CPU Socket Number(Default None)"
	default 0

config DIY_CPU_I440FX
	bool "Intel i440FX"

config DIY_CPU_Q35
	bool "Intel Q35"

if DIY_CPU_Q35

config DIY_VIOMMU
	bool "vIOMMU"
	default N

endif

config PK_BISCUITOS_CPU_HOST
	select PK_KVM
	bool "Support Host CPU Feature Passthrough"

config PK_BISCUITOS_HARDWARE
        select PK_KVM
        select PK_BROILER
        bool "Support BiscuitOS Hardware Emulate"

config HW_AUTO_PK
	bool

config HW_PCI_BAR
	select HW_AUTO_PK
	select PK_PCI
	select PK_PCI_QEMU_DEV_BAR
	select PK_BROILER_PCI_DD
	bool "BiscuitOS PCI/PCIe IO-BAR and MMIO-BAR"

config HW_PCI_INTX
	select HW_AUTO_PK
	select PK_PCI
	select PK_PCI_QEMU_DEV_INTX
	select PK_BROILER_PCI_INTX
	bool "BiscuitOS PCI/PCIe with INTX Interrupt"

config HW_PCI_MSI
	select HW_AUTO_PK
	select PK_PCI
	select PK_PCI_QEMU_DEV_MSI
	select PK_BROILER_PCI_MSI
	bool "BiscuitOS PCI/PCIe with MSI Interrupt"

config HW_PCI_MSIX
	select HW_AUTO_PK
	select PK_PCI
	select PK_PCI_QEMU_DEV_MSIX
	select PK_BROILER_PCI_MSIX
	bool "BiscuitOS PCI/PCIe with MSIX Interrupt"

config HW_PCI_DMA_INTX
	select HW_AUTO_PK
	select PK_PCI
	select PK_BROILER_DMA_INTX
	select PK_PCI_DMA_QEMU_DEV_INTX
	bool "BiscuitOS PCI/PCIe DMA with INTX Interrupt"

config HW_PCI_DMA_MSI
	select HW_AUTO_PK
	select PK_PCI
	select PK_BROILER_DMA_MSI
	select PK_PCI_DMA_QEMU_DEV_MSI
	bool "BiscuitOS PCI/PCIe DMA with MSI Interrupt"

config HW_PCI_DMA_MSIX
	select HW_AUTO_PK
	select PK_PCI
	select PK_BROILER_DMA_MSIX
	select PK_PCI_DMA_QEMU_DEV_MSIX
	bool "BiscuitOS PCI/PCIe DMA with MSIX Interrupt"

config HW_DMA_BUF
	select HW_AUTO_PK
	select PK_PCI
	select PK_DMA
	select PK_DMA_DMABUF_QEMU_DEVICE
	select PK_PCI_DMABUF_QEMU_DEV
	bool "BiscuitOS PCI/PCIe DMA-BUF"

config HW_CXL_GPU
	select HW_AUTO_PK
	select PK_PCI
	select PK_DMA
	bool "CXL SHMEM GPU Device"

config HW_CXL
	select DIY_CPU_Q35
	select QEMU_CXL
	bool "CXL: Compute Express Link"

if HW_CXL

choice

	prompt "CXL Hardware Topology"

config HW_CXL_TPG_TYPE0
	bool "CXL DirectEP: x1 Type3 PMEM"

config HW_CXL_TPG_TYPE1
	bool "CXL DirectEP: x1 Type3 DDR"

config HW_CXL_TPG_TYPE2
	bool "CXL2.0: x1 VCS + x1 Type3 PMEM"

config HW_CXL_TPG_TYPE3
	bool "CXL2.0: x1 VCS + x1 Type DDR"

config HW_CXL_TPG_TYPE4
	bool "CXL2.0: x1 VCS + x4 Type3 DDR"

config HW_CXL_TPG_TYPE5
	bool "CXL2.0: x1 VCS + x4 Type3 PMEM"

config HW_CXL_TPG_TYPE6
	bool "CXL2.0: x2 VCS + x4 Type3 DDR(PerVCS)"

config HW_CXL_TPG_TYPE7
	bool "CXL2.0: x2 Host(VH) + SLD"

config HW_CXL_TPG_TYPE8
	bool "CXL2.0: x2 Host(VH) + MLD"

config HW_CXL_TPG_TYPE9
	bool "CXL2.0: x2 Host(VH) + MH-SLD"

config HW_CXL_TPG_TYPEA
	bool "CXL2.0: x2 Host(VH) + MH-MLD"

endchoice

config HW_CXL_TPG_NR
	int
	default 0 if HW_CXL_TPG_TYPE0
	default 1 if HW_CXL_TPG_TYPE1
	default 2 if HW_CXL_TPG_TYPE2
	default 3 if HW_CXL_TPG_TYPE3
	default 4 if HW_CXL_TPG_TYPE4
	default 5 if HW_CXL_TPG_TYPE5
	default 6 if HW_CXL_TPG_TYPE6
	default 7 if HW_CXL_TPG_TYPE7
	default 8 if HW_CXL_TPG_TYPE8
	default 9 if HW_CXL_TPG_TYPE9
	default 10 if HW_CXL_TPG_TYPEA
	default 100

endif # CXL TOPOLOGY

##
# NUMA DIY
config HW_NUMA
	bool "NUMA(Non-uniform Memory Access)"

if HW_NUMA

choice
	prompt "NUMA Hardware Topology"

config HW_NUMA_TPG_TYPE0
	bool "UMA(Uniform Memory Access) with FSB(Pentium 4)"

config HW_NUMA_TPG_TYPE1
	select DIY_CPU_Q35
	bool "x2 Socket NUMA NODE with QPI(Xeon E5-2600 LCC)"

config HW_NUMA_TPG_TYPE2
	select DIY_CPU_Q35
	bool "x2 Socket NUMA NODE with RingBus(Xeon E5-2600 HCC)"

config HW_NUMA_TPG_TYPE3
	select DIY_CPU_Q35
	bool "x2 SNC NUMA NODE with Mesh(Xeon Skylake-SP)"

config HW_NUMA_TPG_TYPE4
	select DIY_CPU_Q35
	bool "x2 SNC + x2 Socket NUMA NODE with UPI(Xeon Skylake-SP)"

config HW_NUMA_TPG_TYPE5
	select DIY_CPU_Q35
	bool "x2 Socket NUMA with PCIe"

config HW_NUMA_TPG_TYPE6
	select DIY_CPU_Q35
	bool "x2 SNC with CPUless NUMA NODE"

endchoice

config HW_NUMA_TPG_NR
	int
	default 0 if HW_NUMA_TPG_TYPE0
	default 1 if HW_NUMA_TPG_TYPE1
	default 2 if HW_NUMA_TPG_TYPE2
	default 3 if HW_NUMA_TPG_TYPE3
	default 4 if HW_NUMA_TPG_TYPE4
	default 5 if HW_NUMA_TPG_TYPE5
	default 6 if HW_NUMA_TPG_TYPE6
	default 100

endif # HW_NUMA

config HW_NUMA_HMAT
	bool "HMAT NUMA Latency AND Bandwidth"

## END NUMA

## PMEM
config HW_PMEM
	select DIY_CPU_Q35
	bool "PMEM: Persistent Memory(NVDIMMs)"

config VIRTIO_BLK_MINIX
	bool "Virtio-BLK: MINIX Filesystem Disk"

config VIRTIO_BLK_EXT4
	bool "Virtio-BLK: EXT4 Filesystem Disk"

config VIRTIO_BLK_EXT3
	bool "Virtio-BLK: EXT3 Filesystem Disk"

config VIRTIO_BLK_EXT2
	bool "Virtio-BLK: EXT2 Filesystem Disk"

config VIRTIO_BLK_VFAT
	bool "Virtio-BLK: VFAT Filesystem Disk"

config VIRTIO_BLK_MSDOS
	bool "Virtio-BLK: MSDOS Filesystem Disk"

config VIRTIO_BLK_FAT
	bool "Virtio-BLK: FAT Filesystem Disk"

config VIRTIO_BLK_CRAMFS
	bool "Virtio-BLK: CRAMFS Filesystem Disk"

config VIRTIO_BLK_BFS
	bool "Virtio-BLK: BFS Filesystem Disk"

config VIRTIO_BLK_JFFS2
	bool "Virtio-BLK: JFFS2 Filesystem Disk"

config VIRTIO_BLK_UBIFS
	bool "Virtio-BLK: UBIFS Filesystem Disk"

config VIRTIO_BLK_SQUASHFS
	bool "Virtio-BLK: SQUASHFS Filesystem Disk"

config VIRTIO_BLK_BTRFS
	bool "Virtio-BLK: BTRFS Filesystem Disk"

config VIRTIO_BLK_REISERFS
	bool "Virtio-BLK: REISERFS Filesystem Disk"

config VIRTIO_BLK_JFS
	bool "Virtio-BLK: JFS Filesystem Disk"

config VIRTIO_BLK_XFS
	bool "Virtio-BLK: XFS Filesystem Disk"

config VIRTIO_BLK_GFS2
	bool "Virtio-BLK: GFS2 Filesystem Disk"

config VIRTIO_BLK_F2FS
	bool "Virtio-BLK: F2FS Filesystem Disk"

config PSEUDO_TMPFS
	bool "Pseudo Filesystem: TMPFS"

config PSEUDO_HUGE_TMPFS
	bool "Pseudo Filesystem: Huge TMPFS"

config DIY_SWAP
	bool "Support SWAP Space on RAM"

config DIY_ZSWAP
	bool "Support ZSWAP Space"

endif # SUPPORT_BOARD_INDV
```

## board/Kconfig
```kconfig
menu "Board setup"

config SUPPORT_BOARD_INDV
	bool "Support individual Board scheme"
	help
	  On legacy board support dts scheme.

if SUPPORT_BOARD_INDV

config BOARD_NAME
	string "board name"
	default "GoingMerry"

source "board/dts/Kconfig"

endif # SUPPORT_BOARD_INDV

endmenu
```

## board/dts/Kconfig
```kconfig
menu "Device tree board"

config DTS_NAME
	string "dts name"
	default "GoingMerry.dts"

endmenu
```

## boot/Kconfig
```kconfig
menuconfig BOOTLOADER
	bool "Bootloaders"
	default n

if BOOTLOADER	

# SeaBIOS
source "boot/SeaBIOS/Kconfig"

# U-BOOT
source "boot/u-boot/Kconfig"

endif # BOOTLOADER
```

## boot/SeaBIOS/Kconfig
```kconfig
menuconfig BOOT_SEABIOS
	bool "SeaBIOS"
	help
	  SeaBIOS for Intel i386.

if BOOT_SEABIOS

config SEABIOS_VER
	string "SeaBIOS release version"
	default "rel-1.9.3"
	help
	  Version of SeaBIOS.

config COREBOOT_ON
	bool "SeaBIOS running on X86 architecture machine"
	default n
	help
	  SeaBIOS running on Real-hardware.

endif # BOOT_SEABIOS
```

## boot/u-boot/Kconfig
```kconfig
menuconfig UBOOT 
	bool "uboot"

if UBOOT

choice
	prompt "Setup uboot source code"

config UBOOT_GITHUB
	bool "uboot source code from Github"

config UBOOT_DL
	bool "uboot source code from External Package"

config UBOOT_WGET
	bool "uboot source code from Wget"

endchoice

if UBOOT_DL

config UBOOT_DL_NAME
	string "External uboot absolute path"

endif # UBOOT_DL

if UBOOT_WGET

config UBOOT_WGET_SITE
	string "uboot  wget site"
	default "ftp://ftp.denx.de/pub/u-boot/"

endif # UBOOT_WGET

if UBOOT_GITHUB

config UBOOT_GITHUB_SITE
	string "uboot  Github site"
	default "https://github.com/u-boot/u-boot.git"

endif # UBOOT_GITHUB

config UBOOT_VERSION
	string "uboot  verstion"

config UBOOT_SRC
	int 
	default 1 if UBOOT_GITHUB
	default 2 if UBOOT_DL
	default 3 if UBOOT_WGET

config UBOOT_TAR_TYPE
	string "uboot  source code tar type"

choice
	prompt "Choice CROSS compile"

config UBOOT_CROSS_GUNEABI
	bool "arm-linux-gnueabi"
	select TOOL_ARM_GNUEABI

config UBOOT_CROSS_GNUEABIHF
	bool "arm-linux-gnueabihf"
	select TOOL_ARM_GNUEABIHF

config UBOOT_CROSS_NONE_GNUEABI
	bool "arm-none-linux-gnueabi"
	select TOOL_ARM_NONE_GNUEABI 

endchoice

config UBOOT_CROSS_COMPILE
	string
	default "arm-linux-gnueabi" if UBOOT_CROSS_GUNEABI
	default "arm-linux-gnueabihf" if UBOOT_CROSS_GNUEABIHF
	default "arm-none-linux-gnueabi" if UBOOT_CROSS_NONE_GNUEABI

endif # PK_UBOOT_
```

## configs/Apollo-11_defconfig
```kconfig
CONFIG_MAIN_PROJ_NAME="Apollo-11"
CONFIG_x86=y
CONFIG_ARCH_MAGIC="1"
CONFIG_ROOTFS=y
CONFIG_FS_APOLLO=y
CONFIG_TOOLCHAIN=y
CONFIG_APOLLO=y
CONFIG_APOLLO_11=y
CONFIG_APOLLO_VERSION="Apollo-11"
CONFIG_APOLLO_GITHUB="https://github.com/chrislgarry/Apollo-11.git"
```

## configs/BiscuitOS-Desktop-GOKU_defconfig
```kconfig
CONFIG_MAIN_PROJ_NAME="BiscuitOS-Desktop-GOKU"
CONFIG_ARM=y
CONFIG_ARCH_MAGIC="2"
CONFIG_COMMON_UTILISE=y
CONFIG_PK_QEMU_SYSTEM=y
CONFIG_QEMU_SYSTEM_WGET=y
CONFIG_QEMU_SYSTEM_VERSION="3.1.0"
CONFIG_QEMU_SYSTEM_SRC=3
CONFIG_ROOTFS=y
CONFIG_FS_BISCUITOS_ONLY=y
CONFIG_ROOTFS_SIZE=4096
CONFIG_FREEZE_SIZE=512
CONFIG_TOOLCHAIN=y
CONFIG_TOOL_ARM_GNUEABI=y
CONFIG_TOOL_ARM_GNUEABI_WGET=y
CONFIG_TOOL_ARM_GNUEABI_SRC=2
CONFIG_ARM_GNUEABI_V7.4-2019.02=y
CONFIG_ARM_GNUEABI_FULL_NAME="7.4-2019.02/arm-linux-gnueabi/gcc-linaro-7.4.1-2019.02-x86_64_arm-linux-gnueabi.tar.xz"
CONFIG_ARM_GNUEABI_VERSION="v7.4-2019.02"
```

## configs/Debian-0.91_defconfig
```kconfig
CONFIG_MAIN_PROJ_NAME="Debian-0.91"
CONFIG_x86=y
CONFIG_ARCH_MAGIC="1"
CONFIG_ROOTFS=y
CONFIG_FS_DEBIAN_LEGACY=y
CONFIG_TOOLCHAIN=y
CONFIG_LINUX_KERNEL=y
CONFIG_LINUX_LEGACY=y
CONFIG_LINUX_KERNEL_VERSION="0.99.1"
CONFIG_LINUX_BUILD_HIST="Legacy"
CONFIG_LINUX_KERNEL_GITHUB=y
CONFIG_LINUX_KERNEL_GITHUB_SITE="https://github.com/BiscuitOS/Kernel.git"
CONFIG_LINUX_KERNEL_SRC=1
CONFIG_LINUX_KERNEL_TAR_TYPE="tar.gz"
```

## configs/Debian_Desktop_arm_defconfig
```kconfig
CONFIG_MAIN_PROJ_NAME="Debian_Desktop_arm"
CONFIG_ARM=y
CONFIG_ARCH_MAGIC="2"
CONFIG_COMMON_UTILISE=y
CONFIG_PK_QEMU_SYSTEM=y
CONFIG_QEMU_SYSTEM_WGET=y
CONFIG_QEMU_SYSTEM_VERSION="3.1.0"
CONFIG_QEMU_SYSTEM_SRC=3
CONFIG_ROOTFS=y
CONFIG_FS_BISCUITOS=y
CONFIG_ROOTFS_SIZE=4096
CONFIG_FREEZE_SIZE=512
CONFIG_TOOLCHAIN=y
CONFIG_TOOL_ARM_GNUEABI=y
CONFIG_TOOL_ARM_GNUEABI_WGET=y
CONFIG_TOOL_ARM_GNUEABI_SRC=2
CONFIG_ARM_GNUEABI_V7.4-2019.02=y
CONFIG_ARM_GNUEABI_FULL_NAME="7.4-2019.02/arm-linux-gnueabi/gcc-linaro-7.4.1-2019.02-x86_64_arm-linux-gnueabi.tar.xz"
CONFIG_ARM_GNUEABI_VERSION="v7.4-2019.02"
CONFIG_LINUX_KERNEL=y
CONFIG_LINUX_NEWEST=y
CONFIG_LINUX_KERNEL_VERSION="5.0"
CONFIG_LINUX_BUILD_HIST="Newest"
CONFIG_LINUX_KERNEL_WGET=y
CONFIG_LINUX_KERNEL_WGET_SITE="https://mirrors.edge.kernel.org/pub/linux/kernel/v5.x/"
CONFIG_LINUX_KERNEL_SRC=3
CONFIG_LINUX_KERNEL_TAR_TYPE="tar.xz"
CONFIG_LINUX_KERNEL_CROSS_GUNEABI=y
CONFIG_LINUX_KERNEL_CROSS_COMPILE="arm-linux-gnueabi"
```

## configs/MIT-xv6_rev11_defconfig
```kconfig
CONFIG_MAIN_PROJ_NAME="xv6-rev11"
CONFIG_x86=y
CONFIG_ARCH_MAGIC="1"
CONFIG_ROOTFS=y
CONFIG_FS_XV6=y
CONFIG_XV6=y
CONFIG_XV6_REV11=y
CONFIG_XV6_VERSION="xv6-rev11"
```

## configs/MIT-xv6_rev9_defconfig
```kconfig
CONFIG_MAIN_PROJ_NAME="xv6-rev9"
CONFIG_x86=y
CONFIG_ARCH_MAGIC="1"
CONFIG_ROOTFS=y
CONFIG_FS_XV6=y
CONFIG_TOOLCHAIN=y
CONFIG_XV6=y
CONFIG_XV6_REV9=y
CONFIG_XV6_VERSION="xv6-rev9"
```

## configs/RaspberryPi_4B_defconfig
```kconfig
CONFIG_MAIN_PROJ_NAME="RaspberryPi_4B"
CONFIG_ARM=y
CONFIG_ARCH_MAGIC="2"
CONFIG_BOOTLOADER=y
CONFIG_UBOOT=y
CONFIG_UBOOT_WGET=y
CONFIG_UBOOT_WGET_SITE="ftp://ftp.denx.de/pub/u-boot/"
CONFIG_UBOOT_VERSION="2019.01"
CONFIG_UBOOT_SRC=3
CONFIG_UBOOT_TAR_TYPE="tar.bz2"
CONFIG_UBOOT_CROSS_GUNEABI=y
CONFIG_UBOOT_CROSS_COMPILE="arm-linux-gnueabi"
CONFIG_COMMON_UTILISE=y
CONFIG_PK_BUSYBOX=y
CONFIG_BUSYBOX_WGET=y
CONFIG_BUSYBOX_VERSION="1.24.2"
CONFIG_BUSYBOX_SRC=3
CONFIG_PK_QEMU_SYSTEM=y
CONFIG_QEMU_SYSTEM_WGET=y
CONFIG_QEMU_SYSTEM_VERSION="3.1.0"
CONFIG_QEMU_SYSTEM_SRC=3
CONFIG_PK_RPI_4B_BOOTLOADER=y
CONFIG_PK_RPI_4B_BOOTLOADER_VERSION="1.0.0"
CONFIG_PK_RPI_4B_BOOTLOADER_TAR="tar.bz2"
CONFIG_PK_RPI_4B_BOOTLOADER_URL="https://raw.githubusercontent.com/BiscuitOS/PackageManage/master/package/"
CONFIG_PK_RPI_4B_BOOTLOADER_GITHUB=""
CONFIG_PK_RPI_4B_BOOTLOADER_SRCFILE="rpi-4b-bootloader.tar.bz2"
CONFIG_PK_RPI_4B_BOOTLOADER_CONFIG=""
CONFIG_PK_RPI_4B_BOOTLOADER_LIBPATH=""
CONFIG_PK_RPI_4B_BOOTLOADER_CPPFLAGS=""
CONFIG_PK_RPI_4B_BOOTLOADER_DPKCONFIG=""
CONFIG_PK_RPI_4B_BOOTLOADER_CFLAGS=""
CONFIG_PK_RPI_4B_BOOTLOADER_LDFLAGS=""
CONFIG_PK_RPI_4B_BOOTLOADER_CXXFLAGS=""
CONFIG_PK_RPI_4B_BOOTLOADER_ASFLAGS=""
CONFIG_PK_RPI_4B_BOOTLOADER_BUILDARCH="x86_64-unknown-linux-gnu"
CONFIG_ROOTFS=y
CONFIG_FS_EXT4=y
CONFIG_ROOTFS_SIZE=150
CONFIG_FREEZE_SIZE=512
CONFIG_TOOLCHAIN=y
CONFIG_TOOL_ARM_GNUEABI=y
CONFIG_TOOL_ARM_GNUEABI_WGET=y
CONFIG_TOOL_ARM_GNUEABI_SRC=2
CONFIG_ARM_GNUEABI_V7.4-2019.02=y
CONFIG_ARM_GNUEABI_FULL_NAME="7.4-2019.02/arm-linux-gnueabi/gcc-linaro-7.4.1-2019.02-x86_64_arm-linux-gnueabi.tar.xz"
CONFIG_ARM_GNUEABI_VERSION="v7.4-2019.02"
CONFIG_LINUX_KERNEL=y
CONFIG_LINUX_RPI=y
CONFIG_LINUX_KERNEL_VERSION="newest"
CONFIG_LINUX_BUILD_HIST="RPI"
CONFIG_LINUX_KERNEL_GITHUB=y
CONFIG_LINUX_KERNEL_GITHUB_SITE="https://github.com/raspberrypi/linux.git"
CONFIG_LINUX_KERNEL_SRC=1
CONFIG_LINUX_KERNEL_TAR_TYPE="tar.xz"
CONFIG_LINUX_KERNEL_CROSS_GUNEABI=y
CONFIG_LINUX_KERNEL_CROSS_COMPILE="arm-linux-gnueabi"
```

## configs/SerenityOS_defconfig
```kconfig
CONFIG_MAIN_PROJ_NAME="SerenityOS-on-BiscuitOS"
CONFIG_x86=y
CONFIG_ARCH_MAGIC="1"
CONFIG_COMMON_UTILISE=y
CONFIG_PK_CMAKE=y
CONFIG_PK_CMAKE_VERSION="3.16.0"
CONFIG_PK_CMAKE_TAR="tar.gz"
CONFIG_PK_CMAKE_URL="https://cmake.org/files/v3.16/"
CONFIG_PK_CMAKE_GITHUB=""
CONFIG_PK_CMAKE_SRCFILE=""
CONFIG_PK_CMAKE_CONFIG=""
CONFIG_PK_CMAKE_LIBPATH=""
CONFIG_PK_CMAKE_CPPFLAGS=""
CONFIG_PK_CMAKE_DPKCONFIG=""
CONFIG_PK_CMAKE_CFLAGS=""
CONFIG_PK_CMAKE_LDFLAGS=""
CONFIG_PK_CMAKE_CXXFLAGS=""
CONFIG_PK_CMAKE_ASFLAGS=""
CONFIG_PK_CMAKE_BUILDARCH="x86_64-unknown-linux-gnu"
CONFIG_PK_QEMU_SYSTEM=y
CONFIG_QEMU_SYSTEM_WGET=y
CONFIG_QEMU_SYSTEM_VERSION="6.0.0"
CONFIG_QEMU_SYSTEM_SRC=3
CONFIG_ROOTFS=y
CONFIG_FS_EXT4=y
CONFIG_ROOTFS_SIZE=150
CONFIG_FREEZE_SIZE=512
CONFIG_TOOLCHAIN=y
CONFIG_SERENITYOS=y
CONFIG_SERENITYOS_GITHUB="https://gitee.com/mirrors/Serenity.git"
```
