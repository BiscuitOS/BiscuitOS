## configs/defconfig
```kconfig
CONFIG_MAIN_PROJ_NAME="linux-0.11"
CONFIG_x86=y
CONFIG_ARCH_MAGIC="1"
CONFIG_SUPPORT_BOARD_INDV=y
CONFIG_BOARD_NAME="GoingMerry"
CONFIG_DTS_NAME="GoingMerry_linux_0.11.dts"
CONFIG_COMMON_UTILISE=y
CONFIG_PK_BINUTILS=y
CONFIG_PK_GCC=y
CONFIG_ROOTFS=y
CONFIG_FS_MINIX=y
CONFIG_LINUX_KERNEL=y
CONFIG_LINUX_LEGACY=y
CONFIG_LINUX_KERNEL_VERSION="0.11.3"
CONFIG_LINUX_BUILD_HIST="Legacy"
CONFIG_LINUX_KERNEL_GITHUB=y
CONFIG_LINUX_KERNEL_GITHUB_SITE="https://github.com/BiscuitOS/Kernel.git"
CONFIG_LINUX_KERNEL_SRC=1
CONFIG_LINUX_KERNEL_TAR_TYPE="tar.gz"
```

## configs/linux-1.0.1.1-ext2_defconfig
```kconfig
CONFIG_MAIN_PROJ_NAME="linux-1.0.1.1-ext2"
CONFIG_x86=y
CONFIG_ARCH_MAGIC="1"
CONFIG_SUPPORT_BOARD_INDV=y
CONFIG_BOARD_NAME="GoingMerry"
CONFIG_DTS_NAME="GoingMerry_linux_1.0.dts"
CONFIG_COMMON_UTILISE=y
CONFIG_PK_BINUTILS=y
CONFIG_ROOTFS=y
CONFIG_FS_EXT2=y
CONFIG_TOOLCHAIN=y
CONFIG_LINUX_KERNEL=y
CONFIG_LINUX_LEGACY=y
CONFIG_LINUX_KERNEL_VERSION="1.0.1.1"
CONFIG_LINUX_BUILD_HIST="Legacy"
CONFIG_LINUX_KERNEL_GITHUB=y
CONFIG_LINUX_KERNEL_GITHUB_SITE="https://github.com/BiscuitOS/Kernel.git"
CONFIG_LINUX_KERNEL_SRC=1
CONFIG_LINUX_KERNEL_TAR_TYPE="tar.gz"
```

## configs/linux-1.0.1.2_defconfig
```kconfig
CONFIG_MAIN_PROJ_NAME="linux-1.0.1.2-ext2"
CONFIG_x86=y
CONFIG_ARCH_MAGIC="1"
CONFIG_SUPPORT_BOARD_INDV=y
CONFIG_BOARD_NAME="GoingMerry"
CONFIG_DTS_NAME="GoingMerry_linux_1.0.dts"
CONFIG_BOOTLOADER=y
CONFIG_BOOT_SEABIOS=y
CONFIG_SEABIOS_VER="rel-1.9.3"
CONFIG_COMMON_UTILISE=y
CONFIG_PK_BINUTILS=y
CONFIG_ROOTFS=y
CONFIG_FS_EXT2=y
CONFIG_TOOLCHAIN=y
CONFIG_LINUX_KERNEL=y
CONFIG_LINUX_LEGACY=y
CONFIG_LINUX_KERNEL_VERSION="1.0.1.2"
CONFIG_LINUX_BUILD_HIST="Legacy"
CONFIG_LINUX_KERNEL_GITHUB=y
CONFIG_LINUX_KERNEL_GITHUB_SITE="https://github.com/BiscuitOS/Kernel.git"
CONFIG_LINUX_KERNEL_SRC=1
CONFIG_LINUX_KERNEL_TAR_TYPE="tar.gz"
```

## configs/linux-2.6.37-arm32_defconfig
```kconfig
CONFIG_MAIN_PROJ_NAME="linux-2.6.37_arm32"
CONFIG_ARM=y
CONFIG_ARCH_MAGIC="2"
CONFIG_COMMON_UTILISE=y
CONFIG_PK_BUSYBOX=y
CONFIG_BUSYBOX_WGET=y
CONFIG_BUSYBOX_VERSION="1.18.1"
CONFIG_BUSYBOX_SRC=3
CONFIG_PK_QEMU_SYSTEM=y
CONFIG_QEMU_SYSTEM_WGET=y
CONFIG_QEMU_SYSTEM_VERSION="3.1.0"
CONFIG_QEMU_SYSTEM_SRC=3
CONFIG_ROOTFS=y
CONFIG_FS_EXT4=y
CONFIG_TOOLCHAIN=y
CONFIG_TOOL_ARM_NONE_GNUEABI=y
CONFIG_ROOTFS_SIZE=150
CONFIG_FREEZE_SIZE=512
CONFIG_LINUX_KERNEL=y
CONFIG_LINUX_NEWEST=y
CONFIG_LINUX_KERNEL_VERSION="2.6.37"
CONFIG_LINUX_BUILD_HIST="Newest"
CONFIG_LINUX_KERNEL_WGET=y
CONFIG_LINUX_KERNEL_WGET_SITE="http://ftp.sjtu.edu.cn/sites/ftp.kernel.org/pub/linux/kernel/v2.6/"
CONFIG_LINUX_KERNEL_SRC=3
CONFIG_LINUX_KERNEL_TAR_TYPE="tar.xz"
CONFIG_LINUX_KERNEL_CROSS_GUNEABI=y
CONFIG_LINUX_KERNEL_CROSS_COMPILE="arm-linux-gnueabi"
```

## configs/linux-4.16.1-arm64_defconfig
```kconfig
CONFIG_MAIN_PROJ_NAME="linux-4.16.1-aarch"
CONFIG_ARM64=y
CONFIG_ARCH_MAGIC="3"
CONFIG_COMMON_UTILISE=y
CONFIG_PK_BUSYBOX=y
CONFIG_BUSYBOX_WGET=y
CONFIG_BUSYBOX_VERSION="1.24.2"
CONFIG_BUSYBOX_SRC=3
CONFIG_PK_QEMU_SYSTEM=y
CONFIG_QEMU_SYSTEM_WGET=y
CONFIG_QEMU_SYSTEM_VERSION="3.1.0"
CONFIG_QEMU_SYSTEM_SRC=3
CONFIG_ROOTFS=y
CONFIG_FS_EXT4=y
CONFIG_TOOLCHAIN=y
CONFIG_TOOL_AARCH64=y
CONFIG_TOOL_AARCH64_WGET=y
CONFIG_TOOL_AARCH64_SRC=2
CONFIG_AARCH64_V7.4-2019.02=y
CONFIG_AARCH64_FULL_NAME="7.4-2019.02/aarch64-linux-gnu/gcc-linaro-7.4.1-2019.02-x86_64_aarch64-linux-gnu.tar.xz"
CONFIG_AARCH64_VERSION="v7.4-2019.02"
CONFIG_LINUX_KERNEL=y
CONFIG_LINUX_NEWEST=y
CONFIG_LINUX_KERNEL_VERSION="4.16.1"
CONFIG_LINUX_BUILD_HIST="Newest"
CONFIG_LINUX_KERNEL_WGET=y
CONFIG_LINUX_KERNEL_WGET_SITE="https://mirrors.edge.kernel.org/pub/linux/kernel/v4.x/"
CONFIG_LINUX_KERNEL_SRC=3
CONFIG_LINUX_KERNEL_TAR_TYPE="tar.xz"
CONFIG_LINUX_KERNEL_CROSS_COMPILE="aarch64-linux-gnu"
```
