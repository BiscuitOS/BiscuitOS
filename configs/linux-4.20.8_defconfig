## depackage/Xorg/Kconfig
```kconfig
menuconfig PK_XORG
	select PK_EXPAT
	select PK_ZLIB
	select PK_LIBPNG
	select PK_OPENSSL
	select PK_XF86DRIPROTO
	select PK_XCMISCPROTO
	select PK_BIGREQSPROTO
	select PK_FONTSPROTO
	select PK_VIDEOPROTO
	select PK_RECORDPROTO
	select PK_SCRNSAVERPROTO
	select PK_RESOURCEPROTO
	select PK_LIBXKBFILE
	select PK_LIBXFONT
	select PK_LIBPCIACCESS
	select PK_LIBXINERAMA
	select PK_RENDERPROTO
	select PK_DAMAGEPROTO
	select PK_FIXESPROTO
	select PK_COMPOSITEPROTO
	select PK_XF86VIDMODEPROTO
	select PK_LIBXDMCP
	select PK_RANDRPROTO
	select PK_GLPROTO
	select PK_MESALIB
	select PK_DRI2PROTO
	select PK_PIXMAN
	select PK_LIBXPROTO
	select PK_LIBXTRANS
	select PK_LIBKBPROTO
	select PK_LIBINPUTPROTO
	select PK_LIBXCB_PROTO
	select PK_LIBXAU
	select PK_LIBPTHREAD_STUBS
	select PK_LIBXCB
	select PK_LIBXEXTPROTO
	select PK_LIBX11
	select X11R7_7 
	select PK_LIBFONTENC
	select PK_FREETYPE
	select PK_LIBXEXT
	select PK_XINERAMAPROTO
	select PK_PYTHON2_7
	select PK_LIBXML2
	select PK_LIBDRM
	bool "Xorg-server"

if PK_XORG

config XORG_VERSION
	default "1.12.2"
	string "verstion"

config XORG_TAR
	default "tar.gz"
	string "tar type"

config XORG_URL
	default "https://www.x.org/releases/X11R7.7/src/xserver/"
	string "url"

config XORG_SRC
	string "source code list"

config XORG_LDFLAGS
	string "LDFLAGS"

config XORG_CFLAGS
	string "CFLAGS"

config XORG_CONFIG
	string "configure"

endif # PK_XORG
```

## depackage/algo_23tree/Kconfig
```kconfig
menuconfig PK_ALGO_TREE23
	bool "Algo  2-3-tree"

if PK_ALGO_TREE23

config ALGO_TREE23_VERSION
	default "0.11"
	string "verstion"

config ALGO_TREE23_TAR
	string "tar type"

config ALGO_TREE23_URL
	default "https://raw.githubusercontent.com/BiscuitOS/HardStack/master/Algorithem/tree/2-3-tree/Basic"
	string "url"

config ALGO_TREE23_LDFLAGS
	string "LDFLAGS"

config ALGO_TREE23_CFLAGS
	string "CFLAGS"

config ALGO_TREE23_CONFIG
	string "configure"

config ALGO_TREE23_SRC
	default "Makefile README.md tree23.h tree23.c tree23_perform.c tree23_run.c"
	string "source code list"

config ALGO_TREE23_CSRC
	default "tree23.c tree23_run.c"
	string "Compile source code list"

endif # PK_ALGO_TREE23
```

## depackage/algo_bindlist/Kconfig
```kconfig
menuconfig PK_ALGO_BINDLIST
	bool "Algo  bind-list(list_head)"

if PK_ALGO_BINDLIST

config ALGO_BINDLIST_VERSION
	default "0.11"
	string "verstion"

config ALGO_BINDLIST_TAR
	string "tar type"

config ALGO_BINDLIST_URL
	default "https://raw.githubusercontent.com/BiscuitOS/HardStack/master/Algorithem/list/bindirect-list/Basic/"
	string "url"

config ALGO_BINDLIST_LDFLAGS
	string "LDFLAGS"

config ALGO_BINDLIST_CFLAGS
	string "CFLAGS"

config ALGO_BINDLIST_CONFIG
	string "configure"

config ALGO_BINDLIST_SRC
	default "Makefile list.h list_run.c"
	string "source code list"

endif # PK_ALGO_BINDLIST
```

## depackage/algo_bitmap/Kconfig
```kconfig
menuconfig PK_ALGO_BITMAP
	bool "Algo  Bitmap"

if PK_ALGO_BITMAP

config ALGO_BITMAP_VERSION
	default "0.11"
	string "verstion"

config ALGO_BITMAP_TAR
	string "tar type"

config ALGO_BITMAP_URL
	default "https://raw.githubusercontent.com/BiscuitOS/HardStack/master/Algorithem/bitmap/Basic/"
	string "url"

config ALGO_BITMAP_LDFLAGS
	string "LDFLAGS"

config ALGO_BITMAP_CFLAGS
	string "CFLAGS"

config ALGO_BITMAP_CONFIG
	string "configure"

config ALGO_BITMAP_SRC
	default "Makefile bitmap.c bitmap.h bitmap_run.c"
	string "source code list"

endif # PK_ALGO_BITMAP
```

## depackage/algo_rbtree/Kconfig
```kconfig
menuconfig PK_ALGO_RBTREE
	bool "Algo  rbtree"

if PK_ALGO_RBTREE

config ALGO_RBTREE_VERSION
	default "0.11"
	string "verstion"

config ALGO_RBTREE_TAR
	string "tar type"

config ALGO_RBTREE_URL
	default "https://raw.githubusercontent.com/BiscuitOS/HardStack/master/Algorithem/tree/rb-tree/Basic"
	string "url"

config ALGO_RBTREE_LDFLAGS
	string "LDFLAGS"

config ALGO_RBTREE_CFLAGS
	string "CFLAGS"

config ALGO_RBTREE_CONFIG
	string "configure"

config ALGO_RBTREE_SRC
	default "Makefile README.md rb_run.c rbtree.c rbtree.h"
	string "source code list"

config ALGO_RBTREE_CSRC
	default "rb_run.c rbtree.c"
	string "Compile source code list"

endif # PK_ALGO_RBTREE
```
