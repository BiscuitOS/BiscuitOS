## configs/linux-5.0-i386_defconfig
```kconfig
CONFIG_MAIN_PROJ_NAME="linux-5.0-i386"
CONFIG_x86=y
CONFIG_ARCH_MAGIC="1"
CONFIG_COMMON_UTILISE=y
CONFIG_PK_BUSYBOX=y
CONFIG_BUSYBOX_WGET=y
CONFIG_BUSYBOX_VERSION="1.24.2"
CONFIG_BUSYBOX_SRC=3
CONFIG_PK_QEMU_SYSTEM=y
CONFIG_QEMU_SYSTEM_WGET=y
CONFIG_QEMU_SYSTEM_VERSION="3.1.0"
CONFIG_QEMU_SYSTEM_SRC=3
CONFIG_ROOTFS=y
CONFIG_FS_EXT4=y
CONFIG_ROOTFS_SIZE=150
CONFIG_FREEZE_SIZE=512
CONFIG_LINUX_KERNEL=y
CONFIG_LINUX_NEWEST=y
CONFIG_LINUX_KERNEL_VERSION="5.0"
CONFIG_LINUX_BUILD_HIST="Newest"
CONFIG_LINUX_KERNEL_WGET=y
CONFIG_LINUX_KERNEL_WGET_SITE="http://ftp.sjtu.edu.cn/sites/ftp.kernel.org/pub/linux/kernel/v5.x/"
CONFIG_LINUX_KERNEL_SRC=3
CONFIG_LINUX_KERNEL_TAR_TYPE="tar.xz"
```

## configs/linux-5.3-riscv64_defconfig
```kconfig
CONFIG_MAIN_PROJ_NAME="linux-5.3-riscv64"
CONFIG_RISCV64=y
CONFIG_ARCH_MAGIC="5"
CONFIG_COMMON_UTILISE=y
CONFIG_PK_BUSYBOX=y
CONFIG_BUSYBOX_WGET=y
CONFIG_BUSYBOX_VERSION="1.24.2"
CONFIG_BUSYBOX_SRC=3
CONFIG_PK_QEMU_SYSTEM=y
CONFIG_QEMU_SYSTEM_WGET=y
CONFIG_QEMU_SYSTEM_VERSION="3.1.0"
CONFIG_QEMU_SYSTEM_SRC=3
CONFIG_PK_RISCV_PK=y
CONFIG_PK_RISCV_PK_VERSION="1.0.0"
CONFIG_PK_RISCV_PK_TAR="tar.gz"
CONFIG_PK_RISCV_PK_URL="https://raw.githubusercontent.com/BiscuitOS/PackageManage/master/package/"
CONFIG_PK_RISCV_PK_GITHUB="https://github.com/riscv/riscv-pk"
CONFIG_PK_RISCV_PK_SRCFILE=""
CONFIG_PK_RISCV_PK_CONFIG=""
CONFIG_PK_RISCV_PK_LIBPATH=""
CONFIG_PK_RISCV_PK_CPPFLAGS=""
CONFIG_PK_RISCV_PK_DPKCONFIG=""
CONFIG_PK_RISCV_PK_CFLAGS=""
CONFIG_PK_RISCV_PK_LDFLAGS=""
CONFIG_PK_RISCV_PK_CXXFLAGS=""
CONFIG_PK_RISCV_PK_ASFLAGS=""
CONFIG_PK_RISCV_PK_BUILDARCH="x86_64-unknown-linux-gnu"
CONFIG_ROOTFS=y
CONFIG_FS_EXT4=y
CONFIG_EXT4_RISCV="-riscv"
CONFIG_TOOLCHAIN=y
CONFIG_TOOL_RISCV64=y
CONFIG_TOOL_RISCV64_EXT=y
CONFIG_TOOL_RISCV64_WAY=4
CONFIG_TOOL_RISCV64_VERSION="9.2.0"
CONFIG_TOOL_RISCV64_TAR="xz"
CONFIG_LINUX_KERNEL=y
CONFIG_LINUX_NEWEST=y
CONFIG_LINUX_KERNEL_VERSION="5.3"
CONFIG_LINUX_BUILD_HIST="Newest"
CONFIG_LINUX_KERNEL_WGET=y
CONFIG_LINUX_KERNEL_WGET_SITE="http://ftp.sjtu.edu.cn/sites/ftp.kernel.org/pub/linux/kernel/v5.x/"
CONFIG_LINUX_KERNEL_SRC=3
CONFIG_LINUX_KERNEL_TAR_TYPE="tar.xz"
CONFIG_LINUX_KERNEL_CROSS_COMPILE="riscv64-biscuitos-linux-gnu"
```

## configs/linux-next-x86_64_defconfig
```kconfig
CONFIG_MAIN_PROJ_NAME="linux-next-x86_64"
CONFIG_X86_64=y
CONFIG_ARCH_MAGIC="6"
CONFIG_COMMON_UTILISE=y
CONFIG_PK_BUSYBOX=y
CONFIG_BUSYBOX_WGET=y
CONFIG_BUSYBOX_VERSION="1.24.2"
CONFIG_BUSYBOX_SRC=3
CONFIG_PK_QEMU_SYSTEM=y
CONFIG_QEMU_SYSTEM_WGET=y
CONFIG_QEMU_SYSTEM_VERSION="4.0.0"
CONFIG_QEMU_SYSTEM_SRC=3
CONFIG_ROOTFS=y
CONFIG_FS_EXT4=y
CONFIG_ROOTFS_SIZE=150
CONFIG_FREEZE_SIZE=512
CONFIG_LINUX_KERNEL=y
CONFIG_LINUX_NEWEST=y
CONFIG_LINUX_KERNEL_VERSION="next"
CONFIG_LINUX_BUILD_HIST="Newest"
CONFIG_LINUX_KERNEL_GITHUB=y
CONFIG_LINUX_KERNEL_GITHUB_SITE="https://git.kernel.org/pub/scm/linux/kernel/git/next/linux-next.git"
CONFIG_LINUX_KERNEL_SRC=1
CONFIG_LINUX_KERNEL_TAR_TYPE="tar.xz"
```

## configs/linux_0_11_defconfig
```kconfig
CONFIG_KERNEL=y
CONFIG_KERNEL_VERSION_0_1_1=y
CONFIG_COMMON_UTILISE=y
CONFIG_PACKAGE_GCC=y
CONFIG_HOST_DEBUG=y
```

## configs/linux_0_12_defconfig
```kconfig
CONFIG_I386=y
CONFIG_BOARD_NAME="GoingMerry"
CONFIG_DTS_NAME="GoingMerry_linux_0.12.dts"
CONFIG_BOOT_SEABIOS=y
CONFIG_SEABIOS_VER="rel-1.9.3"
CONFIG_KERNEL=y
CONFIG_KERNEL_VERSION_0_1_2=y
CONFIG_KERNEL_VERSION="0.12"
CONFIG_KERNEL_BD_TAG="v0.12.1"
CONFIG_KERNEL_MAGIC=1
CONFIG_COMMON_UTILISE=y
CONFIG_ROOTFS=y
CONFIG_FS_MINIX=y
CONFIG_FS_MAGIC=0
```

## configs/linux_0_95a_defconfig
```kconfig
CONFIG_I386=y
CONFIG_BOARD_NAME="GoingMerry"
CONFIG_DTS_NAME="GoingMerry_linux_0.95.dts"
CONFIG_BOOT_SEABIOS=y
CONFIG_SEABIOS_VER="rel-1.9.3"
CONFIG_KERNEL=y
CONFIG_KERNEL_VERSION_0_9_5A=y
CONFIG_KERNEL_VERSION="0.95a"
CONFIG_KERNEL_BD_TAG="v0.95a"
CONFIG_KERNEL_MAGIC=4
CONFIG_COMMON_UTILISE=y
CONFIG_ROOTFS=y
CONFIG_FS_MINIX=y
CONFIG_FS_MAGIC=0
```

## configs/linux_0_96_1_defconfig
```kconfig
CONFIG_KERNEL=y
CONFIG_KERNEL_VERSION_0_9_6_1=y
CONFIG_COMMON_UTILISE=y
CONFIG_HOST_DEBUG=y
```

## configs/linux_0_97_1_defconfig
```kconfig
CONFIG_I386=y
CONFIG_BOARD_NAME="GoingMerry"
CONFIG_DTS_NAME="GoingMerry_linux_0.97.dts"
CONFIG_BOOT_SEABIOS=y
CONFIG_SEABIOS_VER="rel-1.9.3"
CONFIG_KERNEL=y
CONFIG_KERNEL_VERSION_0_9_7_1=y
CONFIG_KERNEL_VERSION="0.97.1"
CONFIG_KERNEL_BD_TAG="v0.97.1"
CONFIG_KERNEL_MAGIC=6
CONFIG_COMMON_UTILISE=y
CONFIG_ROOTFS=y
CONFIG_FS_MINIX=y
CONFIG_FS_MAGIC=0
```

## configs/linux_0_98_1_defconfig
```kconfig
CONFIG_KERNEL=y
CONFIG_KERNEL_VERSION_0_9_8_1=y
CONFIG_COMMON_UTILISE=y
CONFIG_HOST_DEBUG=y
```

## configs/linux_0_99_1_defconfig
```kconfig
CONFIG_I386=y
CONFIG_BOARD_NAME="GoingMerry"
CONFIG_DTS_NAME="GoingMerry_linux_0.99.dts"
CONFIG_BOOT_SEABIOS=y
CONFIG_SEABIOS_VER="rel-1.9.3"
CONFIG_KERNEL=y
CONFIG_KERNEL_VERSION_0_9_9_1=y
CONFIG_KERNEL_VERSION="0.99.1"
CONFIG_KERNEL_BD_TAG="v0.99.1"
CONFIG_KERNEL_MAGIC=8
CONFIG_COMMON_UTILISE=y
CONFIG_ROOTFS=y
CONFIG_FS_MINIX=y
CONFIG_FS_MAGIC=0
```

## configs/linux_1_0_1_1_ext2_defconfig
```kconfig
CONFIG_KERNEL=y
CONFIG_KERNEL_VERSION_1_0_1_1=y
CONFIG_COMMON_UTILISE=y
CONFIG_FS_EXT2=y
CONFIG_HOST_DEBUG=y
```

## configs/linux_1_0_1_2_minix_defconfig
```kconfig
CONFIG_KERNEL=y
CONFIG_KERNEL_VERSION_1_0_1_2=y
CONFIG_COMMON_UTILISE=y
CONFIG_HOST_DEBUG=y
```

## configs/linux_1_0_1_defconfig
```kconfig
CONFIG_I386=y
CONFIG_BOARD_NAME="GoingMerry"
CONFIG_DTS_NAME="GoingMerry_linux_1.0.dts"
CONFIG_BOOT_SEABIOS=y
CONFIG_SEABIOS_VER="rel-1.9.3"
CONFIG_KERNEL=y
CONFIG_KERNEL_VERSION_1_0_1=y
CONFIG_KERNEL_VERSION="1.0.1"
CONFIG_KERNEL_BD_TAG="v1.0.1"
CONFIG_KERNEL_MAGIC=9
CONFIG_COMMON_UTILISE=y
CONFIG_ROOTFS=y
CONFIG_FS_MINIX=y
CONFIG_FS_MAGIC=0
```

## configs/u-boot-2020.01_defconfig
```kconfig
CONFIG_MAIN_PROJ_NAME="linux-5.0-arm32"
CONFIG_ARM=y
CONFIG_ARCH_MAGIC="2"
CONFIG_BOOTLOADER=y
CONFIG_UBOOT=y
CONFIG_UBOOT_WGET=y
CONFIG_UBOOT_WGET_SITE="ftp://ftp.denx.de/pub/u-boot/"
CONFIG_UBOOT_VERSION="2020.01"
CONFIG_UBOOT_SRC=3
CONFIG_UBOOT_TAR_TYPE="tar.bz2"
CONFIG_UBOOT_CROSS_GUNEABI=y
CONFIG_UBOOT_CROSS_COMPILE="arm-linux-gnueabi"
CONFIG_COMMON_UTILISE=y
CONFIG_PK_BUSYBOX=y
CONFIG_BUSYBOX_WGET=y
CONFIG_BUSYBOX_VERSION="1.24.2"
CONFIG_BUSYBOX_SRC=3
CONFIG_PK_QEMU_SYSTEM=y
CONFIG_QEMU_SYSTEM_WGET=y
CONFIG_QEMU_SYSTEM_VERSION="3.1.0"
CONFIG_QEMU_SYSTEM_SRC=3
CONFIG_ROOTFS=y
CONFIG_FS_EXT4=y
CONFIG_TOOLCHAIN=y
CONFIG_TOOL_ARM_GNUEABI=y
CONFIG_TOOL_ARM_GNUEABI_WGET=y
CONFIG_TOOL_ARM_GNUEABI_SRC=2
CONFIG_ARM_GNUEABI_V7.4-2019.02=y
CONFIG_ARM_GNUEABI_FULL_NAME="7.4-2019.02/arm-linux-gnueabi/gcc-linaro-7.4.1-2019.02-x86_64_arm-linux-gnueabi.tar.xz"
CONFIG_ARM_GNUEABI_VERSION="v7.4-2019.02"
CONFIG_LINUX_KERNEL=y
CONFIG_LINUX_NEWEST=y
CONFIG_LINUX_KERNEL_VERSION="5.0"
CONFIG_LINUX_BUILD_HIST="Newest"
CONFIG_LINUX_KERNEL_WGET=y
CONFIG_LINUX_KERNEL_WGET_SITE="http://ftp.sjtu.edu.cn/sites/ftp.kernel.org/pub/linux/kernel/v5.x/"
CONFIG_LINUX_KERNEL_SRC=3
CONFIG_LINUX_KERNEL_TAR_TYPE="tar.xz"
CONFIG_LINUX_KERNEL_CROSS_GUNEABI=y
CONFIG_LINUX_KERNEL_CROSS_COMPILE="arm-linux-gnueabi"
```

## depackage/DX/Kconfig
```kconfig
menuconfig PK_DX
	bool "DX"

if PK_DX

config PK_DX_VERSION
	default "8.42"
	string "verstion"

config PK_DX_TAR
	default "tar.gz"
	string "tar type"

config PK_DX_URL
	default "https://ftp.pcre.org/pub/pcre/"
	string "url"

config PK_DX_GITHUB
	string "GitHub"

config PK_DX_SRCFILE
	string "Source code list"

config PK_DX_CONFIG
	string "CONFIG: Project Configure Options"

config PK_DX_LIBPATH
	string "LIBS: Libraries to pass to the linker, e.g. -l<library>"

config PK_DX_CPPFLAGS
	string "CPPFLAGS: C/C++ preprocessor flags, e.g. -I<include dir>"

config PK_DX_DPKCONFIG
	string "PKG_CONFIG_PATH: Directories to add to pkg-config's search path"

config PK_DX_CFLAGS
	string "CFLAGS: C compiler flags"

config PK_DX_LDFLAGS
	string "LDFLAGS: Linker flags"

config PK_DX_CXXFLAGS
	string "CXXFLAGS: C++ compiler flags"

config PK_DX_ASFLAGS
	string "CCASFLAGS: assembler compiler flags (defaults to CFLAGS)"

endif # PK_DX
```

## depackage/DirectFB/Kconfig
```kconfig
menuconfig PK_DIRECTFB
	bool "DirectFB"

if PK_DIRECTFB

config DIRECTFB_VERSION
	default "1.7.4"
	string "verstion"

config DIRECTFB_TAR
	default "tar.gz"
	string "tar type"

config DIRECTFB_URL
	default "http://repository.timesys.com/buildsources/d/DirectFB/DirectFB-1.7.4/"
	string "url"

config DIRECTFB_SRC
	string "source code list"

config DIRECTFB_LDFLAGS
	string "LDFLAGS"

config DIRECTFB_CFLAGS
	string "CFLAGS"

config DIRECTFB_CONFIG
	default "--with-gfxdrivers=none"
	string "configure"

endif # PK_DIRECTFB
```

## depackage/Kconfig
```kconfig
#
# Package common configure
#
menuconfig COMMON_UTILISE
	bool "Package"
	help
	  binutilise

if COMMON_UTILISE

# Algorithm binary-tree
source package/algo_binarytree/Kconfig

# elfutils
source package/elfutils/Kconfig

# Demo Package
source package/Aproto/Kconfig

# expat
source package/expat/Kconfig

# DX
source package/DX/Kconfig

# Algorithm IDA
source package/algo_IDA/Kconfig

# Algorithm IDR
source package/algo_IDR/Kconfig

# binutils
config PK_BINUTILS
	bool "binutils"

# Algorithm bindlist
source package/algo_bindlist/Kconfig

# Algorithm bitmap
source package/algo_bitmap/Kconfig

# Algorithm 2-3-tree
source package/algo_23tree/Kconfig

# Algorithm radix-tree
source package/algo_radixtree/Kconfig

# Algorithm rb-tree
source package/algo_rbtree/Kconfig

# bigreqsproto
source package/bigreqsproto/Kconfig

# compositeproto
source package/compositeproto/Kconfig

# damageproto
source package/damageproto/Kconfig

# DirectFB
source package/DirectFB/Kconfig

# dri2proto
source package/dri2proto/Kconfig

# fixesproto
source package/fixesproto/Kconfig

# fontconfig
source package/fontconfig/Kconfig

# fontsproto
source package/fontsproto/Kconfig

# freetype
source package/freetype/Kconfig

# game-snake
source package/game_snake/Kconfig

# game-tetris
source package/game_tetris/Kconfig

# game-2048
source package/game_2048/Kconfig

# GNU-autoconf
source package/gnu_autoconf/Kconfig

# GNU-automake
source package/gnu_automake/Kconfig

# GNU-binutils
source package/gnu_binutils/Kconfig

# GNU-bison
source package/gnu_bison/Kconfig

# busybox
source package/busybox/Kconfig

# demo-application
source package/demo_app/Kconfig

# e2fsprogs
source package/e2fsprogs/Kconfig

# glproto
source package/glproto/Kconfig

# gobject-introspection
source package/gobject-introspection/Kconfig

# GNU-fdisk
source package/gnu_fdisk/Kconfig

# GNU-gawk
source package/gnu_gawk/Kconfig

# GNU-gdb
source package/gnu_gdb/Kconfig

# GNU-glibc
source package/gnu_glibc/Kconfig

# GNU-git
source package/gnu_git/Kconfig

# GNU-hello
source package/gnu_hello/Kconfig

config PK_GCC
	bool "GNU - legacy gcc"

# gtk
source package/gtk/Kconfig

# gdk-pixbuf
source package/gdk-pixbuf/Kconfig

# gtk: cairo
source package/gtk_cairo/Kconfig

# gtk: atk
source package/gtk_atk/Kconfig

# gtk: pango
source package/gtk_pango/Kconfig

# gtk-xfce-engine
source package/gtk-xfce-engine/Kconfig

# intltool
source package/intltool/Kconfig

# libdrm
source package/libdrm/Kconfig

# libffi
source package/libffi/Kconfig

# libfontenc
source package/libfontenc/Kconfig

# libjpeg
source package/libjpeg/Kconfig

# libpciaccess
source package/libpciaccess/Kconfig

# libpng
source package/libpng/Kconfig

# libpthread-stubs
source package/libpthread-stubs/Kconfig

# libtiff
source package/libtiff/Kconfig

# libtool
source package/libtool/Kconfig

# libuuid
source package/libuuid/Kconfig

# libxfce4ui
source package/libxfce4ui/Kconfig

# libxfce4util
source package/libxfce4util/Kconfig

# libxfont
source package/libxfont/Kconfig

# libXfixes
source package/libXfixes/Kconfig

# libxkbfile
source package/libxkbfile/Kconfig

# libxml2
source package/libxml2/Kconfig

# libXinerama
source package/libXinerama/Kconfig

# libXcomposite
source package/libXcomposite/Kconfig

# libXcursor
source package/libXcursor/Kconfig

# libXdamage
source package/libXdamage/Kconfig

# libXdmcp
source package/libXdmcp/Kconfig

# libXrender
source package/libXrender/Kconfig

# MesaLib
source package/MesaLib/Kconfig

# inputproto
source package/libinputproto/Kconfig

# openssl
source package/openssl/Kconfig

# pcre
source package/pcre/Kconfig

# pixman
source package/pixman/Kconfig

# Python2.7
source package/Python2.7/Kconfig

# kbproto
source package/libkbproto/Kconfig

# recordproto
source package/recordproto/Kconfig

# resourceproto
source package/resourceproto/Kconfig

# Xau
source package/libXau/Kconfig

# xcb
source package/libxcb/Kconfig

# xcb-proto
source package/libxcb-proto/Kconfig

# Xext
source package/libXext/Kconfig

# xextproto
source package/libxextproto/Kconfig

# xproto
source package/libxproto/Kconfig

# xtrans
source package/libxtrans/Kconfig

# libX11
source package/libX11/Kconfig

# gnome-glib
source package/gnome_glib/Kconfig

# GNU-ncurses
source package/gnu_ncurses/Kconfig

# GNU-parted
source package/gnu_parted/Kconfig

# GNU-screen
source package/gnu_screen/Kconfig

# GNU-sed
source package/gnu_sed/Kconfig

# qemu-system
source package/qemu/Kconfig

# qt
source package/qt/Kconfig

# randrproto
source package/randrproto/Kconfig

# renderproto
source package/renderproto/Kconfig

# scrnsaverproto
source package/scrnsaverproto/Kconfig

# videoproto
source package/videoproto/Kconfig

# xcmiscproto
source package/xcmiscproto/Kconfig

# xf86driproto
source package/xf86driproto/Kconfig

# Xfce
source package/Xfce/Kconfig

# xfce4-exo
source package/xfce4-exo/Kconfig

# xfce4-panel
source package/xfce4-panel/Kconfig

# xf86vidmodeproto
source package/xf86vidmodeproto/Kconfig

# xineramaproto
source package/xineramaproto/Kconfig

# Xorg-Server
source package/Xorg/Kconfig

# zlib
source package/zlib/Kconfig

endif
```

## depackage/MesaLib/Kconfig
```kconfig
menuconfig PK_MESALIB
	select PK_LIBDRM
	select PK_ZLIB
	select PK_EXPAT
	bool "Mesa"

if PK_MESALIB

config MESALIB_VERSION
	default "17.0.1"
	string "verstion"

config MESALIB_TAR
	default "tar.xz"
	string "tar type"

config MESALIB_URL
	default "http://repository.timesys.com/buildsources/m/Mesa/Mesa-17.0.1/"
	string "url"

config MESALIB_SRC
	string "source code list"

config MESALIB_LDFLAGS
	string "LDFLAGS"

config MESALIB_CFLAGS
	string "CFLAGS"

config MESALIB_CONFIG
	default "--enable-dri3=no --enable-gallium-llvm=no --disable-omx --enable-gallium-tests=no --enable-gallium-osmesa=no -enable-glx=dri --with-gallium-drivers=swrast --with-dri-drivers=swrast --disable-glx --enable-va=no --enable-vdpau=no --with-egl-platforms=drm"
	string "configure"

endif # PK_MESALIB
```

## depackage/Python2.7/Kconfig
```kconfig
menuconfig PK_PYTHON2_7
	bool "python2.7"

if PK_PYTHON2_7

config PYTHON2_7_VERSION
	default "2.7.13"
	string "verstion"

config PYTHON2_7_TAR
	default "tar.xz"
	string "tar type"

config PYTHON2_7_URL
	default "https://www.python.org/ftp/python/2.7.13/"
	string "url"

config PYTHON2_7_SRC
	string "source code list"

config PYTHON2_7_LDFLAGS
	string "LDFLAGS"

config PYTHON2_7_CFLAGS
	string "CFLAGS"

config PYTHON2_7_CONFIG
	default "--build=x86_64-linux-gnu --enable-ipv6 --enable-shared ac_cv_file__dev_ptmx=yes ac_cv_file__dev_ptc=no"
	string "configure"

endif # PK_PYTHON2_7
```
