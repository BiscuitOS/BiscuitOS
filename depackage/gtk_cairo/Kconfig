## depackage/gtk_cairo/Kconfig
```kconfig
menuconfig PK_GTK_CAIRO
	select PK_LIBPNG
	select PK_FREETYPE
	select PK_FONTCONFIG
	select PK_LIBXRENDER
	bool "cairo"

if PK_GTK_CAIRO

config GTK_CAIRO_VERSION
	default "2.26.0" if GTKR3
	default "1.10.0" if GTKR2
	string "verstion"

config GTK_CAIRO_TAR
	default "tar.xz" if GTKR3
	default "tar.gz" if GTKR2
	string "tar type"

config GTK_CAIRO_URL
	default "http://ftp.gnome.org/pub/gnome/sources/cairo/2.26/" if GTKR3
	default "https://cairographics.org/releases/" if GTKR2
	string "url"

config GTK_CAIRO_SRC
	string "source code list"

config GTK_CAIRO_LDFLAGS
	string "LDFLAGS"

config GTK_CAIRO_CFLAGS
	string "CFLAGS"

config GTK_CAIRO_CONFIG
	default "png_REQUIRES=\"libpng\" --enable-pdf=yes --enable-win32-font=no --enable-win32=no --enable-quartz-font=no --enable-quartz=no"
	string "configure"

endif # PK_GTK_CAIRO
```

## depackage/gtk_pango/Kconfig
```kconfig
menuconfig PK_GTK_PANGO
	bool "pango"

if PK_GTK_PANGO

config GTK_PANGO_VERSION
	default "2.26.0" if GTKR3
	default "1.20.0" if GTKR2
	string "verstion"

config GTK_PANGO_TAR
	default "tar.xz" if GTKR3
	default "tar.gz" if GTKR2
	string "tar type"

config GTK_PANGO_URL
	default "http://ftp.gnome.org/pub/gnome/sources/pango/2.26/" if GTKR3
	default "http://ftp.gnome.org/pub/gnome/sources/pango/1.20/" if GTKR2
	string "url"

config GTK_PANGO_SRC
	string "source code list"

config GTK_PANGO_LDFLAGS
	string "LDFLAGS"

config GTK_PANGO_CFLAGS
	string "CFLAGS"

config GTK_PANGO_CONFIG
	default "--with-x --build=i686-pc-linux-gnu"
	string "configure"

endif # PK_GTK_PANGO
```

## depackage/libX11/Kconfig
```kconfig
menuconfig PK_LIBX11
	select PK_LIBXPROTO if X11R7_7
	select PK_LIBXTRANS if X11R7_7
	select PK_LIBKBPROTO if X11R7_7
	select PK_LIBINPUTPROTO if X11R7_7
	select PK_LIBXCB if X11R7_7
	select PK_XCB_DEMO if X11R7_7
	select PK_LIBXEXTPROTO if X11R7_7
	select PK_LIBXEXT if X11R7_7
	bool "libX11"

if PK_LIBX11

choice
	prompt "X11 Release Version"

config X11R7_7
	bool "X11R7.7"

endchoice

config LIB_LIBX11_VERSION
	default "1.5.0" if X11R7_7
	default "1.1.5" if X11R7_4
	string "verstion"

config LIB_LIBX11_TAR
	default "tar.gz"
	string "tar type"

config LIB_LIBX11_URL
	default "https://www.x.org/releases/X11R7.7/src/lib/" if X11R7_7
	default "https://www.x.org/releases/X11R7.4/src/lib/" if X11R7_4
	#default "https://www.x.org/releases/individual/lib/"
	string "url"

config LIB_LIBX11_SRC
	string "source code list"

config LIB_LIBX11_LDFLAGS
	string "LDFLAGS"

config LIB_LIBX11_CFLAGS
	string "CFLAGS"

config LIB_LIBX11_CONFIG
	default "--enable-malloc0returnsnull --disable-selective-werror"
	string "configure"

endif # PK_LIBX11
```

## depackage/libXcomposite/Kconfig
```kconfig
menuconfig PK_LIBXCOMPOSITE
	bool "libXcomposite"

if PK_LIBXCOMPOSITE

config LIB_LIBXCOMPOSITE_VERSION
	default "0.4.3" if X11R7_7
	default "0.4.3"
	string "verstion"

config LIB_LIBXCOMPOSITE_TAR
	default "tar.gz"
	string "tar type"

config LIB_LIBXCOMPOSITE_URL
	default "https://www.x.org/releases/X11R7.7/src/lib/" if X11R7_7
	default "https://www.x.org/releases/X11R7.7/src/lib/"
	string "url"

config LIB_LIBXCOMPOSITE_SRC
	string "source code list"

config LIB_LIBXCOMPOSITE_LDFLAGS
	string "LDFLAGS"

config LIB_LIBXCOMPOSITE_CFLAGS
	string "CFLAGS"

config LIB_LIBXCOMPOSITE_CONFIG
	string "configure"

endif # PK_LIBXCOMPOSITE
```

## depackage/libXcursor/Kconfig
```kconfig
menuconfig PK_LIBXCURSOR
	bool "libXcursor"

if PK_LIBXCURSOR

config LIB_LIBXCURSOR_VERSION
	default "1.1.13" if X11R7_7
	default "1.1.13"
	#default "1.13"
	string "verstion"

config LIB_LIBXCURSOR_TAR
	default "tar.gz"
	string "tar type"

config LIB_LIBXCURSOR_URL
	default "https://www.x.org/releases/X11R7.7/src/lib/" if X11R7_7
	default "https://www.x.org/releases/X11R7.7/src/lib/"
	#default "https://www.x.org/releases/individual/xcb/"
	string "url"

config LIB_LIBXCURSOR_SRC
	string "source code list"

config LIB_LIBXCURSOR_LDFLAGS
	string "LDFLAGS"

config LIB_LIBXCURSOR_CFLAGS
	string "CFLAGS"

config LIB_LIBXCURSOR_CONFIG
	string "configure"

endif # PK_LIBXCURSOR
```

## depackage/libXdamage/Kconfig
```kconfig
menuconfig PK_LIBXDAMAGE
	bool "libXdamage"

if PK_LIBXDAMAGE

config LIB_LIBXDAMAGE_VERSION
	default "1.1.3" if X11R7_7
	default "1.1.3"
	#default "1.13"
	string "verstion"

config LIB_LIBXDAMAGE_TAR
	default "tar.gz"
	string "tar type"

config LIB_LIBXDAMAGE_URL
	default "https://www.x.org/releases/X11R7.7/src/lib/" if X11R7_7
	default "https://www.x.org/releases/X11R7.7/src/lib/"
	#default "https://www.x.org/releases/individual/xcb/"
	string "url"

config LIB_LIBXDAMAGE_SRC
	string "source code list"

config LIB_LIBXDAMAGE_LDFLAGS
	string "LDFLAGS"

config LIB_LIBXDAMAGE_CFLAGS
	string "CFLAGS"

config LIB_LIBXDAMAGE_CONFIG
	string "configure"

endif # PK_LIBXDAMAGE
```

## depackage/libXdmcp/Kconfig
```kconfig
menuconfig PK_LIBXDMCP
	bool "libXdmcp"

if PK_LIBXDMCP

config LIB_LIBXDMCP_VERSION
	default "1.1.1"
	string "verstion"

config LIB_LIBXDMCP_TAR
	default "tar.gz"
	string "tar type"

config LIB_LIBXDMCP_URL
	default "https://www.x.org/releases/X11R7.7/src/lib/"
	string "url"

config LIB_LIBXDMCP_SRC
	string "source code list"

config LIB_LIBXDMCP_LDFLAGS
	string "LDFLAGS"

config LIB_LIBXDMCP_CFLAGS
	string "CFLAGS"

config LIB_LIBXDMCP_CONFIG
	string "configure"

endif # PK_LIBXDMCP
```

## depackage/libXfixes/Kconfig
```kconfig
menuconfig PK_LIBXFIXES
	bool "libXfixes"

if PK_LIBXFIXES

config LIB_LIBXFIXES_VERSION
	default "5.0" if X11R7_7
	default "5.0"
	#default "1.13"
	string "verstion"

config LIB_LIBXFIXES_TAR
	default "tar.gz"
	string "tar type"

config LIB_LIBXFIXES_URL
	default "https://www.x.org/releases/X11R7.7/src/lib/" if X11R7_7
	default "https://www.x.org/releases/X11R7.7/src/lib/"
	#default "https://www.x.org/releases/individual/xcb/"
	string "url"

config LIB_LIBXFIXES_SRC
	string "source code list"

config LIB_LIBXFIXES_LDFLAGS
	string "LDFLAGS"

config LIB_LIBXFIXES_CFLAGS
	string "CFLAGS"

config LIB_LIBXFIXES_CONFIG
	string "configure"

endif # PK_LIBXFIXES
```

## depackage/libXinerama/Kconfig
```kconfig
menuconfig PK_LIBXINERAMA
	select PK_LIBXEXT
	select PK_XINERAMAPROTO
	bool "libXinerama"

if PK_LIBXINERAMA

config LIB_LIBXINERAMA_VERSION
	default "1.1.2" if X11R7_7
	default "1.1.2"
	string "verstion"

config LIB_LIBXINERAMA_TAR
	default "tar.gz"
	string "tar type"

config LIB_LIBXINERAMA_URL
	default "https://www.x.org/releases/X11R7.7/src/lib/" if X11R7_7
	default "https://www.x.org/releases/X11R7.7/src/lib/"
	string "url"

config LIB_LIBXINERAMA_SRC
	string "source code list"

config LIB_LIBXINERAMA_LDFLAGS
	string "LDFLAGS"

config LIB_LIBXINERAMA_CFLAGS
	string "CFLAGS"

config LIB_LIBXINERAMA_CONFIG
	string "configure"

endif # PK_LIBXINERAMA
```

## depackage/libXrender/Kconfig
```kconfig
menuconfig PK_LIBXRENDER
	bool "libXrender"

if PK_LIBXRENDER

config LIB_LIBXRENDER_VERSION
	default "0.9.7"
	string "verstion"

config LIB_LIBXRENDER_TAR
	default "tar.gz"
	string "tar type"

config LIB_LIBXRENDER_URL
	default "https://www.x.org/releases/X11R7.7/src/lib/"
	#default "https://www.x.org/releases/individual/proto/"
	string "url"

config LIB_LIBXRENDER_SRC
	string "source code list"

config LIB_LIBXRENDER_LDFLAGS
	string "LDFLAGS"

config LIB_LIBXRENDER_CFLAGS
	string "CFLAGS"

config LIB_LIBXRENDER_CONFIG
	string "configure"

endif # PK_LIBXRENDER
```

## depackage/libdrm/Kconfig
```kconfig
menuconfig PK_LIBDRM
	bool "libdrm"

if PK_LIBDRM

config LIB_LIBDRM_VERSION
	default "2.4.88"
	string "verstion"

config LIB_LIBDRM_TAR
	default "tar.bz2"
	string "tar type"

config LIB_LIBDRM_URL
	default "http://repository.timesys.com/buildsources/l/libdrm/libdrm-2.4.88/"
	string "url"

config LIB_LIBDRM_SRC
	string "source code list"

config LIB_LIBDRM_LDFLAGS
	string "LDFLAGS"

config LIB_LIBDRM_CFLAGS
	string "CFLAGS"

config LIB_LIBDRM_CONFIG
	string "configure"

endif # PK_LIBDRM
```

## depackage/libffi/Kconfig
```kconfig
menuconfig PK_LIBFFI
	bool "libffi"

if PK_LIBFFI

config LIB_LIBFFI_VERSION
	default "3.2" if GLIBR2
	string "verstion"

config LIB_LIBFFI_TAR
	default "tar.gz"
	string "tar type"

config LIB_LIBFFI_URL
	default "https://www.mirrorservice.org/sites/sourceware.org/pub/libffi/" if GLIBR2
	string "url"

config LIB_LIBFFI_SRC
	string "source code list"

config LIB_LIBFFI_LDFLAGS
	string "LDFLAGS"

config LIB_LIBFFI_CFLAGS
	string "CFLAGS"

config LIB_LIBFFI_CONFIG
	string "configure"

endif # PK_LIBFFI
```

## depackage/libfontenc/Kconfig
```kconfig
menuconfig PK_LIBFONTENC
	bool "libfontenc"

if PK_LIBFONTENC

config LIB_LIBFONTENC_VERSION
	default "1.1.2"
	string "verstion"

config LIB_LIBFONTENC_TAR
	default "tar.bz2"
	string "tar type"

config LIB_LIBFONTENC_URL
	default "http://repository.timesys.com/buildsources/l/libfontenc/libfontenc-1.1.3/"
	string "url"

config LIB_LIBFONTENC_SRC
	string "source code list"

config LIB_LIBFONTENC_LDFLAGS
	string "LDFLAGS"

config LIB_LIBFONTENC_CFLAGS
	string "CFLAGS"

config LIB_LIBFONTENC_CONFIG
	string "configure"

endif # PK_LIBFONTENC
```

## depackage/libjpeg/Kconfig
```kconfig
menuconfig PK_LIBJPEG
	select PK_ZLIB
	bool "libjpeg"

if PK_LIBJPEG

config LIB_LIBJPEG_VERSION
	default "v8d"
	string "verstion"

config LIB_LIBJPEG_TAR
	default "tar.gz"
	string "tar type"

config LIB_LIBJPEG_URL
	default "https://ftp.osuosl.org/pub/blfs/conglomeration/jpeg/"
	string "url"

config LIB_LIBJPEG_SRC
	string "source code list"

config LIB_LIBJPEG_LDFLAGS
	string "LDFLAGS"

config LIB_LIBJPEG_CFLAGS
	string "CFLAGS"

config LIB_LIBJPEG_CONFIG
	string "configure"

endif # PK_LIBJPEG
```

## depackage/libkbproto/Kconfig
```kconfig
menuconfig PK_LIBKBPROTO
	bool "libkbproto"

if PK_LIBKBPROTO

config LIB_LIBKBPROTO_VERSION
	default "1.0.6" if X11R7_7
	default "1.0.3" if X11R7_4
	default "1.0.6"
	#default "1.0.7"
	string "verstion"

config LIB_LIBKBPROTO_TAR
	default "tar.gz"
	string "tar type"

config LIB_LIBKBPROTO_URL
	default "https://www.x.org/releases/X11R7.7/src/proto/" if X11R7_7
	default "https://www.x.org/releases/X11R7.4/src/proto/" if X11R7_4
	#default "https://www.x.org/releases/individual/proto/"
	default "https://www.x.org/releases/X11R7.7/src/proto/"
	string "url"

config LIB_LIBKBPROTO_SRC
	string "source code list"

config LIB_LIBKBPROTO_LDFLAGS
	string "LDFLAGS"

config LIB_LIBKBPROTO_CFLAGS
	string "CFLAGS"

config LIB_LIBKBPROTO_CONFIG
	string "configure"

endif # PK_LIBKBPROTO
```

## depackage/libpciaccess/Kconfig
```kconfig
menuconfig PK_LIBPCIACCESS
	bool "libpciaccess"

if PK_LIBPCIACCESS

config LIB_LIBPCIACCESS_VERSION
	default "0.14"
	string "verstion"

config LIB_LIBPCIACCESS_TAR
	default "tar.bz2"
	string "tar type"

config LIB_LIBPCIACCESS_URL
	default "http://repository.timesys.com/buildsources/l/libpciaccess/libpciaccess-0.14/"
	string "url"

config LIB_LIBPCIACCESS_SRC
	string "source code list"

config LIB_LIBPCIACCESS_LDFLAGS
	string "LDFLAGS"

config LIB_LIBPCIACCESS_CFLAGS
	string "CFLAGS"

config LIB_LIBPCIACCESS_CONFIG
	string "configure"

endif # PK_LIBPCIACCESS
```

## depackage/libpng/Kconfig
```kconfig
menuconfig PK_LIBPNG
	select PK_ZLIB
	bool "libpng"

if PK_LIBPNG

config LIB_LIBPNG_VERSION
	default "1.6.32"
	string "verstion"

config LIB_LIBPNG_TAR
	default "tar.gz"
	string "tar type"

config LIB_LIBPNG_URL
	default "ftp://ftp-osl.osuosl.org/pub/libpng/src/archive/gz/libpng16/"
	string "url"

config LIB_LIBPNG_SRC
	string "source code list"

config LIB_LIBPNG_LDFLAGS
	string "LDFLAGS"

config LIB_LIBPNG_CFLAGS
	string "CFLAGS"

config LIB_LIBPNG_CONFIG
	string "configure"

endif # PK_LIBPNG
```

## depackage/libtool/Kconfig
```kconfig
menuconfig PK_LIBTOOL
	bool "libtool"

if PK_LIBTOOL

config LIBTOOL_VERSION
	default "2.4"
	string "verstion"

config LIBTOOL_TAR
	default "tar.gz"
	string "tar type"

config LIBTOOL_URL
	default "http://ftp.gnu.org/pub/gnu/libtool/"
	string "url"

config LIBTOOL_LDFLAGS
	string "LDFLAGS"

config LIBTOOL_CFLAGS
	string "CFLAGS"

config LIBTOOL_CONFIG
	string "configure"

endif # PK_LIBTOOL
```

## depackage/libuuid/Kconfig
```kconfig
menuconfig PK_LIBUUID
	bool "libuuid"

if PK_LIBUUID

config LIBUUID_VERSION
	default "1.0.3"
	string "verstion"

config LIBUUID_TAR
	default "tar.gz"
	string "tar type"

config LIBUUID_URL
	default "https://nchc.dl.sourceforge.net/project/libuuid/"
	string "url"

config LIBUUID_LDFLAGS
	string "LDFLAGS"

config LIBUUID_CFLAGS
	string "CFLAGS"

config LIBUUID_CONFIG
	string "configure"

endif # PK_LIBUUID
```

## depackage/libxcb-proto/Kconfig
```kconfig
menuconfig PK_LIBXCB_PROTO
	bool "libxcb-proto"

if PK_LIBXCB_PROTO

config LIB_LIBXCB_PROTO_VERSION
	default "1.7.1" if X11R7_7
	default "1.7.1"
	#default "1.13"
	string "verstion"

config LIB_LIBXCB_PROTO_TAR
	default "tar.gz"
	string "tar type"

config LIB_LIBXCB_PROTO_URL
	default "https://www.x.org/releases/X11R7.7/src/xcb/" if X11R7_7
	default "https://www.x.org/releases/X11R7.7/src/xcb/"
	#default "https://www.x.org/releases/individual/xcb/"
	string "url"

config LIB_LIBXCB_PROTO_SRC
	string "source code list"

config LIB_LIBXCB_PROTO_LDFLAGS
	string "LDFLAGS"

config LIB_LIBXCB_PROTO_CFLAGS
	string "CFLAGS"

config LIB_LIBXCB_PROTO_CONFIG
	string "configure"

endif # PK_LIBXCB_PROTO
```

## depackage/libxextproto/Kconfig
```kconfig
menuconfig PK_LIBXEXTPROTO
	bool "xextproto"

if PK_LIBXEXTPROTO

config LIB_LIBXEXTPROTO_VERSION
	default "7.2.1" if X11R7_7
	default "7.2.1"
	#default "7.3.0"
	string "verstion"

config LIB_LIBXEXTPROTO_TAR
	default "tar.gz"
	string "tar type"

config LIB_LIBXEXTPROTO_URL
	default "https://www.x.org/releases/X11R7.7/src/proto/" if X11R7_7
	default "https://www.x.org/releases/X11R7.7/src/proto/"
	#default "https://www.x.org/releases/individual/proto/"
	string "url"

config LIB_LIBXEXTPROTO_SRC
	string "source code list"

config LIB_LIBXEXTPROTO_LDFLAGS
	string "LDFLAGS"

config LIB_LIBXEXTPROTO_CFLAGS
	string "CFLAGS"

config LIB_LIBXEXTPROTO_CONFIG
	string "configure"

endif # PK_LIBXEXTPROTO
```

## depackage/libxfce4ui/Kconfig
```kconfig
menuconfig PK_LIBXFCE4UI
	bool "libxfce4ui"

if PK_LIBXFCE4UI

config LIB_LIBXFCE4UI_VERSION
	default "4.12.0" if XFCER4
	string "verstion"

config LIB_LIBXFCE4UI_TAR
	default "tar.bz2"
	string "tar type"

config LIB_LIBXFCE4UI_URL
	default "http://archive.xfce.org/src/xfce/libxfce4ui/4.12" if XFCER4
	string "url"

config LIB_LIBXFCE4UI_SRC
	string "source code list"

config LIB_LIBXFCE4UI_LDFLAGS
	string "LDFLAGS"

config LIB_LIBXFCE4UI_CFLAGS
	string "CFLAGS"

config LIB_LIBXFCE4UI_CONFIG
	string "configure"

endif # PK_LIBXFCE4UI
```

## depackage/libxfont/Kconfig
```kconfig
menuconfig PK_LIBXFONT
	select PK_ZLIB
	select PK_FONTSPROTO
	select PK_LIBFONTENC
	select PK_FREETYPE
	bool "libxfont"

if PK_LIBXFONT

config LIBXFONT_VERSION
	default "1.5.4"
	string "verstion"

config LIBXFONT_TAR
	default "tar.bz2"
	string "tar type"

config LIBXFONT_URL
	default "http://repository.timesys.com/buildsources/l/libXfont/libXfont-1.5.4/"
	string "url"

config LIBXFONT_SRC
	string "source code list"

config LIBXFONT_LDFLAGS
	string "LDFLAGS"

config LIBXFONT_CFLAGS
	string "CFLAGS"

config LIBXFONT_CONFIG
	default "ac_cv_lib_z_gzopen=yes"
	string "configure"

endif # PK_LIBXFONT
```

## depackage/libxkbfile/Kconfig
```kconfig
menuconfig PK_LIBXKBFILE
	bool "libxkbfile"

if PK_LIBXKBFILE

config LIBXKBFILE_VERSION
	default "1.0.9"
	string "verstion"

config LIBXKBFILE_TAR
	default "tar.bz2"
	string "tar type"

config LIBXKBFILE_URL
	default "http://repository.timesys.com/buildsources/l/libxkbfile/libxkbfile-1.0.9/"
	string "url"

config LIBXKBFILE_SRC
	string "source code list"

config LIBXKBFILE_LDFLAGS
	string "LDFLAGS"

config LIBXKBFILE_CFLAGS
	string "CFLAGS"

config LIBXKBFILE_CONFIG
	string "configure"

endif # PK_LIBXKBFILE
```
