## depackage/libxtrans/Kconfig
```kconfig
menuconfig PK_LIBXTRANS
	bool "libxtrans"

if PK_LIBXTRANS

config LIB_LIBXTRANS_VERSION
	default "1.2.7" if X11R7_7
	default "1.2.1" if X11R7_4
	default "1.2.7"
	#default "1.4.0"
	string "verstion"

config LIB_LIBXTRANS_TAR
	default "tar.gz"
	string "tar type"

config LIB_LIBXTRANS_URL
	default "https://www.x.org/releases/X11R7.7/src/lib/" if X11R7_7
	default "https://www.x.org/releases/X11R7.4/src/lib/" if X11R7_4
	default "https://www.x.org/releases/X11R7.7/src/lib/"
	#default "https://www.x.org/releases/individual/lib/"
	string "url"

config LIB_LIBXTRANS_SRC
	string "source code list"

config LIB_LIBXTRANS_LDFLAGS
	string "LDFLAGS"

config LIB_LIBXTRANS_CFLAGS
	string "CFLAGS"

config LIB_LIBXTRANS_CONFIG
	string "configure"

endif # PK_LIBXTRANS
```

## depackage/pcre/Kconfig
```kconfig
menuconfig PK_PCRE
	bool "pcre"

if PK_PCRE

config PCRE_VERSION
	default "8.42" if GLIBR2
	string "verstion"

config PCRE_TAR
	default "tar.gz"
	string "tar type"

config PCRE_URL
	default "https://ftp.pcre.org/pub/pcre/" if GLIBR2
	string "url"

config PCRE_SRC
	string "source code list"

config PCRE_LDFLAGS
	string "LDFLAGS"

config PCRE_CFLAGS
	string "CFLAGS"

config PCRE_CONFIG
	string "configure"

endif # PK_PCRE
```

## depackage/pixman/Kconfig
```kconfig
menuconfig PK_PIXMAN
	bool "pixman"

if PK_PIXMAN

config PIXMAN_VERSION
	default "0.36.0"
	string "verstion"

config PIXMAN_TAR
	default "tar.gz"
	string "tar type"

config PIXMAN_URL
	default "https://ftp.osuosl.org/pub/blfs/conglomeration/pixman/"
	string "url"

config PIXMAN_SRC
	string "source code list"

config PIXMAN_LDFLAGS
	string "LDFLAGS"

config PIXMAN_CFLAGS
	string "CFLAGS"

config PIXMAN_CONFIG
	string "configure"

endif # PK_PIXMAN
```

## depackage/randrproto/Kconfig
```kconfig
menuconfig PK_RANDRPROTO
	bool "randrproto"

if PK_RANDRPROTO

config RANDRPROTO_VERSION
	default "1.3.2"
	string "verstion"

config RANDRPROTO_TAR
	default "tar.gz"
	string "tar type"

config RANDRPROTO_URL
	default "https://www.x.org/releases/X11R7.7/src/proto/"
	string "url"

config RANDRPROTO_SRC
	string "source code list"

config RANDRPROTO_LDFLAGS
	string "LDFLAGS"

config RANDRPROTO_CFLAGS
	string "CFLAGS"

config RANDRPROTO_CONFIG
	string "configure"

endif # PK_RANDRPROTO
```

## depackage/recordproto/Kconfig
```kconfig
menuconfig PK_RECORDPROTO
	bool "recordproto"

if PK_RECORDPROTO

config RECORDPROTO_VERSION
	default "1.14"
	string "verstion"

config RECORDPROTO_TAR
	default "tar.bz2"
	string "tar type"

config RECORDPROTO_URL
	default "http://repository.timesys.com/buildsources/r/recordproto/recordproto-1.14/"
	string "url"

config RECORDPROTO_SRC
	string "source code list"

config RECORDPROTO_LDFLAGS
	string "LDFLAGS"

config RECORDPROTO_CFLAGS
	string "CFLAGS"

config RECORDPROTO_CONFIG
	string "configure"

endif # PK_RECORDPROTO
```

## depackage/renderproto/Kconfig
```kconfig
menuconfig PK_RENDERPROTO
	bool "renderproto"

if PK_RENDERPROTO

config RENDERPROTO_VERSION
	default "0.11.1"
	string "verstion"

config RENDERPROTO_TAR
	default "tar.gz"
	string "tar type"

config RENDERPROTO_URL
	default "https://www.x.org/releases/X11R7.7/src/proto/"
	string "url"

config RENDERPROTO_SRC
	string "source code list"

config RENDERPROTO_LDFLAGS
	string "LDFLAGS"

config RENDERPROTO_CFLAGS
	string "CFLAGS"

config RENDERPROTO_CONFIG
	string "configure"

endif # PK_RENDERPROTO
```

## depackage/resourceproto/Kconfig
```kconfig
menuconfig PK_RESOURCEPROTO
	bool "resourceproto"

if PK_RESOURCEPROTO

config RESOURCEPROTO_VERSION
	default "1.2.0"
	string "verstion"

config RESOURCEPROTO_TAR
	default "tar.bz2"
	string "tar type"

config RESOURCEPROTO_URL
	default "http://repository.timesys.com/buildsources/r/resourceproto/resourceproto-1.2.0/"
	string "url"

config RESOURCEPROTO_SRC
	string "source code list"

config RESOURCEPROTO_LDFLAGS
	string "LDFLAGS"

config RESOURCEPROTO_CFLAGS
	string "CFLAGS"

config RESOURCEPROTO_CONFIG
	string "configure"

endif # PK_RESOURCEPROTO
```

## depackage/scrnsaverproto/Kconfig
```kconfig
menuconfig PK_SCRNSAVERPROTO
	bool "scrnsaverproto"

if PK_SCRNSAVERPROTO

config SCRNSAVERPROTO_VERSION
	default "1.2.2"
	string "verstion"

config SCRNSAVERPROTO_TAR
	default "tar.bz2"
	string "tar type"

config SCRNSAVERPROTO_URL
	default "http://repository.timesys.com/buildsources/s/scrnsaverproto/scrnsaverproto-1.2.2/"
	string "url"

config SCRNSAVERPROTO_SRC
	string "source code list"

config SCRNSAVERPROTO_LDFLAGS
	string "LDFLAGS"

config SCRNSAVERPROTO_CFLAGS
	string "CFLAGS"

config SCRNSAVERPROTO_CONFIG
	string "configure"

endif # PK_SCRNSAVERPROTO
```

## depackage/videoproto/Kconfig
```kconfig
menuconfig PK_VIDEOPROTO
	bool "videoproto"

if PK_VIDEOPROTO

config VIDEOPROTO_VERSION
	default "2.3.3"
	string "verstion"

config VIDEOPROTO_TAR
	default "tar.bz2"
	string "tar type"

config VIDEOPROTO_URL
	default "repository.timesys.com/buildsources/v/videoproto/videoproto-2.3.3/"
	string "url"

config VIDEOPROTO_SRC
	string "source code list"

config VIDEOPROTO_LDFLAGS
	string "LDFLAGS"

config VIDEOPROTO_CFLAGS
	string "CFLAGS"

config VIDEOPROTO_CONFIG
	string "configure"

endif # PK_VIDEOPROTO
```

## depackage/xcmiscproto/Kconfig
```kconfig
menuconfig PK_XCMISCPROTO
	bool "xcmiscproto"

if PK_XCMISCPROTO

config XCMISCPROTO_VERSION
	default "1.2.2"
	string "verstion"

config XCMISCPROTO_TAR
	default "tar.bz2"
	string "tar type"

config XCMISCPROTO_URL
	default "http://repository.timesys.com/buildsources/x/xcmiscproto/xcmiscproto-1.2.2/"
	string "url"

config XCMISCPROTO_SRC
	string "source code list"

config XCMISCPROTO_LDFLAGS
	string "LDFLAGS"

config XCMISCPROTO_CFLAGS
	string "CFLAGS"

config XCMISCPROTO_CONFIG
	string "configure"

endif # PK_XCMISCPROTO
```

## depackage/xf86vidmodeproto/Kconfig
```kconfig
menuconfig PK_XF86VIDMODEPROTO
	bool "xf86vidmodeproto"

if PK_XF86VIDMODEPROTO

config XF86VIDMODEPROTO_VERSION
	default "2.3.1"
	string "verstion"

config XF86VIDMODEPROTO_TAR
	default "tar.gz"
	string "tar type"

config XF86VIDMODEPROTO_URL
	default "https://www.x.org/releases/X11R7.7/src/proto/"
	string "url"

config XF86VIDMODEPROTO_SRC
	string "source code list"

config XF86VIDMODEPROTO_LDFLAGS
	string "LDFLAGS"

config XF86VIDMODEPROTO_CFLAGS
	string "CFLAGS"

config XF86VIDMODEPROTO_CONFIG
	string "configure"

endif # PK_XF86VIDMODEPROTO
```

## depackage/xineramaproto/Kconfig
```kconfig
menuconfig PK_XINERAMAPROTO
	bool "xineramaproto"

if PK_XINERAMAPROTO

config LIB_XINERAMAPROTO_VERSION
	default "1.2.1" if X11R7_7
	default "1.2.1"
	string "verstion"

config LIB_XINERAMAPROTO_TAR
	default "tar.gz"
	string "tar type"

config LIB_XINERAMAPROTO_URL
	default "https://www.x.org/releases/X11R7.7/src/proto/" if X11R7_7
	default "https://www.x.org/releases/X11R7.7/src/proto/"
	string "url"

config LIB_XINERAMAPROTO_SRC
	string "source code list"

config LIB_XINERAMAPROTO_LDFLAGS
	string "LDFLAGS"

config LIB_XINERAMAPROTO_CFLAGS
	string "CFLAGS"

config LIB_XINERAMAPROTO_CONFIG
	string "configure"

endif # PK_XINERAMAPROTO
```

## fs/BiscuitOS_only/Kconfig
```kconfig
menuconfig FS_BISCUITOS_ONLY
	bool "(only Run)BiscuitOS Desktop Filesystem(rootfs)"
```

## fs/Kconfig
```kconfig
#
# Rootfs configure menu
#

menuconfig ROOTFS
	bool "Root-Filesystem"
	default y
	help
	  The rootfs for BiscuitOS

if ROOTFS

# Ext4
source fs/ext4/Kconfig

# MINIX-FS
source fs/minix/Kconfig

# Ext2
source fs/ext2/Kconfig

# MSDOS
source fs/msdos/Kconfig

# XV6
source fs/xv6/Kconfig

# Apollo
source fs/Apollo/Kconfig

# Debian
source fs/Debian/Kconfig

# BiscuitOS-Desktop
source fs/BiscuitOS/Kconfig

# BiscuitOS-Desktop only running
source fs/BiscuitOS_only/Kconfig

# Debian Server
source fs/Debian_Server/Kconfig

# Docker
source fs/Docker/Kconfig


config ROOTFS_SIZE
	default 150
	int "The size of Rootfs (MB)"

config FREEZE_SIZE
	default 512
	int "The size of Freeze Disk (MB)"

endif # Rootfs
```

## fs/ext4/Kconfig
```kconfig
menuconfig FS_EXT4
	bool "EX4 Filesystem(rootfs)"

if FS_EXT4

config EXT4_RISCV
	default "-riscv" if RISCV64
	default "-riscv" if RISCV32
	string 

endif # FS_EXT4
```

## kernel/Apollo/Kconfig
```kconfig
menu "Apollo"

config APOLLO
	bool "Apollo Guidance Computer"

if APOLLO

choice
	prompt "Choice Apollp version"

config APOLLO_11
	bool "Apollo-11"

endchoice

config APOLLO_VERSION
	string
	default "Apollo-11"	if APOLLO_11

config APOLLO_GITHUB
	string "Apollo Github"

endif # APOLLO

endmenu
```
