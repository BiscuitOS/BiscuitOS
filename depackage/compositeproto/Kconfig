## depackage/compositeproto/Kconfig
```kconfig
menuconfig PK_COMPOSITEPROTO
	bool "compositeproto"

if PK_COMPOSITEPROTO

config COMPOSITEPROTO_VERSION
	default "0.4.2"
	string "verstion"

config COMPOSITEPROTO_TAR
	default "tar.gz"
	string "tar type"

config COMPOSITEPROTO_URL
	default "https://www.x.org/releases/X11R7.7/src/proto/"
	string "url"

config COMPOSITEPROTO_SRC
	string "source code list"

config COMPOSITEPROTO_LDFLAGS
	string "LDFLAGS"

config COMPOSITEPROTO_CFLAGS
	string "CFLAGS"

config COMPOSITEPROTO_CONFIG
	string "configure"

endif # PK_COMPOSITEPROTO
```

## depackage/damageproto/Kconfig
```kconfig
menuconfig PK_DAMAGEPROTO
	bool "damageproto"

if PK_DAMAGEPROTO

config DAMAGEPROTO_VERSION
	default "1.2.1"
	string "verstion"

config DAMAGEPROTO_TAR
	default "tar.gz"
	string "tar type"

config DAMAGEPROTO_URL
	default "https://www.x.org/releases/X11R7.7/src/proto/"
	string "url"

config DAMAGEPROTO_SRC
	string "source code list"

config DAMAGEPROTO_LDFLAGS
	string "LDFLAGS"

config DAMAGEPROTO_CFLAGS
	string "CFLAGS"

config DAMAGEPROTO_CONFIG
	string "configure"

endif # PK_DAMAGEPROTO
```

## depackage/dri2proto/Kconfig
```kconfig
menuconfig PK_DRI2PROTO
	bool "dri2proto"

if PK_DRI2PROTO

config DRI2PROTO_VERSION
	default "2.6"
	string "verstion"

config DRI2PROTO_TAR
	default "tar.gz"
	string "tar type"

config DRI2PROTO_URL
	default "https://www.x.org/releases/X11R7.7/src/proto/"
	string "url"

config DRI2PROTO_SRC
	string "source code list"

config DRI2PROTO_LDFLAGS
	string "LDFLAGS"

config DRI2PROTO_CFLAGS
	string "CFLAGS"

config DRI2PROTO_CONFIG
	string "configure"

endif # PK_DRI2PROTO
```

## depackage/e2fsprogs/Kconfig
```kconfig
menuconfig PK_E2FSPROGS
	bool "e2fsprogs"

if PK_E2FSPROGS

config E2FSPROGS_VERSION
	default "1.45.3"
	string "verstion"

config E2FSPROGS_TAR
	default "tar.gz"
	string "tar type"

config E2FSPROGS_URL
	default "https://nchc.dl.sourceforge.net/project/e2fsprogs/e2fsprogs/v1.45.3/"
	string "url"

config E2FSPROGS_LDFLAGS
	string "LDFLAGS"

config E2FSPROGS_CFLAGS
	string "CFLAGS"

config E2FSPROGS_CONFIG
	default "--enable-elf-shlibs"
	string "configure"

endif # PK_E2FSPROGS
```

## depackage/elfutils/Kconfig
```kconfig
menuconfig PK_ELFUTILS
	bool "elfutils"

if PK_ELFUTILS

config ELFUTILS_VERSION
	default "0.163"
	string "verstion"

config ELFUTILS_TAR
	default "tar.bz2"
	string "tar type"

config ELFUTILS_URL
	default "https://sourceware.org/elfutils/ftp/0.163/"
	string "url"

config ELFUTILS_SRC
	string "source code list"

config ELFUTILS_LDFLAGS
	string "LDFLAGS"

config ELFUTILS_CFLAGS
	string "CFLAGS"

config ELFUTILS_CONFIG
	string "configure"

endif # PK_ELFUTILS
```

## depackage/expat/Kconfig
```kconfig
menuconfig PK_EXPAT
	bool "expat"

if PK_EXPAT

config EXPAT_VERSION
	default "2.2.4"
	string "verstion"

config EXPAT_TAR
	default "tar.bz2"
	string "tar type"

config EXPAT_URL
	default "http://repository.timesys.com/buildsources/e/expat/expat-2.2.4/"
	string "url"

config EXPAT_SRC
	string "source code list"

config EXPAT_LDFLAGS
	string "LDFLAGS"

config EXPAT_CFLAGS
	string "CFLAGS"

config EXPAT_CONFIG
	string "configure"

endif # PK_EXPAT
```

## depackage/fixesproto/Kconfig
```kconfig
menuconfig PK_FIXESPROTO
	bool "fixesproto"

if PK_FIXESPROTO

config FIXESPROTO_VERSION
	default "5.0"
	string "verstion"

config FIXESPROTO_TAR
	default "tar.gz"
	string "tar type"

config FIXESPROTO_URL
	default "https://www.x.org/releases/X11R7.7/src/proto/"
	string "url"

config FIXESPROTO_SRC
	string "source code list"

config FIXESPROTO_LDFLAGS
	string "LDFLAGS"

config FIXESPROTO_CFLAGS
	string "CFLAGS"

config FIXESPROTO_CONFIG
	string "configure"

endif # PK_FIXESPROTO
```

## depackage/fontsproto/Kconfig
```kconfig
menuconfig PK_FONTSPROTO
	bool "fontsproto"

if PK_FONTSPROTO

config FONTSPROTO_VERSION
	default "2.1.3"
	string "verstion"

config FONTSPROTO_TAR
	default "tar.bz2"
	string "tar type"

config FONTSPROTO_URL
	default "http://repository.timesys.com/buildsources/f/fontsproto/fontsproto-2.1.3/"
	string "url"

config FONTSPROTO_SRC
	string "source code list"

config FONTSPROTO_LDFLAGS
	string "LDFLAGS"

config FONTSPROTO_CFLAGS
	string "CFLAGS"

config FONTSPROTO_CONFIG
	string "configure"

endif # PK_FONTSPROTO
```

## depackage/game_2048/Kconfig
```kconfig
menuconfig PK_GAME_2048
	bool "Game  2048"

if PK_GAME_2048

config GAME_2048_VERSION
	default "0.11"
	string "verstion"

config GAME_2048_TAR
	string "tar type"

config GAME_2048_URL
	default "https://raw.githubusercontent.com/mevdschee/2048.c/master/"
	string "url"

config GAME_2048_SRC
	default "2048.c README.md palette.sh Makefile LICENSE"
	string "source code list"

config GAME_2048_LDFLAGS
	string "LDFLAGS"

config GAME_2048_CFLAGS
	string "CFLAGS"

config GAME_2048_CONFIG
	string "configure"

endif # PK_GAME_2048
```

## depackage/game_snake/Kconfig
```kconfig
menuconfig PK_GAME_SNAKE
	select PK_GNU_NCURSES
	bool "Game  snake"

if PK_GAME_SNAKE

config GAME_SNAKE_VERSION
	default "0.11"
	string "verstion"

config GAME_SNAKE_TAR
	string "tar type"

config GAME_SNAKE_URL
	default "https://raw.githubusercontent.com/BiscuitOS/HardStack/master/GAME/snake/"
	string "url"

config GAME_SNAKE_SRC
	default "snake.c README.md"
	string "source code list"

config GAME_SNAKE_LDFLAGS
	default "-lncurses"
	string "LDFLAGS"

config GAME_SNAKE_CFLAGS
	string "CFLAGS"

config GAME_SNAKE_CONFIG
	string "configure"

endif # PK_GAME_SNAKE
```

## depackage/gdk-pixbuf/Kconfig
```kconfig
menuconfig PK_GDK_PIXBUF
	select PK_LIBJPEG
	select PK_LIBTIFF
	bool "gdk-pixbuf"

if PK_GDK_PIXBUF

config GDK_PIXBUF_VERSION
	default "2.28.0" if GTKR3
	default "2.28.0" if GTKR2
	string "verstion"

config GDK_PIXBUF_TAR
	default "tar.xz" if GTKR3
	default "tar.xz" if GTKR2
	string "tar type"

config GDK_PIXBUF_URL
	default "http://ftp.gnome.org/pub/gnome/sources/gdk-pixbuf/2.28/" if GTKR3
	default "http://ftp.gnome.org/pub/gnome/sources/gdk-pixbuf/2.28/" if GTKR2
	string "url"

config GDK_PIXBUF_SRC
	string "source code list"

config GDK_PIXBUF_LDFLAGS
	string "LDFLAGS"

config GDK_PIXBUF_CFLAGS
	string "CFLAGS"

config GDK_PIXBUF_CONFIG
	default "--enable-gio-sniffing"
	string "configure"

endif # PK_GDK_PIXBUF
```

## depackage/glproto/Kconfig
```kconfig
menuconfig PK_GLPROTO
	bool "glproto"

if PK_GLPROTO

config GLPROTO_VERSION
	default "1.4.15"
	string "verstion"

config GLPROTO_TAR
	default "tar.gz"
	string "tar type"

config GLPROTO_URL
	default "https://www.x.org/releases/X11R7.7/src/proto/"
	string "url"

config GLPROTO_SRC
	string "source code list"

config GLPROTO_LDFLAGS
	string "LDFLAGS"

config GLPROTO_CFLAGS
	string "CFLAGS"

config GLPROTO_CONFIG
	string "configure"

endif # PK_GLPROTO
```

## depackage/gnu_autoconf/Kconfig
```kconfig
menuconfig PK_GNU_AUTOCONF
	bool "GNU - autoconf"

if PK_GNU_AUTOCONF

config GNU_AUTOCONF_VERSION
	default "2.69"
	string "verstion"

config GNU_AUTOCONF_TAR
	default "tar.gz"
	string "tar type"

config GNU_AUTOCONF_URL
	default "http://ftp.gnu.org/pub/gnu/autoconf/"
	string "url"

config GNU_AUTOCONF_LDFLAGS
	string "LDFLAGS"

config GNU_AUTOCONF_CFLAGS
	string "CFLAGS"

config GNU_AUTOCONF_CONFIG
	string "configure"

endif # PK_GNU_AUTOCONF
```

## depackage/gnu_automake/Kconfig
```kconfig
menuconfig PK_GNU_AUTOMAKE
	bool "GNU - automake"

if PK_GNU_AUTOMAKE

config GNU_AUTOMAKE_VERSION
	default "1.16"
	string "verstion"

config GNU_AUTOMAKE_TAR
	default "tar.gz"
	string "tar type"

config GNU_AUTOMAKE_URL
	default "http://ftp.gnu.org/pub/gnu/automake/"
	string "url"

config GNU_AUTOMAKE_LDFLAGS
	string "LDFLAGS"

config GNU_AUTOMAKE_CFLAGS
	string "CFLAGS"

config GNU_AUTOMAKE_CONFIG
	string "configure"

endif # PK_GNU_AUTOMAKE
```

## depackage/gnu_bison/Kconfig
```kconfig
menuconfig PK_GNU_BISON
	bool "GNU - bison"

if PK_GNU_BISON

config GNU_BISON_VERSION
	default "3.2"
	string "verstion"

config GNU_BISON_TAR
	default "tar.gz"
	string "tar type"

config GNU_BISON_URL
	default "http://ftp.gnu.org/pub/gnu/bison/"
	string "url"

config GNU_BISON_CONFIG
	string "configure"

endif # PK_GNU_BISON
```

## depackage/gnu_fdisk/Kconfig
```kconfig
menuconfig PK_GNU_FDISK
	bool "GNU - fdisk"

if PK_GNU_FDISK

config GNU_FDISK_VERSION
	default "1.2"
	string "verstion"

config GNU_FDISK_TAR
	default "tar.gz"
	string "tar type"

config GNU_FDISK_URL
	default "http://ftp.gnu.org/pub/gnu/fdisk/"
	string "url"

config GNU_FDISK_LDFLAGS
	string "LDFLAGS"

config GNU_FDISK_CFLAGS
	string "CFLAGS"

config GNU_FDISK_CONFIG
	string "configure"

endif # PK_GNU_FDISK
```

## depackage/gnu_gawk/Kconfig
```kconfig
menuconfig PK_GNU_GAWK
	bool "GNU - gawk"

if PK_GNU_GAWK

config GNU_GAWK_VERSION
	default "5.0.0"
	string "verstion"

config GNU_GAWK_TAR
	default "tar.gz"
	string "tar type"

config GNU_GAWK_URL
	default "http://ftp.gnu.org/pub/gnu/gawk/"
	string "url"

config GNU_GAWK_LDFLAGS
	string "LDFLAGS"

config GNU_GAWK_CFLAGS
	string "CFLAGS"

config GNU_GAWK_CONFIG
	string "configure"

endif # PK_GNU_GAWK
```

## depackage/gnu_gdb/Kconfig
```kconfig
menuconfig PK_GNU_GDB
	bool "GNU - gdb"

if PK_GNU_GDB

config GNU_GDB_VERSION
	default "8.0"
	string "verstion"

config GNU_GDB_TAR
	default "tar.gz"
	string "tar type"

config GNU_GDB_URL
	default "http://ftp.gnu.org/pub/gnu/gdb/"
	string "url"

config GNU_GDB_LDFLAGS
	string "LDFLAGS"

config GNU_GDB_CFLAGS
	string "CFLAGS"

config GNU_GDB_CONFIG
	string "configure"

endif # PK_GNU_GDB
```

## depackage/gnu_glibc/Kconfig
```kconfig
menuconfig PK_GNU_GLIBC
	bool "GNU - glibc"

if PK_GNU_GLIBC

config GNU_GLIBC_VERSION
	default "2.24"
	string "verstion"

config GNU_GLIBC_TAR
	default "tar.gz"
	string "tar type"

config GNU_GLIBC_URL
	default "http://ftp.gnu.org/pub/gnu/glibc/"
	string "url"

config GNU_GLIBC_LDFLAGS
	string "LDFLAGS"

config GNU_GLIBC_CFLAGS
	string "CFLAGS"

config GNU_GLIBC_CONFIG
	default "--disable-nls --disable-werror --disable-multilib --enable-shared"
	string "configure"

endif # PK_GNU_GLIBC
```

## depackage/gnu_parted/Kconfig
```kconfig
menuconfig PK_GNU_PARTED
	bool "GNU - parted"

if PK_GNU_PARTED

config GNU_PARTED_VERSION
	default "2.1"
	string "verstion"

config GNU_PARTED_TAR
	default "tar.gz"
	string "tar type"

config GNU_PARTED_URL
	default "http://ftp.gnu.org/pub/gnu/parted/"
	string "url"

config GNU_PARTED_LDFLAGS
	default "-libuuid"
	string "LDFLAGS"

config GNU_PARTED_CFLAGS
	string "CFLAGS"

config GNU_PARTED_CONFIG
	default "--disable-device-mapper --without-readline"
	string "configure"

endif # PK_GNU_PARTED
```

## depackage/gnu_screen/Kconfig
```kconfig
menuconfig PK_GNU_SCREEN
	bool "GNU - screen"

if PK_GNU_SCREEN

config GNU_SCREEN_VERSION
	default "4.2.0"
	string "verstion"

config GNU_SCREEN_TAR
	default "tar.gz"
	string "tar type"

config GNU_SCREEN_URL
	default "http://ftp.gnu.org/pub/gnu/screen/"
	string "url"

config GNU_SCREEN_LDFLAGS
	string "LDFLAGS"

config GNU_SCREEN_CFLAGS
	string "CFLAGS"

config GNU_SCREEN_CONFIG
	string "configure"

endif # PK_GNU_SCREEN
```

## depackage/gobject-introspection/Kconfig
```kconfig
menuconfig PK_GOBJECT_INTROSPECTION
	bool "gobject-introspection"

if PK_GOBJECT_INTROSPECTION

config GOBJECT_INTROSPECTION_VERSION
	default "1.36.0"
	string "verstion"

config GOBJECT_INTROSPECTION_TAR
	default "tar.xz"
	string "tar type"

config GOBJECT_INTROSPECTION_URL
	default "http://ftp.gnome.org/pub/gnome/sources/gobject-introspection/1.36/"
	string "url"

config GOBJECT_INTROSPECTION_SRC
	string "source code list"

config GOBJECT_INTROSPECTION_LDFLAGS
	string "LDFLAGS"

config GOBJECT_INTROSPECTION_CFLAGS
	string "CFLAGS"

config GOBJECT_INTROSPECTION_CONFIG
	string "configure"

endif # PK_GOBJECT_INTROSPECTION
```

## depackage/gtk-xfce-engine/Kconfig
```kconfig
menuconfig PK_GTK_XFCE_ENGINE
	bool "gtk-xfce-engine"

if PK_GTK_XFCE_ENGINE

config GTK_XFCE_ENGINE_VERSION
	default "2.10.0" if XFCER4
	string "verstion"

config GTK_XFCE_ENGINE_TAR
	default "tar.bz2"
	string "tar type"

config GTK_XFCE_ENGINE_URL
	default "http://archive.xfce.org/src/xfce/" if XFCER4
	string "url"

config GTK_XFCE_ENGINE_SRC
	string "source code list"

config GTK_XFCE_ENGINE_LDFLAGS
	string "LDFLAGS"

config GTK_XFCE_ENGINE_CFLAGS
	string "CFLAGS"

config GTK_XFCE_ENGINE_CONFIG
	string "configure"

endif # PK_GTK_XFCE_ENGINE
```

## depackage/gtk/Kconfig
```kconfig
menuconfig PK_GTK
	select PK_GTK_ATK
	select PK_GTK_CAIRO
	select PK_GTK_PANGO
	select PK_LIBTIFF
	select PK_PIXMAN
	select PK_LIBJPEG
	select PK_LIBX11
	select X11R7_7
	select PK_DIRECTFB
	select PK_GDK_PIXBUF
	select PK_LIBX11
	select X11R7_7
	select PK_LIBXDAMAGE
	select PK_DAMAGEPROTO
	select PK_FIXESPROTO
	select PK_LIBXFIXES
	select PK_LIBXDAMAGE
	select PK_LIBXCURSOR
	bool "gtk"

if PK_GTK

choice
	prompt "GTK+ Release Version"
	
config GTKR2
	select PK_GLIB
	select GLIBR2
	bool "gtk+2"

config GTKR3
	select PK_GLIB
	select GLIBR2
	bool "gtk+3"

endchoice

config GTK_VERSION
	default "3.24.0" if GTKR3
	default "2.24.3" if GTKR2
	string "verstion"

config GTK_TAR
	default "tar.xz" if GTKR3
	default "tar.gz" if GTKR2
	string "tar type"

config GTK_URL
	default "http://ftp.gnome.org/pub/gnome/sources/gtk+/3.24/" if GTKR3
	default "http://ftp.gnome.org/pub/gnome/sources/gtk+/2.24/" if GTKR2
	string "url"

config GTK_SRC
	string "source code list"

config GTK_LDFLAGS
	string "LDFLAGS"

config GTK_CFLAGS
	string "CFLAGS"

config GTK_CONFIG
	string "configure"

endif # PK_GTK
```

## depackage/gtk_atk/Kconfig
```kconfig
menuconfig PK_GTK_ATK
	bool "atk"

if PK_GTK_ATK

config GTK_ATK_VERSION
	default "2.26.0" if GTKR3
	default "2.2.0" if GTKR2
	string "verstion"

config GTK_ATK_TAR
	default "tar.xz" if GTKR3
	default "tar.bz2" if GTKR2
	string "tar type"

config GTK_ATK_URL
	default "http://ftp.gnome.org/pub/gnome/sources/atk/2.26/" if GTKR3
	default "http://ftp.gnome.org/pub/gnome/sources/atk/2.2/" if GTKR2
	string "url"

config GTK_ATK_SRC
	string "source code list"

config GTK_ATK_LDFLAGS
	string "LDFLAGS"

config GTK_ATK_CFLAGS
	string "CFLAGS"

config GTK_ATK_CONFIG
	string "configure"

endif # PK_GTK_ATK
```
