## package/address-space/BiscuitOS-address-space-text-segment/Kconfig
```kconfig
menuconfig PK_BISCUITOS_AS_TEXT_SEGMENT
	bool "Text Segment: Stores ELF binary image"

if PK_BISCUITOS_AS_TEXT_SEGMENT

config PK_BISCUITOS_AS_TEXT_SEGMENT_VERSION
	default "default"
	string "verstion"

config PK_BISCUITOS_AS_TEXT_SEGMENT_TAR
	default "tar.gz"
	string "tar type"

config PK_BISCUITOS_AS_TEXT_SEGMENT_URL
	default "https://gitee.com/BiscuitOS_team/HardStack/raw/Gitee/Memory-Allocator/Address-Space/BiscuitOS-address-space-text-segment"
	string "url"

config PK_BISCUITOS_AS_TEXT_SEGMENT_GITHUB
	string "GitHub"

config PK_BISCUITOS_AS_TEXT_SEGMENT_SRCFILE
	default "main.c Makefile"
	string "Source code list"

config PK_BISCUITOS_AS_TEXT_SEGMENT_CSRCFILE
	string "Compile source code list"

config PK_BISCUITOS_AS_TEXT_SEGMENT_CONFIG
	string "CONFIG: Project Configure Options"

config PK_BISCUITOS_AS_TEXT_SEGMENT_LIBPATH
	string "LIBS: Libraries to pass to the linker, e.g. -l<library>"

config PK_BISCUITOS_AS_TEXT_SEGMENT_CPPFLAGS
	string "CPPFLAGS: C/C++ preprocessor flags, e.g. -I<include dir>"

config PK_BISCUITOS_AS_TEXT_SEGMENT_DPKCONFIG
	string "PKG_CONFIG_PATH: Directories to add to pkg-config's search path"

config PK_BISCUITOS_AS_TEXT_SEGMENT_CFLAGS
	string "CFLAGS: C compiler flags"

config PK_BISCUITOS_AS_TEXT_SEGMENT_LDFLAGS
	string "LDFLAGS: Linker flags"

config PK_BISCUITOS_AS_TEXT_SEGMENT_CXXFLAGS
	string "CXXFLAGS: C++ compiler flags"

config PK_BISCUITOS_AS_TEXT_SEGMENT_ASFLAGS
	string "CCASFLAGS: assembler compiler flags (defaults to CFLAGS)"

config PK_BISCUITOS_AS_TEXT_SEGMENT_BUILDARCH
	string "--host options on configure for Architecture"

endif # PK_BISCUITOS_AS_TEXT_SEGMENT
```

## package/address-space/Kconfig
```kconfig
menuconfig PK_ADDRESS_SPACE
	bool "Address Space Layout"

if PK_ADDRESS_SPACE

# TEXT Segment
source package/address-space/BiscuitOS-address-space-text-segment/Kconfig

# DATA Segment
source package/address-space/BiscuitOS-address-space-data-segment/Kconfig

# DATA Segment: Global variable
source package/address-space/BiscuitOS-address-space-data-segment-global/Kconfig

# DATA Segment: Global variable (Dynamic)
source package/address-space/BiscuitOS-address-space-data-segment-global-dynamic/Kconfig

# Process Address Space
source package/address-space/BiscuitOS-address-space-process/Kconfig

endif # PK_ADDRESS_SPACE
```

## package/algo_IDA/Kconfig
```kconfig
menuconfig PK_ALGO_IDA
	bool "Algo  IDA"

if PK_ALGO_IDA

config ALGO_IDA_VERSION
	default "0.11"
	string "verstion"

config ALGO_IDA_TAR
	string "tar type"

config ALGO_IDA_URL
	default "https://raw.githubusercontent.com/BiscuitOS/HardStack/master/Algorithem/IDA/Basic/"
	string "url"

config ALGO_IDA_LDFLAGS
	string "LDFLAGS"

config ALGO_IDA_CFLAGS
	default "-DCONFIG_BASE_SMALL=0"
	string "CFLAGS"

config ALGO_IDA_CONFIG
	string "configure"

config ALGO_IDA_SRC
	default "Makefile ida.c ida.h ida_run.c radix.c radix.h"
	string "source code list"

endif # PK_ALGO_IDA
```

## package/algo_IDR/Kconfig
```kconfig
menuconfig PK_ALGO_IDR
	bool "Algo  IDR"

if PK_ALGO_IDR

config ALGO_IDR_VERSION
	default "0.11"
	string "verstion"

config ALGO_IDR_TAR
	string "tar type"

config ALGO_IDR_URL
	default "https://raw.githubusercontent.com/BiscuitOS/HardStack/master/Algorithem/IDR/Basic/"
	string "url"

config ALGO_IDR_LDFLAGS
	string "LDFLAGS"

config ALGO_IDR_CFLAGS
	default "-DCONFIG_BASE_SMALL=0"
	string "CFLAGS"

config ALGO_IDR_CONFIG
	string "configure"

config ALGO_IDR_SRC
	default "Makefile idr.c idr.h idr_run.c radix.c radix.h"
	string "source code list"

endif # PK_ALGO_IDR
```

## package/algo_binarytree/Kconfig
```kconfig
menuconfig PK_ALGO_BINARYTREE
	bool "Algo  binary-tree"

if PK_ALGO_BINARYTREE

config ALGO_BINARYTREE_VERSION
	default "0.11"
	string "verstion"

config ALGO_BINARYTREE_TAR
	string "tar type"

config ALGO_BINARYTREE_URL
	default "https://raw.githubusercontent.com/BiscuitOS/HardStack/master/Algorithem/tree/binary-tree/Basic/"
	string "url"

config ALGO_BINARYTREE_LDFLAGS
	string "LDFLAGS"

config ALGO_BINARYTREE_CFLAGS
	string "CFLAGS"

config ALGO_BINARYTREE_CONFIG
	string "configure"

config ALGO_BINARYTREE_SRC
	default "binary.c"
	string "source code list"

config ALGO_BINARYTREE_CSRC
	default "binary.c"
	string "Compile source code list"

endif # PK_ALGO_BINARYTREE
```

## package/algo_radixtree/Kconfig
```kconfig
menuconfig PK_ALGO_RADIXTREE
	bool "Algo  Radix-tree"

if PK_ALGO_RADIXTREE

config ALGO_RADIXTREE_VERSION
	default "0.11"
	string "verstion"

config ALGO_RADIXTREE_TAR
	string "tar type"

config ALGO_RADIXTREE_URL
	default "https://raw.githubusercontent.com/BiscuitOS/HardStack/master/Algorithem/tree/radix-tree/Basic"
	string "url"

config ALGO_RADIXTREE_LDFLAGS
	string "LDFLAGS"

config ALGO_RADIXTREE_CFLAGS
	default "-DCONFIG_BASE_SMALL=0"
	string "CFLAGS"

config ALGO_RADIXTREE_CONFIG
	string "configure"

config ALGO_RADIXTREE_SRC
	default "Makefile radix.c radix.h radix_run.c"
	string "source code list"

config ALGO_RADIXTREE_CSRC
	default "radix.c radix_run.c"
	string "Compile source code list"

endif # PK_ALGO_RADIXTREE
```

## package/arm-asm/Kconfig
```kconfig
menuconfig PK_ARM_ASM
	bool "ARM Assembly Instruction Sets"

if PK_ARM_ASM

# bic
source package/arm-asm/bic/Kconfig

# mov
source package/arm-asm/mov/Kconfig

# .pushsection
source package/arm-asm/pushsection/Kconfig

# .popsection
source package/arm-asm/popsection/Kconfig

endif # PK_ARM_ASM
```

## package/arm-asm/bic/Kconfig
```kconfig
menuconfig PK_ARM_ASM_BIC
	bool "bic"

if PK_ARM_ASM_BIC

config PK_ARM_ASM_BIC_VERSION
	default "0.0.1"
	string "verstion"

config PK_ARM_ASM_BIC_TAR
	default "tar.gz"
	string "tar type"

config PK_ARM_ASM_BIC_URL
	default "https://gitee.com/BiscuitOS_team/HardStack/raw/Gitee/Language/Assembly/ARM-GNU-Assembly/Instruction/bic"
	string "url"

config PK_ARM_ASM_BIC_GITHUB
	string "GitHub"

config PK_ARM_ASM_BIC_SRCFILE
	default "asm.c Makefile"
	string "Source code list"

config PK_ARM_ASM_BIC_CSRCFILE
	string "Compile source code list"

config PK_ARM_ASM_BIC_CONFIG
	string "CONFIG: Project Configure Options"

config PK_ARM_ASM_BIC_LIBPATH
	string "LIBS: Libraries to pass to the linker, e.g. -l<library>"

config PK_ARM_ASM_BIC_CPPFLAGS
	string "CPPFLAGS: C/C++ preprocessor flags, e.g. -I<include dir>"

config PK_ARM_ASM_BIC_DPKCONFIG
	string "PKG_CONFIG_PATH: Directories to add to pkg-config's search path"

config PK_ARM_ASM_BIC_CFLAGS
	string "CFLAGS: C compiler flags"

config PK_ARM_ASM_BIC_LDFLAGS
	string "LDFLAGS: Linker flags"

config PK_ARM_ASM_BIC_CXXFLAGS
	string "CXXFLAGS: C++ compiler flags"

config PK_ARM_ASM_BIC_ASFLAGS
	string "CCASFLAGS: assembler compiler flags (defaults to CFLAGS)"

config PK_ARM_ASM_BIC_BUILDARCH
	string "--host options on configure for Architecture"

endif # PK_ARM_ASM_BIC
```

## package/arm-asm/mov/Kconfig
```kconfig
menuconfig PK_ARM_ASM_MOV
	bool "mov"

if PK_ARM_ASM_MOV

config PK_ARM_ASM_MOV_VERSION
	default "0.0.1"
	string "verstion"

config PK_ARM_ASM_MOV_TAR
	default "tar.gz"
	string "tar type"

config PK_ARM_ASM_MOV_URL
	default "https://gitee.com/BiscuitOS_team/HardStack/raw/Gitee/Language/Assembly/ARM-GNU-Assembly/Instruction/mov"
	string "url"

config PK_ARM_ASM_MOV_GITHUB
	string "GitHub"

config PK_ARM_ASM_MOV_SRCFILE
	default "asm.c Makefile"
	string "Source code list"

config PK_ARM_ASM_MOV_CSRCFILE
	string "Compile source code list"

config PK_ARM_ASM_MOV_CONFIG
	string "CONFIG: Project Configure Options"

config PK_ARM_ASM_MOV_LIBPATH
	string "LIBS: Libraries to pass to the linker, e.g. -l<library>"

config PK_ARM_ASM_MOV_CPPFLAGS
	string "CPPFLAGS: C/C++ preprocessor flags, e.g. -I<include dir>"

config PK_ARM_ASM_MOV_DPKCONFIG
	string "PKG_CONFIG_PATH: Directories to add to pkg-config's search path"

config PK_ARM_ASM_MOV_CFLAGS
	string "CFLAGS: C compiler flags"

config PK_ARM_ASM_MOV_LDFLAGS
	string "LDFLAGS: Linker flags"

config PK_ARM_ASM_MOV_CXXFLAGS
	string "CXXFLAGS: C++ compiler flags"

config PK_ARM_ASM_MOV_ASFLAGS
	string "CCASFLAGS: assembler compiler flags (defaults to CFLAGS)"

config PK_ARM_ASM_MOV_BUILDARCH
	string "--host options on configure for Architecture"

endif # PK_ARM_ASM_MOV
```

## package/arm-asm/popsection/Kconfig
```kconfig
menuconfig PK_ARM_ASM_POPSECTION
	bool ".popsection"

if PK_ARM_ASM_POPSECTION

config PK_ARM_ASM_POPSECTION_VERSION
	default "0.0.1"
	string "verstion"

config PK_ARM_ASM_POPSECTION_TAR
	default "tar.gz"
	string "tar type"

config PK_ARM_ASM_POPSECTION_URL
	default "https://gitee.com/BiscuitOS_team/HardStack/raw/Gitee/Language/Assembly/ARM-GNU-Assembly/Instruction/popsection"
	string "url"

config PK_ARM_ASM_POPSECTION_GITHUB
	string "GitHub"

config PK_ARM_ASM_POPSECTION_SRCFILE
	default "asm.c Makefile Kconfig"
	string "Source code list"

config PK_ARM_ASM_POPSECTION_CSRCFILE
	string "Compile source code list"

config PK_ARM_ASM_POPSECTION_CONFIG
	string "CONFIG: Project Configure Options"

config PK_ARM_ASM_POPSECTION_LIBPATH
	string "LIBS: Libraries to pass to the linker, e.g. -l<library>"

config PK_ARM_ASM_POPSECTION_CPPFLAGS
	string "CPPFLAGS: C/C++ preprocessor flags, e.g. -I<include dir>"

config PK_ARM_ASM_POPSECTION_DPKCONFIG
	string "PKG_CONFIG_PATH: Directories to add to pkg-config's search path"

config PK_ARM_ASM_POPSECTION_CFLAGS
	string "CFLAGS: C compiler flags"

config PK_ARM_ASM_POPSECTION_LDFLAGS
	string "LDFLAGS: Linker flags"

config PK_ARM_ASM_POPSECTION_CXXFLAGS
	string "CXXFLAGS: C++ compiler flags"

config PK_ARM_ASM_POPSECTION_ASFLAGS
	string "CCASFLAGS: assembler compiler flags (defaults to CFLAGS)"

config PK_ARM_ASM_POPSECTION_BUILDARCH
	string "--host options on configure for Architecture"

endif # PK_ARM_ASM_POPSECTION
```

## package/arm-asm/pushsection/Kconfig
```kconfig
menuconfig PK_ARM_ASM_PUSHSECTION
	bool ".pushsection"

if PK_ARM_ASM_PUSHSECTION

config PK_ARM_ASM_PUSHSECTION_VERSION
	default "0.0.1"
	string "verstion"

config PK_ARM_ASM_PUSHSECTION_TAR
	default "tar.gz"
	string "tar type"

config PK_ARM_ASM_PUSHSECTION_URL
	default "https://gitee.com/BiscuitOS_team/HardStack/raw/Gitee/Language/Assembly/ARM-GNU-Assembly/Instruction/pushsection"
	string "url"

config PK_ARM_ASM_PUSHSECTION_GITHUB
	string "GitHub"

config PK_ARM_ASM_PUSHSECTION_SRCFILE
	default "asm.c Makefile Kconfig"
	string "Source code list"

config PK_ARM_ASM_PUSHSECTION_CSRCFILE
	string "Compile source code list"

config PK_ARM_ASM_PUSHSECTION_CONFIG
	string "CONFIG: Project Configure Options"

config PK_ARM_ASM_PUSHSECTION_LIBPATH
	string "LIBS: Libraries to pass to the linker, e.g. -l<library>"

config PK_ARM_ASM_PUSHSECTION_CPPFLAGS
	string "CPPFLAGS: C/C++ preprocessor flags, e.g. -I<include dir>"

config PK_ARM_ASM_PUSHSECTION_DPKCONFIG
	string "PKG_CONFIG_PATH: Directories to add to pkg-config's search path"

config PK_ARM_ASM_PUSHSECTION_CFLAGS
	string "CFLAGS: C compiler flags"

config PK_ARM_ASM_PUSHSECTION_LDFLAGS
	string "LDFLAGS: Linker flags"

config PK_ARM_ASM_PUSHSECTION_CXXFLAGS
	string "CXXFLAGS: C++ compiler flags"

config PK_ARM_ASM_PUSHSECTION_ASFLAGS
	string "CCASFLAGS: assembler compiler flags (defaults to CFLAGS)"

config PK_ARM_ASM_PUSHSECTION_BUILDARCH
	string "--host options on configure for Architecture"

endif # PK_ARM_ASM_PUSHSECTION
```

## package/assembly/Kconfig
```kconfig
menuconfig PK_ASSEMBLY
	bool "Assembly"

if PK_ASSEMBLY

# X86 Architecture assembly
source package/assembly/x86/Kconfig

# inline assembly
source package/assembly/inline-asm/Kconfig

endif # PK_ASSEMBLY
```
