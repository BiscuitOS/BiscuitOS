## package/VFS/Kconfig
```kconfig
menuconfig PK_BISCUITOS_VFS
	bool "VFS (BiscuitOS+)"

if PK_BISCUITOS_VFS

# Anonymous file (Kernel Part+)
source package/VFS/Anonymous-file-kernel/Kconfig

# Anonymous file (Userspace Part+)
source package/VFS/Anonymous-file-userspace/Kconfig

# Kernel read Userspace file
source package/VFS/Kernel-read-Userspace-file/Kconfig

# Kernel write Userspace file
source package/VFS/Kernel-write-Userspace-file/Kconfig

endif # PK_BISCUITOS_VFS
```

## package/VFS/Kernel-read-Userspace-file/Kconfig
```kconfig
menuconfig PK_VFS_KERNEL_READ_UFILE
	bool "Kernel read Userspace file"

if PK_VFS_KERNEL_READ_UFILE

config PK_VFS_KERNEL_READ_UFILE_VERSION
	default "0.0.1"
	string "verstion"

config PK_VFS_KERNEL_READ_UFILE_TAR
	default "tar.gz"
	string "tar type"

config PK_VFS_KERNEL_READ_UFILE_URL
	default "https://gitee.com/BiscuitOS_team/HardStack/raw/Gitee/fs/vfs/Kernel-read-Userspace-file"
	string "url"

config PK_VFS_KERNEL_READ_UFILE_GITHUB
	string "GitHub"

config PK_VFS_KERNEL_READ_UFILE_SRCFILE
	default "main.c Kconfig Makefile"
	string "Source code list"

config PK_VFS_KERNEL_READ_UFILE_CSRCFILE
	string "Compile source code list"

config PK_VFS_KERNEL_READ_UFILE_CONFIG
	string "CONFIG: Project Configure Options"

config PK_VFS_KERNEL_READ_UFILE_LIBPATH
	string "LIBS: Libraries to pass to the linker, e.g. -l<library>"

config PK_VFS_KERNEL_READ_UFILE_CPPFLAGS
	string "CPPFLAGS: C/C++ preprocessor flags, e.g. -I<include dir>"

config PK_VFS_KERNEL_READ_UFILE_DPKCONFIG
	string "PKG_CONFIG_PATH: Directories to add to pkg-config's search path"

config PK_VFS_KERNEL_READ_UFILE_CFLAGS
	string "CFLAGS: C compiler flags"

config PK_VFS_KERNEL_READ_UFILE_LDFLAGS
	string "LDFLAGS: Linker flags"

config PK_VFS_KERNEL_READ_UFILE_CXXFLAGS
	string "CXXFLAGS: C++ compiler flags"

config PK_VFS_KERNEL_READ_UFILE_ASFLAGS
	string "CCASFLAGS: assembler compiler flags (defaults to CFLAGS)"

config PK_VFS_KERNEL_READ_UFILE_BUILDARCH
	string "--host options on configure for Architecture"

endif # PK_VFS_KERNEL_READ_UFILE
```

## package/Virtual-Address/BiscuitOS-VADDR-MECH-Detect-physcal-address/Kconfig
```kconfig
menuconfig PK_VADDR_MECH_DETECT_PADDR
	bool "Detect Physical Address on Userspace"

if PK_VADDR_MECH_DETECT_PADDR

config PK_VADDR_MECH_DETECT_PADDR_VERSION
	default "default"
	string "verstion"

config PK_VADDR_MECH_DETECT_PADDR_TAR
	default "tar.gz"
	string "tar type"

config PK_VADDR_MECH_DETECT_PADDR_URL
	default "https://gitee.com/BiscuitOS_team/HardStack/raw/Gitee/Memory-Allocator/VIRTUAL-ADDRESS-MECH/BiscuitOS-VADDR-MECH-Detect-physcal-address/"
	string "url"

config PK_VADDR_MECH_DETECT_PADDR_GITHUB
	string "GitHub"

config PK_VADDR_MECH_DETECT_PADDR_SRCFILE
	default "main.c Makefile"
	string "Source code list"

config PK_VADDR_MECH_DETECT_PADDR_CSRCFILE
	string "Compile source code list"

config PK_VADDR_MECH_DETECT_PADDR_CONFIG
	string "CONFIG: Project Configure Options"

config PK_VADDR_MECH_DETECT_PADDR_LIBPATH
	string "LIBS: Libraries to pass to the linker, e.g. -l<library>"

config PK_VADDR_MECH_DETECT_PADDR_CPPFLAGS
	string "CPPFLAGS: C/C++ preprocessor flags, e.g. -I<include dir>"

config PK_VADDR_MECH_DETECT_PADDR_DPKCONFIG
	string "PKG_CONFIG_PATH: Directories to add to pkg-config's search path"

config PK_VADDR_MECH_DETECT_PADDR_CFLAGS
	string "CFLAGS: C compiler flags"

config PK_VADDR_MECH_DETECT_PADDR_LDFLAGS
	string "LDFLAGS: Linker flags"

config PK_VADDR_MECH_DETECT_PADDR_CXXFLAGS
	string "CXXFLAGS: C++ compiler flags"

config PK_VADDR_MECH_DETECT_PADDR_ASFLAGS
	string "CCASFLAGS: assembler compiler flags (defaults to CFLAGS)"

config PK_VADDR_MECH_DETECT_PADDR_BUILDARCH
	string "--host options on configure for Architecture"

endif # PK_VADDR_MECH_DETECT_PADDR
```

## package/Virtual-Address/Kconfig
```kconfig
menuconfig PK_VADDR_MECH
	bool "Virtual Address Mechanism"

if PK_VADDR_MECH

# Detect Physical Address on Userspace
source package/Virtual-Address/BiscuitOS-VADDR-MECH-Detect-physcal-address/Kconfig

endif # PK_VADDR_MECH
```

## package/Xfce/Kconfig
```kconfig
menuconfig PK_XFCE
	select PK_LIBXFCE4UTIL
	select PK_LIBXFCE4UI
	select PK_GTK_XFCE_ENGINE
	bool "Xfce"

if PK_XFCE

choice
	prompt "XFCE4 Release Version"
	
config XFCER4
	bool "Xfce 4.12"

endchoice

config XFCE_VERSION
	default "4.12" if XFCER4
	string "verstion"

config XFCE_TAR
	default "tar.bz2"
	string "tar type"

config XFCE_URL
	default "http://archive.xfce.org/xfce/4.12/fat_tarballs/" if XFCER4
	string "url"

config XFCE_SRC
	string "source code list"

config XFCE_LDFLAGS
	string "LDFLAGS"

config XFCE_CFLAGS
	string "CFLAGS"

config XFCE_CONFIG
	string "configure"

endif # PK_XFCE
```

## package/Xorg/Kconfig
```kconfig
menuconfig PK_XORG
	select PK_EXPAT
	select PK_ZLIB
	select PK_LIBPNG
	select PK_OPENSSL
	select PK_XF86DRIPROTO
	select PK_XCMISCPROTO
	select PK_BIGREQSPROTO
	select PK_FONTSPROTO
	bool "Xorg-server"

if PK_XORG

config XORG_VERSION
	default "1.9.5"
	string "verstion"

config XORG_TAR
	default "tar.bz2"
	string "tar type"

config XORG_URL
	default "http://repository.timesys.com/buildsources/x/xorg-server/xorg-server-1.9.5/"
	string "url"

config XORG_SRC
	string "source code list"

config XORG_LDFLAGS
	string "LDFLAGS"

config XORG_CFLAGS
	string "CFLAGS"

config XORG_CONFIG
	string "configure"

endif # PK_XORG
```

## package/ZONE/BiscuitOS-ZONE-DEVICE/Kconfig
```kconfig
menuconfig PK_ZONE_DEVICE
	bool "ZONE_DEVICE"

if PK_ZONE_DEVICE

config PK_ZONE_DEVICE_VERSION
	default "default"
	string "verstion"

config PK_ZONE_DEVICE_TAR
	default "tar.gz"
	string "tar type"

config PK_ZONE_DEVICE_URL
	default "https://gitee.com/BiscuitOS_team/HardStack/raw/Gitee/Memory-Allocator/ZONE-MECH/BiscuitOS-ZONE-DEVICE"
	string "url"

config PK_ZONE_DEVICE_GITHUB
	string "GitHub"

config PK_ZONE_DEVICE_SRCFILE
	default "main.c Kconfig Makefile RunBiscuitOS.sh Makefile.host"
	string "Source code list"

config PK_ZONE_DEVICE_CSRCFILE
	string "Compile source code list"

config PK_ZONE_DEVICE_CONFIG
	string "CONFIG: Project Configure Options"

config PK_ZONE_DEVICE_LIBPATH
	string "LIBS: Libraries to pass to the linker, e.g. -l<library>"

config PK_ZONE_DEVICE_CPPFLAGS
	string "CPPFLAGS: C/C++ preprocessor flags, e.g. -I<include dir>"

config PK_ZONE_DEVICE_DPKCONFIG
	string "PKG_CONFIG_PATH: Directories to add to pkg-config's search path"

config PK_ZONE_DEVICE_CFLAGS
	string "CFLAGS: C compiler flags"

config PK_ZONE_DEVICE_LDFLAGS
	string "LDFLAGS: Linker flags"

config PK_ZONE_DEVICE_CXXFLAGS
	string "CXXFLAGS: C++ compiler flags"

config PK_ZONE_DEVICE_ASFLAGS
	string "CCASFLAGS: assembler compiler flags (defaults to CFLAGS)"

config PK_ZONE_DEVICE_BUILDARCH
	string "--host options on configure for Architecture"

endif # PK_ZONE_DEVICE
```

## package/ZONE/BiscuitOS-ZONE-alloc-page-ZONE_DMA/Kconfig
```kconfig
menuconfig PK_ZONE_ALLOC_ZONE_DMA
	bool "Alloc page from ZONE_DMA"

if PK_ZONE_ALLOC_ZONE_DMA

config PK_ZONE_ALLOC_ZONE_DMA_VERSION
	default "default"
	string "verstion"

config PK_ZONE_ALLOC_ZONE_DMA_TAR
	default "tar.gz"
	string "tar type"

config PK_ZONE_ALLOC_ZONE_DMA_URL
	default "https://gitee.com/BiscuitOS_team/HardStack/raw/Gitee/Memory-Allocator/ZONE/BiscuitOS-ZONE-alloc-page-ZONE_DMA"
	string "url"

config PK_ZONE_ALLOC_ZONE_DMA_GITHUB
	string "GitHub"

config PK_ZONE_ALLOC_ZONE_DMA_SRCFILE
	default "main.c Kconfig Makefile RunBiscuitOS.sh"
	string "Source code list"

config PK_ZONE_ALLOC_ZONE_DMA_CSRCFILE
	string "Compile source code list"

config PK_ZONE_ALLOC_ZONE_DMA_CONFIG
	string "CONFIG: Project Configure Options"

config PK_ZONE_ALLOC_ZONE_DMA_LIBPATH
	string "LIBS: Libraries to pass to the linker, e.g. -l<library>"

config PK_ZONE_ALLOC_ZONE_DMA_CPPFLAGS
	string "CPPFLAGS: C/C++ preprocessor flags, e.g. -I<include dir>"

config PK_ZONE_ALLOC_ZONE_DMA_DPKCONFIG
	string "PKG_CONFIG_PATH: Directories to add to pkg-config's search path"

config PK_ZONE_ALLOC_ZONE_DMA_CFLAGS
	string "CFLAGS: C compiler flags"

config PK_ZONE_ALLOC_ZONE_DMA_LDFLAGS
	string "LDFLAGS: Linker flags"

config PK_ZONE_ALLOC_ZONE_DMA_CXXFLAGS
	string "CXXFLAGS: C++ compiler flags"

config PK_ZONE_ALLOC_ZONE_DMA_ASFLAGS
	string "CCASFLAGS: assembler compiler flags (defaults to CFLAGS)"

config PK_ZONE_ALLOC_ZONE_DMA_BUILDARCH
	string "--host options on configure for Architecture"

endif # PK_ZONE_ALLOC_ZONE_DMA
```

## package/ZONE/Kconfig
```kconfig
menuconfig PK_ZONE
	bool "ZONE"

if PK_ZONE

# Alloc page from ZONE_DMA
source package/ZONE/BiscuitOS-ZONE-alloc-page-ZONE_DMA/Kconfig

# ZONE DEVICE
source package/ZONE/BiscuitOS-ZONE-DEVICE/Kconfig

endif # PK_ZONE
```

## package/address-space/BiscuitOS-address-space-data-segment-global-dynamic/Kconfig
```kconfig
menuconfig PK_BISCUITOS_AS_DATA_SEGMENT_GL_DL
	bool "Data Segment: Global Variable (Dynamic)"

if PK_BISCUITOS_AS_DATA_SEGMENT_GL_DL

config PK_BISCUITOS_AS_DATA_SEGMENT_GL_DL_VERSION
	default "default"
	string "verstion"

config PK_BISCUITOS_AS_DATA_SEGMENT_GL_DL_TAR
	default "tar.gz"
	string "tar type"

config PK_BISCUITOS_AS_DATA_SEGMENT_GL_DL_URL
	default "https://gitee.com/BiscuitOS_team/HardStack/raw/Gitee/Memory-Allocator/Address-Space/BiscuitOS-address-space-data-segment-global-dynamic"
	string "url"

config PK_BISCUITOS_AS_DATA_SEGMENT_GL_DL_GITHUB
	string "GitHub"

config PK_BISCUITOS_AS_DATA_SEGMENT_GL_DL_SRCFILE
	default "main-A.c main-B.c Makefile BiscuitOS-lib.c"
	string "Source code list"

config PK_BISCUITOS_AS_DATA_SEGMENT_GL_DL_CSRCFILE
	string "Compile source code list"

config PK_BISCUITOS_AS_DATA_SEGMENT_GL_DL_CONFIG
	string "CONFIG: Project Configure Options"

config PK_BISCUITOS_AS_DATA_SEGMENT_GL_DL_LIBPATH
	string "LIBS: Libraries to pass to the linker, e.g. -l<library>"

config PK_BISCUITOS_AS_DATA_SEGMENT_GL_DL_CPPFLAGS
	string "CPPFLAGS: C/C++ preprocessor flags, e.g. -I<include dir>"

config PK_BISCUITOS_AS_DATA_SEGMENT_GL_DL_DPKCONFIG
	string "PKG_CONFIG_PATH: Directories to add to pkg-config's search path"

config PK_BISCUITOS_AS_DATA_SEGMENT_GL_DL_CFLAGS
	string "CFLAGS: C compiler flags"

config PK_BISCUITOS_AS_DATA_SEGMENT_GL_DL_LDFLAGS
	string "LDFLAGS: Linker flags"

config PK_BISCUITOS_AS_DATA_SEGMENT_GL_DL_CXXFLAGS
	string "CXXFLAGS: C++ compiler flags"

config PK_BISCUITOS_AS_DATA_SEGMENT_GL_DL_ASFLAGS
	string "CCASFLAGS: assembler compiler flags (defaults to CFLAGS)"

config PK_BISCUITOS_AS_DATA_SEGMENT_GL_DL_BUILDARCH
	string "--host options on configure for Architecture"

endif # PK_BISCUITOS_AS_DATA_SEGMENT_GL_DL
```

## package/address-space/BiscuitOS-address-space-data-segment-global/Kconfig
```kconfig
menuconfig PK_BISCUITOS_AS_DATA_SEGMENT_GL
	bool "Data Segment: Global Variable"

if PK_BISCUITOS_AS_DATA_SEGMENT_GL

config PK_BISCUITOS_AS_DATA_SEGMENT_GL_VERSION
	default "default"
	string "verstion"

config PK_BISCUITOS_AS_DATA_SEGMENT_GL_TAR
	default "tar.gz"
	string "tar type"

config PK_BISCUITOS_AS_DATA_SEGMENT_GL_URL
	default "https://gitee.com/BiscuitOS_team/HardStack/raw/Gitee/Memory-Allocator/Address-Space/BiscuitOS-address-space-data-segment-global"
	string "url"

config PK_BISCUITOS_AS_DATA_SEGMENT_GL_GITHUB
	string "GitHub"

config PK_BISCUITOS_AS_DATA_SEGMENT_GL_SRCFILE
	default "main.c Makefile BiscuitOS.c"
	string "Source code list"

config PK_BISCUITOS_AS_DATA_SEGMENT_GL_CSRCFILE
	string "Compile source code list"

config PK_BISCUITOS_AS_DATA_SEGMENT_GL_CONFIG
	string "CONFIG: Project Configure Options"

config PK_BISCUITOS_AS_DATA_SEGMENT_GL_LIBPATH
	string "LIBS: Libraries to pass to the linker, e.g. -l<library>"

config PK_BISCUITOS_AS_DATA_SEGMENT_GL_CPPFLAGS
	string "CPPFLAGS: C/C++ preprocessor flags, e.g. -I<include dir>"

config PK_BISCUITOS_AS_DATA_SEGMENT_GL_DPKCONFIG
	string "PKG_CONFIG_PATH: Directories to add to pkg-config's search path"

config PK_BISCUITOS_AS_DATA_SEGMENT_GL_CFLAGS
	string "CFLAGS: C compiler flags"

config PK_BISCUITOS_AS_DATA_SEGMENT_GL_LDFLAGS
	string "LDFLAGS: Linker flags"

config PK_BISCUITOS_AS_DATA_SEGMENT_GL_CXXFLAGS
	string "CXXFLAGS: C++ compiler flags"

config PK_BISCUITOS_AS_DATA_SEGMENT_GL_ASFLAGS
	string "CCASFLAGS: assembler compiler flags (defaults to CFLAGS)"

config PK_BISCUITOS_AS_DATA_SEGMENT_GL_BUILDARCH
	string "--host options on configure for Architecture"

endif # PK_BISCUITOS_AS_DATA_SEGMENT_GL
```

## package/address-space/BiscuitOS-address-space-data-segment/Kconfig
```kconfig
menuconfig PK_BISCUITOS_AS_DATA_SEGMENT
	bool "Data Segment: Stores Data for ELF"

if PK_BISCUITOS_AS_DATA_SEGMENT

config PK_BISCUITOS_AS_DATA_SEGMENT_VERSION
	default "default"
	string "verstion"

config PK_BISCUITOS_AS_DATA_SEGMENT_TAR
	default "tar.gz"
	string "tar type"

config PK_BISCUITOS_AS_DATA_SEGMENT_URL
	default "https://gitee.com/BiscuitOS_team/HardStack/raw/Gitee/Memory-Allocator/Address-Space/BiscuitOS-address-space-data-segment"
	string "url"

config PK_BISCUITOS_AS_DATA_SEGMENT_GITHUB
	string "GitHub"

config PK_BISCUITOS_AS_DATA_SEGMENT_SRCFILE
	default "main.c Makefile"
	string "Source code list"

config PK_BISCUITOS_AS_DATA_SEGMENT_CSRCFILE
	string "Compile source code list"

config PK_BISCUITOS_AS_DATA_SEGMENT_CONFIG
	string "CONFIG: Project Configure Options"

config PK_BISCUITOS_AS_DATA_SEGMENT_LIBPATH
	string "LIBS: Libraries to pass to the linker, e.g. -l<library>"

config PK_BISCUITOS_AS_DATA_SEGMENT_CPPFLAGS
	string "CPPFLAGS: C/C++ preprocessor flags, e.g. -I<include dir>"

config PK_BISCUITOS_AS_DATA_SEGMENT_DPKCONFIG
	string "PKG_CONFIG_PATH: Directories to add to pkg-config's search path"

config PK_BISCUITOS_AS_DATA_SEGMENT_CFLAGS
	string "CFLAGS: C compiler flags"

config PK_BISCUITOS_AS_DATA_SEGMENT_LDFLAGS
	string "LDFLAGS: Linker flags"

config PK_BISCUITOS_AS_DATA_SEGMENT_CXXFLAGS
	string "CXXFLAGS: C++ compiler flags"

config PK_BISCUITOS_AS_DATA_SEGMENT_ASFLAGS
	string "CCASFLAGS: assembler compiler flags (defaults to CFLAGS)"

config PK_BISCUITOS_AS_DATA_SEGMENT_BUILDARCH
	string "--host options on configure for Architecture"

endif # PK_BISCUITOS_AS_DATA_SEGMENT
```

## package/address-space/BiscuitOS-address-space-process/Kconfig
```kconfig
menuconfig PK_BISCUITOS_AS_PROCESS
	bool "Process address space"

if PK_BISCUITOS_AS_PROCESS

config PK_BISCUITOS_AS_PROCESS_VERSION
	default "default"
	string "verstion"

config PK_BISCUITOS_AS_PROCESS_TAR
	default "tar.gz"
	string "tar type"

config PK_BISCUITOS_AS_PROCESS_URL
	default "https://gitee.com/BiscuitOS_team/HardStack/raw/Gitee/Memory-Allocator/Address-Space/BiscuitOS-address-space-process"
	string "url"

config PK_BISCUITOS_AS_PROCESS_GITHUB
	string "GitHub"

config PK_BISCUITOS_AS_PROCESS_SRCFILE
	default "main.c Makefile"
	string "Source code list"

config PK_BISCUITOS_AS_PROCESS_CSRCFILE
	string "Compile source code list"

config PK_BISCUITOS_AS_PROCESS_CONFIG
	string "CONFIG: Project Configure Options"

config PK_BISCUITOS_AS_PROCESS_LIBPATH
	string "LIBS: Libraries to pass to the linker, e.g. -l<library>"

config PK_BISCUITOS_AS_PROCESS_CPPFLAGS
	string "CPPFLAGS: C/C++ preprocessor flags, e.g. -I<include dir>"

config PK_BISCUITOS_AS_PROCESS_DPKCONFIG
	string "PKG_CONFIG_PATH: Directories to add to pkg-config's search path"

config PK_BISCUITOS_AS_PROCESS_CFLAGS
	string "CFLAGS: C compiler flags"

config PK_BISCUITOS_AS_PROCESS_LDFLAGS
	string "LDFLAGS: Linker flags"

config PK_BISCUITOS_AS_PROCESS_CXXFLAGS
	string "CXXFLAGS: C++ compiler flags"

config PK_BISCUITOS_AS_PROCESS_ASFLAGS
	string "CCASFLAGS: assembler compiler flags (defaults to CFLAGS)"

config PK_BISCUITOS_AS_PROCESS_BUILDARCH
	string "--host options on configure for Architecture"

endif # PK_BISCUITOS_AS_PROCESS
```
