## package/misc/misc_module/Kconfig
```kconfig
menuconfig PK_MISC_MOD
	bool "MISC Device Driver Module"

if PK_MISC_MOD

config PK_MISC_MOD_VERSION
	default "0.0.1"
	string "verstion"

config PK_MISC_MOD_TAR
	default "tar.gz"
	string "tar type"

config PK_MISC_MOD_URL
	default "https://gitee.com/BiscuitOS_team/HardStack/raw/Gitee/Device-Driver/misc/Base/kernel"
	string "url"

config PK_MISC_MOD_GITHUB
	string "GitHub"

config PK_MISC_MOD_SRCFILE
	default "misc.c Kconfig Makefile"
	string "Source code list"

config PK_MISC_MOD_CSRCFILE
	string "Compile source code list"

config PK_MISC_MOD_CONFIG
	string "CONFIG: Project Configure Options"

config PK_MISC_MOD_LIBPATH
	string "LIBS: Libraries to pass to the linker, e.g. -l<library>"

config PK_MISC_MOD_CPPFLAGS
	string "CPPFLAGS: C/C++ preprocessor flags, e.g. -I<include dir>"

config PK_MISC_MOD_DPKCONFIG
	string "PKG_CONFIG_PATH: Directories to add to pkg-config's search path"

config PK_MISC_MOD_CFLAGS
	string "CFLAGS: C compiler flags"

config PK_MISC_MOD_LDFLAGS
	string "LDFLAGS: Linker flags"

config PK_MISC_MOD_CXXFLAGS
	string "CXXFLAGS: C++ compiler flags"

config PK_MISC_MOD_ASFLAGS
	string "CCASFLAGS: assembler compiler flags (defaults to CFLAGS)"

config PK_MISC_MOD_BUILDARCH
	string "--host options on configure for Architecture"

endif # PK_MISC_MOD
```

## package/mmio/Broiler-Synchronous-mmio-In-Kernel/Kconfig
```kconfig
menuconfig PK_MMIO_SYNC_INKERNEL
	bool "Sychronous MMIO Driver In-Kernel for Broiler"

if PK_MMIO_SYNC_INKERNEL

config PK_MMIO_SYNC_INKERNEL_VERSION
	default "default"
	string "verstion"

config PK_MMIO_SYNC_INKERNEL_TAR
	default "tar.gz"
	string "tar type"

config PK_MMIO_SYNC_INKERNEL_URL
	default "https://gitee.com/BiscuitOS_team/HardStack/raw/Gitee/Memory-Allocator/MMIO/Broiler-Synchronous-mmio-In-Kernel"
	string "url"

config PK_MMIO_SYNC_INKERNEL_GITHUB
	string "GitHub"

config PK_MMIO_SYNC_INKERNEL_SRCFILE
	default "main.c Kconfig Makefile RunBiscuitOS.sh"
	string "Source code list"

config PK_MMIO_SYNC_INKERNEL_CSRCFILE
	string "Compile source code list"

config PK_MMIO_SYNC_INKERNEL_CONFIG
	string "CONFIG: Project Configure Options"

config PK_MMIO_SYNC_INKERNEL_LIBPATH
	string "LIBS: Libraries to pass to the linker, e.g. -l<library>"

config PK_MMIO_SYNC_INKERNEL_CPPFLAGS
	string "CPPFLAGS: C/C++ preprocessor flags, e.g. -I<include dir>"

config PK_MMIO_SYNC_INKERNEL_DPKCONFIG
	string "PKG_CONFIG_PATH: Directories to add to pkg-config's search path"

config PK_MMIO_SYNC_INKERNEL_CFLAGS
	string "CFLAGS: C compiler flags"

config PK_MMIO_SYNC_INKERNEL_LDFLAGS
	string "LDFLAGS: Linker flags"

config PK_MMIO_SYNC_INKERNEL_CXXFLAGS
	string "CXXFLAGS: C++ compiler flags"

config PK_MMIO_SYNC_INKERNEL_ASFLAGS
	string "CCASFLAGS: assembler compiler flags (defaults to CFLAGS)"

config PK_MMIO_SYNC_INKERNEL_BUILDARCH
	string "--host options on configure for Architecture"

endif # PK_MMIO_SYNC_INKERNEL
```

## package/mmio/Broiler-Synchronous-mmio-PCI/Kconfig
```kconfig
menuconfig PK_MMIO_SYNC_PCI
	bool "Sychronous MMIO Driver with PCI for Broiler"

if PK_MMIO_SYNC_PCI

config PK_MMIO_SYNC_PCI_VERSION
	default "default"
	string "verstion"

config PK_MMIO_SYNC_PCI_TAR
	default "tar.gz"
	string "tar type"

config PK_MMIO_SYNC_PCI_URL
	default "https://gitee.com/BiscuitOS_team/HardStack/raw/Gitee/Memory-Allocator/MMIO/Broiler-Synchronous-mmio-PCI"
	string "url"

config PK_MMIO_SYNC_PCI_GITHUB
	string "GitHub"

config PK_MMIO_SYNC_PCI_SRCFILE
	default "main.c Kconfig Makefile RunBiscuitOS.sh"
	string "Source code list"

config PK_MMIO_SYNC_PCI_CSRCFILE
	string "Compile source code list"

config PK_MMIO_SYNC_PCI_CONFIG
	string "CONFIG: Project Configure Options"

config PK_MMIO_SYNC_PCI_LIBPATH
	string "LIBS: Libraries to pass to the linker, e.g. -l<library>"

config PK_MMIO_SYNC_PCI_CPPFLAGS
	string "CPPFLAGS: C/C++ preprocessor flags, e.g. -I<include dir>"

config PK_MMIO_SYNC_PCI_DPKCONFIG
	string "PKG_CONFIG_PATH: Directories to add to pkg-config's search path"

config PK_MMIO_SYNC_PCI_CFLAGS
	string "CFLAGS: C compiler flags"

config PK_MMIO_SYNC_PCI_LDFLAGS
	string "LDFLAGS: Linker flags"

config PK_MMIO_SYNC_PCI_CXXFLAGS
	string "CXXFLAGS: C++ compiler flags"

config PK_MMIO_SYNC_PCI_ASFLAGS
	string "CCASFLAGS: assembler compiler flags (defaults to CFLAGS)"

config PK_MMIO_SYNC_PCI_BUILDARCH
	string "--host options on configure for Architecture"

endif # PK_MMIO_SYNC_PCI
```

## package/mmio/Kconfig
```kconfig
menuconfig PK_MMIO
	bool "MMIO: Memory Mapped IO"

if PK_MMIO

# Broiler Sychronous MMIO
source package/mmio/Broiler-Synchronous-mmio/Kconfig

# Broiler Sychronous MMIO In-Kernel
source package/mmio/Broiler-Synchronous-mmio-In-Kernel/Kconfig

# Broiler Sychronous MMIO with PCI
source package/mmio/Broiler-Synchronous-mmio-PCI/Kconfig

# Broiler Asychronous MMIO
source package/mmio/Broiler-Asynchronous-mmio/Kconfig

# Broiler Asychronous MMIO with PCI
source package/mmio/Broiler-Asynchronous-mmio-PCI/Kconfig

endif # PK_MMIO
```

## package/module/Application_project/Kconfig
```kconfig
menuconfig PK_APP_PROJ
	bool "Application Project"

if PK_APP_PROJ

config PK_APP_PROJ_VERSION
	default "0.0.1"
	string "verstion"

config PK_APP_PROJ_TAR
	default "tar.gz"
	string "tar type"

config PK_APP_PROJ_URL
	default "https://gitee.com/BiscuitOS_team/HardStack/raw/Gitee/Device-Driver/base/App"
	string "url"

config PK_APP_PROJ_GITHUB
	string "GitHub"

config PK_APP_PROJ_SRCFILE
	default "core.c include/linux/demo.h src/demo.c Makefile"
	string "Source code list"

config PK_APP_PROJ_CSRCFILE
	string "Compile source code list"

config PK_APP_PROJ_CONFIG
	string "CONFIG: Project Configure Options"

config PK_APP_PROJ_LIBPATH
	string "LIBS: Libraries to pass to the linker, e.g. -l<library>"

config PK_APP_PROJ_CPPFLAGS
	string "CPPFLAGS: C/C++ preprocessor flags, e.g. -I<include dir>"

config PK_APP_PROJ_DPKCONFIG
	string "PKG_CONFIG_PATH: Directories to add to pkg-config's search path"

config PK_APP_PROJ_CFLAGS
	string "CFLAGS: C compiler flags"

config PK_APP_PROJ_LDFLAGS
	string "LDFLAGS: Linker flags"

config PK_APP_PROJ_CXXFLAGS
	string "CXXFLAGS: C++ compiler flags"

config PK_APP_PROJ_ASFLAGS
	string "CCASFLAGS: assembler compiler flags (defaults to CFLAGS)"

config PK_APP_PROJ_BUILDARCH
	string "--host options on configure for Architecture"

endif # PK_APP_PROJ
```

## package/module/Kconfig
```kconfig
menuconfig PK_MOD
	bool "Module: Linux Device Driver"

if PK_MOD

# Application Project
source package/module/Application_project/Kconfig

# Module Project
source package/module/Module_project/Kconfig

# Basic Device Driver Module
source package/module/module_core/Kconfig

endif # PK_MOD
```

## package/module/Module_project/Kconfig
```kconfig
menuconfig PK_MOD_PROJ
	bool "Module Project"

if PK_MOD_PROJ

config PK_MOD_PROJ_VERSION
	default "0.0.1"
	string "verstion"

config PK_MOD_PROJ_TAR
	default "tar.gz"
	string "tar type"

config PK_MOD_PROJ_URL
	default "https://gitee.com/BiscuitOS_team/HardStack/raw/Gitee/Device-Driver/base/Module"
	string "url"

config PK_MOD_PROJ_GITHUB
	string "GitHub"

config PK_MOD_PROJ_SRCFILE
	default "core.c Kconfig Makefile include/linux/demo.h src/demo.c"
	string "Source code list"

config PK_MOD_PROJ_CSRCFILE
	string "Compile source code list"

config PK_MOD_PROJ_CONFIG
	string "CONFIG: Project Configure Options"

config PK_MOD_PROJ_LIBPATH
	string "LIBS: Libraries to pass to the linker, e.g. -l<library>"

config PK_MOD_PROJ_CPPFLAGS
	string "CPPFLAGS: C/C++ preprocessor flags, e.g. -I<include dir>"

config PK_MOD_PROJ_DPKCONFIG
	string "PKG_CONFIG_PATH: Directories to add to pkg-config's search path"

config PK_MOD_PROJ_CFLAGS
	string "CFLAGS: C compiler flags"

config PK_MOD_PROJ_LDFLAGS
	string "LDFLAGS: Linker flags"

config PK_MOD_PROJ_CXXFLAGS
	string "CXXFLAGS: C++ compiler flags"

config PK_MOD_PROJ_ASFLAGS
	string "CCASFLAGS: assembler compiler flags (defaults to CFLAGS)"

config PK_MOD_PROJ_BUILDARCH
	string "--host options on configure for Architecture"

endif # PK_MOD_PROJ
```
