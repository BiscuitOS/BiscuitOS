## package/memory_history/PERCPU/linux-2.6.13.1/Kconfig
```kconfig
menuconfig PK_PERCPU_2_6_13_1
	bool "PERCPU on linux 2.6.13.1"

if PK_PERCPU_2_6_13_1

config PK_PERCPU_2_6_13_1_VERSION
	default "2.6.13.1"
	string "verstion"

config PK_PERCPU_2_6_13_1_TAR
	default "tar.gz"
	string "tar type"

config PK_PERCPU_2_6_13_1_URL
	default "https://gitee.com/BiscuitOS_team/HardStack/raw/Gitee/Memory-Allocator/History/mm/mm_bs"
	string "url"

config PK_PERCPU_2_6_13_1_GITHUB
	string "GitHub"
	default "https://gitee.com/BiscuitOS_team/BiscuitOS_Memory.git"

config PK_PERCPU_2_6_13_1_SRCFILE
	default "README.md"
	string "Source code list"

config PK_PERCPU_2_6_13_1_CSRCFILE
	string "Compile source code list"

config PK_PERCPU_2_6_13_1_CONFIG
	string "CONFIG: Project Configure Options"

config PK_PERCPU_2_6_13_1_LIBPATH
	string "LIBS: Libraries to pass to the linker, e.g. -l<library>"

config PK_PERCPU_2_6_13_1_CPPFLAGS
	string "CPPFLAGS: C/C++ preprocessor flags, e.g. -I<include dir>"

config PK_PERCPU_2_6_13_1_DPKCONFIG
	string "PKG_CONFIG_PATH: Directories to add to pkg-config's search path"

config PK_PERCPU_2_6_13_1_CFLAGS
	string "CFLAGS: C compiler flags"

config PK_PERCPU_2_6_13_1_LDFLAGS
	string "LDFLAGS: Linker flags"

config PK_PERCPU_2_6_13_1_CXXFLAGS
	string "CXXFLAGS: C++ compiler flags"

config PK_PERCPU_2_6_13_1_ASFLAGS
	string "CCASFLAGS: assembler compiler flags (defaults to CFLAGS)"

config PK_PERCPU_2_6_13_1_BUILDARCH
	string "--host options on configure for Architecture"

endif # PK_PERCPU_2_6_13_1
```

## package/memory_history/SLAB/linux-2.6.12.6/Kconfig
```kconfig
menuconfig PK_SLAB_2_6_12_6
	bool "SLAB on linux 2.6.12.6"

if PK_SLAB_2_6_12_6

config PK_SLAB_2_6_12_6_VERSION
	default "2.6.12.6"
	string "verstion"

config PK_SLAB_2_6_12_6_TAR
	default "tar.gz"
	string "tar type"

config PK_SLAB_2_6_12_6_URL
	default "https://gitee.com/BiscuitOS_team/HardStack/raw/Gitee/Memory-Allocator/History/mm/mm_bs"
	string "url"

config PK_SLAB_2_6_12_6_GITHUB
	string "GitHub"
	default "https://gitee.com/BiscuitOS_team/BiscuitOS_Memory.git"

config PK_SLAB_2_6_12_6_SRCFILE
	default "README.md"
	string "Source code list"

config PK_SLAB_2_6_12_6_CSRCFILE
	string "Compile source code list"

config PK_SLAB_2_6_12_6_CONFIG
	string "CONFIG: Project Configure Options"

config PK_SLAB_2_6_12_6_LIBPATH
	string "LIBS: Libraries to pass to the linker, e.g. -l<library>"

config PK_SLAB_2_6_12_6_CPPFLAGS
	string "CPPFLAGS: C/C++ preprocessor flags, e.g. -I<include dir>"

config PK_SLAB_2_6_12_6_DPKCONFIG
	string "PKG_CONFIG_PATH: Directories to add to pkg-config's search path"

config PK_SLAB_2_6_12_6_CFLAGS
	string "CFLAGS: C compiler flags"

config PK_SLAB_2_6_12_6_LDFLAGS
	string "LDFLAGS: Linker flags"

config PK_SLAB_2_6_12_6_CXXFLAGS
	string "CXXFLAGS: C++ compiler flags"

config PK_SLAB_2_6_12_6_ASFLAGS
	string "CCASFLAGS: assembler compiler flags (defaults to CFLAGS)"

config PK_SLAB_2_6_12_6_BUILDARCH
	string "--host options on configure for Architecture"

endif # PK_SLAB_2_6_12_6
```

## package/memory_history/VMALLOC/Kconfig
```kconfig
menuconfig PK_VMALLOC_HISTORY
	bool "VMALLOC Allocator"

if PK_VMALLOC_HISTORY

# linux 2.6.12
source "package/memory_history/VMALLOC/linux-2.6.12/Kconfig"

endif # PK_VMALLOC_HISTORY
```

## package/memory_history/VMALLOC/linux-2.6.14/Kconfig
```kconfig
menuconfig PK_VMALLOC_2_6_14
	bool "VMALLOC on linux 2.6.14"

if PK_VMALLOC_2_6_14

config PK_VMALLOC_2_6_14_VERSION
	default "2.6.14"
	string "verstion"

config PK_VMALLOC_2_6_14_TAR
	default "tar.gz"
	string "tar type"

config PK_VMALLOC_2_6_14_URL
	default "https://gitee.com/BiscuitOS_team/HardStack/raw/Gitee/Memory-Allocator/History/mm/mm_bs"
	string "url"

config PK_VMALLOC_2_6_14_GITHUB
	string "GitHub"
	default "https://gitee.com/BiscuitOS_team/BiscuitOS_Memory.git"

config PK_VMALLOC_2_6_14_SRCFILE
	default "README.md"
	string "Source code list"

config PK_VMALLOC_2_6_14_CSRCFILE
	string "Compile source code list"

config PK_VMALLOC_2_6_14_CONFIG
	string "CONFIG: Project Configure Options"

config PK_VMALLOC_2_6_14_LIBPATH
	string "LIBS: Libraries to pass to the linker, e.g. -l<library>"

config PK_VMALLOC_2_6_14_CPPFLAGS
	string "CPPFLAGS: C/C++ preprocessor flags, e.g. -I<include dir>"

config PK_VMALLOC_2_6_14_DPKCONFIG
	string "PKG_CONFIG_PATH: Directories to add to pkg-config's search path"

config PK_VMALLOC_2_6_14_CFLAGS
	string "CFLAGS: C compiler flags"

config PK_VMALLOC_2_6_14_LDFLAGS
	string "LDFLAGS: Linker flags"

config PK_VMALLOC_2_6_14_CXXFLAGS
	string "CXXFLAGS: C++ compiler flags"

config PK_VMALLOC_2_6_14_ASFLAGS
	string "CCASFLAGS: assembler compiler flags (defaults to CFLAGS)"

config PK_VMALLOC_2_6_14_BUILDARCH
	string "--host options on configure for Architecture"

endif # PK_VMALLOC_2_6_14
```

## package/memory_history/bootmem/Kconfig
```kconfig
menuconfig PK_BOOTMEM_HISTORY
	bool "Bootmem Allocator"

if PK_BOOTMEM_HISTORY

# linux 2.6.12
source "package/memory_history/bootmem/linux-2.6.12/Kconfig"

# linux 2.6.12.1
source "package/memory_history/bootmem/linux-2.6.12.1/Kconfig"

# linux 2.6.12.2
source "package/memory_history/bootmem/linux-2.6.12.2/Kconfig"

# linux 2.6.12.3
source "package/memory_history/bootmem/linux-2.6.12.3/Kconfig"

# linux 2.6.12.4
source "package/memory_history/bootmem/linux-2.6.12.4/Kconfig"

# linux 2.6.12.5
source "package/memory_history/bootmem/linux-2.6.12.5/Kconfig"

# linux 2.6.12.6
source "package/memory_history/bootmem/linux-2.6.12.6/Kconfig"

# linux 2.6.13
source "package/memory_history/bootmem/linux-2.6.13/Kconfig"

# linux 2.6.13.1
source "package/memory_history/bootmem/linux-2.6.13.1/Kconfig"

# linux 2.6.14
source "package/memory_history/bootmem/linux-2.6.14/Kconfig"

# linux 2.6.15
source "package/memory_history/bootmem/linux-2.6.15/Kconfig"

endif # PK_BOOTMEM_HISTORY
```

## package/memory_history/bootmem/linux-2.6.15/Kconfig
```kconfig
menuconfig PK_BOOTMEM_2_6_15
	bool "bootmem on linux 2.6.15"

if PK_BOOTMEM_2_6_15

config PK_BOOTMEM_2_6_15_VERSION
	default "2.6.15"
	string "verstion"

config PK_BOOTMEM_2_6_15_TAR
	default "tar.gz"
	string "tar type"

config PK_BOOTMEM_2_6_15_URL
	default "https://gitee.com/BiscuitOS_team/HardStack/raw/Gitee/Memory-Allocator/History/mm/mm_bs"
	string "url"

config PK_BOOTMEM_2_6_15_GITHUB
	string "GitHub"
	default "https://gitee.com/BiscuitOS_team/BiscuitOS_Memory.git"

config PK_BOOTMEM_2_6_15_SRCFILE
	default "README.md"
	string "Source code list"

config PK_BOOTMEM_2_6_15_CSRCFILE
	string "Compile source code list"

config PK_BOOTMEM_2_6_15_CONFIG
	string "CONFIG: Project Configure Options"

config PK_BOOTMEM_2_6_15_LIBPATH
	string "LIBS: Libraries to pass to the linker, e.g. -l<library>"

config PK_BOOTMEM_2_6_15_CPPFLAGS
	string "CPPFLAGS: C/C++ preprocessor flags, e.g. -I<include dir>"

config PK_BOOTMEM_2_6_15_DPKCONFIG
	string "PKG_CONFIG_PATH: Directories to add to pkg-config's search path"

config PK_BOOTMEM_2_6_15_CFLAGS
	string "CFLAGS: C compiler flags"

config PK_BOOTMEM_2_6_15_LDFLAGS
	string "LDFLAGS: Linker flags"

config PK_BOOTMEM_2_6_15_CXXFLAGS
	string "CXXFLAGS: C++ compiler flags"

config PK_BOOTMEM_2_6_15_ASFLAGS
	string "CCASFLAGS: assembler compiler flags (defaults to CFLAGS)"

config PK_BOOTMEM_2_6_15_BUILDARCH
	string "--host options on configure for Architecture"

endif # PK_BOOTMEM_2_6_15
```

## package/memory_history/buddy/Kconfig
```kconfig
menuconfig PK_BUDDY_HISTORY
	bool "Buddy Allocator"

if PK_BUDDY_HISTORY

# linux 2.6.12
source "package/memory_history/buddy/linux-2.6.12/Kconfig"

# linux 2.6.12.1
source "package/memory_history/buddy/linux-2.6.12.1/Kconfig"

# linux 2.6.12.2
source "package/memory_history/buddy/linux-2.6.12.2/Kconfig"

# linux 2.6.12.3
source "package/memory_history/buddy/linux-2.6.12.3/Kconfig"

# linux 2.6.12.4
source "package/memory_history/buddy/linux-2.6.12.4/Kconfig"

# linux 2.6.12.5
source "package/memory_history/buddy/linux-2.6.12.5/Kconfig"

# linux 2.6.12.6
source "package/memory_history/buddy/linux-2.6.12.6/Kconfig"

# linux 2.6.13
source "package/memory_history/buddy/linux-2.6.13/Kconfig"

# linux 2.6.13.1
source "package/memory_history/buddy/linux-2.6.13.1/Kconfig"

# linux 2.6.14
source "package/memory_history/buddy/linux-2.6.14/Kconfig"

# linux 2.6.15
source "package/memory_history/buddy/linux-2.6.15/Kconfig"

endif # PK_BUDDY_HISTORY
```

## package/memory_history/buddy/linux-2.6.13/Kconfig
```kconfig
menuconfig PK_BUDDY_2_6_13
	bool "buddy on linux 2.6.13"

if PK_BUDDY_2_6_13

config PK_BUDDY_2_6_13_VERSION
	default "2.6.13"
	string "verstion"

config PK_BUDDY_2_6_13_TAR
	default "tar.gz"
	string "tar type"

config PK_BUDDY_2_6_13_URL
	default "https://gitee.com/BiscuitOS_team/HardStack/raw/Gitee/Memory-Allocator/History/mm/mm_bs"
	string "url"

config PK_BUDDY_2_6_13_GITHUB
	string "GitHub"
	default "https://gitee.com/BiscuitOS_team/BiscuitOS_Memory.git"

config PK_BUDDY_2_6_13_SRCFILE
	default "README.md"
	string "Source code list"

config PK_BUDDY_2_6_13_CSRCFILE
	string "Compile source code list"

config PK_BUDDY_2_6_13_CONFIG
	string "CONFIG: Project Configure Options"

config PK_BUDDY_2_6_13_LIBPATH
	string "LIBS: Libraries to pass to the linker, e.g. -l<library>"

config PK_BUDDY_2_6_13_CPPFLAGS
	string "CPPFLAGS: C/C++ preprocessor flags, e.g. -I<include dir>"

config PK_BUDDY_2_6_13_DPKCONFIG
	string "PKG_CONFIG_PATH: Directories to add to pkg-config's search path"

config PK_BUDDY_2_6_13_CFLAGS
	string "CFLAGS: C compiler flags"

config PK_BUDDY_2_6_13_LDFLAGS
	string "LDFLAGS: Linker flags"

config PK_BUDDY_2_6_13_CXXFLAGS
	string "CXXFLAGS: C++ compiler flags"

config PK_BUDDY_2_6_13_ASFLAGS
	string "CCASFLAGS: assembler compiler flags (defaults to CFLAGS)"

config PK_BUDDY_2_6_13_BUILDARCH
	string "--host options on configure for Architecture"

endif # PK_BUDDY_2_6_13
```

## package/memory_history/fixmap/Kconfig
```kconfig
menuconfig PK_FIXMAP_HISTORY
	bool "Fixmap Allocator"

if PK_FIXMAP_HISTORY

# linux 2.6.12
source "package/memory_history/fixmap/linux-2.6.12/Kconfig"

endif # PK_FIXMAP_HISTORY
```

## package/memory_history/kmap/Kconfig
```kconfig
menuconfig PK_KMAP_HISTORY
	bool "Kmap Allocator"

if PK_KMAP_HISTORY

# linux 2.6.12
source "package/memory_history/kmap/linux-2.6.12/Kconfig"

endif # PK_KMAP_HISTORY
```

## package/memory_history/mm/Kconfig
```kconfig
menuconfig PK_MM_HISTORY
	bool "mm"

if PK_MM_HISTORY

# mm_bs
source "package/memory_history/mm/mm_bs/Kconfig"

endif # PK_MM_HISTORY
```

## package/memory_history/mm/mm_bs/Kconfig
```kconfig
menuconfig PK_MM_BS
	bool "mm (BiscuitOS Cornerstone)"

if PK_MM_BS

config PK_MM_BS_VERSION
	default "0.0.1"
	string "verstion"

config PK_MM_BS_TAR
	default "tar.gz"
	string "tar type"

config PK_MM_BS_URL
	default "https://gitee.com/BiscuitOS_team/HardStack/raw/Gitee/Memory-Allocator/History/mm/mm_bs"
	string "url"

config PK_MM_BS_GITHUB
	string "GitHub"
	default "https://gitee.com/BiscuitOS_team/BiscuitOS_Memory.git"

config PK_MM_BS_SRCFILE
	default "README.md main.c RunBiscuitOS_mm.sh Makefile default.dts Kconfig include/linux/demo.h src/demo.c mm/demo.c"
	string "Source code list"

config PK_MM_BS_CSRCFILE
	string "Compile source code list"

config PK_MM_BS_CONFIG
	string "CONFIG: Project Configure Options"

config PK_MM_BS_LIBPATH
	string "LIBS: Libraries to pass to the linker, e.g. -l<library>"

config PK_MM_BS_CPPFLAGS
	string "CPPFLAGS: C/C++ preprocessor flags, e.g. -I<include dir>"

config PK_MM_BS_DPKCONFIG
	string "PKG_CONFIG_PATH: Directories to add to pkg-config's search path"

config PK_MM_BS_CFLAGS
	string "CFLAGS: C compiler flags"

config PK_MM_BS_LDFLAGS
	string "LDFLAGS: Linker flags"

config PK_MM_BS_CXXFLAGS
	string "CXXFLAGS: C++ compiler flags"

config PK_MM_BS_ASFLAGS
	string "CCASFLAGS: assembler compiler flags (defaults to CFLAGS)"

config PK_MM_BS_BUILDARCH
	string "--host options on configure for Architecture"

endif # PK_MM_BS
```

## package/memory_history/slab/Kconfig
```kconfig
menuconfig PK_SLAB_HISTORY
	bool "SLAB Allocator"

if PK_SLAB_HISTORY

# linux 2.6.12
source "package/memory_history/slab/linux-2.6.12/Kconfig"

endif # PK_SLAB_HISTORY
```

## package/memory_history/slob/Kconfig
```kconfig
menuconfig PK_SLOB_HISTORY
	bool "SLOB Allocator"

if PK_SLOB_HISTORY

endif # PK_SLOB_HISTORY
```

## package/memory_history/slub/Kconfig
```kconfig
menuconfig PK_SLUB_HISTORY
	bool "SLUB Allocator"

if PK_SLUB_HISTORY

endif # PK_SLUB_HISTORY
```

## package/mesa/Kconfig
```kconfig
menuconfig PK_MESA
	select PK_LIBDRM
	select PK_EXPAT
	select PK_GLPROTO
	select PK_DRI2PROTO
	select PK_LIBXDAMAGE
	bool "mesa"

if PK_MESA

config PK_MESA_VERSION
	default "17.0.1"
	string "verstion"

config PK_MESA_TAR
	default "tar.xz"
	string "tar type"

config PK_MESA_URL
	default "http://repository.timesys.com/buildsources/m/Mesa/Mesa-17.0.1/"
	string "url"

config PK_MESA_GITHUB
	string "GitHub"

config PK_MESA_SRCFILE
	string "Source code list"

config PK_MESA_CONFIG
	default "--enable-silent-rules -C --disable-static --enable-dri3=no --enable-gallium-llvm=no --disable-omx --enable-gallium-tests=no --enable-gallium-osmesa=no -enable-glx=dri --with-gallium-drivers=swrast --with-dri-drivers=swrast  --enable-va=no --enable-vdpau=no --with-egl-platforms=drm"
	string "CONFIG: Project Configure Options"

config PK_MESA_LIBPATH
	string "LIBS: Libraries to pass to the linker, e.g. -l<library>"

config PK_MESA_CPPFLAGS
	string "CPPFLAGS: C/C++ preprocessor flags, e.g. -I<include dir>"

config PK_MESA_DPKCONFIG
	string "PKG_CONFIG_PATH: Directories to add to pkg-config's search path"

config PK_MESA_CFLAGS
	string "CFLAGS: C compiler flags"

config PK_MESA_LDFLAGS
	string "LDFLAGS: Linker flags"

config PK_MESA_CXXFLAGS
	string "CXXFLAGS: C++ compiler flags"

config PK_MESA_ASFLAGS
	string "CCASFLAGS: assembler compiler flags (defaults to CFLAGS)"

config PK_MESA_BUILDARCH
	default "x86_64-unknown-linux-gnu"
	string "--host options on configure for Architecture"

endif # PK_MESA
```

## package/misc/Kconfig
```kconfig
menuconfig PK_MISC
	bool "MISC Device Driver and Application"

if PK_MISC

# MISC application
source package/misc/misc_app/Kconfig

# MISC Module
source package/misc/misc_module/Kconfig

endif # PK_MISC
```

## package/misc/misc_app/Kconfig
```kconfig
menuconfig PK_MISC_APP
	select PK_MISC_MOD
	bool "MISC Device Driver Application"

if PK_MISC_APP

config PK_MISC_APP_VERSION
	default "0.0.1"
	string "verstion"

config PK_MISC_APP_TAR
	default "tar.gz"
	string "tar type"

config PK_MISC_APP_URL
	default "https://gitee.com/BiscuitOS_team/HardStack/raw/Gitee/Device-Driver/misc/Base/userland"
	string "url"

config PK_MISC_APP_GITHUB
	string "GitHub"

config PK_MISC_APP_SRCFILE
	default "misc.c misc.sh Makefile"
	string "Source code list"

config PK_MISC_APP_CSRCFILE
	string "Compile source code list"

config PK_MISC_APP_CONFIG
	string "CONFIG: Project Configure Options"

config PK_MISC_APP_LIBPATH
	string "LIBS: Libraries to pass to the linker, e.g. -l<library>"

config PK_MISC_APP_CPPFLAGS
	string "CPPFLAGS: C/C++ preprocessor flags, e.g. -I<include dir>"

config PK_MISC_APP_DPKCONFIG
	string "PKG_CONFIG_PATH: Directories to add to pkg-config's search path"

config PK_MISC_APP_CFLAGS
	string "CFLAGS: C compiler flags"

config PK_MISC_APP_LDFLAGS
	string "LDFLAGS: Linker flags"

config PK_MISC_APP_CXXFLAGS
	string "CXXFLAGS: C++ compiler flags"

config PK_MISC_APP_ASFLAGS
	string "CCASFLAGS: assembler compiler flags (defaults to CFLAGS)"

config PK_MISC_APP_BUILDARCH
	string "--host options on configure for Architecture"

endif # PK_MISC_APP
```
