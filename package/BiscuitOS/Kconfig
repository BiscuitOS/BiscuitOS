## package/CACHE/BiscuitOS-CACHE-DMA-IOMMU/Kconfig
```kconfig
menuconfig PK_CACHE_DMA_IOMMU
	bool "DMA: DMA IOMMU(WB/UC) Memory"

if PK_CACHE_DMA_IOMMU

config PK_CACHE_DMA_IOMMU_VERSION
	default "default"
	string "verstion"

config PK_CACHE_DMA_IOMMU_TAR
	default "tar.gz"
	string "tar type"

config PK_CACHE_DMA_IOMMU_URL
	default "https://gitee.com/BiscuitOS_team/HardStack/raw/Gitee/Memory-Allocator/CACHE-MECH/BiscuitOS-CACHE-DMA-IOMMU"
	string "url"

config PK_CACHE_DMA_IOMMU_GITHUB
	string "GitHub"

config PK_CACHE_DMA_IOMMU_SRCFILE
	default "Kconfig main.c Makefile Makefile.host README.md RunBiscuitOS.sh"
	string "Source code list"

config PK_CACHE_DMA_IOMMU_CSRCFILE
	string "Compile source code list"

config PK_CACHE_DMA_IOMMU_CONFIG
	string "CONFIG: Project Configure Options"

config PK_CACHE_DMA_IOMMU_LIBPATH
	string "LIBS: Libraries to pass to the linker, e.g. -l<library>"

config PK_CACHE_DMA_IOMMU_CPPFLAGS
	string "CPPFLAGS: C/C++ preprocessor flags, e.g. -I<include dir>"

config PK_CACHE_DMA_IOMMU_DPKCONFIG
	string "PKG_CONFIG_PATH: Directories to add to pkg-config's search path"

config PK_CACHE_DMA_IOMMU_CFLAGS
	string "CFLAGS: C compiler flags"

config PK_CACHE_DMA_IOMMU_LDFLAGS
	string "LDFLAGS: Linker flags"

config PK_CACHE_DMA_IOMMU_CXXFLAGS
	string "CXXFLAGS: C++ compiler flags"

config PK_CACHE_DMA_IOMMU_ASFLAGS
	string "CCASFLAGS: assembler compiler flags (defaults to CFLAGS)"

config PK_CACHE_DMA_IOMMU_BUILDARCH
	string "--host options on configure for Architecture"

endif # PK_CACHE_DMA_IOMMU
```

## package/CACHE/BiscuitOS-CACHE-DMA-NOCACHE/Kconfig
```kconfig
menuconfig PK_CACHE_DMA_NOCACHE
	bool "DMA: DMA NOCACHE(UC) Memory"

if PK_CACHE_DMA_NOCACHE

config PK_CACHE_DMA_NOCACHE_VERSION
	default "default"
	string "verstion"

config PK_CACHE_DMA_NOCACHE_TAR
	default "tar.gz"
	string "tar type"

config PK_CACHE_DMA_NOCACHE_URL
	default "https://gitee.com/BiscuitOS_team/HardStack/raw/Gitee/Memory-Allocator/CACHE-MECH/BiscuitOS-CACHE-DMA-NOCACHE"
	string "url"

config PK_CACHE_DMA_NOCACHE_GITHUB
	string "GitHub"

config PK_CACHE_DMA_NOCACHE_SRCFILE
	default "main.c Kconfig Makefile Makefile.host RunBiscuitOS.sh"
	string "Source code list"

config PK_CACHE_DMA_NOCACHE_CSRCFILE
	string "Compile source code list"

config PK_CACHE_DMA_NOCACHE_CONFIG
	string "CONFIG: Project Configure Options"

config PK_CACHE_DMA_NOCACHE_LIBPATH
	string "LIBS: Libraries to pass to the linker, e.g. -l<library>"

config PK_CACHE_DMA_NOCACHE_CPPFLAGS
	string "CPPFLAGS: C/C++ preprocessor flags, e.g. -I<include dir>"

config PK_CACHE_DMA_NOCACHE_DPKCONFIG
	string "PKG_CONFIG_PATH: Directories to add to pkg-config's search path"

config PK_CACHE_DMA_NOCACHE_CFLAGS
	string "CFLAGS: C compiler flags"

config PK_CACHE_DMA_NOCACHE_LDFLAGS
	string "LDFLAGS: Linker flags"

config PK_CACHE_DMA_NOCACHE_CXXFLAGS
	string "CXXFLAGS: C++ compiler flags"

config PK_CACHE_DMA_NOCACHE_ASFLAGS
	string "CCASFLAGS: assembler compiler flags (defaults to CFLAGS)"

config PK_CACHE_DMA_NOCACHE_BUILDARCH
	string "--host options on configure for Architecture"

endif # PK_CACHE_DMA_NOCACHE
```

## package/CACHE/BiscuitOS-CACHE-DMA-POOL/Kconfig
```kconfig
menuconfig PK_CACHE_DMA_POOL
	bool "DMA: DMA-POOL(WB/UC) Memory"

if PK_CACHE_DMA_POOL

config PK_CACHE_DMA_POOL_VERSION
	default "default"
	string "verstion"

config PK_CACHE_DMA_POOL_TAR
	default "tar.gz"
	string "tar type"

config PK_CACHE_DMA_POOL_URL
	default "https://gitee.com/BiscuitOS_team/HardStack/raw/Gitee/Memory-Allocator/CACHE-MECH/BiscuitOS-CACHE-DMA-POOL"
	string "url"

config PK_CACHE_DMA_POOL_GITHUB
	string "GitHub"

config PK_CACHE_DMA_POOL_SRCFILE
	default "app.c Kconfig main.c Makefile Makefile.host README.md RunBiscuitOS.sh"
	string "Source code list"

config PK_CACHE_DMA_POOL_CSRCFILE
	string "Compile source code list"

config PK_CACHE_DMA_POOL_CONFIG
	string "CONFIG: Project Configure Options"

config PK_CACHE_DMA_POOL_LIBPATH
	string "LIBS: Libraries to pass to the linker, e.g. -l<library>"

config PK_CACHE_DMA_POOL_CPPFLAGS
	string "CPPFLAGS: C/C++ preprocessor flags, e.g. -I<include dir>"

config PK_CACHE_DMA_POOL_DPKCONFIG
	string "PKG_CONFIG_PATH: Directories to add to pkg-config's search path"

config PK_CACHE_DMA_POOL_CFLAGS
	string "CFLAGS: C compiler flags"

config PK_CACHE_DMA_POOL_LDFLAGS
	string "LDFLAGS: Linker flags"

config PK_CACHE_DMA_POOL_CXXFLAGS
	string "CXXFLAGS: C++ compiler flags"

config PK_CACHE_DMA_POOL_ASFLAGS
	string "CCASFLAGS: assembler compiler flags (defaults to CFLAGS)"

config PK_CACHE_DMA_POOL_BUILDARCH
	string "--host options on configure for Architecture"

endif # PK_CACHE_DMA_POOL
```

## package/CACHE/BiscuitOS-CACHE-DMA-STREAMING/Kconfig
```kconfig
menuconfig PK_CACHE_DMA_STREAMING
	bool "DMA: DMA Streaming(WB) Memory"

if PK_CACHE_DMA_STREAMING

config PK_CACHE_DMA_STREAMING_VERSION
	default "default"
	string "verstion"

config PK_CACHE_DMA_STREAMING_TAR
	default "tar.gz"
	string "tar type"

config PK_CACHE_DMA_STREAMING_URL
	default "https://gitee.com/BiscuitOS_team/HardStack/raw/Gitee/Memory-Allocator/CACHE-MECH/BiscuitOS-CACHE-DMA-STREAMING"
	string "url"

config PK_CACHE_DMA_STREAMING_GITHUB
	string "GitHub"

config PK_CACHE_DMA_STREAMING_SRCFILE
	default "main.c Kconfig Makefile Makefile.host RunBiscuitOS.sh"
	string "Source code list"

config PK_CACHE_DMA_STREAMING_CSRCFILE
	string "Compile source code list"

config PK_CACHE_DMA_STREAMING_CONFIG
	string "CONFIG: Project Configure Options"

config PK_CACHE_DMA_STREAMING_LIBPATH
	string "LIBS: Libraries to pass to the linker, e.g. -l<library>"

config PK_CACHE_DMA_STREAMING_CPPFLAGS
	string "CPPFLAGS: C/C++ preprocessor flags, e.g. -I<include dir>"

config PK_CACHE_DMA_STREAMING_DPKCONFIG
	string "PKG_CONFIG_PATH: Directories to add to pkg-config's search path"

config PK_CACHE_DMA_STREAMING_CFLAGS
	string "CFLAGS: C compiler flags"

config PK_CACHE_DMA_STREAMING_LDFLAGS
	string "LDFLAGS: Linker flags"

config PK_CACHE_DMA_STREAMING_CXXFLAGS
	string "CXXFLAGS: C++ compiler flags"

config PK_CACHE_DMA_STREAMING_ASFLAGS
	string "CCASFLAGS: assembler compiler flags (defaults to CFLAGS)"

config PK_CACHE_DMA_STREAMING_BUILDARCH
	string "--host options on configure for Architecture"

endif # PK_CACHE_DMA_STREAMING
```

## package/CACHE/BiscuitOS-CACHE-FLUSH-CACHE-CLFLUSH-USERSPACE/Kconfig
```kconfig
menuconfig PK_CACHE_FLUSH_CACHE_CLFLUSH_U
	bool "FLUSH CACHE: CLFLUSH on Userspace _mm_clflush()"

if PK_CACHE_FLUSH_CACHE_CLFLUSH_U

config PK_CACHE_FLUSH_CACHE_CLFLUSH_U_VERSION
	default "default"
	string "verstion"

config PK_CACHE_FLUSH_CACHE_CLFLUSH_U_TAR
	default "tar.gz"
	string "tar type"

config PK_CACHE_FLUSH_CACHE_CLFLUSH_U_URL
	default "https://gitee.com/BiscuitOS_team/HardStack/raw/Gitee/Memory-Allocator/CACHE-MECH/BiscuitOS-CACHE-FLUSH-CACHE-CLFLUSH-USERSPACE"
	string "url"

config PK_CACHE_FLUSH_CACHE_CLFLUSH_U_GITHUB
	string "GitHub"

config PK_CACHE_FLUSH_CACHE_CLFLUSH_U_SRCFILE
	default "main.c Makefile"
	string "Source code list"

config PK_CACHE_FLUSH_CACHE_CLFLUSH_U_CSRCFILE
	string "Compile source code list"

config PK_CACHE_FLUSH_CACHE_CLFLUSH_U_CONFIG
	string "CONFIG: Project Configure Options"

config PK_CACHE_FLUSH_CACHE_CLFLUSH_U_LIBPATH
	string "LIBS: Libraries to pass to the linker, e.g. -l<library>"

config PK_CACHE_FLUSH_CACHE_CLFLUSH_U_CPPFLAGS
	string "CPPFLAGS: C/C++ preprocessor flags, e.g. -I<include dir>"

config PK_CACHE_FLUSH_CACHE_CLFLUSH_U_DPKCONFIG
	string "PKG_CONFIG_PATH: Directories to add to pkg-config's search path"

config PK_CACHE_FLUSH_CACHE_CLFLUSH_U_CFLAGS
	string "CFLAGS: C compiler flags"

config PK_CACHE_FLUSH_CACHE_CLFLUSH_U_LDFLAGS
	string "LDFLAGS: Linker flags"

config PK_CACHE_FLUSH_CACHE_CLFLUSH_U_CXXFLAGS
	string "CXXFLAGS: C++ compiler flags"

config PK_CACHE_FLUSH_CACHE_CLFLUSH_U_ASFLAGS
	string "CCASFLAGS: assembler compiler flags (defaults to CFLAGS)"

config PK_CACHE_FLUSH_CACHE_CLFLUSH_U_BUILDARCH
	string "--host options on configure for Architecture"

endif # PK_CACHE_FLUSH_CACHE_CLFLUSH_U
```

## package/CACHE/BiscuitOS-CACHE-FLUSH-CACHE-DMA/Kconfig
```kconfig
menuconfig PK_CACHE_FLUSH_CACHE_DMA
	bool "FLUSH CACHE: Flush for DMA"

if PK_CACHE_FLUSH_CACHE_DMA

config PK_CACHE_FLUSH_CACHE_DMA_VERSION
	default "default"
	string "verstion"

config PK_CACHE_FLUSH_CACHE_DMA_TAR
	default "tar.gz"
	string "tar type"

config PK_CACHE_FLUSH_CACHE_DMA_URL
	default "https://gitee.com/BiscuitOS_team/HardStack/raw/Gitee/Memory-Allocator/CACHE-MECH/BiscuitOS-CACHE-FLUSH-CACHE-DMA"
	string "url"

config PK_CACHE_FLUSH_CACHE_DMA_GITHUB
	string "GitHub"

config PK_CACHE_FLUSH_CACHE_DMA_SRCFILE
	default "app.c main.c Kconfig Makefile Makefile.host RunBiscuitOS.sh"
	string "Source code list"

config PK_CACHE_FLUSH_CACHE_DMA_CSRCFILE
	string "Compile source code list"

config PK_CACHE_FLUSH_CACHE_DMA_CONFIG
	string "CONFIG: Project Configure Options"

config PK_CACHE_FLUSH_CACHE_DMA_LIBPATH
	string "LIBS: Libraries to pass to the linker, e.g. -l<library>"

config PK_CACHE_FLUSH_CACHE_DMA_CPPFLAGS
	string "CPPFLAGS: C/C++ preprocessor flags, e.g. -I<include dir>"

config PK_CACHE_FLUSH_CACHE_DMA_DPKCONFIG
	string "PKG_CONFIG_PATH: Directories to add to pkg-config's search path"

config PK_CACHE_FLUSH_CACHE_DMA_CFLAGS
	string "CFLAGS: C compiler flags"

config PK_CACHE_FLUSH_CACHE_DMA_LDFLAGS
	string "LDFLAGS: Linker flags"

config PK_CACHE_FLUSH_CACHE_DMA_CXXFLAGS
	string "CXXFLAGS: C++ compiler flags"

config PK_CACHE_FLUSH_CACHE_DMA_ASFLAGS
	string "CCASFLAGS: assembler compiler flags (defaults to CFLAGS)"

config PK_CACHE_FLUSH_CACHE_DMA_BUILDARCH
	string "--host options on configure for Architecture"

endif # PK_CACHE_FLUSH_CACHE_DMA
```

## package/CACHE/BiscuitOS-CACHE-FLUSH-CACHE-THREAD/Kconfig
```kconfig
menuconfig PK_CACHE_FLUSH_CACHE_THREAD
	bool "FLUSH CACHE: Flush for Thread"

if PK_CACHE_FLUSH_CACHE_THREAD

config PK_CACHE_FLUSH_CACHE_THREAD_VERSION
	default "default"
	string "verstion"

config PK_CACHE_FLUSH_CACHE_THREAD_TAR
	default "tar.gz"
	string "tar type"

config PK_CACHE_FLUSH_CACHE_THREAD_URL
	default "https://gitee.com/BiscuitOS_team/HardStack/raw/Gitee/Memory-Allocator/CACHE-MECH/BiscuitOS-CACHE-FLUSH-CACHE-THREAD"
	string "url"

config PK_CACHE_FLUSH_CACHE_THREAD_GITHUB
	string "GitHub"

config PK_CACHE_FLUSH_CACHE_THREAD_SRCFILE
	default "main.c Makefile"
	string "Source code list"

config PK_CACHE_FLUSH_CACHE_THREAD_CSRCFILE
	string "Compile source code list"

config PK_CACHE_FLUSH_CACHE_THREAD_CONFIG
	string "CONFIG: Project Configure Options"

config PK_CACHE_FLUSH_CACHE_THREAD_LIBPATH
	string "LIBS: Libraries to pass to the linker, e.g. -l<library>"

config PK_CACHE_FLUSH_CACHE_THREAD_CPPFLAGS
	string "CPPFLAGS: C/C++ preprocessor flags, e.g. -I<include dir>"

config PK_CACHE_FLUSH_CACHE_THREAD_DPKCONFIG
	string "PKG_CONFIG_PATH: Directories to add to pkg-config's search path"

config PK_CACHE_FLUSH_CACHE_THREAD_CFLAGS
	string "CFLAGS: C compiler flags"

config PK_CACHE_FLUSH_CACHE_THREAD_LDFLAGS
	string "LDFLAGS: Linker flags"

config PK_CACHE_FLUSH_CACHE_THREAD_CXXFLAGS
	string "CXXFLAGS: C++ compiler flags"

config PK_CACHE_FLUSH_CACHE_THREAD_ASFLAGS
	string "CCASFLAGS: assembler compiler flags (defaults to CFLAGS)"

config PK_CACHE_FLUSH_CACHE_THREAD_BUILDARCH
	string "--host options on configure for Architecture"

endif # PK_CACHE_FLUSH_CACHE_THREAD
```

## package/CACHE/BiscuitOS-CACHE-INSTRUCT-CLFLUSH/Kconfig
```kconfig
menuconfig PK_CACHE_INSTRUCT_CLFLUSH
	bool "CACHE Instruction(X86): CLFLUSH - Flush CACHE Line"

if PK_CACHE_INSTRUCT_CLFLUSH

config PK_CACHE_INSTRUCT_CLFLUSH_VERSION
	default "default"
	string "verstion"

config PK_CACHE_INSTRUCT_CLFLUSH_TAR
	default "tar.gz"
	string "tar type"

config PK_CACHE_INSTRUCT_CLFLUSH_URL
	default "https://gitee.com/BiscuitOS_team/HardStack/raw/Gitee/Memory-Allocator/CACHE-MECH/BiscuitOS-CACHE-INSTRUCT-CLFLUSH"
	string "url"

config PK_CACHE_INSTRUCT_CLFLUSH_GITHUB
	string "GitHub"

config PK_CACHE_INSTRUCT_CLFLUSH_SRCFILE
	default "main.c Kconfig Makefile Makefile.host RunBiscuitOS.sh"
	string "Source code list"

config PK_CACHE_INSTRUCT_CLFLUSH_CSRCFILE
	string "Compile source code list"

config PK_CACHE_INSTRUCT_CLFLUSH_CONFIG
	string "CONFIG: Project Configure Options"

config PK_CACHE_INSTRUCT_CLFLUSH_LIBPATH
	string "LIBS: Libraries to pass to the linker, e.g. -l<library>"

config PK_CACHE_INSTRUCT_CLFLUSH_CPPFLAGS
	string "CPPFLAGS: C/C++ preprocessor flags, e.g. -I<include dir>"

config PK_CACHE_INSTRUCT_CLFLUSH_DPKCONFIG
	string "PKG_CONFIG_PATH: Directories to add to pkg-config's search path"

config PK_CACHE_INSTRUCT_CLFLUSH_CFLAGS
	string "CFLAGS: C compiler flags"

config PK_CACHE_INSTRUCT_CLFLUSH_LDFLAGS
	string "LDFLAGS: Linker flags"

config PK_CACHE_INSTRUCT_CLFLUSH_CXXFLAGS
	string "CXXFLAGS: C++ compiler flags"

config PK_CACHE_INSTRUCT_CLFLUSH_ASFLAGS
	string "CCASFLAGS: assembler compiler flags (defaults to CFLAGS)"

config PK_CACHE_INSTRUCT_CLFLUSH_BUILDARCH
	string "--host options on configure for Architecture"

endif # PK_CACHE_INSTRUCT_CLFLUSH
```

## package/CACHE/BiscuitOS-CACHE-INSTRUCT-CLFLUSHOPT/Kconfig
```kconfig
menuconfig PK_CACHE_INSTRUCT_CLFLUSHOPT
	bool "CACHE Instruction(X86): CLFLUSHOPT - Flush CACHE Line Optimized"

if PK_CACHE_INSTRUCT_CLFLUSHOPT

config PK_CACHE_INSTRUCT_CLFLUSHOPT_VERSION
	default "default"
	string "verstion"

config PK_CACHE_INSTRUCT_CLFLUSHOPT_TAR
	default "tar.gz"
	string "tar type"

config PK_CACHE_INSTRUCT_CLFLUSHOPT_URL
	default "https://gitee.com/BiscuitOS_team/HardStack/raw/Gitee/Memory-Allocator/CACHE-MECH/BiscuitOS-CACHE-INSTRUCT-CLFLUSHOPT"
	string "url"

config PK_CACHE_INSTRUCT_CLFLUSHOPT_GITHUB
	string "GitHub"

config PK_CACHE_INSTRUCT_CLFLUSHOPT_SRCFILE
	default "main.c Kconfig Makefile Makefile.host RunBiscuitOS.sh"
	string "Source code list"

config PK_CACHE_INSTRUCT_CLFLUSHOPT_CSRCFILE
	string "Compile source code list"

config PK_CACHE_INSTRUCT_CLFLUSHOPT_CONFIG
	string "CONFIG: Project Configure Options"

config PK_CACHE_INSTRUCT_CLFLUSHOPT_LIBPATH
	string "LIBS: Libraries to pass to the linker, e.g. -l<library>"

config PK_CACHE_INSTRUCT_CLFLUSHOPT_CPPFLAGS
	string "CPPFLAGS: C/C++ preprocessor flags, e.g. -I<include dir>"

config PK_CACHE_INSTRUCT_CLFLUSHOPT_DPKCONFIG
	string "PKG_CONFIG_PATH: Directories to add to pkg-config's search path"

config PK_CACHE_INSTRUCT_CLFLUSHOPT_CFLAGS
	string "CFLAGS: C compiler flags"

config PK_CACHE_INSTRUCT_CLFLUSHOPT_LDFLAGS
	string "LDFLAGS: Linker flags"

config PK_CACHE_INSTRUCT_CLFLUSHOPT_CXXFLAGS
	string "CXXFLAGS: C++ compiler flags"

config PK_CACHE_INSTRUCT_CLFLUSHOPT_ASFLAGS
	string "CCASFLAGS: assembler compiler flags (defaults to CFLAGS)"

config PK_CACHE_INSTRUCT_CLFLUSHOPT_BUILDARCH
	string "--host options on configure for Architecture"

endif # PK_CACHE_INSTRUCT_CLFLUSHOPT
```
