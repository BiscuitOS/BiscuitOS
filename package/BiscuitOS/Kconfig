## package/CACHE/BiscuitOS-CACHE-INSTRUCT-CLWB/Kconfig
```kconfig
menuconfig PK_CACHE_INSTRUCT_CLWB
	bool "CACHE Instruction(X86): CLWB - WriteBack CACHE Line"

if PK_CACHE_INSTRUCT_CLWB

config PK_CACHE_INSTRUCT_CLWB_VERSION
	default "default"
	string "verstion"

config PK_CACHE_INSTRUCT_CLWB_TAR
	default "tar.gz"
	string "tar type"

config PK_CACHE_INSTRUCT_CLWB_URL
	default "https://gitee.com/BiscuitOS_team/HardStack/raw/Gitee/Memory-Allocator/CACHE-MECH/BiscuitOS-CACHE-INSTRUCT-CLWB"
	string "url"

config PK_CACHE_INSTRUCT_CLWB_GITHUB
	string "GitHub"

config PK_CACHE_INSTRUCT_CLWB_SRCFILE
	default "main.c Kconfig Makefile Makefile.host RunBiscuitOS.sh"
	string "Source code list"

config PK_CACHE_INSTRUCT_CLWB_CSRCFILE
	string "Compile source code list"

config PK_CACHE_INSTRUCT_CLWB_CONFIG
	string "CONFIG: Project Configure Options"

config PK_CACHE_INSTRUCT_CLWB_LIBPATH
	string "LIBS: Libraries to pass to the linker, e.g. -l<library>"

config PK_CACHE_INSTRUCT_CLWB_CPPFLAGS
	string "CPPFLAGS: C/C++ preprocessor flags, e.g. -I<include dir>"

config PK_CACHE_INSTRUCT_CLWB_DPKCONFIG
	string "PKG_CONFIG_PATH: Directories to add to pkg-config's search path"

config PK_CACHE_INSTRUCT_CLWB_CFLAGS
	string "CFLAGS: C compiler flags"

config PK_CACHE_INSTRUCT_CLWB_LDFLAGS
	string "LDFLAGS: Linker flags"

config PK_CACHE_INSTRUCT_CLWB_CXXFLAGS
	string "CXXFLAGS: C++ compiler flags"

config PK_CACHE_INSTRUCT_CLWB_ASFLAGS
	string "CCASFLAGS: assembler compiler flags (defaults to CFLAGS)"

config PK_CACHE_INSTRUCT_CLWB_BUILDARCH
	string "--host options on configure for Architecture"

endif # PK_CACHE_INSTRUCT_CLWB
```

## package/CACHE/BiscuitOS-CACHE-INSTRUCT-INVD/Kconfig
```kconfig
menuconfig PK_CACHE_INSTRUCT_INVD
	bool "CACHE Instruction(X86): INVD - Invalidate Internal CACHE"

if PK_CACHE_INSTRUCT_INVD

config PK_CACHE_INSTRUCT_INVD_VERSION
	default "default"
	string "verstion"

config PK_CACHE_INSTRUCT_INVD_TAR
	default "tar.gz"
	string "tar type"

config PK_CACHE_INSTRUCT_INVD_URL
	default "https://gitee.com/BiscuitOS_team/HardStack/raw/Gitee/Memory-Allocator/CACHE-MECH/BiscuitOS-CACHE-INSTRUCT-INVD"
	string "url"

config PK_CACHE_INSTRUCT_INVD_GITHUB
	string "GitHub"

config PK_CACHE_INSTRUCT_INVD_SRCFILE
	default "main.c Kconfig Makefile Makefile.host RunBiscuitOS.sh"
	string "Source code list"

config PK_CACHE_INSTRUCT_INVD_CSRCFILE
	string "Compile source code list"

config PK_CACHE_INSTRUCT_INVD_CONFIG
	string "CONFIG: Project Configure Options"

config PK_CACHE_INSTRUCT_INVD_LIBPATH
	string "LIBS: Libraries to pass to the linker, e.g. -l<library>"

config PK_CACHE_INSTRUCT_INVD_CPPFLAGS
	string "CPPFLAGS: C/C++ preprocessor flags, e.g. -I<include dir>"

config PK_CACHE_INSTRUCT_INVD_DPKCONFIG
	string "PKG_CONFIG_PATH: Directories to add to pkg-config's search path"

config PK_CACHE_INSTRUCT_INVD_CFLAGS
	string "CFLAGS: C compiler flags"

config PK_CACHE_INSTRUCT_INVD_LDFLAGS
	string "LDFLAGS: Linker flags"

config PK_CACHE_INSTRUCT_INVD_CXXFLAGS
	string "CXXFLAGS: C++ compiler flags"

config PK_CACHE_INSTRUCT_INVD_ASFLAGS
	string "CCASFLAGS: assembler compiler flags (defaults to CFLAGS)"

config PK_CACHE_INSTRUCT_INVD_BUILDARCH
	string "--host options on configure for Architecture"

endif # PK_CACHE_INSTRUCT_INVD
```

## package/CACHE/BiscuitOS-CACHE-INSTRUCT-MOVNTI/Kconfig
```kconfig
menuconfig PK_CACHE_INSTRUCT_MOVNTI
	bool "CACHE Instruction(X86): MOVNTI - Store Doubleword Using No-Temporal Hint"

if PK_CACHE_INSTRUCT_MOVNTI

config PK_CACHE_INSTRUCT_MOVNTI_VERSION
	default "default"
	string "verstion"

config PK_CACHE_INSTRUCT_MOVNTI_TAR
	default "tar.gz"
	string "tar type"

config PK_CACHE_INSTRUCT_MOVNTI_URL
	default "https://gitee.com/BiscuitOS_team/HardStack/raw/Gitee/Memory-Allocator/CACHE-MECH/BiscuitOS-CACHE-INSTRUCT-MOVNTI"
	string "url"

config PK_CACHE_INSTRUCT_MOVNTI_GITHUB
	string "GitHub"

config PK_CACHE_INSTRUCT_MOVNTI_SRCFILE
	default "main.c Kconfig Makefile Makefile.host RunBiscuitOS.sh"
	string "Source code list"

config PK_CACHE_INSTRUCT_MOVNTI_CSRCFILE
	string "Compile source code list"

config PK_CACHE_INSTRUCT_MOVNTI_CONFIG
	string "CONFIG: Project Configure Options"

config PK_CACHE_INSTRUCT_MOVNTI_LIBPATH
	string "LIBS: Libraries to pass to the linker, e.g. -l<library>"

config PK_CACHE_INSTRUCT_MOVNTI_CPPFLAGS
	string "CPPFLAGS: C/C++ preprocessor flags, e.g. -I<include dir>"

config PK_CACHE_INSTRUCT_MOVNTI_DPKCONFIG
	string "PKG_CONFIG_PATH: Directories to add to pkg-config's search path"

config PK_CACHE_INSTRUCT_MOVNTI_CFLAGS
	string "CFLAGS: C compiler flags"

config PK_CACHE_INSTRUCT_MOVNTI_LDFLAGS
	string "LDFLAGS: Linker flags"

config PK_CACHE_INSTRUCT_MOVNTI_CXXFLAGS
	string "CXXFLAGS: C++ compiler flags"

config PK_CACHE_INSTRUCT_MOVNTI_ASFLAGS
	string "CCASFLAGS: assembler compiler flags (defaults to CFLAGS)"

config PK_CACHE_INSTRUCT_MOVNTI_BUILDARCH
	string "--host options on configure for Architecture"

endif # PK_CACHE_INSTRUCT_MOVNTI
```

## package/CACHE/BiscuitOS-CACHE-INSTRUCT-PREFETCH/Kconfig
```kconfig
menuconfig PK_CACHE_INSTRUCT_PREFETCH
	bool "CACHE Instruction(X86): PREFETCH - Prefetch Data into CACHE"

if PK_CACHE_INSTRUCT_PREFETCH

config PK_CACHE_INSTRUCT_PREFETCH_VERSION
	default "default"
	string "verstion"

config PK_CACHE_INSTRUCT_PREFETCH_TAR
	default "tar.gz"
	string "tar type"

config PK_CACHE_INSTRUCT_PREFETCH_URL
	default "https://gitee.com/BiscuitOS_team/HardStack/raw/Gitee/Memory-Allocator/CACHE-MECH/BiscuitOS-CACHE-INSTRUCT-PREFETCH"
	string "url"

config PK_CACHE_INSTRUCT_PREFETCH_GITHUB
	string "GitHub"

config PK_CACHE_INSTRUCT_PREFETCH_SRCFILE
	default "main.c Kconfig Makefile Makefile.host RunBiscuitOS.sh"
	string "Source code list"

config PK_CACHE_INSTRUCT_PREFETCH_CSRCFILE
	string "Compile source code list"

config PK_CACHE_INSTRUCT_PREFETCH_CONFIG
	string "CONFIG: Project Configure Options"

config PK_CACHE_INSTRUCT_PREFETCH_LIBPATH
	string "LIBS: Libraries to pass to the linker, e.g. -l<library>"

config PK_CACHE_INSTRUCT_PREFETCH_CPPFLAGS
	string "CPPFLAGS: C/C++ preprocessor flags, e.g. -I<include dir>"

config PK_CACHE_INSTRUCT_PREFETCH_DPKCONFIG
	string "PKG_CONFIG_PATH: Directories to add to pkg-config's search path"

config PK_CACHE_INSTRUCT_PREFETCH_CFLAGS
	string "CFLAGS: C compiler flags"

config PK_CACHE_INSTRUCT_PREFETCH_LDFLAGS
	string "LDFLAGS: Linker flags"

config PK_CACHE_INSTRUCT_PREFETCH_CXXFLAGS
	string "CXXFLAGS: C++ compiler flags"

config PK_CACHE_INSTRUCT_PREFETCH_ASFLAGS
	string "CCASFLAGS: assembler compiler flags (defaults to CFLAGS)"

config PK_CACHE_INSTRUCT_PREFETCH_BUILDARCH
	string "--host options on configure for Architecture"

endif # PK_CACHE_INSTRUCT_PREFETCH
```

## package/CACHE/BiscuitOS-CACHE-INSTRUCT-PREFETCHW/Kconfig
```kconfig
menuconfig PK_CACHE_INSTRUCT_PREFETCHW
	bool "CACHE Instruction(X86): PREFETCHW - Prefetch Data into CACHE in Anticipation of a Write"

if PK_CACHE_INSTRUCT_PREFETCHW

config PK_CACHE_INSTRUCT_PREFETCHW_VERSION
	default "default"
	string "verstion"

config PK_CACHE_INSTRUCT_PREFETCHW_TAR
	default "tar.gz"
	string "tar type"

config PK_CACHE_INSTRUCT_PREFETCHW_URL
	default "https://gitee.com/BiscuitOS_team/HardStack/raw/Gitee/Memory-Allocator/CACHE-MECH/BiscuitOS-CACHE-INSTRUCT-PREFETCHW"
	string "url"

config PK_CACHE_INSTRUCT_PREFETCHW_GITHUB
	string "GitHub"

config PK_CACHE_INSTRUCT_PREFETCHW_SRCFILE
	default "main.c Kconfig Makefile Makefile.host RunBiscuitOS.sh"
	string "Source code list"

config PK_CACHE_INSTRUCT_PREFETCHW_CSRCFILE
	string "Compile source code list"

config PK_CACHE_INSTRUCT_PREFETCHW_CONFIG
	string "CONFIG: Project Configure Options"

config PK_CACHE_INSTRUCT_PREFETCHW_LIBPATH
	string "LIBS: Libraries to pass to the linker, e.g. -l<library>"

config PK_CACHE_INSTRUCT_PREFETCHW_CPPFLAGS
	string "CPPFLAGS: C/C++ preprocessor flags, e.g. -I<include dir>"

config PK_CACHE_INSTRUCT_PREFETCHW_DPKCONFIG
	string "PKG_CONFIG_PATH: Directories to add to pkg-config's search path"

config PK_CACHE_INSTRUCT_PREFETCHW_CFLAGS
	string "CFLAGS: C compiler flags"

config PK_CACHE_INSTRUCT_PREFETCHW_LDFLAGS
	string "LDFLAGS: Linker flags"

config PK_CACHE_INSTRUCT_PREFETCHW_CXXFLAGS
	string "CXXFLAGS: C++ compiler flags"

config PK_CACHE_INSTRUCT_PREFETCHW_ASFLAGS
	string "CCASFLAGS: assembler compiler flags (defaults to CFLAGS)"

config PK_CACHE_INSTRUCT_PREFETCHW_BUILDARCH
	string "--host options on configure for Architecture"

endif # PK_CACHE_INSTRUCT_PREFETCHW
```
