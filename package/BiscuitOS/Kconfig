## package/BiscuitOS/Kconfig
```kconfig
menuconfig PK_BISCUITOS_ARCH
	bool "BiscuitOS Architecture Specify Setup"

if PK_BISCUITOS_ARCH

config PK_BISCUITOS_CPU_HOST
	select PK_KVM
	bool "Support Host CPU Feature Passthrough"

config PK_BISCUITOS_NUMA
	select PK_NUMA
	bool "Support NUMA Topology"

config PK_BISCUITOS_HARDWARE
	select PK_KVM
	select PK_BROILER
	bool "Support BiscuitOS Hardware Emulate"

endif # PK_BISCUITOS_ARCH
```

## package/Broiler/Kconfig
```kconfig
menuconfig PK_BROILER_SYSTEM
	bool "Broiler hypervison for BiscuitOS"

if PK_BROILER_SYSTEM

choice
	prompt "Source of Broiler source code"

config BROILER_SYSTEM_GITHUB
	bool "Broiler source code from github"

config BROILER_SYSTEM_DL
	bool "Broiler source code from external file"

config BROILER_SYSTEM_WGET
	bool "Broiler source code from wget"

endchoice

if BROILER_SYSTEM_DL

config BROILER_SYSTEM_DL_NAME
	string "External Broiler absolute path"

endif # BROILER_SYSTEM_DL

config BROILER_SYSTEM_SRC
	int 
	default 1 if BROILER_SYSTEM_GITHUB
	default 2 if BROILER_SYSTEM_DL
	default 3 if BROILER_SYSTEM_WGET

endif # PK_BROILER_SYSTEM
```

## package/CACHE/BiscuitOS-CACHE-ALIAS/Kconfig
```kconfig
menuconfig PK_CACHE_ALIAS
	bool "CACHE Alias: OnDemand GUP"

if PK_CACHE_ALIAS

config PK_CACHE_ALIAS_VERSION
	default "default"
	string "verstion"

config PK_CACHE_ALIAS_TAR
	default "tar.gz"
	string "tar type"

config PK_CACHE_ALIAS_URL
	default "https://gitee.com/BiscuitOS_team/HardStack/raw/Gitee/Memory-Allocator/CACHE-MECH/BiscuitOS-CACHE-ALIAS"
	string "url"

config PK_CACHE_ALIAS_GITHUB
	string "GitHub"

config PK_CACHE_ALIAS_SRCFILE
	default "main.c app.c Kconfig Makefile Makefile.host RunBiscuitOS.sh"
	string "Source code list"

config PK_CACHE_ALIAS_CSRCFILE
	string "Compile source code list"

config PK_CACHE_ALIAS_CONFIG
	string "CONFIG: Project Configure Options"

config PK_CACHE_ALIAS_LIBPATH
	string "LIBS: Libraries to pass to the linker, e.g. -l<library>"

config PK_CACHE_ALIAS_CPPFLAGS
	string "CPPFLAGS: C/C++ preprocessor flags, e.g. -I<include dir>"

config PK_CACHE_ALIAS_DPKCONFIG
	string "PKG_CONFIG_PATH: Directories to add to pkg-config's search path"

config PK_CACHE_ALIAS_CFLAGS
	string "CFLAGS: C compiler flags"

config PK_CACHE_ALIAS_LDFLAGS
	string "LDFLAGS: Linker flags"

config PK_CACHE_ALIAS_CXXFLAGS
	string "CXXFLAGS: C++ compiler flags"

config PK_CACHE_ALIAS_ASFLAGS
	string "CCASFLAGS: assembler compiler flags (defaults to CFLAGS)"

config PK_CACHE_ALIAS_BUILDARCH
	string "--host options on configure for Architecture"

endif # PK_CACHE_ALIAS
```

## package/CACHE/BiscuitOS-CACHE-ALLOC-EARLY-IORSVDMEM/Kconfig
```kconfig
menuconfig PK_CACHE_ALLOC_EARLY_IORSVDMEM
	bool "Allocator: EARLY IO/RSVDMEM with CACHE"

if PK_CACHE_ALLOC_EARLY_IORSVDMEM

config PK_CACHE_ALLOC_EARLY_IORSVDMEM_VERSION
	default "default"
	string "verstion"

config PK_CACHE_ALLOC_EARLY_IORSVDMEM_TAR
	default "tar.gz"
	string "tar type"

config PK_CACHE_ALLOC_EARLY_IORSVDMEM_URL
	default "https://gitee.com/BiscuitOS_team/HardStack/raw/Gitee/Memory-Allocator/CACHE-MECH/BiscuitOS-CACHE-ALLOC-EARLY-IORSVDMEM"
	string "url"

config PK_CACHE_ALLOC_EARLY_IORSVDMEM_GITHUB
	string "GitHub"

config PK_CACHE_ALLOC_EARLY_IORSVDMEM_SRCFILE
	default "main.c Kconfig Makefile BiscuitOS_Insert.bs"
	string "Source code list"

config PK_CACHE_ALLOC_EARLY_IORSVDMEM_CSRCFILE
	string "Compile source code list"

config PK_CACHE_ALLOC_EARLY_IORSVDMEM_CONFIG
	string "CONFIG: Project Configure Options"

config PK_CACHE_ALLOC_EARLY_IORSVDMEM_LIBPATH
	string "LIBS: Libraries to pass to the linker, e.g. -l<library>"

config PK_CACHE_ALLOC_EARLY_IORSVDMEM_CPPFLAGS
	string "CPPFLAGS: C/C++ preprocessor flags, e.g. -I<include dir>"

config PK_CACHE_ALLOC_EARLY_IORSVDMEM_DPKCONFIG
	string "PKG_CONFIG_PATH: Directories to add to pkg-config's search path"

config PK_CACHE_ALLOC_EARLY_IORSVDMEM_CFLAGS
	string "CFLAGS: C compiler flags"

config PK_CACHE_ALLOC_EARLY_IORSVDMEM_LDFLAGS
	string "LDFLAGS: Linker flags"

config PK_CACHE_ALLOC_EARLY_IORSVDMEM_CXXFLAGS
	string "CXXFLAGS: C++ compiler flags"

config PK_CACHE_ALLOC_EARLY_IORSVDMEM_ASFLAGS
	string "CCASFLAGS: assembler compiler flags (defaults to CFLAGS)"

config PK_CACHE_ALLOC_EARLY_IORSVDMEM_BUILDARCH
	string "--host options on configure for Architecture"

endif # PK_CACHE_ALLOC_EARLY_IORSVDMEM
```

## package/CACHE/BiscuitOS-CACHE-ALLOC-PERMANENT/Kconfig
```kconfig
menuconfig PK_CACHE_ALLOC_PERMANENT
	bool "Allocator: Permanent Mapping with CACHE"

if PK_CACHE_ALLOC_PERMANENT

config PK_CACHE_ALLOC_PERMANENT_VERSION
	default "default"
	string "verstion"

config PK_CACHE_ALLOC_PERMANENT_TAR
	default "tar.gz"
	string "tar type"

config PK_CACHE_ALLOC_PERMANENT_URL
	default "https://gitee.com/BiscuitOS_team/HardStack/raw/Gitee/Memory-Allocator/CACHE-MECH/BiscuitOS-CACHE-ALLOC-PERMANENT"
	string "url"

config PK_CACHE_ALLOC_PERMANENT_GITHUB
	string "GitHub"

config PK_CACHE_ALLOC_PERMANENT_SRCFILE
	default "main.c Kconfig Makefile"
	string "Source code list"

config PK_CACHE_ALLOC_PERMANENT_CSRCFILE
	string "Compile source code list"

config PK_CACHE_ALLOC_PERMANENT_CONFIG
	string "CONFIG: Project Configure Options"

config PK_CACHE_ALLOC_PERMANENT_LIBPATH
	string "LIBS: Libraries to pass to the linker, e.g. -l<library>"

config PK_CACHE_ALLOC_PERMANENT_CPPFLAGS
	string "CPPFLAGS: C/C++ preprocessor flags, e.g. -I<include dir>"

config PK_CACHE_ALLOC_PERMANENT_DPKCONFIG
	string "PKG_CONFIG_PATH: Directories to add to pkg-config's search path"

config PK_CACHE_ALLOC_PERMANENT_CFLAGS
	string "CFLAGS: C compiler flags"

config PK_CACHE_ALLOC_PERMANENT_LDFLAGS
	string "LDFLAGS: Linker flags"

config PK_CACHE_ALLOC_PERMANENT_CXXFLAGS
	string "CXXFLAGS: C++ compiler flags"

config PK_CACHE_ALLOC_PERMANENT_ASFLAGS
	string "CCASFLAGS: assembler compiler flags (defaults to CFLAGS)"

config PK_CACHE_ALLOC_PERMANENT_BUILDARCH
	string "--host options on configure for Architecture"

endif # PK_CACHE_ALLOC_PERMANENT
```

## package/CACHE/BiscuitOS-CACHE-ALLOC-VMALLOC/Kconfig
```kconfig
menuconfig PK_CACHE_ALLOC_VMALLOC
	bool "Allocator: VMALLOC with CACHE"

if PK_CACHE_ALLOC_VMALLOC

config PK_CACHE_ALLOC_VMALLOC_VERSION
	default "default"
	string "verstion"

config PK_CACHE_ALLOC_VMALLOC_TAR
	default "tar.gz"
	string "tar type"

config PK_CACHE_ALLOC_VMALLOC_URL
	default "https://gitee.com/BiscuitOS_team/HardStack/raw/Gitee/Memory-Allocator/CACHE-MECH/BiscuitOS-CACHE-ALLOC-VMALLOC"
	string "url"

config PK_CACHE_ALLOC_VMALLOC_GITHUB
	string "GitHub"

config PK_CACHE_ALLOC_VMALLOC_SRCFILE
	default "main.c Kconfig Makefile Makefile.host RunBiscuitOS.sh"
	string "Source code list"

config PK_CACHE_ALLOC_VMALLOC_CSRCFILE
	string "Compile source code list"

config PK_CACHE_ALLOC_VMALLOC_CONFIG
	string "CONFIG: Project Configure Options"

config PK_CACHE_ALLOC_VMALLOC_LIBPATH
	string "LIBS: Libraries to pass to the linker, e.g. -l<library>"

config PK_CACHE_ALLOC_VMALLOC_CPPFLAGS
	string "CPPFLAGS: C/C++ preprocessor flags, e.g. -I<include dir>"

config PK_CACHE_ALLOC_VMALLOC_DPKCONFIG
	string "PKG_CONFIG_PATH: Directories to add to pkg-config's search path"

config PK_CACHE_ALLOC_VMALLOC_CFLAGS
	string "CFLAGS: C compiler flags"

config PK_CACHE_ALLOC_VMALLOC_LDFLAGS
	string "LDFLAGS: Linker flags"

config PK_CACHE_ALLOC_VMALLOC_CXXFLAGS
	string "CXXFLAGS: C++ compiler flags"

config PK_CACHE_ALLOC_VMALLOC_ASFLAGS
	string "CCASFLAGS: assembler compiler flags (defaults to CFLAGS)"

config PK_CACHE_ALLOC_VMALLOC_BUILDARCH
	string "--host options on configure for Architecture"

endif # PK_CACHE_ALLOC_VMALLOC
```

## package/CACHE/BiscuitOS-CACHE-COLOURING/Kconfig
```kconfig
menuconfig PK_CACHE_COLOURING
	bool "Colouring: CACHE Bin and CACHE Colouring"

if PK_CACHE_COLOURING

config PK_CACHE_COLOURING_VERSION
	default "default"
	string "verstion"

config PK_CACHE_COLOURING_TAR
	default "tar.gz"
	string "tar type"

config PK_CACHE_COLOURING_URL
	default "https://gitee.com/BiscuitOS_team/HardStack/raw/Gitee/Memory-Allocator/CACHE-MECH/BiscuitOS-CACHE-COLOURING"
	string "url"

config PK_CACHE_COLOURING_GITHUB
	string "GitHub"

config PK_CACHE_COLOURING_SRCFILE
	default "main.c Makefile RunBiscuitOS.sh"
	string "Source code list"

config PK_CACHE_COLOURING_CSRCFILE
	string "Compile source code list"

config PK_CACHE_COLOURING_CONFIG
	string "CONFIG: Project Configure Options"

config PK_CACHE_COLOURING_LIBPATH
	string "LIBS: Libraries to pass to the linker, e.g. -l<library>"

config PK_CACHE_COLOURING_CPPFLAGS
	string "CPPFLAGS: C/C++ preprocessor flags, e.g. -I<include dir>"

config PK_CACHE_COLOURING_DPKCONFIG
	string "PKG_CONFIG_PATH: Directories to add to pkg-config's search path"

config PK_CACHE_COLOURING_CFLAGS
	string "CFLAGS: C compiler flags"

config PK_CACHE_COLOURING_LDFLAGS
	string "LDFLAGS: Linker flags"

config PK_CACHE_COLOURING_CXXFLAGS
	string "CXXFLAGS: C++ compiler flags"

config PK_CACHE_COLOURING_ASFLAGS
	string "CCASFLAGS: assembler compiler flags (defaults to CFLAGS)"

config PK_CACHE_COLOURING_BUILDARCH
	string "--host options on configure for Architecture"

endif # PK_CACHE_COLOURING
```

## package/CACHE/BiscuitOS-CACHE-CPA/Kconfig
```kconfig
menuconfig PK_CACHE_CPA
	bool "CPA: Change Page Attribute with CACHE"

if PK_CACHE_CPA

config PK_CACHE_CPA_VERSION
	default "default"
	string "verstion"

config PK_CACHE_CPA_TAR
	default "tar.gz"
	string "tar type"

config PK_CACHE_CPA_URL
	default "https://gitee.com/BiscuitOS_team/HardStack/raw/Gitee/Memory-Allocator/CACHE-MECH/BiscuitOS-CACHE-CPA"
	string "url"

config PK_CACHE_CPA_GITHUB
	string "GitHub"

config PK_CACHE_CPA_SRCFILE
	default "app.c main.c Kconfig Makefile Makefile.host RunBiscuitOS.sh"
	string "Source code list"

config PK_CACHE_CPA_CSRCFILE
	string "Compile source code list"

config PK_CACHE_CPA_CONFIG
	string "CONFIG: Project Configure Options"

config PK_CACHE_CPA_LIBPATH
	string "LIBS: Libraries to pass to the linker, e.g. -l<library>"

config PK_CACHE_CPA_CPPFLAGS
	string "CPPFLAGS: C/C++ preprocessor flags, e.g. -I<include dir>"

config PK_CACHE_CPA_DPKCONFIG
	string "PKG_CONFIG_PATH: Directories to add to pkg-config's search path"

config PK_CACHE_CPA_CFLAGS
	string "CFLAGS: C compiler flags"

config PK_CACHE_CPA_LDFLAGS
	string "LDFLAGS: Linker flags"

config PK_CACHE_CPA_CXXFLAGS
	string "CXXFLAGS: C++ compiler flags"

config PK_CACHE_CPA_ASFLAGS
	string "CCASFLAGS: assembler compiler flags (defaults to CFLAGS)"

config PK_CACHE_CPA_BUILDARCH
	string "--host options on configure for Architecture"

endif # PK_CACHE_CPA
```

## package/CACHE/BiscuitOS-CACHE-DEVMMIO/Kconfig
```kconfig
menuconfig PK_CACHE_DEVMMIO
	bool "MMIO: CACHE MODE with DEVMMIO (Recommend)"

if PK_CACHE_DEVMMIO

config PK_CACHE_DEVMMIO_VERSION
	default "default"
	string "verstion"

config PK_CACHE_DEVMMIO_TAR
	default "tar.gz"
	string "tar type"

config PK_CACHE_DEVMMIO_URL
	default "https://gitee.com/BiscuitOS_team/HardStack/raw/Gitee/Memory-Allocator/CACHE-MECH/BiscuitOS-CACHE-DEVMMIO"
	string "url"

config PK_CACHE_DEVMMIO_GITHUB
	string "GitHub"

config PK_CACHE_DEVMMIO_SRCFILE
	default "app.c main.c Kconfig Makefile Makefile.host RunBiscuitOS.sh"
	string "Source code list"

config PK_CACHE_DEVMMIO_CSRCFILE
	string "Compile source code list"

config PK_CACHE_DEVMMIO_CONFIG
	string "CONFIG: Project Configure Options"

config PK_CACHE_DEVMMIO_LIBPATH
	string "LIBS: Libraries to pass to the linker, e.g. -l<library>"

config PK_CACHE_DEVMMIO_CPPFLAGS
	string "CPPFLAGS: C/C++ preprocessor flags, e.g. -I<include dir>"

config PK_CACHE_DEVMMIO_DPKCONFIG
	string "PKG_CONFIG_PATH: Directories to add to pkg-config's search path"

config PK_CACHE_DEVMMIO_CFLAGS
	string "CFLAGS: C compiler flags"

config PK_CACHE_DEVMMIO_LDFLAGS
	string "LDFLAGS: Linker flags"

config PK_CACHE_DEVMMIO_CXXFLAGS
	string "CXXFLAGS: C++ compiler flags"

config PK_CACHE_DEVMMIO_ASFLAGS
	string "CCASFLAGS: assembler compiler flags (defaults to CFLAGS)"

config PK_CACHE_DEVMMIO_BUILDARCH
	string "--host options on configure for Architecture"

endif # PK_CACHE_DEVMMIO
```

## package/CACHE/BiscuitOS-CACHE-DMA-BUF/Kconfig
```kconfig
menuconfig PK_CACHE_DMA_BUF
	bool "DMA: DMA-BUF(WB/UC) Memory"

if PK_CACHE_DMA_BUF

config PK_CACHE_DMA_BUF_VERSION
	default "default"
	string "verstion"

config PK_CACHE_DMA_BUF_TAR
	default "tar.gz"
	string "tar type"

config PK_CACHE_DMA_BUF_URL
	default "https://gitee.com/BiscuitOS_team/HardStack/raw/Gitee/Memory-Allocator/CACHE-MECH/BiscuitOS-CACHE-DMA-BUF"
	string "url"

config PK_CACHE_DMA_BUF_GITHUB
	string "GitHub"

config PK_CACHE_DMA_BUF_SRCFILE
	default "APP-Export-Capture.c APP-Import-GPUA.c APP-Import-GPUB.c DMABUF-Export-Capture.c DMABUF-Import-GPUA.c DMABUF-Import-GPUB.c Kconfig Makefile Makefile.host RunBiscuitOS.sh"
	string "Source code list"

config PK_CACHE_DMA_BUF_CSRCFILE
	string "Compile source code list"

config PK_CACHE_DMA_BUF_CONFIG
	string "CONFIG: Project Configure Options"

config PK_CACHE_DMA_BUF_LIBPATH
	string "LIBS: Libraries to pass to the linker, e.g. -l<library>"

config PK_CACHE_DMA_BUF_CPPFLAGS
	string "CPPFLAGS: C/C++ preprocessor flags, e.g. -I<include dir>"

config PK_CACHE_DMA_BUF_DPKCONFIG
	string "PKG_CONFIG_PATH: Directories to add to pkg-config's search path"

config PK_CACHE_DMA_BUF_CFLAGS
	string "CFLAGS: C compiler flags"

config PK_CACHE_DMA_BUF_LDFLAGS
	string "LDFLAGS: Linker flags"

config PK_CACHE_DMA_BUF_CXXFLAGS
	string "CXXFLAGS: C++ compiler flags"

config PK_CACHE_DMA_BUF_ASFLAGS
	string "CCASFLAGS: assembler compiler flags (defaults to CFLAGS)"

config PK_CACHE_DMA_BUF_BUILDARCH
	string "--host options on configure for Architecture"

endif # PK_CACHE_DMA_BUF
```

## package/CACHE/BiscuitOS-CACHE-DMA-COHERENT/Kconfig
```kconfig
menuconfig PK_CACHE_DMA_COHERENT
	bool "DMA: DMA Coherent(WB/UC) Memory"

if PK_CACHE_DMA_COHERENT

config PK_CACHE_DMA_COHERENT_VERSION
	default "default"
	string "verstion"

config PK_CACHE_DMA_COHERENT_TAR
	default "tar.gz"
	string "tar type"

config PK_CACHE_DMA_COHERENT_URL
	default "https://gitee.com/BiscuitOS_team/HardStack/raw/Gitee/Memory-Allocator/CACHE-MECH/BiscuitOS-CACHE-DMA-COHERENT"
	string "url"

config PK_CACHE_DMA_COHERENT_GITHUB
	string "GitHub"

config PK_CACHE_DMA_COHERENT_SRCFILE
	default "main.c Kconfig Makefile Makefile.host RunBiscuitOS.sh"
	string "Source code list"

config PK_CACHE_DMA_COHERENT_CSRCFILE
	string "Compile source code list"

config PK_CACHE_DMA_COHERENT_CONFIG
	string "CONFIG: Project Configure Options"

config PK_CACHE_DMA_COHERENT_LIBPATH
	string "LIBS: Libraries to pass to the linker, e.g. -l<library>"

config PK_CACHE_DMA_COHERENT_CPPFLAGS
	string "CPPFLAGS: C/C++ preprocessor flags, e.g. -I<include dir>"

config PK_CACHE_DMA_COHERENT_DPKCONFIG
	string "PKG_CONFIG_PATH: Directories to add to pkg-config's search path"

config PK_CACHE_DMA_COHERENT_CFLAGS
	string "CFLAGS: C compiler flags"

config PK_CACHE_DMA_COHERENT_LDFLAGS
	string "LDFLAGS: Linker flags"

config PK_CACHE_DMA_COHERENT_CXXFLAGS
	string "CXXFLAGS: C++ compiler flags"

config PK_CACHE_DMA_COHERENT_ASFLAGS
	string "CCASFLAGS: assembler compiler flags (defaults to CFLAGS)"

config PK_CACHE_DMA_COHERENT_BUILDARCH
	string "--host options on configure for Architecture"

endif # PK_CACHE_DMA_COHERENT
```
