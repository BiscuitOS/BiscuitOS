## package/MEMBLOCK/BiscuitOS-MEMBLOCK-memblock_is_region_reserved/Kconfig
```kconfig
menuconfig PK_MEMBLOCK_MEMBLOCK_IS_REGION_RESERVED
	bool "MEMBLOCK API: memblock_is_region_reserved()"

if PK_MEMBLOCK_MEMBLOCK_IS_REGION_RESERVED

config PK_MEMBLOCK_MEMBLOCK_IS_REGION_RESERVED_VERSION
	default "default"
	string "verstion"

config PK_MEMBLOCK_MEMBLOCK_IS_REGION_RESERVED_TAR
	default "tar.gz"
	string "tar type"

config PK_MEMBLOCK_MEMBLOCK_IS_REGION_RESERVED_URL
	default "https://gitee.com/BiscuitOS_team/HardStack/raw/Gitee/Memory-Allocator/MEMBLOCK/BiscuitOS-MEMBLOCK-memblock_is_region_reserved"
	string "url"

config PK_MEMBLOCK_MEMBLOCK_IS_REGION_RESERVED_GITHUB
	string "GitHub"

config PK_MEMBLOCK_MEMBLOCK_IS_REGION_RESERVED_SRCFILE
	default "main.c Kconfig Makefile BiscuitOS_Insert.bs"
	string "Source code list"

config PK_MEMBLOCK_MEMBLOCK_IS_REGION_RESERVED_CSRCFILE
	string "Compile source code list"

config PK_MEMBLOCK_MEMBLOCK_IS_REGION_RESERVED_CONFIG
	string "CONFIG: Project Configure Options"

config PK_MEMBLOCK_MEMBLOCK_IS_REGION_RESERVED_LIBPATH
	string "LIBS: Libraries to pass to the linker, e.g. -l<library>"

config PK_MEMBLOCK_MEMBLOCK_IS_REGION_RESERVED_CPPFLAGS
	string "CPPFLAGS: C/C++ preprocessor flags, e.g. -I<include dir>"

config PK_MEMBLOCK_MEMBLOCK_IS_REGION_RESERVED_DPKCONFIG
	string "PKG_CONFIG_PATH: Directories to add to pkg-config's search path"

config PK_MEMBLOCK_MEMBLOCK_IS_REGION_RESERVED_CFLAGS
	string "CFLAGS: C compiler flags"

config PK_MEMBLOCK_MEMBLOCK_IS_REGION_RESERVED_LDFLAGS
	string "LDFLAGS: Linker flags"

config PK_MEMBLOCK_MEMBLOCK_IS_REGION_RESERVED_CXXFLAGS
	string "CXXFLAGS: C++ compiler flags"

config PK_MEMBLOCK_MEMBLOCK_IS_REGION_RESERVED_ASFLAGS
	string "CCASFLAGS: assembler compiler flags (defaults to CFLAGS)"

config PK_MEMBLOCK_MEMBLOCK_IS_REGION_RESERVED_BUILDARCH
	string "--host options on configure for Architecture"

endif # PK_MEMBLOCK_MEMBLOCK_IS_REGION_RESERVED
```

## package/MEMBLOCK/BiscuitOS-MEMBLOCK-memblock_overlaps_region/Kconfig
```kconfig
menuconfig PK_MEMBLOCK_MEMBLOCK_OVERLAPS_REGION
	bool "MEMBLOCK API: memblock_overlaps_region()"

if PK_MEMBLOCK_MEMBLOCK_OVERLAPS_REGION

config PK_MEMBLOCK_MEMBLOCK_OVERLAPS_REGION_VERSION
	default "default"
	string "verstion"

config PK_MEMBLOCK_MEMBLOCK_OVERLAPS_REGION_TAR
	default "tar.gz"
	string "tar type"

config PK_MEMBLOCK_MEMBLOCK_OVERLAPS_REGION_URL
	default "https://gitee.com/BiscuitOS_team/HardStack/raw/Gitee/Memory-Allocator/MEMBLOCK/BiscuitOS-MEMBLOCK-memblock_overlaps_region"
	string "url"

config PK_MEMBLOCK_MEMBLOCK_OVERLAPS_REGION_GITHUB
	string "GitHub"

config PK_MEMBLOCK_MEMBLOCK_OVERLAPS_REGION_SRCFILE
	default "main.c Kconfig Makefile BiscuitOS_Insert.bs"
	string "Source code list"

config PK_MEMBLOCK_MEMBLOCK_OVERLAPS_REGION_CSRCFILE
	string "Compile source code list"

config PK_MEMBLOCK_MEMBLOCK_OVERLAPS_REGION_CONFIG
	string "CONFIG: Project Configure Options"

config PK_MEMBLOCK_MEMBLOCK_OVERLAPS_REGION_LIBPATH
	string "LIBS: Libraries to pass to the linker, e.g. -l<library>"

config PK_MEMBLOCK_MEMBLOCK_OVERLAPS_REGION_CPPFLAGS
	string "CPPFLAGS: C/C++ preprocessor flags, e.g. -I<include dir>"

config PK_MEMBLOCK_MEMBLOCK_OVERLAPS_REGION_DPKCONFIG
	string "PKG_CONFIG_PATH: Directories to add to pkg-config's search path"

config PK_MEMBLOCK_MEMBLOCK_OVERLAPS_REGION_CFLAGS
	string "CFLAGS: C compiler flags"

config PK_MEMBLOCK_MEMBLOCK_OVERLAPS_REGION_LDFLAGS
	string "LDFLAGS: Linker flags"

config PK_MEMBLOCK_MEMBLOCK_OVERLAPS_REGION_CXXFLAGS
	string "CXXFLAGS: C++ compiler flags"

config PK_MEMBLOCK_MEMBLOCK_OVERLAPS_REGION_ASFLAGS
	string "CCASFLAGS: assembler compiler flags (defaults to CFLAGS)"

config PK_MEMBLOCK_MEMBLOCK_OVERLAPS_REGION_BUILDARCH
	string "--host options on configure for Architecture"

endif # PK_MEMBLOCK_MEMBLOCK_OVERLAPS_REGION
```

## package/MEMBLOCK/BiscuitOS-MEMBLOCK-memblock_phys_alloc_range/Kconfig
```kconfig
menuconfig PK_MEMBLOCK_MEMBLOCK_PHYS_ALLOC_RANGE
	select PK_NUMA
	bool "MEMBLOCK API: memblock_phys_alloc_range()"

if PK_MEMBLOCK_MEMBLOCK_PHYS_ALLOC_RANGE

config PK_MEMBLOCK_MEMBLOCK_PHYS_ALLOC_RANGE_VERSION
	default "default"
	string "verstion"

config PK_MEMBLOCK_MEMBLOCK_PHYS_ALLOC_RANGE_TAR
	default "tar.gz"
	string "tar type"

config PK_MEMBLOCK_MEMBLOCK_PHYS_ALLOC_RANGE_URL
	default "https://gitee.com/BiscuitOS_team/HardStack/raw/Gitee/Memory-Allocator/MEMBLOCK/BiscuitOS-MEMBLOCK-memblock_phys_alloc_range"
	string "url"

config PK_MEMBLOCK_MEMBLOCK_PHYS_ALLOC_RANGE_GITHUB
	string "GitHub"

config PK_MEMBLOCK_MEMBLOCK_PHYS_ALLOC_RANGE_SRCFILE
	default "main.c Kconfig Makefile BiscuitOS_Insert.bs"
	string "Source code list"

config PK_MEMBLOCK_MEMBLOCK_PHYS_ALLOC_RANGE_CSRCFILE
	string "Compile source code list"

config PK_MEMBLOCK_MEMBLOCK_PHYS_ALLOC_RANGE_CONFIG
	string "CONFIG: Project Configure Options"

config PK_MEMBLOCK_MEMBLOCK_PHYS_ALLOC_RANGE_LIBPATH
	string "LIBS: Libraries to pass to the linker, e.g. -l<library>"

config PK_MEMBLOCK_MEMBLOCK_PHYS_ALLOC_RANGE_CPPFLAGS
	string "CPPFLAGS: C/C++ preprocessor flags, e.g. -I<include dir>"

config PK_MEMBLOCK_MEMBLOCK_PHYS_ALLOC_RANGE_DPKCONFIG
	string "PKG_CONFIG_PATH: Directories to add to pkg-config's search path"

config PK_MEMBLOCK_MEMBLOCK_PHYS_ALLOC_RANGE_CFLAGS
	string "CFLAGS: C compiler flags"

config PK_MEMBLOCK_MEMBLOCK_PHYS_ALLOC_RANGE_LDFLAGS
	string "LDFLAGS: Linker flags"

config PK_MEMBLOCK_MEMBLOCK_PHYS_ALLOC_RANGE_CXXFLAGS
	string "CXXFLAGS: C++ compiler flags"

config PK_MEMBLOCK_MEMBLOCK_PHYS_ALLOC_RANGE_ASFLAGS
	string "CCASFLAGS: assembler compiler flags (defaults to CFLAGS)"

config PK_MEMBLOCK_MEMBLOCK_PHYS_ALLOC_RANGE_BUILDARCH
	string "--host options on configure for Architecture"

endif # PK_MEMBLOCK_MEMBLOCK_PHYS_ALLOC_RANGE
```

## package/MEMBLOCK/BiscuitOS-MEMBLOCK-memblock_phys_free/Kconfig
```kconfig
menuconfig PK_MEMBLOCK_MEMBLOCK_PHYS_FREE
	bool "MEMBLOCK API: memblock_phys_free()"

if PK_MEMBLOCK_MEMBLOCK_PHYS_FREE

config PK_MEMBLOCK_MEMBLOCK_PHYS_FREE_VERSION
	default "default"
	string "verstion"

config PK_MEMBLOCK_MEMBLOCK_PHYS_FREE_TAR
	default "tar.gz"
	string "tar type"

config PK_MEMBLOCK_MEMBLOCK_PHYS_FREE_URL
	default "https://gitee.com/BiscuitOS_team/HardStack/raw/Gitee/Memory-Allocator/MEMBLOCK/BiscuitOS-MEMBLOCK-memblock_phys_free"
	string "url"

config PK_MEMBLOCK_MEMBLOCK_PHYS_FREE_GITHUB
	string "GitHub"

config PK_MEMBLOCK_MEMBLOCK_PHYS_FREE_SRCFILE
	default "main.c Kconfig Makefile BiscuitOS_Insert.bs"
	string "Source code list"

config PK_MEMBLOCK_MEMBLOCK_PHYS_FREE_CSRCFILE
	string "Compile source code list"

config PK_MEMBLOCK_MEMBLOCK_PHYS_FREE_CONFIG
	string "CONFIG: Project Configure Options"

config PK_MEMBLOCK_MEMBLOCK_PHYS_FREE_LIBPATH
	string "LIBS: Libraries to pass to the linker, e.g. -l<library>"

config PK_MEMBLOCK_MEMBLOCK_PHYS_FREE_CPPFLAGS
	string "CPPFLAGS: C/C++ preprocessor flags, e.g. -I<include dir>"

config PK_MEMBLOCK_MEMBLOCK_PHYS_FREE_DPKCONFIG
	string "PKG_CONFIG_PATH: Directories to add to pkg-config's search path"

config PK_MEMBLOCK_MEMBLOCK_PHYS_FREE_CFLAGS
	string "CFLAGS: C compiler flags"

config PK_MEMBLOCK_MEMBLOCK_PHYS_FREE_LDFLAGS
	string "LDFLAGS: Linker flags"

config PK_MEMBLOCK_MEMBLOCK_PHYS_FREE_CXXFLAGS
	string "CXXFLAGS: C++ compiler flags"

config PK_MEMBLOCK_MEMBLOCK_PHYS_FREE_ASFLAGS
	string "CCASFLAGS: assembler compiler flags (defaults to CFLAGS)"

config PK_MEMBLOCK_MEMBLOCK_PHYS_FREE_BUILDARCH
	string "--host options on configure for Architecture"

endif # PK_MEMBLOCK_MEMBLOCK_PHYS_FREE
```

## package/MEMBLOCK/BiscuitOS-MEMBLOCK-memblock_remove/Kconfig
```kconfig
menuconfig PK_MEMBLOCK_MEMBLOCK_REMOVE
	bool "MEMBLOCK API: memblock_remove()"

if PK_MEMBLOCK_MEMBLOCK_REMOVE

config PK_MEMBLOCK_MEMBLOCK_REMOVE_VERSION
	default "default"
	string "verstion"

config PK_MEMBLOCK_MEMBLOCK_REMOVE_TAR
	default "tar.gz"
	string "tar type"

config PK_MEMBLOCK_MEMBLOCK_REMOVE_URL
	default "https://gitee.com/BiscuitOS_team/HardStack/raw/Gitee/Memory-Allocator/MEMBLOCK/BiscuitOS-MEMBLOCK-memblock_remove"
	string "url"

config PK_MEMBLOCK_MEMBLOCK_REMOVE_GITHUB
	string "GitHub"

config PK_MEMBLOCK_MEMBLOCK_REMOVE_SRCFILE
	default "main.c Kconfig Makefile BiscuitOS_Insert.bs"
	string "Source code list"

config PK_MEMBLOCK_MEMBLOCK_REMOVE_CSRCFILE
	string "Compile source code list"

config PK_MEMBLOCK_MEMBLOCK_REMOVE_CONFIG
	string "CONFIG: Project Configure Options"

config PK_MEMBLOCK_MEMBLOCK_REMOVE_LIBPATH
	string "LIBS: Libraries to pass to the linker, e.g. -l<library>"

config PK_MEMBLOCK_MEMBLOCK_REMOVE_CPPFLAGS
	string "CPPFLAGS: C/C++ preprocessor flags, e.g. -I<include dir>"

config PK_MEMBLOCK_MEMBLOCK_REMOVE_DPKCONFIG
	string "PKG_CONFIG_PATH: Directories to add to pkg-config's search path"

config PK_MEMBLOCK_MEMBLOCK_REMOVE_CFLAGS
	string "CFLAGS: C compiler flags"

config PK_MEMBLOCK_MEMBLOCK_REMOVE_LDFLAGS
	string "LDFLAGS: Linker flags"

config PK_MEMBLOCK_MEMBLOCK_REMOVE_CXXFLAGS
	string "CXXFLAGS: C++ compiler flags"

config PK_MEMBLOCK_MEMBLOCK_REMOVE_ASFLAGS
	string "CCASFLAGS: assembler compiler flags (defaults to CFLAGS)"

config PK_MEMBLOCK_MEMBLOCK_REMOVE_BUILDARCH
	string "--host options on configure for Architecture"

endif # PK_MEMBLOCK_MEMBLOCK_REMOVE
```

## package/MEMBLOCK/BiscuitOS-MEMBLOCK-memblock_reserve/Kconfig
```kconfig
menuconfig PK_MEMBLOCK_MEMBLOCK_RESERVE
	bool "MEMBLOCK API: memblock_reserve()"

if PK_MEMBLOCK_MEMBLOCK_RESERVE

config PK_MEMBLOCK_MEMBLOCK_RESERVE_VERSION
	default "default"
	string "verstion"

config PK_MEMBLOCK_MEMBLOCK_RESERVE_TAR
	default "tar.gz"
	string "tar type"

config PK_MEMBLOCK_MEMBLOCK_RESERVE_URL
	default "https://gitee.com/BiscuitOS_team/HardStack/raw/Gitee/Memory-Allocator/MEMBLOCK/BiscuitOS-MEMBLOCK-memblock_reserve"
	string "url"

config PK_MEMBLOCK_MEMBLOCK_RESERVE_GITHUB
	string "GitHub"

config PK_MEMBLOCK_MEMBLOCK_RESERVE_SRCFILE
	default "main.c Kconfig Makefile BiscuitOS_Insert.bs"
	string "Source code list"

config PK_MEMBLOCK_MEMBLOCK_RESERVE_CSRCFILE
	string "Compile source code list"

config PK_MEMBLOCK_MEMBLOCK_RESERVE_CONFIG
	string "CONFIG: Project Configure Options"

config PK_MEMBLOCK_MEMBLOCK_RESERVE_LIBPATH
	string "LIBS: Libraries to pass to the linker, e.g. -l<library>"

config PK_MEMBLOCK_MEMBLOCK_RESERVE_CPPFLAGS
	string "CPPFLAGS: C/C++ preprocessor flags, e.g. -I<include dir>"

config PK_MEMBLOCK_MEMBLOCK_RESERVE_DPKCONFIG
	string "PKG_CONFIG_PATH: Directories to add to pkg-config's search path"

config PK_MEMBLOCK_MEMBLOCK_RESERVE_CFLAGS
	string "CFLAGS: C compiler flags"

config PK_MEMBLOCK_MEMBLOCK_RESERVE_LDFLAGS
	string "LDFLAGS: Linker flags"

config PK_MEMBLOCK_MEMBLOCK_RESERVE_CXXFLAGS
	string "CXXFLAGS: C++ compiler flags"

config PK_MEMBLOCK_MEMBLOCK_RESERVE_ASFLAGS
	string "CCASFLAGS: assembler compiler flags (defaults to CFLAGS)"

config PK_MEMBLOCK_MEMBLOCK_RESERVE_BUILDARCH
	string "--host options on configure for Architecture"

endif # PK_MEMBLOCK_MEMBLOCK_RESERVE
```

## package/MEMBLOCK/BiscuitOS-MEMBLOCK-memblock_reserved_size/Kconfig
```kconfig
menuconfig PK_MEMBLOCK_MEMBLOCK_RESERVED_SIZE
	bool "MEMBLOCK API: memblock_reserved_size()"

if PK_MEMBLOCK_MEMBLOCK_RESERVED_SIZE

config PK_MEMBLOCK_MEMBLOCK_RESERVED_SIZE_VERSION
	default "default"
	string "verstion"

config PK_MEMBLOCK_MEMBLOCK_RESERVED_SIZE_TAR
	default "tar.gz"
	string "tar type"

config PK_MEMBLOCK_MEMBLOCK_RESERVED_SIZE_URL
	default "https://gitee.com/BiscuitOS_team/HardStack/raw/Gitee/Memory-Allocator/MEMBLOCK/BiscuitOS-MEMBLOCK-memblock_reserved_size"
	string "url"

config PK_MEMBLOCK_MEMBLOCK_RESERVED_SIZE_GITHUB
	string "GitHub"

config PK_MEMBLOCK_MEMBLOCK_RESERVED_SIZE_SRCFILE
	default "main.c Kconfig Makefile BiscuitOS_Insert.bs"
	string "Source code list"

config PK_MEMBLOCK_MEMBLOCK_RESERVED_SIZE_CSRCFILE
	string "Compile source code list"

config PK_MEMBLOCK_MEMBLOCK_RESERVED_SIZE_CONFIG
	string "CONFIG: Project Configure Options"

config PK_MEMBLOCK_MEMBLOCK_RESERVED_SIZE_LIBPATH
	string "LIBS: Libraries to pass to the linker, e.g. -l<library>"

config PK_MEMBLOCK_MEMBLOCK_RESERVED_SIZE_CPPFLAGS
	string "CPPFLAGS: C/C++ preprocessor flags, e.g. -I<include dir>"

config PK_MEMBLOCK_MEMBLOCK_RESERVED_SIZE_DPKCONFIG
	string "PKG_CONFIG_PATH: Directories to add to pkg-config's search path"

config PK_MEMBLOCK_MEMBLOCK_RESERVED_SIZE_CFLAGS
	string "CFLAGS: C compiler flags"

config PK_MEMBLOCK_MEMBLOCK_RESERVED_SIZE_LDFLAGS
	string "LDFLAGS: Linker flags"

config PK_MEMBLOCK_MEMBLOCK_RESERVED_SIZE_CXXFLAGS
	string "CXXFLAGS: C++ compiler flags"

config PK_MEMBLOCK_MEMBLOCK_RESERVED_SIZE_ASFLAGS
	string "CCASFLAGS: assembler compiler flags (defaults to CFLAGS)"

config PK_MEMBLOCK_MEMBLOCK_RESERVED_SIZE_BUILDARCH
	string "--host options on configure for Architecture"

endif # PK_MEMBLOCK_MEMBLOCK_RESERVED_SIZE
```

## package/MEMBLOCK/BiscuitOS-MEMBLOCK-physmem/Kconfig
```kconfig
menuconfig PK_MEMBLOCK_PHYSMEM
	select PK_NUMA
	bool "MEMBLOCK physmem Region"

if PK_MEMBLOCK_PHYSMEM

config PK_MEMBLOCK_PHYSMEM_VERSION
	default "default"
	string "verstion"

config PK_MEMBLOCK_PHYSMEM_TAR
	default "tar.gz"
	string "tar type"

config PK_MEMBLOCK_PHYSMEM_URL
	default "https://gitee.com/BiscuitOS_team/HardStack/raw/Gitee/Memory-Allocator/MEMBLOCK/BiscuitOS-MEMBLOCK-physmem"
	string "url"

config PK_MEMBLOCK_PHYSMEM_GITHUB
	string "GitHub"

config PK_MEMBLOCK_PHYSMEM_SRCFILE
	default "main.c Kconfig Makefile BiscuitOS_Insert.bs"
	string "Source code list"

config PK_MEMBLOCK_PHYSMEM_CSRCFILE
	string "Compile source code list"

config PK_MEMBLOCK_PHYSMEM_CONFIG
	string "CONFIG: Project Configure Options"

config PK_MEMBLOCK_PHYSMEM_LIBPATH
	string "LIBS: Libraries to pass to the linker, e.g. -l<library>"

config PK_MEMBLOCK_PHYSMEM_CPPFLAGS
	string "CPPFLAGS: C/C++ preprocessor flags, e.g. -I<include dir>"

config PK_MEMBLOCK_PHYSMEM_DPKCONFIG
	string "PKG_CONFIG_PATH: Directories to add to pkg-config's search path"

config PK_MEMBLOCK_PHYSMEM_CFLAGS
	string "CFLAGS: C compiler flags"

config PK_MEMBLOCK_PHYSMEM_LDFLAGS
	string "LDFLAGS: Linker flags"

config PK_MEMBLOCK_PHYSMEM_CXXFLAGS
	string "CXXFLAGS: C++ compiler flags"

config PK_MEMBLOCK_PHYSMEM_ASFLAGS
	string "CCASFLAGS: assembler compiler flags (defaults to CFLAGS)"

config PK_MEMBLOCK_PHYSMEM_BUILDARCH
	string "--host options on configure for Architecture"

endif # PK_MEMBLOCK_PHYSMEM
```
