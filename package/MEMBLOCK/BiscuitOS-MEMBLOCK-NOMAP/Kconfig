## package/MEMBLOCK/BiscuitOS-MEMBLOCK-memblock_alloc_from/Kconfig
```kconfig
menuconfig PK_MEMBLOCK_MEMBLOCK_ALLOC_FROM
	bool "MEMBLOCK API: memblock_alloc_from()"

if PK_MEMBLOCK_MEMBLOCK_ALLOC_FROM

config PK_MEMBLOCK_MEMBLOCK_ALLOC_FROM_VERSION
	default "default"
	string "verstion"

config PK_MEMBLOCK_MEMBLOCK_ALLOC_FROM_TAR
	default "tar.gz"
	string "tar type"

config PK_MEMBLOCK_MEMBLOCK_ALLOC_FROM_URL
	default "https://gitee.com/BiscuitOS_team/HardStack/raw/Gitee/Memory-Allocator/MEMBLOCK/BiscuitOS-MEMBLOCK-memblock_alloc_from"
	string "url"

config PK_MEMBLOCK_MEMBLOCK_ALLOC_FROM_GITHUB
	string "GitHub"

config PK_MEMBLOCK_MEMBLOCK_ALLOC_FROM_SRCFILE
	default "main.c Kconfig Makefile BiscuitOS_Insert.bs"
	string "Source code list"

config PK_MEMBLOCK_MEMBLOCK_ALLOC_FROM_CSRCFILE
	string "Compile source code list"

config PK_MEMBLOCK_MEMBLOCK_ALLOC_FROM_CONFIG
	string "CONFIG: Project Configure Options"

config PK_MEMBLOCK_MEMBLOCK_ALLOC_FROM_LIBPATH
	string "LIBS: Libraries to pass to the linker, e.g. -l<library>"

config PK_MEMBLOCK_MEMBLOCK_ALLOC_FROM_CPPFLAGS
	string "CPPFLAGS: C/C++ preprocessor flags, e.g. -I<include dir>"

config PK_MEMBLOCK_MEMBLOCK_ALLOC_FROM_DPKCONFIG
	string "PKG_CONFIG_PATH: Directories to add to pkg-config's search path"

config PK_MEMBLOCK_MEMBLOCK_ALLOC_FROM_CFLAGS
	string "CFLAGS: C compiler flags"

config PK_MEMBLOCK_MEMBLOCK_ALLOC_FROM_LDFLAGS
	string "LDFLAGS: Linker flags"

config PK_MEMBLOCK_MEMBLOCK_ALLOC_FROM_CXXFLAGS
	string "CXXFLAGS: C++ compiler flags"

config PK_MEMBLOCK_MEMBLOCK_ALLOC_FROM_ASFLAGS
	string "CCASFLAGS: assembler compiler flags (defaults to CFLAGS)"

config PK_MEMBLOCK_MEMBLOCK_ALLOC_FROM_BUILDARCH
	string "--host options on configure for Architecture"

endif # PK_MEMBLOCK_MEMBLOCK_ALLOC_FROM
```

## package/MEMBLOCK/BiscuitOS-MEMBLOCK-memblock_alloc_low/Kconfig
```kconfig
menuconfig PK_MEMBLOCK_MEMBLOCK_ALLOC_LOW
	bool "MEMBLOCK API: memblock_alloc_low()"

if PK_MEMBLOCK_MEMBLOCK_ALLOC_LOW

config PK_MEMBLOCK_MEMBLOCK_ALLOC_LOW_VERSION
	default "default"
	string "verstion"

config PK_MEMBLOCK_MEMBLOCK_ALLOC_LOW_TAR
	default "tar.gz"
	string "tar type"

config PK_MEMBLOCK_MEMBLOCK_ALLOC_LOW_URL
	default "https://gitee.com/BiscuitOS_team/HardStack/raw/Gitee/Memory-Allocator/MEMBLOCK/BiscuitOS-MEMBLOCK-memblock_alloc_low"
	string "url"

config PK_MEMBLOCK_MEMBLOCK_ALLOC_LOW_GITHUB
	string "GitHub"

config PK_MEMBLOCK_MEMBLOCK_ALLOC_LOW_SRCFILE
	default "main.c Kconfig Makefile BiscuitOS_Insert.bs"
	string "Source code list"

config PK_MEMBLOCK_MEMBLOCK_ALLOC_LOW_CSRCFILE
	string "Compile source code list"

config PK_MEMBLOCK_MEMBLOCK_ALLOC_LOW_CONFIG
	string "CONFIG: Project Configure Options"

config PK_MEMBLOCK_MEMBLOCK_ALLOC_LOW_LIBPATH
	string "LIBS: Libraries to pass to the linker, e.g. -l<library>"

config PK_MEMBLOCK_MEMBLOCK_ALLOC_LOW_CPPFLAGS
	string "CPPFLAGS: C/C++ preprocessor flags, e.g. -I<include dir>"

config PK_MEMBLOCK_MEMBLOCK_ALLOC_LOW_DPKCONFIG
	string "PKG_CONFIG_PATH: Directories to add to pkg-config's search path"

config PK_MEMBLOCK_MEMBLOCK_ALLOC_LOW_CFLAGS
	string "CFLAGS: C compiler flags"

config PK_MEMBLOCK_MEMBLOCK_ALLOC_LOW_LDFLAGS
	string "LDFLAGS: Linker flags"

config PK_MEMBLOCK_MEMBLOCK_ALLOC_LOW_CXXFLAGS
	string "CXXFLAGS: C++ compiler flags"

config PK_MEMBLOCK_MEMBLOCK_ALLOC_LOW_ASFLAGS
	string "CCASFLAGS: assembler compiler flags (defaults to CFLAGS)"

config PK_MEMBLOCK_MEMBLOCK_ALLOC_LOW_BUILDARCH
	string "--host options on configure for Architecture"

endif # PK_MEMBLOCK_MEMBLOCK_ALLOC_LOW
```

## package/MEMBLOCK/BiscuitOS-MEMBLOCK-memblock_alloc_range_nid/Kconfig
```kconfig
menuconfig PK_MEMBLOCK_MEMBLOCK_ALLOC_RANGE_NID
	select PK_NUMA
	bool "MEMBLOCK API: memblock_alloc_range_nid()"

if PK_MEMBLOCK_MEMBLOCK_ALLOC_RANGE_NID

config PK_MEMBLOCK_MEMBLOCK_ALLOC_RANGE_NID_VERSION
	default "default"
	string "verstion"

config PK_MEMBLOCK_MEMBLOCK_ALLOC_RANGE_NID_TAR
	default "tar.gz"
	string "tar type"

config PK_MEMBLOCK_MEMBLOCK_ALLOC_RANGE_NID_URL
	default "https://gitee.com/BiscuitOS_team/HardStack/raw/Gitee/Memory-Allocator/MEMBLOCK/BiscuitOS-MEMBLOCK-memblock_alloc_range_nid"
	string "url"

config PK_MEMBLOCK_MEMBLOCK_ALLOC_RANGE_NID_GITHUB
	string "GitHub"

config PK_MEMBLOCK_MEMBLOCK_ALLOC_RANGE_NID_SRCFILE
	default "main.c Kconfig Makefile BiscuitOS_Insert.bs"
	string "Source code list"

config PK_MEMBLOCK_MEMBLOCK_ALLOC_RANGE_NID_CSRCFILE
	string "Compile source code list"

config PK_MEMBLOCK_MEMBLOCK_ALLOC_RANGE_NID_CONFIG
	string "CONFIG: Project Configure Options"

config PK_MEMBLOCK_MEMBLOCK_ALLOC_RANGE_NID_LIBPATH
	string "LIBS: Libraries to pass to the linker, e.g. -l<library>"

config PK_MEMBLOCK_MEMBLOCK_ALLOC_RANGE_NID_CPPFLAGS
	string "CPPFLAGS: C/C++ preprocessor flags, e.g. -I<include dir>"

config PK_MEMBLOCK_MEMBLOCK_ALLOC_RANGE_NID_DPKCONFIG
	string "PKG_CONFIG_PATH: Directories to add to pkg-config's search path"

config PK_MEMBLOCK_MEMBLOCK_ALLOC_RANGE_NID_CFLAGS
	string "CFLAGS: C compiler flags"

config PK_MEMBLOCK_MEMBLOCK_ALLOC_RANGE_NID_LDFLAGS
	string "LDFLAGS: Linker flags"

config PK_MEMBLOCK_MEMBLOCK_ALLOC_RANGE_NID_CXXFLAGS
	string "CXXFLAGS: C++ compiler flags"

config PK_MEMBLOCK_MEMBLOCK_ALLOC_RANGE_NID_ASFLAGS
	string "CCASFLAGS: assembler compiler flags (defaults to CFLAGS)"

config PK_MEMBLOCK_MEMBLOCK_ALLOC_RANGE_NID_BUILDARCH
	string "--host options on configure for Architecture"

endif # PK_MEMBLOCK_MEMBLOCK_ALLOC_RANGE_NID
```

## package/MEMBLOCK/BiscuitOS-MEMBLOCK-memblock_alloc_raw/Kconfig
```kconfig
menuconfig PK_MEMBLOCK_MEMBLOCK_ALLOC_RAW
	bool "MEMBLOCK API: memblock_alloc_raw()"

if PK_MEMBLOCK_MEMBLOCK_ALLOC_RAW

config PK_MEMBLOCK_MEMBLOCK_ALLOC_RAW_VERSION
	default "default"
	string "verstion"

config PK_MEMBLOCK_MEMBLOCK_ALLOC_RAW_TAR
	default "tar.gz"
	string "tar type"

config PK_MEMBLOCK_MEMBLOCK_ALLOC_RAW_URL
	default "https://gitee.com/BiscuitOS_team/HardStack/raw/Gitee/Memory-Allocator/MEMBLOCK/BiscuitOS-MEMBLOCK-memblock_alloc_raw"
	string "url"

config PK_MEMBLOCK_MEMBLOCK_ALLOC_RAW_GITHUB
	string "GitHub"

config PK_MEMBLOCK_MEMBLOCK_ALLOC_RAW_SRCFILE
	default "main.c Kconfig Makefile BiscuitOS_Insert.bs"
	string "Source code list"

config PK_MEMBLOCK_MEMBLOCK_ALLOC_RAW_CSRCFILE
	string "Compile source code list"

config PK_MEMBLOCK_MEMBLOCK_ALLOC_RAW_CONFIG
	string "CONFIG: Project Configure Options"

config PK_MEMBLOCK_MEMBLOCK_ALLOC_RAW_LIBPATH
	string "LIBS: Libraries to pass to the linker, e.g. -l<library>"

config PK_MEMBLOCK_MEMBLOCK_ALLOC_RAW_CPPFLAGS
	string "CPPFLAGS: C/C++ preprocessor flags, e.g. -I<include dir>"

config PK_MEMBLOCK_MEMBLOCK_ALLOC_RAW_DPKCONFIG
	string "PKG_CONFIG_PATH: Directories to add to pkg-config's search path"

config PK_MEMBLOCK_MEMBLOCK_ALLOC_RAW_CFLAGS
	string "CFLAGS: C compiler flags"

config PK_MEMBLOCK_MEMBLOCK_ALLOC_RAW_LDFLAGS
	string "LDFLAGS: Linker flags"

config PK_MEMBLOCK_MEMBLOCK_ALLOC_RAW_CXXFLAGS
	string "CXXFLAGS: C++ compiler flags"

config PK_MEMBLOCK_MEMBLOCK_ALLOC_RAW_ASFLAGS
	string "CCASFLAGS: assembler compiler flags (defaults to CFLAGS)"

config PK_MEMBLOCK_MEMBLOCK_ALLOC_RAW_BUILDARCH
	string "--host options on configure for Architecture"

endif # PK_MEMBLOCK_MEMBLOCK_ALLOC_RAW
```

## package/MEMBLOCK/BiscuitOS-MEMBLOCK-memblock_bottom_up/Kconfig
```kconfig
menuconfig PK_MEMBLOCK_MEMBLOCK_BOTTOM_UP
	bool "MEMBLOCK API: memblock_bottom_up()"

if PK_MEMBLOCK_MEMBLOCK_BOTTOM_UP

config PK_MEMBLOCK_MEMBLOCK_BOTTOM_UP_VERSION
	default "default"
	string "verstion"

config PK_MEMBLOCK_MEMBLOCK_BOTTOM_UP_TAR
	default "tar.gz"
	string "tar type"

config PK_MEMBLOCK_MEMBLOCK_BOTTOM_UP_URL
	default "https://gitee.com/BiscuitOS_team/HardStack/raw/Gitee/Memory-Allocator/MEMBLOCK/BiscuitOS-MEMBLOCK-memblock_bottom_up"
	string "url"

config PK_MEMBLOCK_MEMBLOCK_BOTTOM_UP_GITHUB
	string "GitHub"

config PK_MEMBLOCK_MEMBLOCK_BOTTOM_UP_SRCFILE
	default "main.c Kconfig Makefile BiscuitOS_Insert.bs"
	string "Source code list"

config PK_MEMBLOCK_MEMBLOCK_BOTTOM_UP_CSRCFILE
	string "Compile source code list"

config PK_MEMBLOCK_MEMBLOCK_BOTTOM_UP_CONFIG
	string "CONFIG: Project Configure Options"

config PK_MEMBLOCK_MEMBLOCK_BOTTOM_UP_LIBPATH
	string "LIBS: Libraries to pass to the linker, e.g. -l<library>"

config PK_MEMBLOCK_MEMBLOCK_BOTTOM_UP_CPPFLAGS
	string "CPPFLAGS: C/C++ preprocessor flags, e.g. -I<include dir>"

config PK_MEMBLOCK_MEMBLOCK_BOTTOM_UP_DPKCONFIG
	string "PKG_CONFIG_PATH: Directories to add to pkg-config's search path"

config PK_MEMBLOCK_MEMBLOCK_BOTTOM_UP_CFLAGS
	string "CFLAGS: C compiler flags"

config PK_MEMBLOCK_MEMBLOCK_BOTTOM_UP_LDFLAGS
	string "LDFLAGS: Linker flags"

config PK_MEMBLOCK_MEMBLOCK_BOTTOM_UP_CXXFLAGS
	string "CXXFLAGS: C++ compiler flags"

config PK_MEMBLOCK_MEMBLOCK_BOTTOM_UP_ASFLAGS
	string "CCASFLAGS: assembler compiler flags (defaults to CFLAGS)"

config PK_MEMBLOCK_MEMBLOCK_BOTTOM_UP_BUILDARCH
	string "--host options on configure for Architecture"

endif # PK_MEMBLOCK_MEMBLOCK_BOTTOM_UP
```

## package/MEMBLOCK/BiscuitOS-MEMBLOCK-memblock_end_of_DRAM/Kconfig
```kconfig
menuconfig PK_MEMBLOCK_MEMBLOCK_END_OF_DRAM
	bool "MEMBLOCK API: memblock_end_of_DRAM()"

if PK_MEMBLOCK_MEMBLOCK_END_OF_DRAM

config PK_MEMBLOCK_MEMBLOCK_END_OF_DRAM_VERSION
	default "default"
	string "verstion"

config PK_MEMBLOCK_MEMBLOCK_END_OF_DRAM_TAR
	default "tar.gz"
	string "tar type"

config PK_MEMBLOCK_MEMBLOCK_END_OF_DRAM_URL
	default "https://gitee.com/BiscuitOS_team/HardStack/raw/Gitee/Memory-Allocator/MEMBLOCK/BiscuitOS-MEMBLOCK-memblock_end_of_DRAM"
	string "url"

config PK_MEMBLOCK_MEMBLOCK_END_OF_DRAM_GITHUB
	string "GitHub"

config PK_MEMBLOCK_MEMBLOCK_END_OF_DRAM_SRCFILE
	default "main.c Kconfig Makefile BiscuitOS_Insert.bs"
	string "Source code list"

config PK_MEMBLOCK_MEMBLOCK_END_OF_DRAM_CSRCFILE
	string "Compile source code list"

config PK_MEMBLOCK_MEMBLOCK_END_OF_DRAM_CONFIG
	string "CONFIG: Project Configure Options"

config PK_MEMBLOCK_MEMBLOCK_END_OF_DRAM_LIBPATH
	string "LIBS: Libraries to pass to the linker, e.g. -l<library>"

config PK_MEMBLOCK_MEMBLOCK_END_OF_DRAM_CPPFLAGS
	string "CPPFLAGS: C/C++ preprocessor flags, e.g. -I<include dir>"

config PK_MEMBLOCK_MEMBLOCK_END_OF_DRAM_DPKCONFIG
	string "PKG_CONFIG_PATH: Directories to add to pkg-config's search path"

config PK_MEMBLOCK_MEMBLOCK_END_OF_DRAM_CFLAGS
	string "CFLAGS: C compiler flags"

config PK_MEMBLOCK_MEMBLOCK_END_OF_DRAM_LDFLAGS
	string "LDFLAGS: Linker flags"

config PK_MEMBLOCK_MEMBLOCK_END_OF_DRAM_CXXFLAGS
	string "CXXFLAGS: C++ compiler flags"

config PK_MEMBLOCK_MEMBLOCK_END_OF_DRAM_ASFLAGS
	string "CCASFLAGS: assembler compiler flags (defaults to CFLAGS)"

config PK_MEMBLOCK_MEMBLOCK_END_OF_DRAM_BUILDARCH
	string "--host options on configure for Architecture"

endif # PK_MEMBLOCK_MEMBLOCK_END_OF_DRAM
```

## package/MEMBLOCK/BiscuitOS-MEMBLOCK-memblock_get_current_limit/Kconfig
```kconfig
menuconfig PK_MEMBLOCK_MEMBLOCK_GET_CURRENT_LIMIT
	bool "MEMBLOCK API: memblock_get_current_limit()"

if PK_MEMBLOCK_MEMBLOCK_GET_CURRENT_LIMIT

config PK_MEMBLOCK_MEMBLOCK_GET_CURRENT_LIMIT_VERSION
	default "default"
	string "verstion"

config PK_MEMBLOCK_MEMBLOCK_GET_CURRENT_LIMIT_TAR
	default "tar.gz"
	string "tar type"

config PK_MEMBLOCK_MEMBLOCK_GET_CURRENT_LIMIT_URL
	default "https://gitee.com/BiscuitOS_team/HardStack/raw/Gitee/Memory-Allocator/MEMBLOCK/BiscuitOS-MEMBLOCK-memblock_get_current_limit"
	string "url"

config PK_MEMBLOCK_MEMBLOCK_GET_CURRENT_LIMIT_GITHUB
	string "GitHub"

config PK_MEMBLOCK_MEMBLOCK_GET_CURRENT_LIMIT_SRCFILE
	default "main.c Kconfig Makefile BiscuitOS_Insert.bs"
	string "Source code list"

config PK_MEMBLOCK_MEMBLOCK_GET_CURRENT_LIMIT_CSRCFILE
	string "Compile source code list"

config PK_MEMBLOCK_MEMBLOCK_GET_CURRENT_LIMIT_CONFIG
	string "CONFIG: Project Configure Options"

config PK_MEMBLOCK_MEMBLOCK_GET_CURRENT_LIMIT_LIBPATH
	string "LIBS: Libraries to pass to the linker, e.g. -l<library>"

config PK_MEMBLOCK_MEMBLOCK_GET_CURRENT_LIMIT_CPPFLAGS
	string "CPPFLAGS: C/C++ preprocessor flags, e.g. -I<include dir>"

config PK_MEMBLOCK_MEMBLOCK_GET_CURRENT_LIMIT_DPKCONFIG
	string "PKG_CONFIG_PATH: Directories to add to pkg-config's search path"

config PK_MEMBLOCK_MEMBLOCK_GET_CURRENT_LIMIT_CFLAGS
	string "CFLAGS: C compiler flags"

config PK_MEMBLOCK_MEMBLOCK_GET_CURRENT_LIMIT_LDFLAGS
	string "LDFLAGS: Linker flags"

config PK_MEMBLOCK_MEMBLOCK_GET_CURRENT_LIMIT_CXXFLAGS
	string "CXXFLAGS: C++ compiler flags"

config PK_MEMBLOCK_MEMBLOCK_GET_CURRENT_LIMIT_ASFLAGS
	string "CCASFLAGS: assembler compiler flags (defaults to CFLAGS)"

config PK_MEMBLOCK_MEMBLOCK_GET_CURRENT_LIMIT_BUILDARCH
	string "--host options on configure for Architecture"

endif # PK_MEMBLOCK_MEMBLOCK_GET_CURRENT_LIMIT
```

## package/MEMBLOCK/BiscuitOS-MEMBLOCK-memblock_is_region_memory/Kconfig
```kconfig
menuconfig PK_MEMBLOCK_MEMBLOCK_IS_REGION_MEMORY
	bool "MEMBLOCK API: memblock_is_region_memory()"

if PK_MEMBLOCK_MEMBLOCK_IS_REGION_MEMORY

config PK_MEMBLOCK_MEMBLOCK_IS_REGION_MEMORY_VERSION
	default "default"
	string "verstion"

config PK_MEMBLOCK_MEMBLOCK_IS_REGION_MEMORY_TAR
	default "tar.gz"
	string "tar type"

config PK_MEMBLOCK_MEMBLOCK_IS_REGION_MEMORY_URL
	default "https://gitee.com/BiscuitOS_team/HardStack/raw/Gitee/Memory-Allocator/MEMBLOCK/BiscuitOS-MEMBLOCK-memblock_is_region_memory"
	string "url"

config PK_MEMBLOCK_MEMBLOCK_IS_REGION_MEMORY_GITHUB
	string "GitHub"

config PK_MEMBLOCK_MEMBLOCK_IS_REGION_MEMORY_SRCFILE
	default "main.c Kconfig Makefile BiscuitOS_Insert.bs"
	string "Source code list"

config PK_MEMBLOCK_MEMBLOCK_IS_REGION_MEMORY_CSRCFILE
	string "Compile source code list"

config PK_MEMBLOCK_MEMBLOCK_IS_REGION_MEMORY_CONFIG
	string "CONFIG: Project Configure Options"

config PK_MEMBLOCK_MEMBLOCK_IS_REGION_MEMORY_LIBPATH
	string "LIBS: Libraries to pass to the linker, e.g. -l<library>"

config PK_MEMBLOCK_MEMBLOCK_IS_REGION_MEMORY_CPPFLAGS
	string "CPPFLAGS: C/C++ preprocessor flags, e.g. -I<include dir>"

config PK_MEMBLOCK_MEMBLOCK_IS_REGION_MEMORY_DPKCONFIG
	string "PKG_CONFIG_PATH: Directories to add to pkg-config's search path"

config PK_MEMBLOCK_MEMBLOCK_IS_REGION_MEMORY_CFLAGS
	string "CFLAGS: C compiler flags"

config PK_MEMBLOCK_MEMBLOCK_IS_REGION_MEMORY_LDFLAGS
	string "LDFLAGS: Linker flags"

config PK_MEMBLOCK_MEMBLOCK_IS_REGION_MEMORY_CXXFLAGS
	string "CXXFLAGS: C++ compiler flags"

config PK_MEMBLOCK_MEMBLOCK_IS_REGION_MEMORY_ASFLAGS
	string "CCASFLAGS: assembler compiler flags (defaults to CFLAGS)"

config PK_MEMBLOCK_MEMBLOCK_IS_REGION_MEMORY_BUILDARCH
	string "--host options on configure for Architecture"

endif # PK_MEMBLOCK_MEMBLOCK_IS_REGION_MEMORY
```
