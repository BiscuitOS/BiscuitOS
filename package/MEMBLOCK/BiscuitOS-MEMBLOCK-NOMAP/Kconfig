## package/MEMBLOCK/BiscuitOS-MEMBLOCK-NOMAP/Kconfig
```kconfig
menuconfig PK_MEMBLOCK_NOMAP
	bool "MEMBLOCK NOMAP Memory"

if PK_MEMBLOCK_NOMAP

config PK_MEMBLOCK_NOMAP_VERSION
	default "default"
	string "verstion"

config PK_MEMBLOCK_NOMAP_TAR
	default "tar.gz"
	string "tar type"

config PK_MEMBLOCK_NOMAP_URL
	default "https://gitee.com/BiscuitOS_team/HardStack/raw/Gitee/Memory-Allocator/MEMBLOCK/BiscuitOS-MEMBLOCK-NOMAP"
	string "url"

config PK_MEMBLOCK_NOMAP_GITHUB
	string "GitHub"

config PK_MEMBLOCK_NOMAP_SRCFILE
	default "main.c Kconfig Makefile"
	string "Source code list"

config PK_MEMBLOCK_NOMAP_CSRCFILE
	string "Compile source code list"

config PK_MEMBLOCK_NOMAP_CONFIG
	string "CONFIG: Project Configure Options"

config PK_MEMBLOCK_NOMAP_LIBPATH
	string "LIBS: Libraries to pass to the linker, e.g. -l<library>"

config PK_MEMBLOCK_NOMAP_CPPFLAGS
	string "CPPFLAGS: C/C++ preprocessor flags, e.g. -I<include dir>"

config PK_MEMBLOCK_NOMAP_DPKCONFIG
	string "PKG_CONFIG_PATH: Directories to add to pkg-config's search path"

config PK_MEMBLOCK_NOMAP_CFLAGS
	string "CFLAGS: C compiler flags"

config PK_MEMBLOCK_NOMAP_LDFLAGS
	string "LDFLAGS: Linker flags"

config PK_MEMBLOCK_NOMAP_CXXFLAGS
	string "CXXFLAGS: C++ compiler flags"

config PK_MEMBLOCK_NOMAP_ASFLAGS
	string "CCASFLAGS: assembler compiler flags (defaults to CFLAGS)"

config PK_MEMBLOCK_NOMAP_BUILDARCH
	string "--host options on configure for Architecture"

endif # PK_MEMBLOCK_NOMAP
```

## package/MEMBLOCK/BiscuitOS-MEMBLOCK-__for_each_mem_range_rev/Kconfig
```kconfig
menuconfig PK_MEMBLOCK___FOR_EACH_MEM_RANGE_REV
	select PK_NUMA
	bool "MEMBLOCK API: __for_each_mem_range_rev()"

if PK_MEMBLOCK___FOR_EACH_MEM_RANGE_REV

config PK_MEMBLOCK___FOR_EACH_MEM_RANGE_REV_VERSION
	default "default"
	string "verstion"

config PK_MEMBLOCK___FOR_EACH_MEM_RANGE_REV_TAR
	default "tar.gz"
	string "tar type"

config PK_MEMBLOCK___FOR_EACH_MEM_RANGE_REV_URL
	default "https://gitee.com/BiscuitOS_team/HardStack/raw/Gitee/Memory-Allocator/MEMBLOCK/BiscuitOS-MEMBLOCK-__for_each_mem_range_rev"
	string "url"

config PK_MEMBLOCK___FOR_EACH_MEM_RANGE_REV_GITHUB
	string "GitHub"

config PK_MEMBLOCK___FOR_EACH_MEM_RANGE_REV_SRCFILE
	default "main.c Kconfig Makefile BiscuitOS_Insert.bs"
	string "Source code list"

config PK_MEMBLOCK___FOR_EACH_MEM_RANGE_REV_CSRCFILE
	string "Compile source code list"

config PK_MEMBLOCK___FOR_EACH_MEM_RANGE_REV_CONFIG
	string "CONFIG: Project Configure Options"

config PK_MEMBLOCK___FOR_EACH_MEM_RANGE_REV_LIBPATH
	string "LIBS: Libraries to pass to the linker, e.g. -l<library>"

config PK_MEMBLOCK___FOR_EACH_MEM_RANGE_REV_CPPFLAGS
	string "CPPFLAGS: C/C++ preprocessor flags, e.g. -I<include dir>"

config PK_MEMBLOCK___FOR_EACH_MEM_RANGE_REV_DPKCONFIG
	string "PKG_CONFIG_PATH: Directories to add to pkg-config's search path"

config PK_MEMBLOCK___FOR_EACH_MEM_RANGE_REV_CFLAGS
	string "CFLAGS: C compiler flags"

config PK_MEMBLOCK___FOR_EACH_MEM_RANGE_REV_LDFLAGS
	string "LDFLAGS: Linker flags"

config PK_MEMBLOCK___FOR_EACH_MEM_RANGE_REV_CXXFLAGS
	string "CXXFLAGS: C++ compiler flags"

config PK_MEMBLOCK___FOR_EACH_MEM_RANGE_REV_ASFLAGS
	string "CCASFLAGS: assembler compiler flags (defaults to CFLAGS)"

config PK_MEMBLOCK___FOR_EACH_MEM_RANGE_REV_BUILDARCH
	string "--host options on configure for Architecture"

endif # PK_MEMBLOCK___FOR_EACH_MEM_RANGE_REV
```

## package/MEMBLOCK/BiscuitOS-MEMBLOCK-for_each_free_mem_range_reverse/Kconfig
```kconfig
menuconfig PK_MEMBLOCK_FOR_EACH_FREE_MEM_RANGE_REVERSE
	select PK_NUMA
	bool "MEMBLOCK API: for_each_free_mem_range_reverse()"

if PK_MEMBLOCK_FOR_EACH_FREE_MEM_RANGE_REVERSE

config PK_MEMBLOCK_FOR_EACH_FREE_MEM_RANGE_REVERSE_VERSION
	default "default"
	string "verstion"

config PK_MEMBLOCK_FOR_EACH_FREE_MEM_RANGE_REVERSE_TAR
	default "tar.gz"
	string "tar type"

config PK_MEMBLOCK_FOR_EACH_FREE_MEM_RANGE_REVERSE_URL
	default "https://gitee.com/BiscuitOS_team/HardStack/raw/Gitee/Memory-Allocator/MEMBLOCK/BiscuitOS-MEMBLOCK-for_each_free_mem_range_reverse"
	string "url"

config PK_MEMBLOCK_FOR_EACH_FREE_MEM_RANGE_REVERSE_GITHUB
	string "GitHub"

config PK_MEMBLOCK_FOR_EACH_FREE_MEM_RANGE_REVERSE_SRCFILE
	default "main.c Kconfig Makefile BiscuitOS_Insert.bs"
	string "Source code list"

config PK_MEMBLOCK_FOR_EACH_FREE_MEM_RANGE_REVERSE_CSRCFILE
	string "Compile source code list"

config PK_MEMBLOCK_FOR_EACH_FREE_MEM_RANGE_REVERSE_CONFIG
	string "CONFIG: Project Configure Options"

config PK_MEMBLOCK_FOR_EACH_FREE_MEM_RANGE_REVERSE_LIBPATH
	string "LIBS: Libraries to pass to the linker, e.g. -l<library>"

config PK_MEMBLOCK_FOR_EACH_FREE_MEM_RANGE_REVERSE_CPPFLAGS
	string "CPPFLAGS: C/C++ preprocessor flags, e.g. -I<include dir>"

config PK_MEMBLOCK_FOR_EACH_FREE_MEM_RANGE_REVERSE_DPKCONFIG
	string "PKG_CONFIG_PATH: Directories to add to pkg-config's search path"

config PK_MEMBLOCK_FOR_EACH_FREE_MEM_RANGE_REVERSE_CFLAGS
	string "CFLAGS: C compiler flags"

config PK_MEMBLOCK_FOR_EACH_FREE_MEM_RANGE_REVERSE_LDFLAGS
	string "LDFLAGS: Linker flags"

config PK_MEMBLOCK_FOR_EACH_FREE_MEM_RANGE_REVERSE_CXXFLAGS
	string "CXXFLAGS: C++ compiler flags"

config PK_MEMBLOCK_FOR_EACH_FREE_MEM_RANGE_REVERSE_ASFLAGS
	string "CCASFLAGS: assembler compiler flags (defaults to CFLAGS)"

config PK_MEMBLOCK_FOR_EACH_FREE_MEM_RANGE_REVERSE_BUILDARCH
	string "--host options on configure for Architecture"

endif # PK_MEMBLOCK_FOR_EACH_FREE_MEM_RANGE_REVERSE
```

## package/MEMBLOCK/BiscuitOS-MEMBLOCK-for_each_reserved_mem_range/Kconfig
```kconfig
menuconfig PK_MEMBLOCK_FOR_EACH_RESERVED_MEM_RANGE
	select PK_NUMA
	bool "MEMBLOCK API: for_each_reserved_mem_range()"

if PK_MEMBLOCK_FOR_EACH_RESERVED_MEM_RANGE

config PK_MEMBLOCK_FOR_EACH_RESERVED_MEM_RANGE_VERSION
	default "default"
	string "verstion"

config PK_MEMBLOCK_FOR_EACH_RESERVED_MEM_RANGE_TAR
	default "tar.gz"
	string "tar type"

config PK_MEMBLOCK_FOR_EACH_RESERVED_MEM_RANGE_URL
	default "https://gitee.com/BiscuitOS_team/HardStack/raw/Gitee/Memory-Allocator/MEMBLOCK/BiscuitOS-MEMBLOCK-for_each_reserved_mem_range"
	string "url"

config PK_MEMBLOCK_FOR_EACH_RESERVED_MEM_RANGE_GITHUB
	string "GitHub"

config PK_MEMBLOCK_FOR_EACH_RESERVED_MEM_RANGE_SRCFILE
	default "main.c Kconfig Makefile BiscuitOS_Insert.bs"
	string "Source code list"

config PK_MEMBLOCK_FOR_EACH_RESERVED_MEM_RANGE_CSRCFILE
	string "Compile source code list"

config PK_MEMBLOCK_FOR_EACH_RESERVED_MEM_RANGE_CONFIG
	string "CONFIG: Project Configure Options"

config PK_MEMBLOCK_FOR_EACH_RESERVED_MEM_RANGE_LIBPATH
	string "LIBS: Libraries to pass to the linker, e.g. -l<library>"

config PK_MEMBLOCK_FOR_EACH_RESERVED_MEM_RANGE_CPPFLAGS
	string "CPPFLAGS: C/C++ preprocessor flags, e.g. -I<include dir>"

config PK_MEMBLOCK_FOR_EACH_RESERVED_MEM_RANGE_DPKCONFIG
	string "PKG_CONFIG_PATH: Directories to add to pkg-config's search path"

config PK_MEMBLOCK_FOR_EACH_RESERVED_MEM_RANGE_CFLAGS
	string "CFLAGS: C compiler flags"

config PK_MEMBLOCK_FOR_EACH_RESERVED_MEM_RANGE_LDFLAGS
	string "LDFLAGS: Linker flags"

config PK_MEMBLOCK_FOR_EACH_RESERVED_MEM_RANGE_CXXFLAGS
	string "CXXFLAGS: C++ compiler flags"

config PK_MEMBLOCK_FOR_EACH_RESERVED_MEM_RANGE_ASFLAGS
	string "CCASFLAGS: assembler compiler flags (defaults to CFLAGS)"

config PK_MEMBLOCK_FOR_EACH_RESERVED_MEM_RANGE_BUILDARCH
	string "--host options on configure for Architecture"

endif # PK_MEMBLOCK_FOR_EACH_RESERVED_MEM_RANGE
```

## package/MEMBLOCK/BiscuitOS-MEMBLOCK-for_each_reserved_mem_region/Kconfig
```kconfig
menuconfig PK_MEMBLOCK_FOR_EACH_RESERVED_MEM_REGION
	select PK_NUMA
	bool "MEMBLOCK API: for_each_reserved_mem_region()"

if PK_MEMBLOCK_FOR_EACH_RESERVED_MEM_REGION

config PK_MEMBLOCK_FOR_EACH_RESERVED_MEM_REGION_VERSION
	default "default"
	string "verstion"

config PK_MEMBLOCK_FOR_EACH_RESERVED_MEM_REGION_TAR
	default "tar.gz"
	string "tar type"

config PK_MEMBLOCK_FOR_EACH_RESERVED_MEM_REGION_URL
	default "https://gitee.com/BiscuitOS_team/HardStack/raw/Gitee/Memory-Allocator/MEMBLOCK/BiscuitOS-MEMBLOCK-for_each_reserved_mem_region"
	string "url"

config PK_MEMBLOCK_FOR_EACH_RESERVED_MEM_REGION_GITHUB
	string "GitHub"

config PK_MEMBLOCK_FOR_EACH_RESERVED_MEM_REGION_SRCFILE
	default "main.c Kconfig Makefile BiscuitOS_Insert.bs"
	string "Source code list"

config PK_MEMBLOCK_FOR_EACH_RESERVED_MEM_REGION_CSRCFILE
	string "Compile source code list"

config PK_MEMBLOCK_FOR_EACH_RESERVED_MEM_REGION_CONFIG
	string "CONFIG: Project Configure Options"

config PK_MEMBLOCK_FOR_EACH_RESERVED_MEM_REGION_LIBPATH
	string "LIBS: Libraries to pass to the linker, e.g. -l<library>"

config PK_MEMBLOCK_FOR_EACH_RESERVED_MEM_REGION_CPPFLAGS
	string "CPPFLAGS: C/C++ preprocessor flags, e.g. -I<include dir>"

config PK_MEMBLOCK_FOR_EACH_RESERVED_MEM_REGION_DPKCONFIG
	string "PKG_CONFIG_PATH: Directories to add to pkg-config's search path"

config PK_MEMBLOCK_FOR_EACH_RESERVED_MEM_REGION_CFLAGS
	string "CFLAGS: C compiler flags"

config PK_MEMBLOCK_FOR_EACH_RESERVED_MEM_REGION_LDFLAGS
	string "LDFLAGS: Linker flags"

config PK_MEMBLOCK_FOR_EACH_RESERVED_MEM_REGION_CXXFLAGS
	string "CXXFLAGS: C++ compiler flags"

config PK_MEMBLOCK_FOR_EACH_RESERVED_MEM_REGION_ASFLAGS
	string "CCASFLAGS: assembler compiler flags (defaults to CFLAGS)"

config PK_MEMBLOCK_FOR_EACH_RESERVED_MEM_REGION_BUILDARCH
	string "--host options on configure for Architecture"

endif # PK_MEMBLOCK_FOR_EACH_RESERVED_MEM_REGION
```

## package/MEMBLOCK/BiscuitOS-MEMBLOCK-memblock_add/Kconfig
```kconfig
menuconfig PK_MEMBLOCK_MEMBLOCK_ADD
	bool "MEMBLOCK API: memblock_add()"

if PK_MEMBLOCK_MEMBLOCK_ADD

config PK_MEMBLOCK_MEMBLOCK_ADD_VERSION
	default "default"
	string "verstion"

config PK_MEMBLOCK_MEMBLOCK_ADD_TAR
	default "tar.gz"
	string "tar type"

config PK_MEMBLOCK_MEMBLOCK_ADD_URL
	default "https://gitee.com/BiscuitOS_team/HardStack/raw/Gitee/Memory-Allocator/MEMBLOCK/BiscuitOS-MEMBLOCK-memblock_add"
	string "url"

config PK_MEMBLOCK_MEMBLOCK_ADD_GITHUB
	string "GitHub"

config PK_MEMBLOCK_MEMBLOCK_ADD_SRCFILE
	default "main.c Kconfig Makefile BiscuitOS_Insert.bs"
	string "Source code list"

config PK_MEMBLOCK_MEMBLOCK_ADD_CSRCFILE
	string "Compile source code list"

config PK_MEMBLOCK_MEMBLOCK_ADD_CONFIG
	string "CONFIG: Project Configure Options"

config PK_MEMBLOCK_MEMBLOCK_ADD_LIBPATH
	string "LIBS: Libraries to pass to the linker, e.g. -l<library>"

config PK_MEMBLOCK_MEMBLOCK_ADD_CPPFLAGS
	string "CPPFLAGS: C/C++ preprocessor flags, e.g. -I<include dir>"

config PK_MEMBLOCK_MEMBLOCK_ADD_DPKCONFIG
	string "PKG_CONFIG_PATH: Directories to add to pkg-config's search path"

config PK_MEMBLOCK_MEMBLOCK_ADD_CFLAGS
	string "CFLAGS: C compiler flags"

config PK_MEMBLOCK_MEMBLOCK_ADD_LDFLAGS
	string "LDFLAGS: Linker flags"

config PK_MEMBLOCK_MEMBLOCK_ADD_CXXFLAGS
	string "CXXFLAGS: C++ compiler flags"

config PK_MEMBLOCK_MEMBLOCK_ADD_ASFLAGS
	string "CCASFLAGS: assembler compiler flags (defaults to CFLAGS)"

config PK_MEMBLOCK_MEMBLOCK_ADD_BUILDARCH
	string "--host options on configure for Architecture"

endif # PK_MEMBLOCK_MEMBLOCK_ADD
```

## package/MEMBLOCK/BiscuitOS-MEMBLOCK-memblock_add_node/Kconfig
```kconfig
menuconfig PK_MEMBLOCK_MEMBLOCK_ADD_NODE
	select PK_NUMA
	bool "MEMBLOCK API: memblock_add_node()"

if PK_MEMBLOCK_MEMBLOCK_ADD_NODE

config PK_MEMBLOCK_MEMBLOCK_ADD_NODE_VERSION
	default "default"
	string "verstion"

config PK_MEMBLOCK_MEMBLOCK_ADD_NODE_TAR
	default "tar.gz"
	string "tar type"

config PK_MEMBLOCK_MEMBLOCK_ADD_NODE_URL
	default "https://gitee.com/BiscuitOS_team/HardStack/raw/Gitee/Memory-Allocator/MEMBLOCK/BiscuitOS-MEMBLOCK-memblock_add_node"
	string "url"

config PK_MEMBLOCK_MEMBLOCK_ADD_NODE_GITHUB
	string "GitHub"

config PK_MEMBLOCK_MEMBLOCK_ADD_NODE_SRCFILE
	default "main.c Kconfig Makefile BiscuitOS_Insert.bs"
	string "Source code list"

config PK_MEMBLOCK_MEMBLOCK_ADD_NODE_CSRCFILE
	string "Compile source code list"

config PK_MEMBLOCK_MEMBLOCK_ADD_NODE_CONFIG
	string "CONFIG: Project Configure Options"

config PK_MEMBLOCK_MEMBLOCK_ADD_NODE_LIBPATH
	string "LIBS: Libraries to pass to the linker, e.g. -l<library>"

config PK_MEMBLOCK_MEMBLOCK_ADD_NODE_CPPFLAGS
	string "CPPFLAGS: C/C++ preprocessor flags, e.g. -I<include dir>"

config PK_MEMBLOCK_MEMBLOCK_ADD_NODE_DPKCONFIG
	string "PKG_CONFIG_PATH: Directories to add to pkg-config's search path"

config PK_MEMBLOCK_MEMBLOCK_ADD_NODE_CFLAGS
	string "CFLAGS: C compiler flags"

config PK_MEMBLOCK_MEMBLOCK_ADD_NODE_LDFLAGS
	string "LDFLAGS: Linker flags"

config PK_MEMBLOCK_MEMBLOCK_ADD_NODE_CXXFLAGS
	string "CXXFLAGS: C++ compiler flags"

config PK_MEMBLOCK_MEMBLOCK_ADD_NODE_ASFLAGS
	string "CCASFLAGS: assembler compiler flags (defaults to CFLAGS)"

config PK_MEMBLOCK_MEMBLOCK_ADD_NODE_BUILDARCH
	string "--host options on configure for Architecture"

endif # PK_MEMBLOCK_MEMBLOCK_ADD_NODE
```

## package/MEMBLOCK/BiscuitOS-MEMBLOCK-memblock_alloc_exact_nid_raw/Kconfig
```kconfig
menuconfig PK_MEMBLOCK_MEMBLOCK_ALLOC_EXACT_NID_RAW
	select PK_NUMA
	bool "MEMBLOCK API: memblock_alloc_exact_nid_raw()"

if PK_MEMBLOCK_MEMBLOCK_ALLOC_EXACT_NID_RAW

config PK_MEMBLOCK_MEMBLOCK_ALLOC_EXACT_NID_RAW_VERSION
	default "default"
	string "verstion"

config PK_MEMBLOCK_MEMBLOCK_ALLOC_EXACT_NID_RAW_TAR
	default "tar.gz"
	string "tar type"

config PK_MEMBLOCK_MEMBLOCK_ALLOC_EXACT_NID_RAW_URL
	default "https://gitee.com/BiscuitOS_team/HardStack/raw/Gitee/Memory-Allocator/MEMBLOCK/BiscuitOS-MEMBLOCK-memblock_alloc_exact_nid_raw"
	string "url"

config PK_MEMBLOCK_MEMBLOCK_ALLOC_EXACT_NID_RAW_GITHUB
	string "GitHub"

config PK_MEMBLOCK_MEMBLOCK_ALLOC_EXACT_NID_RAW_SRCFILE
	default "main.c Kconfig Makefile BiscuitOS_Insert.bs"
	string "Source code list"

config PK_MEMBLOCK_MEMBLOCK_ALLOC_EXACT_NID_RAW_CSRCFILE
	string "Compile source code list"

config PK_MEMBLOCK_MEMBLOCK_ALLOC_EXACT_NID_RAW_CONFIG
	string "CONFIG: Project Configure Options"

config PK_MEMBLOCK_MEMBLOCK_ALLOC_EXACT_NID_RAW_LIBPATH
	string "LIBS: Libraries to pass to the linker, e.g. -l<library>"

config PK_MEMBLOCK_MEMBLOCK_ALLOC_EXACT_NID_RAW_CPPFLAGS
	string "CPPFLAGS: C/C++ preprocessor flags, e.g. -I<include dir>"

config PK_MEMBLOCK_MEMBLOCK_ALLOC_EXACT_NID_RAW_DPKCONFIG
	string "PKG_CONFIG_PATH: Directories to add to pkg-config's search path"

config PK_MEMBLOCK_MEMBLOCK_ALLOC_EXACT_NID_RAW_CFLAGS
	string "CFLAGS: C compiler flags"

config PK_MEMBLOCK_MEMBLOCK_ALLOC_EXACT_NID_RAW_LDFLAGS
	string "LDFLAGS: Linker flags"

config PK_MEMBLOCK_MEMBLOCK_ALLOC_EXACT_NID_RAW_CXXFLAGS
	string "CXXFLAGS: C++ compiler flags"

config PK_MEMBLOCK_MEMBLOCK_ALLOC_EXACT_NID_RAW_ASFLAGS
	string "CCASFLAGS: assembler compiler flags (defaults to CFLAGS)"

config PK_MEMBLOCK_MEMBLOCK_ALLOC_EXACT_NID_RAW_BUILDARCH
	string "--host options on configure for Architecture"

endif # PK_MEMBLOCK_MEMBLOCK_ALLOC_EXACT_NID_RAW
```
