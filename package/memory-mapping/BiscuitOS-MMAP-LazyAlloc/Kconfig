## package/memory-mapping/BiscuitOS-MMAP-LazyAlloc/Kconfig
```kconfig
menuconfig PK_MMAP_LAZYALLOC
	bool "Lazy-Alloc: Default Route"

if PK_MMAP_LAZYALLOC

config PK_MMAP_LAZYALLOC_VERSION
	default "default"
	string "verstion"

config PK_MMAP_LAZYALLOC_TAR
	default "tar.gz"
	string "tar type"

config PK_MMAP_LAZYALLOC_URL
	default "https://gitee.com/BiscuitOS_team/HardStack/raw/Gitee/Memory-Allocator/MMAP/BiscuitOS-MMAP-LazyAlloc"
	string "url"

config PK_MMAP_LAZYALLOC_GITHUB
	string "GitHub"

config PK_MMAP_LAZYALLOC_SRCFILE
	default "main.c Makefile"
	string "Source code list"

config PK_MMAP_LAZYALLOC_CSRCFILE
	string "Compile source code list"

config PK_MMAP_LAZYALLOC_CONFIG
	string "CONFIG: Project Configure Options"

config PK_MMAP_LAZYALLOC_LIBPATH
	string "LIBS: Libraries to pass to the linker, e.g. -l<library>"

config PK_MMAP_LAZYALLOC_CPPFLAGS
	string "CPPFLAGS: C/C++ preprocessor flags, e.g. -I<include dir>"

config PK_MMAP_LAZYALLOC_DPKCONFIG
	string "PKG_CONFIG_PATH: Directories to add to pkg-config's search path"

config PK_MMAP_LAZYALLOC_CFLAGS
	string "CFLAGS: C compiler flags"

config PK_MMAP_LAZYALLOC_LDFLAGS
	string "LDFLAGS: Linker flags"

config PK_MMAP_LAZYALLOC_CXXFLAGS
	string "CXXFLAGS: C++ compiler flags"

config PK_MMAP_LAZYALLOC_ASFLAGS
	string "CCASFLAGS: assembler compiler flags (defaults to CFLAGS)"

config PK_MMAP_LAZYALLOC_BUILDARCH
	string "--host options on configure for Architecture"

endif # PK_MMAP_LAZYALLOC
```

## package/memory-mapping/BiscuitOS-MMAP-OnDemand-Alloc/Kconfig
```kconfig
menuconfig PK_MMAP_ODALLOC
	bool "On-Demand Alloc: Memory from OSMEM"

if PK_MMAP_ODALLOC

config PK_MMAP_ODALLOC_VERSION
	default "default"
	string "verstion"

config PK_MMAP_ODALLOC_TAR
	default "tar.gz"
	string "tar type"

config PK_MMAP_ODALLOC_URL
	default "https://gitee.com/BiscuitOS_team/HardStack/raw/Gitee/Memory-Allocator/MMAP/BiscuitOS-MMAP-OnDemand-Alloc"
	string "url"

config PK_MMAP_ODALLOC_GITHUB
	string "GitHub"

config PK_MMAP_ODALLOC_SRCFILE
	default "app.c main.c Kconfig Makefile Makefile.host RunBiscuitOS.sh"
	string "Source code list"

config PK_MMAP_ODALLOC_CSRCFILE
	string "Compile source code list"

config PK_MMAP_ODALLOC_CONFIG
	string "CONFIG: Project Configure Options"

config PK_MMAP_ODALLOC_LIBPATH
	string "LIBS: Libraries to pass to the linker, e.g. -l<library>"

config PK_MMAP_ODALLOC_CPPFLAGS
	string "CPPFLAGS: C/C++ preprocessor flags, e.g. -I<include dir>"

config PK_MMAP_ODALLOC_DPKCONFIG
	string "PKG_CONFIG_PATH: Directories to add to pkg-config's search path"

config PK_MMAP_ODALLOC_CFLAGS
	string "CFLAGS: C compiler flags"

config PK_MMAP_ODALLOC_LDFLAGS
	string "LDFLAGS: Linker flags"

config PK_MMAP_ODALLOC_CXXFLAGS
	string "CXXFLAGS: C++ compiler flags"

config PK_MMAP_ODALLOC_ASFLAGS
	string "CCASFLAGS: assembler compiler flags (defaults to CFLAGS)"

config PK_MMAP_ODALLOC_BUILDARCH
	string "--host options on configure for Architecture"

endif # PK_MMAP_ODALLOC
```

## package/memory-mapping/BiscuitOS-MMAP-PreAlloc-CMA/Kconfig
```kconfig
menuconfig PK_MMAP_PREALLOC_CMA
	select PK_MMAP_SPECIAL_U
	bool "PreAlloc: Memory from CMA Contiguous Memory"

if PK_MMAP_PREALLOC_CMA

config PK_MMAP_PREALLOC_CMA_VERSION
	default "default"
	string "verstion"

config PK_MMAP_PREALLOC_CMA_TAR
	default "tar.gz"
	string "tar type"

config PK_MMAP_PREALLOC_CMA_URL
	default "https://gitee.com/BiscuitOS_team/HardStack/raw/Gitee/Memory-Allocator/MMAP/BiscuitOS-MMAP-PreAlloc-CMA"
	string "url"

config PK_MMAP_PREALLOC_CMA_GITHUB
	string "GitHub"

config PK_MMAP_PREALLOC_CMA_SRCFILE
	default "main.c Makefile Kconfig"
	string "Source code list"

config PK_MMAP_PREALLOC_CMA_CSRCFILE
	string "Compile source code list"

config PK_MMAP_PREALLOC_CMA_CONFIG
	string "CONFIG: Project Configure Options"

config PK_MMAP_PREALLOC_CMA_LIBPATH
	string "LIBS: Libraries to pass to the linker, e.g. -l<library>"

config PK_MMAP_PREALLOC_CMA_CPPFLAGS
	string "CPPFLAGS: C/C++ preprocessor flags, e.g. -I<include dir>"

config PK_MMAP_PREALLOC_CMA_DPKCONFIG
	string "PKG_CONFIG_PATH: Directories to add to pkg-config's search path"

config PK_MMAP_PREALLOC_CMA_CFLAGS
	string "CFLAGS: C compiler flags"

config PK_MMAP_PREALLOC_CMA_LDFLAGS
	string "LDFLAGS: Linker flags"

config PK_MMAP_PREALLOC_CMA_CXXFLAGS
	string "CXXFLAGS: C++ compiler flags"

config PK_MMAP_PREALLOC_CMA_ASFLAGS
	string "CCASFLAGS: assembler compiler flags (defaults to CFLAGS)"

config PK_MMAP_PREALLOC_CMA_BUILDARCH
	string "--host options on configure for Architecture"

endif # PK_MMAP_PREALLOC_CMA
```

## package/memory-mapping/BiscuitOS-MMAP-PreAlloc-DMA/Kconfig
```kconfig
menuconfig PK_MMAP_PREALLOC_DMA
	select PK_MMAP_SPECIAL_U
	bool "PreAlloc: Memory from DMA Coherent Memory"

if PK_MMAP_PREALLOC_DMA

config PK_MMAP_PREALLOC_DMA_VERSION
	default "default"
	string "verstion"

config PK_MMAP_PREALLOC_DMA_TAR
	default "tar.gz"
	string "tar type"

config PK_MMAP_PREALLOC_DMA_URL
	default "https://gitee.com/BiscuitOS_team/HardStack/raw/Gitee/Memory-Allocator/MMAP/BiscuitOS-MMAP-PreAlloc-DMA"
	string "url"

config PK_MMAP_PREALLOC_DMA_GITHUB
	string "GitHub"

config PK_MMAP_PREALLOC_DMA_SRCFILE
	default "main.c Makefile Kconfig"
	string "Source code list"

config PK_MMAP_PREALLOC_DMA_CSRCFILE
	string "Compile source code list"

config PK_MMAP_PREALLOC_DMA_CONFIG
	string "CONFIG: Project Configure Options"

config PK_MMAP_PREALLOC_DMA_LIBPATH
	string "LIBS: Libraries to pass to the linker, e.g. -l<library>"

config PK_MMAP_PREALLOC_DMA_CPPFLAGS
	string "CPPFLAGS: C/C++ preprocessor flags, e.g. -I<include dir>"

config PK_MMAP_PREALLOC_DMA_DPKCONFIG
	string "PKG_CONFIG_PATH: Directories to add to pkg-config's search path"

config PK_MMAP_PREALLOC_DMA_CFLAGS
	string "CFLAGS: C compiler flags"

config PK_MMAP_PREALLOC_DMA_LDFLAGS
	string "LDFLAGS: Linker flags"

config PK_MMAP_PREALLOC_DMA_CXXFLAGS
	string "CXXFLAGS: C++ compiler flags"

config PK_MMAP_PREALLOC_DMA_ASFLAGS
	string "CCASFLAGS: assembler compiler flags (defaults to CFLAGS)"

config PK_MMAP_PREALLOC_DMA_BUILDARCH
	string "--host options on configure for Architecture"

endif # PK_MMAP_PREALLOC_DMA
```

## package/memory-mapping/BiscuitOS-MMAP-PreAlloc-MAPLOCKED/Kconfig
```kconfig
menuconfig PK_MMAP_PREALLOC_MAPLOCKED
	bool "PreAlloc: Memory from mmap(MAP_LOCKED)"

if PK_MMAP_PREALLOC_MAPLOCKED

config PK_MMAP_PREALLOC_MAPLOCKED_VERSION
	default "default"
	string "verstion"

config PK_MMAP_PREALLOC_MAPLOCKED_TAR
	default "tar.gz"
	string "tar type"

config PK_MMAP_PREALLOC_MAPLOCKED_URL
	default "https://gitee.com/BiscuitOS_team/HardStack/raw/Gitee/Memory-Allocator/MMAP/BiscuitOS-MMAP-PreAlloc-MAPLOCKED"
	string "url"

config PK_MMAP_PREALLOC_MAPLOCKED_GITHUB
	string "GitHub"

config PK_MMAP_PREALLOC_MAPLOCKED_SRCFILE
	default "main.c Makefile"
	string "Source code list"

config PK_MMAP_PREALLOC_MAPLOCKED_CSRCFILE
	string "Compile source code list"

config PK_MMAP_PREALLOC_MAPLOCKED_CONFIG
	string "CONFIG: Project Configure Options"

config PK_MMAP_PREALLOC_MAPLOCKED_LIBPATH
	string "LIBS: Libraries to pass to the linker, e.g. -l<library>"

config PK_MMAP_PREALLOC_MAPLOCKED_CPPFLAGS
	string "CPPFLAGS: C/C++ preprocessor flags, e.g. -I<include dir>"

config PK_MMAP_PREALLOC_MAPLOCKED_DPKCONFIG
	string "PKG_CONFIG_PATH: Directories to add to pkg-config's search path"

config PK_MMAP_PREALLOC_MAPLOCKED_CFLAGS
	string "CFLAGS: C compiler flags"

config PK_MMAP_PREALLOC_MAPLOCKED_LDFLAGS
	string "LDFLAGS: Linker flags"

config PK_MMAP_PREALLOC_MAPLOCKED_CXXFLAGS
	string "CXXFLAGS: C++ compiler flags"

config PK_MMAP_PREALLOC_MAPLOCKED_ASFLAGS
	string "CCASFLAGS: assembler compiler flags (defaults to CFLAGS)"

config PK_MMAP_PREALLOC_MAPLOCKED_BUILDARCH
	string "--host options on configure for Architecture"

endif # PK_MMAP_PREALLOC_MAPLOCKED
```

## package/memory-mapping/BiscuitOS-MMAP-PreAlloc-RSVDMEM/Kconfig
```kconfig
menuconfig PK_MMAP_PREALLOC_RSVDMEM
	select PK_MMAP_SPECIAL_U
	bool "PreAlloc: Memory from Reserved Memory"

if PK_MMAP_PREALLOC_RSVDMEM

config PK_MMAP_PREALLOC_RSVDMEM_VERSION
	default "default"
	string "verstion"

config PK_MMAP_PREALLOC_RSVDMEM_TAR
	default "tar.gz"
	string "tar type"

config PK_MMAP_PREALLOC_RSVDMEM_URL
	default "https://gitee.com/BiscuitOS_team/HardStack/raw/Gitee/Memory-Allocator/MMAP/BiscuitOS-MMAP-PreAlloc-RSVDMEM"
	string "url"

config PK_MMAP_PREALLOC_RSVDMEM_GITHUB
	string "GitHub"

config PK_MMAP_PREALLOC_RSVDMEM_SRCFILE
	default "main.c Kconfig Makefile RunBiscuitOS.sh"
	string "Source code list"

config PK_MMAP_PREALLOC_RSVDMEM_CSRCFILE
	string "Compile source code list"

config PK_MMAP_PREALLOC_RSVDMEM_CONFIG
	string "CONFIG: Project Configure Options"

config PK_MMAP_PREALLOC_RSVDMEM_LIBPATH
	string "LIBS: Libraries to pass to the linker, e.g. -l<library>"

config PK_MMAP_PREALLOC_RSVDMEM_CPPFLAGS
	string "CPPFLAGS: C/C++ preprocessor flags, e.g. -I<include dir>"

config PK_MMAP_PREALLOC_RSVDMEM_DPKCONFIG
	string "PKG_CONFIG_PATH: Directories to add to pkg-config's search path"

config PK_MMAP_PREALLOC_RSVDMEM_CFLAGS
	string "CFLAGS: C compiler flags"

config PK_MMAP_PREALLOC_RSVDMEM_LDFLAGS
	string "LDFLAGS: Linker flags"

config PK_MMAP_PREALLOC_RSVDMEM_CXXFLAGS
	string "CXXFLAGS: C++ compiler flags"

config PK_MMAP_PREALLOC_RSVDMEM_ASFLAGS
	string "CCASFLAGS: assembler compiler flags (defaults to CFLAGS)"

config PK_MMAP_PREALLOC_RSVDMEM_BUILDARCH
	string "--host options on configure for Architecture"

endif # PK_MMAP_PREALLOC_RSVDMEM
```

## package/memory-mapping/BiscuitOS-MMAP-PreAlloc-Special-ZONE-NODE/Kconfig
```kconfig
menuconfig PK_MMAP_PREALLOC_ZONE_NODE
	select PK_MMAP_SPECIAL_U
	bool "PreAlloc: Memory from Special ZONE/NODE"

if PK_MMAP_PREALLOC_ZONE_NODE

config PK_MMAP_PREALLOC_ZONE_NODE_VERSION
	default "default"
	string "verstion"

config PK_MMAP_PREALLOC_ZONE_NODE_TAR
	default "tar.gz"
	string "tar type"

config PK_MMAP_PREALLOC_ZONE_NODE_URL
	default "https://gitee.com/BiscuitOS_team/HardStack/raw/Gitee/Memory-Allocator/MMAP/BiscuitOS-MMAP-PreAlloc-Special-ZONE-NODE"
	string "url"

config PK_MMAP_PREALLOC_ZONE_NODE_GITHUB
	string "GitHub"

config PK_MMAP_PREALLOC_ZONE_NODE_SRCFILE
	default "main.c Kconfig Makefile RunBiscuitOS.sh"
	string "Source code list"

config PK_MMAP_PREALLOC_ZONE_NODE_CSRCFILE
	string "Compile source code list"

config PK_MMAP_PREALLOC_ZONE_NODE_CONFIG
	string "CONFIG: Project Configure Options"

config PK_MMAP_PREALLOC_ZONE_NODE_LIBPATH
	string "LIBS: Libraries to pass to the linker, e.g. -l<library>"

config PK_MMAP_PREALLOC_ZONE_NODE_CPPFLAGS
	string "CPPFLAGS: C/C++ preprocessor flags, e.g. -I<include dir>"

config PK_MMAP_PREALLOC_ZONE_NODE_DPKCONFIG
	string "PKG_CONFIG_PATH: Directories to add to pkg-config's search path"

config PK_MMAP_PREALLOC_ZONE_NODE_CFLAGS
	string "CFLAGS: C compiler flags"

config PK_MMAP_PREALLOC_ZONE_NODE_LDFLAGS
	string "LDFLAGS: Linker flags"

config PK_MMAP_PREALLOC_ZONE_NODE_CXXFLAGS
	string "CXXFLAGS: C++ compiler flags"

config PK_MMAP_PREALLOC_ZONE_NODE_ASFLAGS
	string "CCASFLAGS: assembler compiler flags (defaults to CFLAGS)"

config PK_MMAP_PREALLOC_ZONE_NODE_BUILDARCH
	string "--host options on configure for Architecture"

endif # PK_MMAP_PREALLOC_ZONE_NODE
```

## package/memory-mapping/BiscuitOS-MMAP-PreAlloc-VMALLOC/Kconfig
```kconfig
menuconfig PK_MMAP_PREALLOC_VMALLOC
	select PK_MMAP_SPECIAL_U
	bool "PreAlloc: Memory from VMALLOC"

if PK_MMAP_PREALLOC_VMALLOC

config PK_MMAP_PREALLOC_VMALLOC_VERSION
	default "default"
	string "verstion"

config PK_MMAP_PREALLOC_VMALLOC_TAR
	default "tar.gz"
	string "tar type"

config PK_MMAP_PREALLOC_VMALLOC_URL
	default "https://gitee.com/BiscuitOS_team/HardStack/raw/Gitee/Memory-Allocator/MMAP/BiscuitOS-MMAP-PreAlloc-VMALLOC"
	string "url"

config PK_MMAP_PREALLOC_VMALLOC_GITHUB
	string "GitHub"

config PK_MMAP_PREALLOC_VMALLOC_SRCFILE
	default "main.c Kconfig Makefile RunBiscuitOS.sh"
	string "Source code list"

config PK_MMAP_PREALLOC_VMALLOC_CSRCFILE
	string "Compile source code list"

config PK_MMAP_PREALLOC_VMALLOC_CONFIG
	string "CONFIG: Project Configure Options"

config PK_MMAP_PREALLOC_VMALLOC_LIBPATH
	string "LIBS: Libraries to pass to the linker, e.g. -l<library>"

config PK_MMAP_PREALLOC_VMALLOC_CPPFLAGS
	string "CPPFLAGS: C/C++ preprocessor flags, e.g. -I<include dir>"

config PK_MMAP_PREALLOC_VMALLOC_DPKCONFIG
	string "PKG_CONFIG_PATH: Directories to add to pkg-config's search path"

config PK_MMAP_PREALLOC_VMALLOC_CFLAGS
	string "CFLAGS: C compiler flags"

config PK_MMAP_PREALLOC_VMALLOC_LDFLAGS
	string "LDFLAGS: Linker flags"

config PK_MMAP_PREALLOC_VMALLOC_CXXFLAGS
	string "CXXFLAGS: C++ compiler flags"

config PK_MMAP_PREALLOC_VMALLOC_ASFLAGS
	string "CCASFLAGS: assembler compiler flags (defaults to CFLAGS)"

config PK_MMAP_PREALLOC_VMALLOC_BUILDARCH
	string "--host options on configure for Architecture"

endif # PK_MMAP_PREALLOC_VMALLOC
```

## package/memory-mapping/BiscuitOS-MMAP-PreAlloc/Kconfig
```kconfig
menuconfig PK_MMAP_PREALLOC
	bool "PreAlloc: Default Route"

if PK_MMAP_PREALLOC

config PK_MMAP_PREALLOC_VERSION
	default "default"
	string "verstion"

config PK_MMAP_PREALLOC_TAR
	default "tar.gz"
	string "tar type"

config PK_MMAP_PREALLOC_URL
	default "https://gitee.com/BiscuitOS_team/HardStack/raw/Gitee/Memory-Allocator/MMAP/BiscuitOS-MMAP-PreAlloc"
	string "url"

config PK_MMAP_PREALLOC_GITHUB
	string "GitHub"

config PK_MMAP_PREALLOC_SRCFILE
	default "main.c Makefile"
	string "Source code list"

config PK_MMAP_PREALLOC_CSRCFILE
	string "Compile source code list"

config PK_MMAP_PREALLOC_CONFIG
	string "CONFIG: Project Configure Options"

config PK_MMAP_PREALLOC_LIBPATH
	string "LIBS: Libraries to pass to the linker, e.g. -l<library>"

config PK_MMAP_PREALLOC_CPPFLAGS
	string "CPPFLAGS: C/C++ preprocessor flags, e.g. -I<include dir>"

config PK_MMAP_PREALLOC_DPKCONFIG
	string "PKG_CONFIG_PATH: Directories to add to pkg-config's search path"

config PK_MMAP_PREALLOC_CFLAGS
	string "CFLAGS: C compiler flags"

config PK_MMAP_PREALLOC_LDFLAGS
	string "LDFLAGS: Linker flags"

config PK_MMAP_PREALLOC_CXXFLAGS
	string "CXXFLAGS: C++ compiler flags"

config PK_MMAP_PREALLOC_ASFLAGS
	string "CCASFLAGS: assembler compiler flags (defaults to CFLAGS)"

config PK_MMAP_PREALLOC_BUILDARCH
	string "--host options on configure for Architecture"

endif # PK_MMAP_PREALLOC
```
