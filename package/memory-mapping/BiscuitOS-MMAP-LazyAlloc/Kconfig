## package/memory-mapping/BiscuitOS-file-mmap-ext2-userspace/Kconfig
```kconfig
menuconfig PK_BISCUITOS_FILE_MMAP_EXT2_USERSPACE
	bool "File mmap on EXT2 Filesystem (Userspace+)"

if PK_BISCUITOS_FILE_MMAP_EXT2_USERSPACE

config PK_BISCUITOS_FILE_MMAP_EXT2_USERSPACE_VERSION
	default "default"
	string "verstion"

config PK_BISCUITOS_FILE_MMAP_EXT2_USERSPACE_TAR
	default "tar.gz"
	string "tar type"

config PK_BISCUITOS_FILE_MMAP_EXT2_USERSPACE_URL
	default "https://gitee.com/BiscuitOS_team/HardStack/raw/Gitee/Memory-Allocator/MMAP/BiscuitOS-file-mmap-ext2-userspace"
	string "url"

config PK_BISCUITOS_FILE_MMAP_EXT2_USERSPACE_GITHUB
	string "GitHub"

config PK_BISCUITOS_FILE_MMAP_EXT2_USERSPACE_SRCFILE
	default "main.c Makefile RunBiscuitOS.sh"
	string "Source code list"

config PK_BISCUITOS_FILE_MMAP_EXT2_USERSPACE_CSRCFILE
	string "Compile source code list"

config PK_BISCUITOS_FILE_MMAP_EXT2_USERSPACE_CONFIG
	string "CONFIG: Project Configure Options"

config PK_BISCUITOS_FILE_MMAP_EXT2_USERSPACE_LIBPATH
	string "LIBS: Libraries to pass to the linker, e.g. -l<library>"

config PK_BISCUITOS_FILE_MMAP_EXT2_USERSPACE_CPPFLAGS
	string "CPPFLAGS: C/C++ preprocessor flags, e.g. -I<include dir>"

config PK_BISCUITOS_FILE_MMAP_EXT2_USERSPACE_DPKCONFIG
	string "PKG_CONFIG_PATH: Directories to add to pkg-config's search path"

config PK_BISCUITOS_FILE_MMAP_EXT2_USERSPACE_CFLAGS
	string "CFLAGS: C compiler flags"

config PK_BISCUITOS_FILE_MMAP_EXT2_USERSPACE_LDFLAGS
	string "LDFLAGS: Linker flags"

config PK_BISCUITOS_FILE_MMAP_EXT2_USERSPACE_CXXFLAGS
	string "CXXFLAGS: C++ compiler flags"

config PK_BISCUITOS_FILE_MMAP_EXT2_USERSPACE_ASFLAGS
	string "CCASFLAGS: assembler compiler flags (defaults to CFLAGS)"

config PK_BISCUITOS_FILE_MMAP_EXT2_USERSPACE_BUILDARCH
	string "--host options on configure for Architecture"

endif # PK_BISCUITOS_FILE_MMAP_EXT2_USERSPACE
```

## package/memory-mapping/BiscuitOS-file-mmap-ext4-userspace/Kconfig
```kconfig
menuconfig PK_BISCUITOS_FILE_MMAP_EXT4_USERSPACE
	bool "File mmap on EXT4 Filesystem (Userspace+)"

if PK_BISCUITOS_FILE_MMAP_EXT4_USERSPACE

config PK_BISCUITOS_FILE_MMAP_EXT4_USERSPACE_VERSION
	default "default"
	string "verstion"

config PK_BISCUITOS_FILE_MMAP_EXT4_USERSPACE_TAR
	default "tar.gz"
	string "tar type"

config PK_BISCUITOS_FILE_MMAP_EXT4_USERSPACE_URL
	default "https://gitee.com/BiscuitOS_team/HardStack/raw/Gitee/Memory-Allocator/MMAP/BiscuitOS-file-mmap-ext4-userspace"
	string "url"

config PK_BISCUITOS_FILE_MMAP_EXT4_USERSPACE_GITHUB
	string "GitHub"

config PK_BISCUITOS_FILE_MMAP_EXT4_USERSPACE_SRCFILE
	default "main.c Makefile RunBiscuitOS.sh"
	string "Source code list"

config PK_BISCUITOS_FILE_MMAP_EXT4_USERSPACE_CSRCFILE
	string "Compile source code list"

config PK_BISCUITOS_FILE_MMAP_EXT4_USERSPACE_CONFIG
	string "CONFIG: Project Configure Options"

config PK_BISCUITOS_FILE_MMAP_EXT4_USERSPACE_LIBPATH
	string "LIBS: Libraries to pass to the linker, e.g. -l<library>"

config PK_BISCUITOS_FILE_MMAP_EXT4_USERSPACE_CPPFLAGS
	string "CPPFLAGS: C/C++ preprocessor flags, e.g. -I<include dir>"

config PK_BISCUITOS_FILE_MMAP_EXT4_USERSPACE_DPKCONFIG
	string "PKG_CONFIG_PATH: Directories to add to pkg-config's search path"

config PK_BISCUITOS_FILE_MMAP_EXT4_USERSPACE_CFLAGS
	string "CFLAGS: C compiler flags"

config PK_BISCUITOS_FILE_MMAP_EXT4_USERSPACE_LDFLAGS
	string "LDFLAGS: Linker flags"

config PK_BISCUITOS_FILE_MMAP_EXT4_USERSPACE_CXXFLAGS
	string "CXXFLAGS: C++ compiler flags"

config PK_BISCUITOS_FILE_MMAP_EXT4_USERSPACE_ASFLAGS
	string "CCASFLAGS: assembler compiler flags (defaults to CFLAGS)"

config PK_BISCUITOS_FILE_MMAP_EXT4_USERSPACE_BUILDARCH
	string "--host options on configure for Architecture"

endif # PK_BISCUITOS_FILE_MMAP_EXT4_USERSPACE
```

## package/memory-mapping/BiscuitOS-file-mmap-msdos-userspace/Kconfig
```kconfig
menuconfig PK_BISCUITOS_FILE_MMAP_MSDOS_USERSPACE
	bool "File mmap on msdos Filesystem (Userspace+)"

if PK_BISCUITOS_FILE_MMAP_MSDOS_USERSPACE

config PK_BISCUITOS_FILE_MMAP_MSDOS_USERSPACE_VERSION
	default "default"
	string "verstion"

config PK_BISCUITOS_FILE_MMAP_MSDOS_USERSPACE_TAR
	default "tar.gz"
	string "tar type"

config PK_BISCUITOS_FILE_MMAP_MSDOS_USERSPACE_URL
	default "https://gitee.com/BiscuitOS_team/HardStack/raw/Gitee/Memory-Allocator/MMAP/BiscuitOS-file-mmap-msdos-userspace"
	string "url"

config PK_BISCUITOS_FILE_MMAP_MSDOS_USERSPACE_GITHUB
	string "GitHub"

config PK_BISCUITOS_FILE_MMAP_MSDOS_USERSPACE_SRCFILE
	default "main.c Makefile RunBiscuitOS.sh"
	string "Source code list"

config PK_BISCUITOS_FILE_MMAP_MSDOS_USERSPACE_CSRCFILE
	string "Compile source code list"

config PK_BISCUITOS_FILE_MMAP_MSDOS_USERSPACE_CONFIG
	string "CONFIG: Project Configure Options"

config PK_BISCUITOS_FILE_MMAP_MSDOS_USERSPACE_LIBPATH
	string "LIBS: Libraries to pass to the linker, e.g. -l<library>"

config PK_BISCUITOS_FILE_MMAP_MSDOS_USERSPACE_CPPFLAGS
	string "CPPFLAGS: C/C++ preprocessor flags, e.g. -I<include dir>"

config PK_BISCUITOS_FILE_MMAP_MSDOS_USERSPACE_DPKCONFIG
	string "PKG_CONFIG_PATH: Directories to add to pkg-config's search path"

config PK_BISCUITOS_FILE_MMAP_MSDOS_USERSPACE_CFLAGS
	string "CFLAGS: C compiler flags"

config PK_BISCUITOS_FILE_MMAP_MSDOS_USERSPACE_LDFLAGS
	string "LDFLAGS: Linker flags"

config PK_BISCUITOS_FILE_MMAP_MSDOS_USERSPACE_CXXFLAGS
	string "CXXFLAGS: C++ compiler flags"

config PK_BISCUITOS_FILE_MMAP_MSDOS_USERSPACE_ASFLAGS
	string "CCASFLAGS: assembler compiler flags (defaults to CFLAGS)"

config PK_BISCUITOS_FILE_MMAP_MSDOS_USERSPACE_BUILDARCH
	string "--host options on configure for Architecture"

endif # PK_BISCUITOS_FILE_MMAP_MSDOS_USERSPACE
```

## package/memory-mapping/BiscuitOS-hugetlbfs-2M-private-mmap-userspace/Kconfig
```kconfig
menuconfig PK_BISCUITOS_HUGE2M_PRIVATE_MMAP_USERSPACE
	bool "Hugepage(Hugetlbfs) 2MiB private mmap on Userspace"

if PK_BISCUITOS_HUGE2M_PRIVATE_MMAP_USERSPACE

config PK_BISCUITOS_HUGE2M_PRIVATE_MMAP_USERSPACE_VERSION
	default "default"
	string "verstion"

config PK_BISCUITOS_HUGE2M_PRIVATE_MMAP_USERSPACE_TAR
	default "tar.gz"
	string "tar type"

config PK_BISCUITOS_HUGE2M_PRIVATE_MMAP_USERSPACE_URL
	default "https://gitee.com/BiscuitOS_team/HardStack/raw/Gitee/Memory-Allocator/MMAP/BiscuitOS-hugetlbfs-2M-private-mmap-userspace"
	string "url"

config PK_BISCUITOS_HUGE2M_PRIVATE_MMAP_USERSPACE_GITHUB
	string "GitHub"

config PK_BISCUITOS_HUGE2M_PRIVATE_MMAP_USERSPACE_SRCFILE
	default "main.c Makefile RunBiscuitOS.sh"
	string "Source code list"

config PK_BISCUITOS_HUGE2M_PRIVATE_MMAP_USERSPACE_CSRCFILE
	string "Compile source code list"

config PK_BISCUITOS_HUGE2M_PRIVATE_MMAP_USERSPACE_CONFIG
	string "CONFIG: Project Configure Options"

config PK_BISCUITOS_HUGE2M_PRIVATE_MMAP_USERSPACE_LIBPATH
	string "LIBS: Libraries to pass to the linker, e.g. -l<library>"

config PK_BISCUITOS_HUGE2M_PRIVATE_MMAP_USERSPACE_CPPFLAGS
	string "CPPFLAGS: C/C++ preprocessor flags, e.g. -I<include dir>"

config PK_BISCUITOS_HUGE2M_PRIVATE_MMAP_USERSPACE_DPKCONFIG
	string "PKG_CONFIG_PATH: Directories to add to pkg-config's search path"

config PK_BISCUITOS_HUGE2M_PRIVATE_MMAP_USERSPACE_CFLAGS
	string "CFLAGS: C compiler flags"

config PK_BISCUITOS_HUGE2M_PRIVATE_MMAP_USERSPACE_LDFLAGS
	string "LDFLAGS: Linker flags"

config PK_BISCUITOS_HUGE2M_PRIVATE_MMAP_USERSPACE_CXXFLAGS
	string "CXXFLAGS: C++ compiler flags"

config PK_BISCUITOS_HUGE2M_PRIVATE_MMAP_USERSPACE_ASFLAGS
	string "CCASFLAGS: assembler compiler flags (defaults to CFLAGS)"

config PK_BISCUITOS_HUGE2M_PRIVATE_MMAP_USERSPACE_BUILDARCH
	string "--host options on configure for Architecture"

endif # PK_BISCUITOS_HUGE2M_PRIVATE_MMAP_USERSPACE
```

## package/memory-mapping/BiscuitOS-special-private-mmap-kernel/Kconfig
```kconfig
menuconfig PK_BISCUITOS_SPECIAL_PRIVATE_MMAP_KERNEL
	bool "Speical Private mmap (Kernel+)"

if PK_BISCUITOS_SPECIAL_PRIVATE_MMAP_KERNEL

config PK_BISCUITOS_SPECIAL_PRIVATE_MMAP_KERNEL_VERSION
	default "default"
	string "verstion"

config PK_BISCUITOS_SPECIAL_PRIVATE_MMAP_KERNEL_TAR
	default "tar.gz"
	string "tar type"

config PK_BISCUITOS_SPECIAL_PRIVATE_MMAP_KERNEL_URL
	default "https://gitee.com/BiscuitOS_team/HardStack/raw/Gitee/Memory-Allocator/MMAP/BiscuitOS-special-private-mmap-kernel"
	string "url"

config PK_BISCUITOS_SPECIAL_PRIVATE_MMAP_KERNEL_GITHUB
	string "GitHub"

config PK_BISCUITOS_SPECIAL_PRIVATE_MMAP_KERNEL_SRCFILE
	default "main.c Kconfig Makefile RunBiscuitOS.sh"
	string "Source code list"

config PK_BISCUITOS_SPECIAL_PRIVATE_MMAP_KERNEL_CSRCFILE
	string "Compile source code list"

config PK_BISCUITOS_SPECIAL_PRIVATE_MMAP_KERNEL_CONFIG
	string "CONFIG: Project Configure Options"

config PK_BISCUITOS_SPECIAL_PRIVATE_MMAP_KERNEL_LIBPATH
	string "LIBS: Libraries to pass to the linker, e.g. -l<library>"

config PK_BISCUITOS_SPECIAL_PRIVATE_MMAP_KERNEL_CPPFLAGS
	string "CPPFLAGS: C/C++ preprocessor flags, e.g. -I<include dir>"

config PK_BISCUITOS_SPECIAL_PRIVATE_MMAP_KERNEL_DPKCONFIG
	string "PKG_CONFIG_PATH: Directories to add to pkg-config's search path"

config PK_BISCUITOS_SPECIAL_PRIVATE_MMAP_KERNEL_CFLAGS
	string "CFLAGS: C compiler flags"

config PK_BISCUITOS_SPECIAL_PRIVATE_MMAP_KERNEL_LDFLAGS
	string "LDFLAGS: Linker flags"

config PK_BISCUITOS_SPECIAL_PRIVATE_MMAP_KERNEL_CXXFLAGS
	string "CXXFLAGS: C++ compiler flags"

config PK_BISCUITOS_SPECIAL_PRIVATE_MMAP_KERNEL_ASFLAGS
	string "CCASFLAGS: assembler compiler flags (defaults to CFLAGS)"

config PK_BISCUITOS_SPECIAL_PRIVATE_MMAP_KERNEL_BUILDARCH
	string "--host options on configure for Architecture"

endif # PK_BISCUITOS_SPECIAL_PRIVATE_MMAP_KERNEL
```

## package/memory-mapping/BiscuitOS-sys-mmap/BiscuitOS-sys-mmap-example-00/Kconfig
```kconfig
menuconfig PK_BISCUITOS_SYS_MMAP_EXAMPLE_00
	bool "Example 00: Mount noexec add PROT_EXEC"

if PK_BISCUITOS_SYS_MMAP_EXAMPLE_00

config PK_BISCUITOS_SYS_MMAP_EXAMPLE_00_VERSION
	default "default"
	string "verstion"

config PK_BISCUITOS_SYS_MMAP_EXAMPLE_00_TAR
	default "tar.gz"
	string "tar type"

config PK_BISCUITOS_SYS_MMAP_EXAMPLE_00_URL
	default "https://gitee.com/BiscuitOS_team/HardStack/raw/Gitee/Memory-Allocator/MMAP/BiscuitOS-sys-mmap/BiscuitOS-sys-mmap-example-00"
	string "url"

config PK_BISCUITOS_SYS_MMAP_EXAMPLE_00_GITHUB
	string "GitHub"

config PK_BISCUITOS_SYS_MMAP_EXAMPLE_00_SRCFILE
	default "main.c Makefile RunBiscuitOS.sh"
	string "Source code list"

config PK_BISCUITOS_SYS_MMAP_EXAMPLE_00_CSRCFILE
	string "Compile source code list"

config PK_BISCUITOS_SYS_MMAP_EXAMPLE_00_CONFIG
	string "CONFIG: Project Configure Options"

config PK_BISCUITOS_SYS_MMAP_EXAMPLE_00_LIBPATH
	string "LIBS: Libraries to pass to the linker, e.g. -l<library>"

config PK_BISCUITOS_SYS_MMAP_EXAMPLE_00_CPPFLAGS
	string "CPPFLAGS: C/C++ preprocessor flags, e.g. -I<include dir>"

config PK_BISCUITOS_SYS_MMAP_EXAMPLE_00_DPKCONFIG
	string "PKG_CONFIG_PATH: Directories to add to pkg-config's search path"

config PK_BISCUITOS_SYS_MMAP_EXAMPLE_00_CFLAGS
	string "CFLAGS: C compiler flags"

config PK_BISCUITOS_SYS_MMAP_EXAMPLE_00_LDFLAGS
	string "LDFLAGS: Linker flags"

config PK_BISCUITOS_SYS_MMAP_EXAMPLE_00_CXXFLAGS
	string "CXXFLAGS: C++ compiler flags"

config PK_BISCUITOS_SYS_MMAP_EXAMPLE_00_ASFLAGS
	string "CCASFLAGS: assembler compiler flags (defaults to CFLAGS)"

config PK_BISCUITOS_SYS_MMAP_EXAMPLE_00_BUILDARCH
	string "--host options on configure for Architecture"

endif # PK_BISCUITOS_SYS_MMAP_EXAMPLE_00
```

## package/memory-mapping/BiscuitOS-sys-mmap/BiscuitOS-sys-mmap-example-01/Kconfig
```kconfig
menuconfig PK_BISCUITOS_SYS_MMAP_EXAMPLE_01
	bool "Example 01: MAP_FIXED/MAP_FIXED_NOREPLACE/MAP_FIXED_SAFE"

if PK_BISCUITOS_SYS_MMAP_EXAMPLE_01

config PK_BISCUITOS_SYS_MMAP_EXAMPLE_01_VERSION
	default "default"
	string "verstion"

config PK_BISCUITOS_SYS_MMAP_EXAMPLE_01_TAR
	default "tar.gz"
	string "tar type"

config PK_BISCUITOS_SYS_MMAP_EXAMPLE_01_URL
	default "https://gitee.com/BiscuitOS_team/HardStack/raw/Gitee/Memory-Allocator/MMAP/BiscuitOS-sys-mmap/BiscuitOS-sys-mmap-example-01"
	string "url"

config PK_BISCUITOS_SYS_MMAP_EXAMPLE_01_GITHUB
	string "GitHub"

config PK_BISCUITOS_SYS_MMAP_EXAMPLE_01_SRCFILE
	default "main.c Makefile"
	string "Source code list"

config PK_BISCUITOS_SYS_MMAP_EXAMPLE_01_CSRCFILE
	string "Compile source code list"

config PK_BISCUITOS_SYS_MMAP_EXAMPLE_01_CONFIG
	string "CONFIG: Project Configure Options"

config PK_BISCUITOS_SYS_MMAP_EXAMPLE_01_LIBPATH
	string "LIBS: Libraries to pass to the linker, e.g. -l<library>"

config PK_BISCUITOS_SYS_MMAP_EXAMPLE_01_CPPFLAGS
	string "CPPFLAGS: C/C++ preprocessor flags, e.g. -I<include dir>"

config PK_BISCUITOS_SYS_MMAP_EXAMPLE_01_DPKCONFIG
	string "PKG_CONFIG_PATH: Directories to add to pkg-config's search path"

config PK_BISCUITOS_SYS_MMAP_EXAMPLE_01_CFLAGS
	string "CFLAGS: C compiler flags"

config PK_BISCUITOS_SYS_MMAP_EXAMPLE_01_LDFLAGS
	string "LDFLAGS: Linker flags"

config PK_BISCUITOS_SYS_MMAP_EXAMPLE_01_CXXFLAGS
	string "CXXFLAGS: C++ compiler flags"

config PK_BISCUITOS_SYS_MMAP_EXAMPLE_01_ASFLAGS
	string "CCASFLAGS: assembler compiler flags (defaults to CFLAGS)"

config PK_BISCUITOS_SYS_MMAP_EXAMPLE_01_BUILDARCH
	string "--host options on configure for Architecture"

endif # PK_BISCUITOS_SYS_MMAP_EXAMPLE_01
```

## package/memory-mapping/BiscuitOS-sys-mmap/BiscuitOS-sys-mmap-example-02/Kconfig
```kconfig
menuconfig PK_BISCUITOS_SYS_MMAP_EXAMPLE_02
	bool "Example 02: Exception for NULL"

if PK_BISCUITOS_SYS_MMAP_EXAMPLE_02

config PK_BISCUITOS_SYS_MMAP_EXAMPLE_02_VERSION
	default "default"
	string "verstion"

config PK_BISCUITOS_SYS_MMAP_EXAMPLE_02_TAR
	default "tar.gz"
	string "tar type"

config PK_BISCUITOS_SYS_MMAP_EXAMPLE_02_URL
	default "https://gitee.com/BiscuitOS_team/HardStack/raw/Gitee/Memory-Allocator/MMAP/BiscuitOS-sys-mmap/BiscuitOS-sys-mmap-example-02"
	string "url"

config PK_BISCUITOS_SYS_MMAP_EXAMPLE_02_GITHUB
	string "GitHub"

config PK_BISCUITOS_SYS_MMAP_EXAMPLE_02_SRCFILE
	default "main.c Makefile"
	string "Source code list"

config PK_BISCUITOS_SYS_MMAP_EXAMPLE_02_CSRCFILE
	string "Compile source code list"

config PK_BISCUITOS_SYS_MMAP_EXAMPLE_02_CONFIG
	string "CONFIG: Project Configure Options"

config PK_BISCUITOS_SYS_MMAP_EXAMPLE_02_LIBPATH
	string "LIBS: Libraries to pass to the linker, e.g. -l<library>"

config PK_BISCUITOS_SYS_MMAP_EXAMPLE_02_CPPFLAGS
	string "CPPFLAGS: C/C++ preprocessor flags, e.g. -I<include dir>"

config PK_BISCUITOS_SYS_MMAP_EXAMPLE_02_DPKCONFIG
	string "PKG_CONFIG_PATH: Directories to add to pkg-config's search path"

config PK_BISCUITOS_SYS_MMAP_EXAMPLE_02_CFLAGS
	string "CFLAGS: C compiler flags"

config PK_BISCUITOS_SYS_MMAP_EXAMPLE_02_LDFLAGS
	string "LDFLAGS: Linker flags"

config PK_BISCUITOS_SYS_MMAP_EXAMPLE_02_CXXFLAGS
	string "CXXFLAGS: C++ compiler flags"

config PK_BISCUITOS_SYS_MMAP_EXAMPLE_02_ASFLAGS
	string "CCASFLAGS: assembler compiler flags (defaults to CFLAGS)"

config PK_BISCUITOS_SYS_MMAP_EXAMPLE_02_BUILDARCH
	string "--host options on configure for Architecture"

endif # PK_BISCUITOS_SYS_MMAP_EXAMPLE_02
```
