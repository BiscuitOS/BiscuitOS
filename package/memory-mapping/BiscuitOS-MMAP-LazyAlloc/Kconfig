## package/memory-mapping/BiscuitOS-sys-mmap/BiscuitOS-sys-mmap-example-03/Kconfig
```kconfig
menuconfig PK_BISCUITOS_SYS_MMAP_EXAMPLE_03
	bool "Example 03: Direct refer NULL pointer"

if PK_BISCUITOS_SYS_MMAP_EXAMPLE_03

config PK_BISCUITOS_SYS_MMAP_EXAMPLE_03_VERSION
	default "default"
	string "verstion"

config PK_BISCUITOS_SYS_MMAP_EXAMPLE_03_TAR
	default "tar.gz"
	string "tar type"

config PK_BISCUITOS_SYS_MMAP_EXAMPLE_03_URL
	default "https://gitee.com/BiscuitOS_team/HardStack/raw/Gitee/Memory-Allocator/MMAP/BiscuitOS-sys-mmap/BiscuitOS-sys-mmap-example-03"
	string "url"

config PK_BISCUITOS_SYS_MMAP_EXAMPLE_03_GITHUB
	string "GitHub"

config PK_BISCUITOS_SYS_MMAP_EXAMPLE_03_SRCFILE
	default "main.c Makefile RunBiscuitOS.sh"
	string "Source code list"

config PK_BISCUITOS_SYS_MMAP_EXAMPLE_03_CSRCFILE
	string "Compile source code list"

config PK_BISCUITOS_SYS_MMAP_EXAMPLE_03_CONFIG
	string "CONFIG: Project Configure Options"

config PK_BISCUITOS_SYS_MMAP_EXAMPLE_03_LIBPATH
	string "LIBS: Libraries to pass to the linker, e.g. -l<library>"

config PK_BISCUITOS_SYS_MMAP_EXAMPLE_03_CPPFLAGS
	string "CPPFLAGS: C/C++ preprocessor flags, e.g. -I<include dir>"

config PK_BISCUITOS_SYS_MMAP_EXAMPLE_03_DPKCONFIG
	string "PKG_CONFIG_PATH: Directories to add to pkg-config's search path"

config PK_BISCUITOS_SYS_MMAP_EXAMPLE_03_CFLAGS
	string "CFLAGS: C compiler flags"

config PK_BISCUITOS_SYS_MMAP_EXAMPLE_03_LDFLAGS
	string "LDFLAGS: Linker flags"

config PK_BISCUITOS_SYS_MMAP_EXAMPLE_03_CXXFLAGS
	string "CXXFLAGS: C++ compiler flags"

config PK_BISCUITOS_SYS_MMAP_EXAMPLE_03_ASFLAGS
	string "CCASFLAGS: assembler compiler flags (defaults to CFLAGS)"

config PK_BISCUITOS_SYS_MMAP_EXAMPLE_03_BUILDARCH
	string "--host options on configure for Architecture"

endif # PK_BISCUITOS_SYS_MMAP_EXAMPLE_03
```

## package/memory-mapping/BiscuitOS-sys-mmap/BiscuitOS-sys-mmap-example-04/Kconfig
```kconfig
menuconfig PK_BISCUITOS_SYS_MMAP_EXAMPLE_04
	bool "Example 04: NULL Pointer on Kernel Space"

if PK_BISCUITOS_SYS_MMAP_EXAMPLE_04

config PK_BISCUITOS_SYS_MMAP_EXAMPLE_04_VERSION
	default "default"
	string "verstion"

config PK_BISCUITOS_SYS_MMAP_EXAMPLE_04_TAR
	default "tar.gz"
	string "tar type"

config PK_BISCUITOS_SYS_MMAP_EXAMPLE_04_URL
	default "https://gitee.com/BiscuitOS_team/HardStack/raw/Gitee/Memory-Allocator/MMAP/BiscuitOS-sys-mmap/BiscuitOS-sys-mmap-example-04"
	string "url"

config PK_BISCUITOS_SYS_MMAP_EXAMPLE_04_GITHUB
	string "GitHub"

config PK_BISCUITOS_SYS_MMAP_EXAMPLE_04_SRCFILE
	default "main.c Kconfig Makefile"
	string "Source code list"

config PK_BISCUITOS_SYS_MMAP_EXAMPLE_04_CSRCFILE
	string "Compile source code list"

config PK_BISCUITOS_SYS_MMAP_EXAMPLE_04_CONFIG
	string "CONFIG: Project Configure Options"

config PK_BISCUITOS_SYS_MMAP_EXAMPLE_04_LIBPATH
	string "LIBS: Libraries to pass to the linker, e.g. -l<library>"

config PK_BISCUITOS_SYS_MMAP_EXAMPLE_04_CPPFLAGS
	string "CPPFLAGS: C/C++ preprocessor flags, e.g. -I<include dir>"

config PK_BISCUITOS_SYS_MMAP_EXAMPLE_04_DPKCONFIG
	string "PKG_CONFIG_PATH: Directories to add to pkg-config's search path"

config PK_BISCUITOS_SYS_MMAP_EXAMPLE_04_CFLAGS
	string "CFLAGS: C compiler flags"

config PK_BISCUITOS_SYS_MMAP_EXAMPLE_04_LDFLAGS
	string "LDFLAGS: Linker flags"

config PK_BISCUITOS_SYS_MMAP_EXAMPLE_04_CXXFLAGS
	string "CXXFLAGS: C++ compiler flags"

config PK_BISCUITOS_SYS_MMAP_EXAMPLE_04_ASFLAGS
	string "CCASFLAGS: assembler compiler flags (defaults to CFLAGS)"

config PK_BISCUITOS_SYS_MMAP_EXAMPLE_04_BUILDARCH
	string "--host options on configure for Architecture"

endif # PK_BISCUITOS_SYS_MMAP_EXAMPLE_04
```

## package/memory-mapping/BiscuitOS-sys-mmap/BiscuitOS-sys-mmap-example-05-k/Kconfig
```kconfig
menuconfig PK_BISCUITOS_SYS_MMAP_EXAMPLE_05_K
	bool "Example 05: NULL Pointer on Kernel Space (Kernel)"

if PK_BISCUITOS_SYS_MMAP_EXAMPLE_05_K

config PK_BISCUITOS_SYS_MMAP_EXAMPLE_05_K_VERSION
	default "default"
	string "verstion"

config PK_BISCUITOS_SYS_MMAP_EXAMPLE_05_K_TAR
	default "tar.gz"
	string "tar type"

config PK_BISCUITOS_SYS_MMAP_EXAMPLE_05_K_URL
	default "https://gitee.com/BiscuitOS_team/HardStack/raw/Gitee/Memory-Allocator/MMAP/BiscuitOS-sys-mmap/BiscuitOS-sys-mmap-example-05-k"
	string "url"

config PK_BISCUITOS_SYS_MMAP_EXAMPLE_05_K_GITHUB
	string "GitHub"

config PK_BISCUITOS_SYS_MMAP_EXAMPLE_05_K_SRCFILE
	default "main.c Kconfig Makefile"
	string "Source code list"

config PK_BISCUITOS_SYS_MMAP_EXAMPLE_05_K_CSRCFILE
	string "Compile source code list"

config PK_BISCUITOS_SYS_MMAP_EXAMPLE_05_K_CONFIG
	string "CONFIG: Project Configure Options"

config PK_BISCUITOS_SYS_MMAP_EXAMPLE_05_K_LIBPATH
	string "LIBS: Libraries to pass to the linker, e.g. -l<library>"

config PK_BISCUITOS_SYS_MMAP_EXAMPLE_05_K_CPPFLAGS
	string "CPPFLAGS: C/C++ preprocessor flags, e.g. -I<include dir>"

config PK_BISCUITOS_SYS_MMAP_EXAMPLE_05_K_DPKCONFIG
	string "PKG_CONFIG_PATH: Directories to add to pkg-config's search path"

config PK_BISCUITOS_SYS_MMAP_EXAMPLE_05_K_CFLAGS
	string "CFLAGS: C compiler flags"

config PK_BISCUITOS_SYS_MMAP_EXAMPLE_05_K_LDFLAGS
	string "LDFLAGS: Linker flags"

config PK_BISCUITOS_SYS_MMAP_EXAMPLE_05_K_CXXFLAGS
	string "CXXFLAGS: C++ compiler flags"

config PK_BISCUITOS_SYS_MMAP_EXAMPLE_05_K_ASFLAGS
	string "CCASFLAGS: assembler compiler flags (defaults to CFLAGS)"

config PK_BISCUITOS_SYS_MMAP_EXAMPLE_05_K_BUILDARCH
	string "--host options on configure for Architecture"

endif # PK_BISCUITOS_SYS_MMAP_EXAMPLE_05_K
```

## package/memory-mapping/BiscuitOS-sys-mmap/BiscuitOS-sys-mmap-example-05-u/Kconfig
```kconfig
menuconfig PK_BISCUITOS_SYS_MMAP_EXAMPLE_05_U
	select PK_BISCUITOS_SYS_MMAP_EXAMPLE_05_K
	bool "Example 05: NULL Pointer on Kernel Space (Userspace)"

if PK_BISCUITOS_SYS_MMAP_EXAMPLE_05_U

config PK_BISCUITOS_SYS_MMAP_EXAMPLE_05_U_VERSION
	default "default"
	string "verstion"

config PK_BISCUITOS_SYS_MMAP_EXAMPLE_05_U_TAR
	default "tar.gz"
	string "tar type"

config PK_BISCUITOS_SYS_MMAP_EXAMPLE_05_U_URL
	default "https://gitee.com/BiscuitOS_team/HardStack/raw/Gitee/Memory-Allocator/MMAP/BiscuitOS-sys-mmap/BiscuitOS-sys-mmap-example-05-u"
	string "url"

config PK_BISCUITOS_SYS_MMAP_EXAMPLE_05_U_GITHUB
	string "GitHub"

config PK_BISCUITOS_SYS_MMAP_EXAMPLE_05_U_SRCFILE
	default "main.c Makefile"
	string "Source code list"

config PK_BISCUITOS_SYS_MMAP_EXAMPLE_05_U_CSRCFILE
	string "Compile source code list"

config PK_BISCUITOS_SYS_MMAP_EXAMPLE_05_U_CONFIG
	string "CONFIG: Project Configure Options"

config PK_BISCUITOS_SYS_MMAP_EXAMPLE_05_U_LIBPATH
	string "LIBS: Libraries to pass to the linker, e.g. -l<library>"

config PK_BISCUITOS_SYS_MMAP_EXAMPLE_05_U_CPPFLAGS
	string "CPPFLAGS: C/C++ preprocessor flags, e.g. -I<include dir>"

config PK_BISCUITOS_SYS_MMAP_EXAMPLE_05_U_DPKCONFIG
	string "PKG_CONFIG_PATH: Directories to add to pkg-config's search path"

config PK_BISCUITOS_SYS_MMAP_EXAMPLE_05_U_CFLAGS
	string "CFLAGS: C compiler flags"

config PK_BISCUITOS_SYS_MMAP_EXAMPLE_05_U_LDFLAGS
	string "LDFLAGS: Linker flags"

config PK_BISCUITOS_SYS_MMAP_EXAMPLE_05_U_CXXFLAGS
	string "CXXFLAGS: C++ compiler flags"

config PK_BISCUITOS_SYS_MMAP_EXAMPLE_05_U_ASFLAGS
	string "CCASFLAGS: assembler compiler flags (defaults to CFLAGS)"

config PK_BISCUITOS_SYS_MMAP_EXAMPLE_05_U_BUILDARCH
	string "--host options on configure for Architecture"

endif # PK_BISCUITOS_SYS_MMAP_EXAMPLE_05_U
```

## package/memory-mapping/BiscuitOS-sys-mmap/Kconfig
```kconfig
menuconfig PK_BISCUITOS_SYS_MMAP
	bool "SYSCALL: mmap/mmap2"

if PK_BISCUITOS_SYS_MMAP

# Example 00
source "package/memory-mapping/BiscuitOS-sys-mmap/BiscuitOS-sys-mmap-example-00/Kconfig"

# Example 01
source "package/memory-mapping/BiscuitOS-sys-mmap/BiscuitOS-sys-mmap-example-01/Kconfig"

# Example 02
source "package/memory-mapping/BiscuitOS-sys-mmap/BiscuitOS-sys-mmap-example-02/Kconfig"

# Example 03
source "package/memory-mapping/BiscuitOS-sys-mmap/BiscuitOS-sys-mmap-example-03/Kconfig"

# Example 04
source "package/memory-mapping/BiscuitOS-sys-mmap/BiscuitOS-sys-mmap-example-04/Kconfig"

# Example 05 (U)
source "package/memory-mapping/BiscuitOS-sys-mmap/BiscuitOS-sys-mmap-example-05-u/Kconfig"

# Example 05 (K)
source "package/memory-mapping/BiscuitOS-sys-mmap/BiscuitOS-sys-mmap-example-05-k/Kconfig"

endif # 
```

## package/memory-mapping/BiscuitOS-vma-merge/BiscuitOS-vma-merge-case0/Kconfig
```kconfig
menuconfig PK_BISCUITOS_VMA_MERGE_CASE0
	bool "Case0: start == prev->vm_end && end == next->vm_start"

if PK_BISCUITOS_VMA_MERGE_CASE0

config PK_BISCUITOS_VMA_MERGE_CASE0_VERSION
	default "default"
	string "verstion"

config PK_BISCUITOS_VMA_MERGE_CASE0_TAR
	default "tar.gz"
	string "tar type"

config PK_BISCUITOS_VMA_MERGE_CASE0_URL
	default "https://gitee.com/BiscuitOS_team/HardStack/raw/Gitee/Memory-Allocator/MMAP/BiscuitOS-vma-merge/BiscuitOS-vma-merge-case0"
	string "url"

config PK_BISCUITOS_VMA_MERGE_CASE0_GITHUB
	string "GitHub"

config PK_BISCUITOS_VMA_MERGE_CASE0_SRCFILE
	default "main.c Makefile"
	string "Source code list"

config PK_BISCUITOS_VMA_MERGE_CASE0_CSRCFILE
	string "Compile source code list"

config PK_BISCUITOS_VMA_MERGE_CASE0_CONFIG
	string "CONFIG: Project Configure Options"

config PK_BISCUITOS_VMA_MERGE_CASE0_LIBPATH
	string "LIBS: Libraries to pass to the linker, e.g. -l<library>"

config PK_BISCUITOS_VMA_MERGE_CASE0_CPPFLAGS
	string "CPPFLAGS: C/C++ preprocessor flags, e.g. -I<include dir>"

config PK_BISCUITOS_VMA_MERGE_CASE0_DPKCONFIG
	string "PKG_CONFIG_PATH: Directories to add to pkg-config's search path"

config PK_BISCUITOS_VMA_MERGE_CASE0_CFLAGS
	string "CFLAGS: C compiler flags"

config PK_BISCUITOS_VMA_MERGE_CASE0_LDFLAGS
	string "LDFLAGS: Linker flags"

config PK_BISCUITOS_VMA_MERGE_CASE0_CXXFLAGS
	string "CXXFLAGS: C++ compiler flags"

config PK_BISCUITOS_VMA_MERGE_CASE0_ASFLAGS
	string "CCASFLAGS: assembler compiler flags (defaults to CFLAGS)"

config PK_BISCUITOS_VMA_MERGE_CASE0_BUILDARCH
	string "--host options on configure for Architecture"

endif # PK_BISCUITOS_VMA_MERGE_CASE0
```

## package/memory-mapping/BiscuitOS-vma-merge/BiscuitOS-vma-merge-layout0-intersect/Kconfig
```kconfig
menuconfig PK_BISCUITOS_VMA_MERGE_LAYOUT0_INTERSECT
	bool "Layout0: intersect with NEXT region"

if PK_BISCUITOS_VMA_MERGE_LAYOUT0_INTERSECT

config PK_BISCUITOS_VMA_MERGE_LAYOUT0_INTERSECT_VERSION
	default "default"
	string "verstion"

config PK_BISCUITOS_VMA_MERGE_LAYOUT0_INTERSECT_TAR
	default "tar.gz"
	string "tar type"

config PK_BISCUITOS_VMA_MERGE_LAYOUT0_INTERSECT_URL
	default "https://gitee.com/BiscuitOS_team/HardStack/raw/Gitee/Memory-Allocator/MMAP/BiscuitOS-vma-merge/BiscuitOS-vma-merge-layout0-intersect"
	string "url"

config PK_BISCUITOS_VMA_MERGE_LAYOUT0_INTERSECT_GITHUB
	string "GitHub"

config PK_BISCUITOS_VMA_MERGE_LAYOUT0_INTERSECT_SRCFILE
	default "main.c Makefile"
	string "Source code list"

config PK_BISCUITOS_VMA_MERGE_LAYOUT0_INTERSECT_CSRCFILE
	string "Compile source code list"

config PK_BISCUITOS_VMA_MERGE_LAYOUT0_INTERSECT_CONFIG
	string "CONFIG: Project Configure Options"

config PK_BISCUITOS_VMA_MERGE_LAYOUT0_INTERSECT_LIBPATH
	string "LIBS: Libraries to pass to the linker, e.g. -l<library>"

config PK_BISCUITOS_VMA_MERGE_LAYOUT0_INTERSECT_CPPFLAGS
	string "CPPFLAGS: C/C++ preprocessor flags, e.g. -I<include dir>"

config PK_BISCUITOS_VMA_MERGE_LAYOUT0_INTERSECT_DPKCONFIG
	string "PKG_CONFIG_PATH: Directories to add to pkg-config's search path"

config PK_BISCUITOS_VMA_MERGE_LAYOUT0_INTERSECT_CFLAGS
	string "CFLAGS: C compiler flags"

config PK_BISCUITOS_VMA_MERGE_LAYOUT0_INTERSECT_LDFLAGS
	string "LDFLAGS: Linker flags"

config PK_BISCUITOS_VMA_MERGE_LAYOUT0_INTERSECT_CXXFLAGS
	string "CXXFLAGS: C++ compiler flags"

config PK_BISCUITOS_VMA_MERGE_LAYOUT0_INTERSECT_ASFLAGS
	string "CCASFLAGS: assembler compiler flags (defaults to CFLAGS)"

config PK_BISCUITOS_VMA_MERGE_LAYOUT0_INTERSECT_BUILDARCH
	string "--host options on configure for Architecture"

endif # PK_BISCUITOS_VMA_MERGE_LAYOUT0_INTERSECT
```

## package/memory-mapping/BiscuitOS-vma-merge/BiscuitOS-vma-merge-layout1-adjoin/Kconfig
```kconfig
menuconfig PK_BISCUITOS_VMA_MERGE_LAYOUT1_ADJOIN
	bool "Layout1: adjoin with NEXT region"

if PK_BISCUITOS_VMA_MERGE_LAYOUT1_ADJOIN

config PK_BISCUITOS_VMA_MERGE_LAYOUT1_ADJOIN_VERSION
	default "default"
	string "verstion"

config PK_BISCUITOS_VMA_MERGE_LAYOUT1_ADJOIN_TAR
	default "tar.gz"
	string "tar type"

config PK_BISCUITOS_VMA_MERGE_LAYOUT1_ADJOIN_URL
	default "https://gitee.com/BiscuitOS_team/HardStack/raw/Gitee/Memory-Allocator/MMAP/BiscuitOS-vma-merge/BiscuitOS-vma-merge-layout1-adjoin"
	string "url"

config PK_BISCUITOS_VMA_MERGE_LAYOUT1_ADJOIN_GITHUB
	string "GitHub"

config PK_BISCUITOS_VMA_MERGE_LAYOUT1_ADJOIN_SRCFILE
	default "main.c Makefile"
	string "Source code list"

config PK_BISCUITOS_VMA_MERGE_LAYOUT1_ADJOIN_CSRCFILE
	string "Compile source code list"

config PK_BISCUITOS_VMA_MERGE_LAYOUT1_ADJOIN_CONFIG
	string "CONFIG: Project Configure Options"

config PK_BISCUITOS_VMA_MERGE_LAYOUT1_ADJOIN_LIBPATH
	string "LIBS: Libraries to pass to the linker, e.g. -l<library>"

config PK_BISCUITOS_VMA_MERGE_LAYOUT1_ADJOIN_CPPFLAGS
	string "CPPFLAGS: C/C++ preprocessor flags, e.g. -I<include dir>"

config PK_BISCUITOS_VMA_MERGE_LAYOUT1_ADJOIN_DPKCONFIG
	string "PKG_CONFIG_PATH: Directories to add to pkg-config's search path"

config PK_BISCUITOS_VMA_MERGE_LAYOUT1_ADJOIN_CFLAGS
	string "CFLAGS: C compiler flags"

config PK_BISCUITOS_VMA_MERGE_LAYOUT1_ADJOIN_LDFLAGS
	string "LDFLAGS: Linker flags"

config PK_BISCUITOS_VMA_MERGE_LAYOUT1_ADJOIN_CXXFLAGS
	string "CXXFLAGS: C++ compiler flags"

config PK_BISCUITOS_VMA_MERGE_LAYOUT1_ADJOIN_ASFLAGS
	string "CCASFLAGS: assembler compiler flags (defaults to CFLAGS)"

config PK_BISCUITOS_VMA_MERGE_LAYOUT1_ADJOIN_BUILDARCH
	string "--host options on configure for Architecture"

endif # PK_BISCUITOS_VMA_MERGE_LAYOUT1_ADJOIN
```
