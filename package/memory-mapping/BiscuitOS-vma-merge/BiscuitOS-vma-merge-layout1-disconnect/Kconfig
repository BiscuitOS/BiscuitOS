## package/memory-sanitizers/Kconfig
```kconfig
menuconfig PK_MEMORY_SANITIZER
	bool "Memory Sanitizers"

if PK_MEMORY_SANITIZER

# GCC ASAN
source package/memory-sanitizers/BiscuitOS-ASAN/Kconfig

# GCC ASAN: heap-use-after-free
source package/memory-sanitizers/BiscuitOS-ASAN-heap-use-after-free/Kconfig

# GCC ASAN: heap-use-after-free on C++
source package/memory-sanitizers/BiscuitOS-ASAN-heap-use-after-free-CPP/Kconfig

# GCC ASAN: heap-buffer-overflow
source package/memory-sanitizers/BiscuitOS-ASAN-heap-buffer-overflow/Kconfig

# GCC ASAN: heap-buffer-overflow on C++
source package/memory-sanitizers/BiscuitOS-ASAN-heap-buffer-overflow-CPP/Kconfig

# GCC ASAN: stack-buffer-overflow
source package/memory-sanitizers/BiscuitOS-ASAN-stack-buffer-overflow/Kconfig

# GCC ASAN: stack-buffer-overflow on C++
source package/memory-sanitizers/BiscuitOS-ASAN-stack-buffer-overflow-CPP/Kconfig

# GCC ASAN: global-buffer-overflow
source package/memory-sanitizers/BiscuitOS-ASAN-global-buffer-overflow/Kconfig

# GCC ASAN: global-buffer-overflow on C++
source package/memory-sanitizers/BiscuitOS-ASAN-global-buffer-overflow-CPP/Kconfig

# GCC ASAN: stack-use-after-scope
source package/memory-sanitizers/BiscuitOS-ASAN-stack-use-after-scope/Kconfig

# GCC ASAN: stack-use-after-scope on C++
source package/memory-sanitizers/BiscuitOS-ASAN-stack-use-after-scope-CPP/Kconfig

# GCC ASAN: memory leak
source package/memory-sanitizers/BiscuitOS-ASAN-memory-leak/Kconfig

# GCC ASAN: memory leak on C++
source package/memory-sanitizers/BiscuitOS-ASAN-memory-leak-CPP/Kconfig

endif # PK_MEMORY_SANITIZER
```

## package/memory-statistic/BiscuitOS-Cgroup/BiscuitOS-vma-merge-layout0-disconnect/Kconfig
```kconfig
menuconfig PK_BISCUITOS_VMA_MERGE_LAYOUT0_DISCONNECT
	bool "Layout0: Disconnect with NEXT"

if PK_BISCUITOS_VMA_MERGE_LAYOUT0_DISCONNECT

config PK_BISCUITOS_VMA_MERGE_LAYOUT0_DISCONNECT_VERSION
	default "default"
	string "verstion"

config PK_BISCUITOS_VMA_MERGE_LAYOUT0_DISCONNECT_TAR
	default "tar.gz"
	string "tar type"

config PK_BISCUITOS_VMA_MERGE_LAYOUT0_DISCONNECT_URL
	default "https://gitee.com/BiscuitOS_team/HardStack/raw/Gitee/Memory-Allocator/MMAP/BiscuitOS-vma-merge/BiscuitOS-vma-merge-layout0-disconnect"
	string "url"

config PK_BISCUITOS_VMA_MERGE_LAYOUT0_DISCONNECT_GITHUB
	string "GitHub"

config PK_BISCUITOS_VMA_MERGE_LAYOUT0_DISCONNECT_SRCFILE
	default "main.c Makefile"
	string "Source code list"

config PK_BISCUITOS_VMA_MERGE_LAYOUT0_DISCONNECT_CSRCFILE
	string "Compile source code list"

config PK_BISCUITOS_VMA_MERGE_LAYOUT0_DISCONNECT_CONFIG
	string "CONFIG: Project Configure Options"

config PK_BISCUITOS_VMA_MERGE_LAYOUT0_DISCONNECT_LIBPATH
	string "LIBS: Libraries to pass to the linker, e.g. -l<library>"

config PK_BISCUITOS_VMA_MERGE_LAYOUT0_DISCONNECT_CPPFLAGS
	string "CPPFLAGS: C/C++ preprocessor flags, e.g. -I<include dir>"

config PK_BISCUITOS_VMA_MERGE_LAYOUT0_DISCONNECT_DPKCONFIG
	string "PKG_CONFIG_PATH: Directories to add to pkg-config's search path"

config PK_BISCUITOS_VMA_MERGE_LAYOUT0_DISCONNECT_CFLAGS
	string "CFLAGS: C compiler flags"

config PK_BISCUITOS_VMA_MERGE_LAYOUT0_DISCONNECT_LDFLAGS
	string "LDFLAGS: Linker flags"

config PK_BISCUITOS_VMA_MERGE_LAYOUT0_DISCONNECT_CXXFLAGS
	string "CXXFLAGS: C++ compiler flags"

config PK_BISCUITOS_VMA_MERGE_LAYOUT0_DISCONNECT_ASFLAGS
	string "CCASFLAGS: assembler compiler flags (defaults to CFLAGS)"

config PK_BISCUITOS_VMA_MERGE_LAYOUT0_DISCONNECT_BUILDARCH
	string "--host options on configure for Architecture"

endif # PK_BISCUITOS_VMA_MERGE_LAYOUT0_DISCONNECT
```

## package/memory-statistic/BiscuitOS-Cgroup/Kconfig
```kconfig
menuconfig PK_BISCUITOS_VMA_MERGE
	bool "VMA Merge Region Algorithm"

if PK_BISCUITOS_VMA_MERGE

# Layout 0: Disconnect with NEXT
source "package/memory-mapping/BiscuitOS-vma-merge/BiscuitOS-vma-merge-layout0-disconnect/Kconfig"

endif # 
```

## package/memory-statistic/Kconfig
```kconfig
menuconfig PK_MEMORY_STATISTIC
	bool "Memory Statistic Tools"

if PK_MEMORY_STATISTIC

# Memory Cgroup
source package/memory-mapping/BiscuitOS-Cgroup/Kconfig

endif # PK_MEMORY_STATISTIC
```

## package/memory_history/BiscuitOS/BiscuitOS_Memory-0.11/Kconfig
```kconfig
menuconfig PK_BISCUITOS_MEMORY_0_11
	bool "BiscuitOS Memory Design: 0.11"

if PK_BISCUITOS_MEMORY_0_11

config PK_BISCUITOS_MEMORY_0_11_VERSION
	default "0.11"
	string "verstion"

config PK_BISCUITOS_MEMORY_0_11_TAR
	default "tar.gz"
	string "tar type"

config PK_BISCUITOS_MEMORY_0_11_URL
	default "https://gitee.com/BiscuitOS_team/HardStack/raw/Gitee/Memory-Allocator/History/mm/mm_bs"
	string "url"

config PK_BISCUITOS_MEMORY_0_11_GITHUB
	string "GitHub"
	default "https://gitee.com/BiscuitOS_team/BiscuitOS_Memory.git"

config PK_BISCUITOS_MEMORY_0_11_SRCFILE
	default "README.md"
	string "Source code list"

config PK_BISCUITOS_MEMORY_0_11_CSRCFILE
	string "Compile source code list"

config PK_BISCUITOS_MEMORY_0_11_CONFIG
	string "CONFIG: Project Configure Options"

config PK_BISCUITOS_MEMORY_0_11_LIBPATH
	string "LIBS: Libraries to pass to the linker, e.g. -l<library>"

config PK_BISCUITOS_MEMORY_0_11_CPPFLAGS
	string "CPPFLAGS: C/C++ preprocessor flags, e.g. -I<include dir>"

config PK_BISCUITOS_MEMORY_0_11_DPKCONFIG
	string "PKG_CONFIG_PATH: Directories to add to pkg-config's search path"

config PK_BISCUITOS_MEMORY_0_11_CFLAGS
	string "CFLAGS: C compiler flags"

config PK_BISCUITOS_MEMORY_0_11_LDFLAGS
	string "LDFLAGS: Linker flags"

config PK_BISCUITOS_MEMORY_0_11_CXXFLAGS
	string "CXXFLAGS: C++ compiler flags"

config PK_BISCUITOS_MEMORY_0_11_ASFLAGS
	string "CCASFLAGS: assembler compiler flags (defaults to CFLAGS)"

config PK_BISCUITOS_MEMORY_0_11_BUILDARCH
	string "--host options on configure for Architecture"

endif # PK_BISCUITOS_MEMORY_0_11
```

## package/memory_history/BiscuitOS/BiscuitOS_Memory-Base/Kconfig
```kconfig
menuconfig PK_BISCUITOS_MEMORY_BASE
	bool "BiscuitOS Memory Design: Base"

if PK_BISCUITOS_MEMORY_BASE

config PK_BISCUITOS_MEMORY_BASE_VERSION
	default "Base"
	string "verstion"

config PK_BISCUITOS_MEMORY_BASE_TAR
	default "tar.gz"
	string "tar type"

config PK_BISCUITOS_MEMORY_BASE_URL
	default "https://gitee.com/BiscuitOS_team/HardStack/raw/Gitee/Memory-Allocator/History/mm/mm_bs"
	string "url"

config PK_BISCUITOS_MEMORY_BASE_GITHUB
	string "GitHub"
	default "https://gitee.com/BiscuitOS_team/BiscuitOS_Memory.git"

config PK_BISCUITOS_MEMORY_BASE_SRCFILE
	default "README.md"
	string "Source code list"

config PK_BISCUITOS_MEMORY_BASE_CSRCFILE
	string "Compile source code list"

config PK_BISCUITOS_MEMORY_BASE_CONFIG
	string "CONFIG: Project Configure Options"

config PK_BISCUITOS_MEMORY_BASE_LIBPATH
	string "LIBS: Libraries to pass to the linker, e.g. -l<library>"

config PK_BISCUITOS_MEMORY_BASE_CPPFLAGS
	string "CPPFLAGS: C/C++ preprocessor flags, e.g. -I<include dir>"

config PK_BISCUITOS_MEMORY_BASE_DPKCONFIG
	string "PKG_CONFIG_PATH: Directories to add to pkg-config's search path"

config PK_BISCUITOS_MEMORY_BASE_CFLAGS
	string "CFLAGS: C compiler flags"

config PK_BISCUITOS_MEMORY_BASE_LDFLAGS
	string "LDFLAGS: Linker flags"

config PK_BISCUITOS_MEMORY_BASE_CXXFLAGS
	string "CXXFLAGS: C++ compiler flags"

config PK_BISCUITOS_MEMORY_BASE_ASFLAGS
	string "CCASFLAGS: assembler compiler flags (defaults to CFLAGS)"

config PK_BISCUITOS_MEMORY_BASE_BUILDARCH
	string "--host options on configure for Architecture"

endif # PK_BISCUITOS_MEMORY_BASE
```

## package/memory_history/BiscuitOS/Kconfig
```kconfig
menuconfig PK_BISCUITOS_MEMORY
	bool "BiscuitOS MMU Design"

if PK_BISCUITOS_MEMORY

# BiscuitOS-Base
source "package/memory_history/BiscuitOS/BiscuitOS_Memory-Base/Kconfig"

# BiscuitOS-0.11
source "package/memory_history/BiscuitOS/BiscuitOS_Memory-0.11/Kconfig"

endif # PK_BISCUITOS_MEMORY
```

## package/memory_history/CMA/Kconfig
```kconfig
menuconfig PK_CMA_HISTORY
	bool "CMA Allocator"

if PK_CMA_HISTORY


endif # PK_CMA_HISTORY
```

## package/memory_history/FIXMAP/Kconfig
```kconfig
menuconfig PK_FIXMAP_HISTORY
	bool "FIXMAP Allocator"

if PK_FIXMAP_HISTORY

# linux 2.6.12
source "package/memory_history/FIXMAP/linux-2.6.12/Kconfig"

# linux 2.6.12.1
source "package/memory_history/FIXMAP/linux-2.6.12.1/Kconfig"

# linux 2.6.12.2
source "package/memory_history/FIXMAP/linux-2.6.12.2/Kconfig"

# linux 2.6.12.3
source "package/memory_history/FIXMAP/linux-2.6.12.3/Kconfig"

# linux 2.6.12.4
source "package/memory_history/FIXMAP/linux-2.6.12.4/Kconfig"

# linux 2.6.12.5
source "package/memory_history/FIXMAP/linux-2.6.12.5/Kconfig"

# linux 2.6.12.6
source "package/memory_history/FIXMAP/linux-2.6.12.6/Kconfig"

# linux 2.6.13
source "package/memory_history/FIXMAP/linux-2.6.13/Kconfig"

# linux 2.6.13.1
source "package/memory_history/FIXMAP/linux-2.6.13.1/Kconfig"

# linux 2.6.14
source "package/memory_history/FIXMAP/linux-2.6.14/Kconfig"

# linux 2.6.15
source "package/memory_history/FIXMAP/linux-2.6.15/Kconfig"

endif # PK_FIXMAP_HISTORY
```

## package/memory_history/Kconfig
```kconfig
menuconfig PK_MEMORY_HISTORY
	bool "Memory Development History"

if PK_MEMORY_HISTORY

# MMU 
source "package/memory_history/MMU/Kconfig"

# Bootmem
source "package/memory_history/bootmem/Kconfig"

# Buddy
source "package/memory_history/buddy/Kconfig"

# PCP
source "package/memory_history/PCP/Kconfig"

# PERCPU
source "package/memory_history/PERCPU/Kconfig"

# Slab
source "package/memory_history/SLAB/Kconfig"

# Slub
source "package/memory_history/slub/Kconfig"

# Slob
source "package/memory_history/slob/Kconfig"

# VMALLOC
source "package/memory_history/VMALLOC/Kconfig"

# kmap
source "package/memory_history/KMAP/Kconfig"

# fixmap
source "package/memory_history/FIXMAP/Kconfig"

# CMA
source "package/memory_history/CMA/Kconfig"

# BiscuitOS Memory
source "package/memory_history/BiscuitOS/Kconfig"

endif # PK_MEMORY_HISTORY
```

## package/memory_history/MMU/linux-2.6.16/Kconfig
```kconfig
menuconfig PK_MMU_2_6_16
	bool "MMU on linux 2.6.16"

if PK_MMU_2_6_16

config PK_MMU_2_6_16_VERSION
	default "2.6.16"
	string "verstion"

config PK_MMU_2_6_16_TAR
	default "tar.gz"
	string "tar type"

config PK_MMU_2_6_16_URL
	default "https://gitee.com/BiscuitOS_team/HardStack/raw/Gitee/Memory-Allocator/History/mm/mm_bs"
	string "url"

config PK_MMU_2_6_16_GITHUB
	string "GitHub"
	default "https://gitee.com/BiscuitOS_team/BiscuitOS_Memory.git"

config PK_MMU_2_6_16_SRCFILE
	default "README.md"
	string "Source code list"

config PK_MMU_2_6_16_CSRCFILE
	string "Compile source code list"

config PK_MMU_2_6_16_CONFIG
	string "CONFIG: Project Configure Options"

config PK_MMU_2_6_16_LIBPATH
	string "LIBS: Libraries to pass to the linker, e.g. -l<library>"

config PK_MMU_2_6_16_CPPFLAGS
	string "CPPFLAGS: C/C++ preprocessor flags, e.g. -I<include dir>"

config PK_MMU_2_6_16_DPKCONFIG
	string "PKG_CONFIG_PATH: Directories to add to pkg-config's search path"

config PK_MMU_2_6_16_CFLAGS
	string "CFLAGS: C compiler flags"

config PK_MMU_2_6_16_LDFLAGS
	string "LDFLAGS: Linker flags"

config PK_MMU_2_6_16_CXXFLAGS
	string "CXXFLAGS: C++ compiler flags"

config PK_MMU_2_6_16_ASFLAGS
	string "CCASFLAGS: assembler compiler flags (defaults to CFLAGS)"

config PK_MMU_2_6_16_BUILDARCH
	string "--host options on configure for Architecture"

endif # PK_MMU_2_6_16
```

## package/memory_history/PCP/Kconfig
```kconfig
menuconfig PK_PCP_HISTORY
	bool "PCP Allocator (Hot-Cold Page)"

if PK_PCP_HISTORY

# linux 2.6.12
source "package/memory_history/PCP/linux-2.6.12/Kconfig"

endif # PK_PCP_HISTORY
```

## package/memory_history/PCP/linux-2.6.12.5/Kconfig
```kconfig
menuconfig PK_PCP_2_6_12_5
	bool "PCP on linux 2.6.12.5"

if PK_PCP_2_6_12_5

config PK_PCP_2_6_12_5_VERSION
	default "2.6.12.5"
	string "verstion"

config PK_PCP_2_6_12_5_TAR
	default "tar.gz"
	string "tar type"

config PK_PCP_2_6_12_5_URL
	default "https://gitee.com/BiscuitOS_team/HardStack/raw/Gitee/Memory-Allocator/History/mm/mm_bs"
	string "url"

config PK_PCP_2_6_12_5_GITHUB
	string "GitHub"
	default "https://gitee.com/BiscuitOS_team/BiscuitOS_Memory.git"

config PK_PCP_2_6_12_5_SRCFILE
	default "README.md"
	string "Source code list"

config PK_PCP_2_6_12_5_CSRCFILE
	string "Compile source code list"

config PK_PCP_2_6_12_5_CONFIG
	string "CONFIG: Project Configure Options"

config PK_PCP_2_6_12_5_LIBPATH
	string "LIBS: Libraries to pass to the linker, e.g. -l<library>"

config PK_PCP_2_6_12_5_CPPFLAGS
	string "CPPFLAGS: C/C++ preprocessor flags, e.g. -I<include dir>"

config PK_PCP_2_6_12_5_DPKCONFIG
	string "PKG_CONFIG_PATH: Directories to add to pkg-config's search path"

config PK_PCP_2_6_12_5_CFLAGS
	string "CFLAGS: C compiler flags"

config PK_PCP_2_6_12_5_LDFLAGS
	string "LDFLAGS: Linker flags"

config PK_PCP_2_6_12_5_CXXFLAGS
	string "CXXFLAGS: C++ compiler flags"

config PK_PCP_2_6_12_5_ASFLAGS
	string "CCASFLAGS: assembler compiler flags (defaults to CFLAGS)"

config PK_PCP_2_6_12_5_BUILDARCH
	string "--host options on configure for Architecture"

endif # PK_PCP_2_6_12_5
```

## package/memory_history/PCP/linux-2.6.14/Kconfig
```kconfig
menuconfig PK_PCP_2_6_14
	bool "PCP on linux 2.6.14"

if PK_PCP_2_6_14

config PK_PCP_2_6_14_VERSION
	default "2.6.14"
	string "verstion"

config PK_PCP_2_6_14_TAR
	default "tar.gz"
	string "tar type"

config PK_PCP_2_6_14_URL
	default "https://gitee.com/BiscuitOS_team/HardStack/raw/Gitee/Memory-Allocator/History/mm/mm_bs"
	string "url"

config PK_PCP_2_6_14_GITHUB
	string "GitHub"
	default "https://gitee.com/BiscuitOS_team/BiscuitOS_Memory.git"

config PK_PCP_2_6_14_SRCFILE
	default "README.md"
	string "Source code list"

config PK_PCP_2_6_14_CSRCFILE
	string "Compile source code list"

config PK_PCP_2_6_14_CONFIG
	string "CONFIG: Project Configure Options"

config PK_PCP_2_6_14_LIBPATH
	string "LIBS: Libraries to pass to the linker, e.g. -l<library>"

config PK_PCP_2_6_14_CPPFLAGS
	string "CPPFLAGS: C/C++ preprocessor flags, e.g. -I<include dir>"

config PK_PCP_2_6_14_DPKCONFIG
	string "PKG_CONFIG_PATH: Directories to add to pkg-config's search path"

config PK_PCP_2_6_14_CFLAGS
	string "CFLAGS: C compiler flags"

config PK_PCP_2_6_14_LDFLAGS
	string "LDFLAGS: Linker flags"

config PK_PCP_2_6_14_CXXFLAGS
	string "CXXFLAGS: C++ compiler flags"

config PK_PCP_2_6_14_ASFLAGS
	string "CCASFLAGS: assembler compiler flags (defaults to CFLAGS)"

config PK_PCP_2_6_14_BUILDARCH
	string "--host options on configure for Architecture"

endif # PK_PCP_2_6_14
```

## package/memory_history/PERCPU/Kconfig
```kconfig
menuconfig PK_PERCPU_HISTORY
	bool "PERCPU Allocator (UP/SMP)"

if PK_PERCPU_HISTORY

# linux 2.6.12
source "package/memory_history/PERCPU/linux-2.6.12/Kconfig"

endif # PK_PERCPU_HISTORY
```
