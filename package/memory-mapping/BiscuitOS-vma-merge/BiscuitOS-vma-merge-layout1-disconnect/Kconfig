## package/memory_history/PERCPU/linux-2.6.12.2/Kconfig
```kconfig
menuconfig PK_PERCPU_2_6_12_2
	bool "PERCPU on linux 2.6.12.2"

if PK_PERCPU_2_6_12_2

config PK_PERCPU_2_6_12_2_VERSION
	default "2.6.12.2"
	string "verstion"

config PK_PERCPU_2_6_12_2_TAR
	default "tar.gz"
	string "tar type"

config PK_PERCPU_2_6_12_2_URL
	default "https://gitee.com/BiscuitOS_team/HardStack/raw/Gitee/Memory-Allocator/History/mm/mm_bs"
	string "url"

config PK_PERCPU_2_6_12_2_GITHUB
	string "GitHub"
	default "https://gitee.com/BiscuitOS_team/BiscuitOS_Memory.git"

config PK_PERCPU_2_6_12_2_SRCFILE
	default "README.md"
	string "Source code list"

config PK_PERCPU_2_6_12_2_CSRCFILE
	string "Compile source code list"

config PK_PERCPU_2_6_12_2_CONFIG
	string "CONFIG: Project Configure Options"

config PK_PERCPU_2_6_12_2_LIBPATH
	string "LIBS: Libraries to pass to the linker, e.g. -l<library>"

config PK_PERCPU_2_6_12_2_CPPFLAGS
	string "CPPFLAGS: C/C++ preprocessor flags, e.g. -I<include dir>"

config PK_PERCPU_2_6_12_2_DPKCONFIG
	string "PKG_CONFIG_PATH: Directories to add to pkg-config's search path"

config PK_PERCPU_2_6_12_2_CFLAGS
	string "CFLAGS: C compiler flags"

config PK_PERCPU_2_6_12_2_LDFLAGS
	string "LDFLAGS: Linker flags"

config PK_PERCPU_2_6_12_2_CXXFLAGS
	string "CXXFLAGS: C++ compiler flags"

config PK_PERCPU_2_6_12_2_ASFLAGS
	string "CCASFLAGS: assembler compiler flags (defaults to CFLAGS)"

config PK_PERCPU_2_6_12_2_BUILDARCH
	string "--host options on configure for Architecture"

endif # PK_PERCPU_2_6_12_2
```

## package/memory_history/PERCPU/linux-2.6.12.4/Kconfig
```kconfig
menuconfig PK_PERCPU_2_6_12_4
	bool "PERCPU on linux 2.6.12.4"

if PK_PERCPU_2_6_12_4

config PK_PERCPU_2_6_12_4_VERSION
	default "2.6.12.4"
	string "verstion"

config PK_PERCPU_2_6_12_4_TAR
	default "tar.gz"
	string "tar type"

config PK_PERCPU_2_6_12_4_URL
	default "https://gitee.com/BiscuitOS_team/HardStack/raw/Gitee/Memory-Allocator/History/mm/mm_bs"
	string "url"

config PK_PERCPU_2_6_12_4_GITHUB
	string "GitHub"
	default "https://gitee.com/BiscuitOS_team/BiscuitOS_Memory.git"

config PK_PERCPU_2_6_12_4_SRCFILE
	default "README.md"
	string "Source code list"

config PK_PERCPU_2_6_12_4_CSRCFILE
	string "Compile source code list"

config PK_PERCPU_2_6_12_4_CONFIG
	string "CONFIG: Project Configure Options"

config PK_PERCPU_2_6_12_4_LIBPATH
	string "LIBS: Libraries to pass to the linker, e.g. -l<library>"

config PK_PERCPU_2_6_12_4_CPPFLAGS
	string "CPPFLAGS: C/C++ preprocessor flags, e.g. -I<include dir>"

config PK_PERCPU_2_6_12_4_DPKCONFIG
	string "PKG_CONFIG_PATH: Directories to add to pkg-config's search path"

config PK_PERCPU_2_6_12_4_CFLAGS
	string "CFLAGS: C compiler flags"

config PK_PERCPU_2_6_12_4_LDFLAGS
	string "LDFLAGS: Linker flags"

config PK_PERCPU_2_6_12_4_CXXFLAGS
	string "CXXFLAGS: C++ compiler flags"

config PK_PERCPU_2_6_12_4_ASFLAGS
	string "CCASFLAGS: assembler compiler flags (defaults to CFLAGS)"

config PK_PERCPU_2_6_12_4_BUILDARCH
	string "--host options on configure for Architecture"

endif # PK_PERCPU_2_6_12_4
```
