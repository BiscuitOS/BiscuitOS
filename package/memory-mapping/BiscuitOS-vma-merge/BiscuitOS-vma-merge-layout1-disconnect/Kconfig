## package/memory-mapping/BiscuitOS-vma-merge/BiscuitOS-vma-merge-layout1-disconnect/Kconfig
```kconfig
menuconfig PK_BISCUITOS_VMA_MERGE_LAYOUT1_DISCONNECT
	bool "Layout1: disconnect with NEXT region"

if PK_BISCUITOS_VMA_MERGE_LAYOUT1_DISCONNECT

config PK_BISCUITOS_VMA_MERGE_LAYOUT1_DISCONNECT_VERSION
	default "default"
	string "verstion"

config PK_BISCUITOS_VMA_MERGE_LAYOUT1_DISCONNECT_TAR
	default "tar.gz"
	string "tar type"

config PK_BISCUITOS_VMA_MERGE_LAYOUT1_DISCONNECT_URL
	default "https://gitee.com/BiscuitOS_team/HardStack/raw/Gitee/Memory-Allocator/MMAP/BiscuitOS-vma-merge/BiscuitOS-vma-merge-layout1-disconnect"
	string "url"

config PK_BISCUITOS_VMA_MERGE_LAYOUT1_DISCONNECT_GITHUB
	string "GitHub"

config PK_BISCUITOS_VMA_MERGE_LAYOUT1_DISCONNECT_SRCFILE
	default "main.c Makefile"
	string "Source code list"

config PK_BISCUITOS_VMA_MERGE_LAYOUT1_DISCONNECT_CSRCFILE
	string "Compile source code list"

config PK_BISCUITOS_VMA_MERGE_LAYOUT1_DISCONNECT_CONFIG
	string "CONFIG: Project Configure Options"

config PK_BISCUITOS_VMA_MERGE_LAYOUT1_DISCONNECT_LIBPATH
	string "LIBS: Libraries to pass to the linker, e.g. -l<library>"

config PK_BISCUITOS_VMA_MERGE_LAYOUT1_DISCONNECT_CPPFLAGS
	string "CPPFLAGS: C/C++ preprocessor flags, e.g. -I<include dir>"

config PK_BISCUITOS_VMA_MERGE_LAYOUT1_DISCONNECT_DPKCONFIG
	string "PKG_CONFIG_PATH: Directories to add to pkg-config's search path"

config PK_BISCUITOS_VMA_MERGE_LAYOUT1_DISCONNECT_CFLAGS
	string "CFLAGS: C compiler flags"

config PK_BISCUITOS_VMA_MERGE_LAYOUT1_DISCONNECT_LDFLAGS
	string "LDFLAGS: Linker flags"

config PK_BISCUITOS_VMA_MERGE_LAYOUT1_DISCONNECT_CXXFLAGS
	string "CXXFLAGS: C++ compiler flags"

config PK_BISCUITOS_VMA_MERGE_LAYOUT1_DISCONNECT_ASFLAGS
	string "CCASFLAGS: assembler compiler flags (defaults to CFLAGS)"

config PK_BISCUITOS_VMA_MERGE_LAYOUT1_DISCONNECT_BUILDARCH
	string "--host options on configure for Architecture"

endif # PK_BISCUITOS_VMA_MERGE_LAYOUT1_DISCONNECT
```

## package/memory-mapping/BiscuitOS-vma-merge/Kconfig
```kconfig
menuconfig PK_BISCUITOS_VMA_MERGE
	bool "VMA Merge Region Algorithm"

if PK_BISCUITOS_VMA_MERGE

# Layout 0: Disconnect with NEXT
source "package/memory-mapping/BiscuitOS-vma-merge/BiscuitOS-vma-merge-layout0-disconnect/Kconfig"

# Layout 0: Adjoin with NEXT
source "package/memory-mapping/BiscuitOS-vma-merge/BiscuitOS-vma-merge-layout0-adjoin/Kconfig"

# Layout 0: Intersect with NEXT
source "package/memory-mapping/BiscuitOS-vma-merge/BiscuitOS-vma-merge-layout0-intersect/Kconfig"

# Layout 1: Disconnect with NEXT
source "package/memory-mapping/BiscuitOS-vma-merge/BiscuitOS-vma-merge-layout1-disconnect/Kconfig"

# Layout 1: Adjoin with NEXT
source "package/memory-mapping/BiscuitOS-vma-merge/BiscuitOS-vma-merge-layout1-adjoin/Kconfig"

endif # 
```

## package/memory-mapping/Kconfig
```kconfig
menuconfig PK_MEMORY_MAPPING
	bool "Memory Mapping Mechanism"

if PK_MEMORY_MAPPING

# Anonymout share mmap on userspace
source package/memory-mapping/BiscuitOS-anonymous-share-mmap-userspace/Kconfig

# Anonymout private mmap on userspace
source package/memory-mapping/BiscuitOS-anonymous-private-mmap-userspace/Kconfig

# Memory share mmap on userspace
source package/memory-mapping/BiscuitOS-memory-share-mmap-userspace/Kconfig

# Memory private mmap on userspace
source package/memory-mapping/BiscuitOS-memory-private-mmap-userspace/Kconfig

# File share mmap on userspace
source package/memory-mapping/BiscuitOS-file-share-mmap-userspace/Kconfig

# File private mmap on userspace
source package/memory-mapping/BiscuitOS-file-private-mmap-userspace/Kconfig

# File mmap on tmpfs (userspace+)
source package/memory-mapping/BiscuitOS-file-mmap-tmpfs-userspace/Kconfig

# File mmap on ext2 (userspace+)
source package/memory-mapping/BiscuitOS-file-mmap-ext2-userspace/Kconfig

# File mmap on ext3 (userspace+)
source package/memory-mapping/BiscuitOS-file-mmap-ext3-userspace/Kconfig

# File mmap on ext4 (userspace+)
source package/memory-mapping/BiscuitOS-file-mmap-ext4-userspace/Kconfig

# File mmap on minix (userspace+)
source package/memory-mapping/BiscuitOS-file-mmap-minix-userspace/Kconfig

# File mmap on vfat (userspace+)
source package/memory-mapping/BiscuitOS-file-mmap-vfat-userspace/Kconfig

# File mmap on msdos (userspace+)
source package/memory-mapping/BiscuitOS-file-mmap-msdos-userspace/Kconfig

# Special share mmap on userspace
source package/memory-mapping/BiscuitOS-special-share-mmap-userspace/Kconfig

# Special share mmap on kernel
source package/memory-mapping/BiscuitOS-special-share-mmap-kernel/Kconfig

# Special private mmap on userspace
source package/memory-mapping/BiscuitOS-special-private-mmap-userspace/Kconfig

# Special private mmap on kernel
source package/memory-mapping/BiscuitOS-special-private-mmap-kernel/Kconfig

# Hugetlbfs 2M share mmap on userspace
source package/memory-mapping/BiscuitOS-hugetlbfs-2M-share-mmap-userspace/Kconfig

# Hugetlbfs 2M private mmap on userspace
source package/memory-mapping/BiscuitOS-hugetlbfs-2M-private-mmap-userspace/Kconfig

# Hugetlbfs 2M anonymous share mmap on userspace
source package/memory-mapping/BiscuitOS-hugetlbfs-2M-anonymous-share-mmap-userspace/Kconfig

# Hugetlbfs 2M anonymous private mmap on userspace
source package/memory-mapping/BiscuitOS-hugetlbfs-2M-anonymous-private-mmap-userspace/Kconfig

# Hugetlbfs 1G share mmap on userspace
source package/memory-mapping/BiscuitOS-hugetlbfs-1G-share-mmap-userspace/Kconfig

# Hugetlbfs 1G private mmap on userspace
source package/memory-mapping/BiscuitOS-hugetlbfs-1G-private-mmap-userspace/Kconfig

# Hugetlbfs 1G anonymous share mmap on userspace
source package/memory-mapping/BiscuitOS-hugetlbfs-1G-anonymous-share-mmap-userspace/Kconfig

# Hugetlbfs 1G anonymous private mmap on userspace
source package/memory-mapping/BiscuitOS-hugetlbfs-1G-anonymous-private-mmap-userspace/Kconfig

# VMA merge
source package/memory-mapping/BiscuitOS-vma-merge/Kconfig

# sys_mmap
source package/memory-mapping/BiscuitOS-sys-mmap/Kconfig

# Alloc from Special Memory
source package/memory-mapping/BiscuitOS-MMAP-Alloc-Special-Memory-Userspace/Kconfig

# Lazy-Alloc for default route
source package/memory-mapping/BiscuitOS-MMAP-LazyAlloc/Kconfig

# Lazy-Alloc from Special ZONE/NODE
source package/memory-mapping/BiscuitOS-MMAP-LazyAlloc-Special-ZONE-NODE/Kconfig

# Lazy-Alloc from VMALLOC
source package/memory-mapping/BiscuitOS-MMAP-LazyAlloc-VMALLOC/Kconfig

# Lazy-Alloc from VMALLOC32
source package/memory-mapping/BiscuitOS-MMAP-LazyAlloc-VMALLOC32/Kconfig

# PreAlloc for default route
source package/memory-mapping/BiscuitOS-MMAP-PreAlloc/Kconfig

# PreAlloc for Special ZONE/NODE
source package/memory-mapping/BiscuitOS-MMAP-PreAlloc-Special-ZONE-NODE/Kconfig

# PreAlloc for VMALLOC
source package/memory-mapping/BiscuitOS-MMAP-PreAlloc-VMALLOC/Kconfig

# PreAlloc for VMALLOC32
source package/memory-mapping/BiscuitOS-MMAP-PreAlloc-VMALLOC32/Kconfig

# PreAlloc for RSVDMEM
source package/memory-mapping/BiscuitOS-MMAP-PreAlloc-RSVDMEM/Kconfig

# PreAlloc for MAP_LOCKED
source package/memory-mapping/BiscuitOS-MMAP-PreAlloc-MAPLOCKED/Kconfig

endif # PK_MEMORY_MAPPING
```

## package/memory-sanitizers/BiscuitOS-ASAN-heap-use-after-free-CPP/Kconfig
```kconfig
menuconfig PK_ASAN_HEAP_UAF_CPP
	bool "ASAN: Heap use after free (C++ Version)"

if PK_ASAN_HEAP_UAF_CPP

config PK_ASAN_HEAP_UAF_CPP_VERSION
	default "default"
	string "verstion"

config PK_ASAN_HEAP_UAF_CPP_TAR
	default "tar.gz"
	string "tar type"

config PK_ASAN_HEAP_UAF_CPP_URL
	default "https://gitee.com/BiscuitOS_team/HardStack/raw/Gitee/Memory-Allocator/Memory-Sanitizer/BiscuitOS-ASAN-heap-use-after-free-CPP"
	string "url"

config PK_ASAN_HEAP_UAF_CPP_GITHUB
	string "GitHub"

config PK_ASAN_HEAP_UAF_CPP_SRCFILE
	default "main.c Makefile"
	string "Source code list"

config PK_ASAN_HEAP_UAF_CPP_CSRCFILE
	string "Compile source code list"

config PK_ASAN_HEAP_UAF_CPP_CONFIG
	string "CONFIG: Project Configure Options"

config PK_ASAN_HEAP_UAF_CPP_LIBPATH
	string "LIBS: Libraries to pass to the linker, e.g. -l<library>"

config PK_ASAN_HEAP_UAF_CPP_CPPFLAGS
	string "CPPFLAGS: C/C++ preprocessor flags, e.g. -I<include dir>"

config PK_ASAN_HEAP_UAF_CPP_DPKCONFIG
	string "PKG_CONFIG_PATH: Directories to add to pkg-config's search path"

config PK_ASAN_HEAP_UAF_CPP_CFLAGS
	string "CFLAGS: C compiler flags"

config PK_ASAN_HEAP_UAF_CPP_LDFLAGS
	string "LDFLAGS: Linker flags"

config PK_ASAN_HEAP_UAF_CPP_CXXFLAGS
	string "CXXFLAGS: C++ compiler flags"

config PK_ASAN_HEAP_UAF_CPP_ASFLAGS
	string "CCASFLAGS: assembler compiler flags (defaults to CFLAGS)"

config PK_ASAN_HEAP_UAF_CPP_BUILDARCH
	string "--host options on configure for Architecture"

endif # PK_ASAN_HEAP_UAF_CPP
```

## package/memory-sanitizers/BiscuitOS-ASAN-heap-use-after-free/Kconfig
```kconfig
menuconfig PK_ASAN_HEAP_UAF
	bool "ASAN: Heap use after free (C Version)"

if PK_ASAN_HEAP_UAF

config PK_ASAN_HEAP_UAF_VERSION
	default "default"
	string "verstion"

config PK_ASAN_HEAP_UAF_TAR
	default "tar.gz"
	string "tar type"

config PK_ASAN_HEAP_UAF_URL
	default "https://gitee.com/BiscuitOS_team/HardStack/raw/Gitee/Memory-Allocator/Memory-Sanitizer/BiscuitOS-ASAN-heap-use-after-free"
	string "url"

config PK_ASAN_HEAP_UAF_GITHUB
	string "GitHub"

config PK_ASAN_HEAP_UAF_SRCFILE
	default "main.c Makefile"
	string "Source code list"

config PK_ASAN_HEAP_UAF_CSRCFILE
	string "Compile source code list"

config PK_ASAN_HEAP_UAF_CONFIG
	string "CONFIG: Project Configure Options"

config PK_ASAN_HEAP_UAF_LIBPATH
	string "LIBS: Libraries to pass to the linker, e.g. -l<library>"

config PK_ASAN_HEAP_UAF_CPPFLAGS
	string "CPPFLAGS: C/C++ preprocessor flags, e.g. -I<include dir>"

config PK_ASAN_HEAP_UAF_DPKCONFIG
	string "PKG_CONFIG_PATH: Directories to add to pkg-config's search path"

config PK_ASAN_HEAP_UAF_CFLAGS
	string "CFLAGS: C compiler flags"

config PK_ASAN_HEAP_UAF_LDFLAGS
	string "LDFLAGS: Linker flags"

config PK_ASAN_HEAP_UAF_CXXFLAGS
	string "CXXFLAGS: C++ compiler flags"

config PK_ASAN_HEAP_UAF_ASFLAGS
	string "CCASFLAGS: assembler compiler flags (defaults to CFLAGS)"

config PK_ASAN_HEAP_UAF_BUILDARCH
	string "--host options on configure for Architecture"

endif # PK_ASAN_HEAP_UAF
```

## package/memory-sanitizers/BiscuitOS-ASAN-memory-leak-CPP/Kconfig
```kconfig
menuconfig PK_ASAN_MM_LEAK_CPP
	bool "ASAN: Memory leak (C++ Version)"

if PK_ASAN_MM_LEAK_CPP

config PK_ASAN_MM_LEAK_CPP_VERSION
	default "default"
	string "verstion"

config PK_ASAN_MM_LEAK_CPP_TAR
	default "tar.gz"
	string "tar type"

config PK_ASAN_MM_LEAK_CPP_URL
	default "https://gitee.com/BiscuitOS_team/HardStack/raw/Gitee/Memory-Allocator/Memory-Sanitizer/BiscuitOS-ASAN-memory-leak-CPP"
	string "url"

config PK_ASAN_MM_LEAK_CPP_GITHUB
	string "GitHub"

config PK_ASAN_MM_LEAK_CPP_SRCFILE
	default "main.c Makefile"
	string "Source code list"

config PK_ASAN_MM_LEAK_CPP_CSRCFILE
	string "Compile source code list"

config PK_ASAN_MM_LEAK_CPP_CONFIG
	string "CONFIG: Project Configure Options"

config PK_ASAN_MM_LEAK_CPP_LIBPATH
	string "LIBS: Libraries to pass to the linker, e.g. -l<library>"

config PK_ASAN_MM_LEAK_CPP_CPPFLAGS
	string "CPPFLAGS: C/C++ preprocessor flags, e.g. -I<include dir>"

config PK_ASAN_MM_LEAK_CPP_DPKCONFIG
	string "PKG_CONFIG_PATH: Directories to add to pkg-config's search path"

config PK_ASAN_MM_LEAK_CPP_CFLAGS
	string "CFLAGS: C compiler flags"

config PK_ASAN_MM_LEAK_CPP_LDFLAGS
	string "LDFLAGS: Linker flags"

config PK_ASAN_MM_LEAK_CPP_CXXFLAGS
	string "CXXFLAGS: C++ compiler flags"

config PK_ASAN_MM_LEAK_CPP_ASFLAGS
	string "CCASFLAGS: assembler compiler flags (defaults to CFLAGS)"

config PK_ASAN_MM_LEAK_CPP_BUILDARCH
	string "--host options on configure for Architecture"

endif # PK_ASAN_MM_LEAK_CPP
```

## package/memory-sanitizers/BiscuitOS-ASAN-memory-leak/Kconfig
```kconfig
menuconfig PK_ASAN_MM_LEAK
	bool "ASAN: Memory leak (C Version)"

if PK_ASAN_MM_LEAK

config PK_ASAN_MM_LEAK_VERSION
	default "default"
	string "verstion"

config PK_ASAN_MM_LEAK_TAR
	default "tar.gz"
	string "tar type"

config PK_ASAN_MM_LEAK_URL
	default "https://gitee.com/BiscuitOS_team/HardStack/raw/Gitee/Memory-Allocator/Memory-Sanitizer/BiscuitOS-ASAN-memory-leak"
	string "url"

config PK_ASAN_MM_LEAK_GITHUB
	string "GitHub"

config PK_ASAN_MM_LEAK_SRCFILE
	default "main.c Makefile"
	string "Source code list"

config PK_ASAN_MM_LEAK_CSRCFILE
	string "Compile source code list"

config PK_ASAN_MM_LEAK_CONFIG
	string "CONFIG: Project Configure Options"

config PK_ASAN_MM_LEAK_LIBPATH
	string "LIBS: Libraries to pass to the linker, e.g. -l<library>"

config PK_ASAN_MM_LEAK_CPPFLAGS
	string "CPPFLAGS: C/C++ preprocessor flags, e.g. -I<include dir>"

config PK_ASAN_MM_LEAK_DPKCONFIG
	string "PKG_CONFIG_PATH: Directories to add to pkg-config's search path"

config PK_ASAN_MM_LEAK_CFLAGS
	string "CFLAGS: C compiler flags"

config PK_ASAN_MM_LEAK_LDFLAGS
	string "LDFLAGS: Linker flags"

config PK_ASAN_MM_LEAK_CXXFLAGS
	string "CXXFLAGS: C++ compiler flags"

config PK_ASAN_MM_LEAK_ASFLAGS
	string "CCASFLAGS: assembler compiler flags (defaults to CFLAGS)"

config PK_ASAN_MM_LEAK_BUILDARCH
	string "--host options on configure for Architecture"

endif # PK_ASAN_MM_LEAK
```

## package/memory-sanitizers/BiscuitOS-ASAN-stack-buffer-overflow/Kconfig
```kconfig
menuconfig PK_ASAN_STACK_BOF
	bool "ASAN: Stack buffer overflow (C Version)"

if PK_ASAN_STACK_BOF

config PK_ASAN_STACK_BOF_VERSION
	default "default"
	string "verstion"

config PK_ASAN_STACK_BOF_TAR
	default "tar.gz"
	string "tar type"

config PK_ASAN_STACK_BOF_URL
	default "https://gitee.com/BiscuitOS_team/HardStack/raw/Gitee/Memory-Allocator/Memory-Sanitizer/BiscuitOS-ASAN-stack-buffer-overflow"
	string "url"

config PK_ASAN_STACK_BOF_GITHUB
	string "GitHub"

config PK_ASAN_STACK_BOF_SRCFILE
	default "main.c Makefile"
	string "Source code list"

config PK_ASAN_STACK_BOF_CSRCFILE
	string "Compile source code list"

config PK_ASAN_STACK_BOF_CONFIG
	string "CONFIG: Project Configure Options"

config PK_ASAN_STACK_BOF_LIBPATH
	string "LIBS: Libraries to pass to the linker, e.g. -l<library>"

config PK_ASAN_STACK_BOF_CPPFLAGS
	string "CPPFLAGS: C/C++ preprocessor flags, e.g. -I<include dir>"

config PK_ASAN_STACK_BOF_DPKCONFIG
	string "PKG_CONFIG_PATH: Directories to add to pkg-config's search path"

config PK_ASAN_STACK_BOF_CFLAGS
	string "CFLAGS: C compiler flags"

config PK_ASAN_STACK_BOF_LDFLAGS
	string "LDFLAGS: Linker flags"

config PK_ASAN_STACK_BOF_CXXFLAGS
	string "CXXFLAGS: C++ compiler flags"

config PK_ASAN_STACK_BOF_ASFLAGS
	string "CCASFLAGS: assembler compiler flags (defaults to CFLAGS)"

config PK_ASAN_STACK_BOF_BUILDARCH
	string "--host options on configure for Architecture"

endif # PK_ASAN_STACK_BOF
```
