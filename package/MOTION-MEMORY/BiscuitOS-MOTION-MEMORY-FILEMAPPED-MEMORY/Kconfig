## package/MOTION-MEMORY/BiscuitOS-MOTION-MEMORY-RMAP-ANONYMOUS/Kconfig
```kconfig
menuconfig PK_MOTION_MEMORY_RMAP_ANONYMOUS
	bool "RMAP FOR ANONYMOUS MEMORY"

if PK_MOTION_MEMORY_RMAP_ANONYMOUS

config PK_MOTION_MEMORY_RMAP_ANONYMOUS_VERSION
	default "default"
	string "verstion"

config PK_MOTION_MEMORY_RMAP_ANONYMOUS_TAR
	default "tar.gz"
	string "tar type"

config PK_MOTION_MEMORY_RMAP_ANONYMOUS_URL
	default "https://gitee.com/BiscuitOS_team/HardStack/raw/Gitee/MOTION/MEMORY/BiscuitOS-MOTION-MEMORY-RMAP-ANONYMOUS"
	string "url"

config PK_MOTION_MEMORY_RMAP_ANONYMOUS_GITHUB
	string "GitHub"

config PK_MOTION_MEMORY_RMAP_ANONYMOUS_SRCFILE
	default "app.c  Kconfig  main.c  Makefile  Makefile.app  RunBiscuitOS.sh"
	string "Source code list"

config PK_MOTION_MEMORY_RMAP_ANONYMOUS_CSRCFILE
	string "Compile source code list"

config PK_MOTION_MEMORY_RMAP_ANONYMOUS_CONFIG
	string "CONFIG: Project Configure Options"

config PK_MOTION_MEMORY_RMAP_ANONYMOUS_LIBPATH
	string "LIBS: Libraries to pass to the linker, e.g. -l<library>"

config PK_MOTION_MEMORY_RMAP_ANONYMOUS_CPPFLAGS
	string "CPPFLAGS: C/C++ preprocessor flags, e.g. -I<include dir>"

config PK_MOTION_MEMORY_RMAP_ANONYMOUS_DPKCONFIG
	string "PKG_CONFIG_PATH: Directories to add to pkg-config's search path"

config PK_MOTION_MEMORY_RMAP_ANONYMOUS_CFLAGS
	string "CFLAGS: C compiler flags"

config PK_MOTION_MEMORY_RMAP_ANONYMOUS_LDFLAGS
	string "LDFLAGS: Linker flags"

config PK_MOTION_MEMORY_RMAP_ANONYMOUS_CXXFLAGS
	string "CXXFLAGS: C++ compiler flags"

config PK_MOTION_MEMORY_RMAP_ANONYMOUS_ASFLAGS
	string "CCASFLAGS: assembler compiler flags (defaults to CFLAGS)"

config PK_MOTION_MEMORY_RMAP_ANONYMOUS_BUILDARCH
	string "--host options on configure for Architecture"

endif # PK_MOTION_MEMORY_RMAP_ANONYMOUS
```

## package/MOTION-MEMORY/BiscuitOS-MOTION-MEMORY-RMAP-SHARED/Kconfig
```kconfig
menuconfig PK_MOTION_MEMORY_RMAP_SHARED
	bool "RMAP FOR SHARED/FILEMAPPED MEMORY"

if PK_MOTION_MEMORY_RMAP_SHARED

config PK_MOTION_MEMORY_RMAP_SHARED_VERSION
	default "default"
	string "verstion"

config PK_MOTION_MEMORY_RMAP_SHARED_TAR
	default "tar.gz"
	string "tar type"

config PK_MOTION_MEMORY_RMAP_SHARED_URL
	default "https://gitee.com/BiscuitOS_team/HardStack/raw/Gitee/MOTION/MEMORY/BiscuitOS-MOTION-MEMORY-RMAP-SHARED"
	string "url"

config PK_MOTION_MEMORY_RMAP_SHARED_GITHUB
	string "GitHub"

config PK_MOTION_MEMORY_RMAP_SHARED_SRCFILE
	default "app.c  Kconfig  main.c  Makefile  Makefile.app  RunBiscuitOS.sh"
	string "Source code list"

config PK_MOTION_MEMORY_RMAP_SHARED_CSRCFILE
	string "Compile source code list"

config PK_MOTION_MEMORY_RMAP_SHARED_CONFIG
	string "CONFIG: Project Configure Options"

config PK_MOTION_MEMORY_RMAP_SHARED_LIBPATH
	string "LIBS: Libraries to pass to the linker, e.g. -l<library>"

config PK_MOTION_MEMORY_RMAP_SHARED_CPPFLAGS
	string "CPPFLAGS: C/C++ preprocessor flags, e.g. -I<include dir>"

config PK_MOTION_MEMORY_RMAP_SHARED_DPKCONFIG
	string "PKG_CONFIG_PATH: Directories to add to pkg-config's search path"

config PK_MOTION_MEMORY_RMAP_SHARED_CFLAGS
	string "CFLAGS: C compiler flags"

config PK_MOTION_MEMORY_RMAP_SHARED_LDFLAGS
	string "LDFLAGS: Linker flags"

config PK_MOTION_MEMORY_RMAP_SHARED_CXXFLAGS
	string "CXXFLAGS: C++ compiler flags"

config PK_MOTION_MEMORY_RMAP_SHARED_ASFLAGS
	string "CCASFLAGS: assembler compiler flags (defaults to CFLAGS)"

config PK_MOTION_MEMORY_RMAP_SHARED_BUILDARCH
	string "--host options on configure for Architecture"

endif # PK_MOTION_MEMORY_RMAP_SHARED
```

## package/MOTION-MEMORY/BiscuitOS-MOTION-MEMORY-SLAB-GENERAL/Kconfig
```kconfig
menuconfig PK_MOTION_MEMORY_SLAB_GENERAL
	bool "SLAB ALLOCATOR: GENERAL POOL"

if PK_MOTION_MEMORY_SLAB_GENERAL

config PK_MOTION_MEMORY_SLAB_GENERAL_VERSION
	default "default"
	string "verstion"

config PK_MOTION_MEMORY_SLAB_GENERAL_TAR
	default "tar.gz"
	string "tar type"

config PK_MOTION_MEMORY_SLAB_GENERAL_URL
	default "https://gitee.com/BiscuitOS_team/HardStack/raw/Gitee/MOTION/MEMORY/BiscuitOS-MOTION-MEMORY-SLAB-GENERAL"
	string "url"

config PK_MOTION_MEMORY_SLAB_GENERAL_GITHUB
	string "GitHub"

config PK_MOTION_MEMORY_SLAB_GENERAL_SRCFILE
	default "Kconfig  main.c  Makefile  Makefile.host  RunBiscuitOS.sh"
	string "Source code list"

config PK_MOTION_MEMORY_SLAB_GENERAL_CSRCFILE
	string "Compile source code list"

config PK_MOTION_MEMORY_SLAB_GENERAL_CONFIG
	string "CONFIG: Project Configure Options"

config PK_MOTION_MEMORY_SLAB_GENERAL_LIBPATH
	string "LIBS: Libraries to pass to the linker, e.g. -l<library>"

config PK_MOTION_MEMORY_SLAB_GENERAL_CPPFLAGS
	string "CPPFLAGS: C/C++ preprocessor flags, e.g. -I<include dir>"

config PK_MOTION_MEMORY_SLAB_GENERAL_DPKCONFIG
	string "PKG_CONFIG_PATH: Directories to add to pkg-config's search path"

config PK_MOTION_MEMORY_SLAB_GENERAL_CFLAGS
	string "CFLAGS: C compiler flags"

config PK_MOTION_MEMORY_SLAB_GENERAL_LDFLAGS
	string "LDFLAGS: Linker flags"

config PK_MOTION_MEMORY_SLAB_GENERAL_CXXFLAGS
	string "CXXFLAGS: C++ compiler flags"

config PK_MOTION_MEMORY_SLAB_GENERAL_ASFLAGS
	string "CCASFLAGS: assembler compiler flags (defaults to CFLAGS)"

config PK_MOTION_MEMORY_SLAB_GENERAL_BUILDARCH
	string "--host options on configure for Architecture"

endif # PK_MOTION_MEMORY_SLAB_GENERAL
```

## package/MOTION-MEMORY/BiscuitOS-MOTION-MEMORY-SLAB/Kconfig
```kconfig
menuconfig PK_MOTION_MEMORY_SLAB
	bool "SLAB ALLOCATOR"

if PK_MOTION_MEMORY_SLAB

config PK_MOTION_MEMORY_SLAB_VERSION
	default "default"
	string "verstion"

config PK_MOTION_MEMORY_SLAB_TAR
	default "tar.gz"
	string "tar type"

config PK_MOTION_MEMORY_SLAB_URL
	default "https://gitee.com/BiscuitOS_team/HardStack/raw/Gitee/MOTION/MEMORY/BiscuitOS-MOTION-MEMORY-SLAB"
	string "url"

config PK_MOTION_MEMORY_SLAB_GITHUB
	string "GitHub"

config PK_MOTION_MEMORY_SLAB_SRCFILE
	default "Kconfig  main.c  Makefile  Makefile.host  RunBiscuitOS.sh"
	string "Source code list"

config PK_MOTION_MEMORY_SLAB_CSRCFILE
	string "Compile source code list"

config PK_MOTION_MEMORY_SLAB_CONFIG
	string "CONFIG: Project Configure Options"

config PK_MOTION_MEMORY_SLAB_LIBPATH
	string "LIBS: Libraries to pass to the linker, e.g. -l<library>"

config PK_MOTION_MEMORY_SLAB_CPPFLAGS
	string "CPPFLAGS: C/C++ preprocessor flags, e.g. -I<include dir>"

config PK_MOTION_MEMORY_SLAB_DPKCONFIG
	string "PKG_CONFIG_PATH: Directories to add to pkg-config's search path"

config PK_MOTION_MEMORY_SLAB_CFLAGS
	string "CFLAGS: C compiler flags"

config PK_MOTION_MEMORY_SLAB_LDFLAGS
	string "LDFLAGS: Linker flags"

config PK_MOTION_MEMORY_SLAB_CXXFLAGS
	string "CXXFLAGS: C++ compiler flags"

config PK_MOTION_MEMORY_SLAB_ASFLAGS
	string "CCASFLAGS: assembler compiler flags (defaults to CFLAGS)"

config PK_MOTION_MEMORY_SLAB_BUILDARCH
	string "--host options on configure for Architecture"

endif # PK_MOTION_MEMORY_SLAB
```

## package/MOTION-MEMORY/BiscuitOS-MOTION-MEMORY-SWAP-ANON/Kconfig
```kconfig
menuconfig PK_MOTION_MEMORY_SWAP_ANON
	bool "SWAP ANONYMOUS MEMORY"

if PK_MOTION_MEMORY_SWAP_ANON

config PK_MOTION_MEMORY_SWAP_ANON_VERSION
	default "default"
	string "verstion"

config PK_MOTION_MEMORY_SWAP_ANON_TAR
	default "tar.gz"
	string "tar type"

config PK_MOTION_MEMORY_SWAP_ANON_URL
	default "https://gitee.com/BiscuitOS_team/HardStack/raw/Gitee/MOTION/MEMORY/BiscuitOS-MOTION-MEMORY-SWAP-ANON"
	string "url"

config PK_MOTION_MEMORY_SWAP_ANON_GITHUB
	string "GitHub"

config PK_MOTION_MEMORY_SWAP_ANON_SRCFILE
	default "main.c Makefile RunBiscuitOS.sh"
	string "Source code list"

config PK_MOTION_MEMORY_SWAP_ANON_CSRCFILE
	string "Compile source code list"

config PK_MOTION_MEMORY_SWAP_ANON_CONFIG
	string "CONFIG: Project Configure Options"

config PK_MOTION_MEMORY_SWAP_ANON_LIBPATH
	string "LIBS: Libraries to pass to the linker, e.g. -l<library>"

config PK_MOTION_MEMORY_SWAP_ANON_CPPFLAGS
	string "CPPFLAGS: C/C++ preprocessor flags, e.g. -I<include dir>"

config PK_MOTION_MEMORY_SWAP_ANON_DPKCONFIG
	string "PKG_CONFIG_PATH: Directories to add to pkg-config's search path"

config PK_MOTION_MEMORY_SWAP_ANON_CFLAGS
	string "CFLAGS: C compiler flags"

config PK_MOTION_MEMORY_SWAP_ANON_LDFLAGS
	string "LDFLAGS: Linker flags"

config PK_MOTION_MEMORY_SWAP_ANON_CXXFLAGS
	string "CXXFLAGS: C++ compiler flags"

config PK_MOTION_MEMORY_SWAP_ANON_ASFLAGS
	string "CCASFLAGS: assembler compiler flags (defaults to CFLAGS)"

config PK_MOTION_MEMORY_SWAP_ANON_BUILDARCH
	string "--host options on configure for Architecture"

endif # PK_MOTION_MEMORY_SWAP_ANON
```

## package/MOTION-MEMORY/BiscuitOS-MOTION-MEMORY-SWAP-SHARED/Kconfig
```kconfig
menuconfig PK_MOTION_MEMORY_SWAP_SHARED
	bool "SWAP SHARED MEMORY"

if PK_MOTION_MEMORY_SWAP_SHARED

config PK_MOTION_MEMORY_SWAP_SHARED_VERSION
	default "default"
	string "verstion"

config PK_MOTION_MEMORY_SWAP_SHARED_TAR
	default "tar.gz"
	string "tar type"

config PK_MOTION_MEMORY_SWAP_SHARED_URL
	default "https://gitee.com/BiscuitOS_team/HardStack/raw/Gitee/MOTION/MEMORY/BiscuitOS-MOTION-MEMORY-SWAP-SHARED"
	string "url"

config PK_MOTION_MEMORY_SWAP_SHARED_GITHUB
	string "GitHub"

config PK_MOTION_MEMORY_SWAP_SHARED_SRCFILE
	default "main.c Makefile RunBiscuitOS.sh"
	string "Source code list"

config PK_MOTION_MEMORY_SWAP_SHARED_CSRCFILE
	string "Compile source code list"

config PK_MOTION_MEMORY_SWAP_SHARED_CONFIG
	string "CONFIG: Project Configure Options"

config PK_MOTION_MEMORY_SWAP_SHARED_LIBPATH
	string "LIBS: Libraries to pass to the linker, e.g. -l<library>"

config PK_MOTION_MEMORY_SWAP_SHARED_CPPFLAGS
	string "CPPFLAGS: C/C++ preprocessor flags, e.g. -I<include dir>"

config PK_MOTION_MEMORY_SWAP_SHARED_DPKCONFIG
	string "PKG_CONFIG_PATH: Directories to add to pkg-config's search path"

config PK_MOTION_MEMORY_SWAP_SHARED_CFLAGS
	string "CFLAGS: C compiler flags"

config PK_MOTION_MEMORY_SWAP_SHARED_LDFLAGS
	string "LDFLAGS: Linker flags"

config PK_MOTION_MEMORY_SWAP_SHARED_CXXFLAGS
	string "CXXFLAGS: C++ compiler flags"

config PK_MOTION_MEMORY_SWAP_SHARED_ASFLAGS
	string "CCASFLAGS: assembler compiler flags (defaults to CFLAGS)"

config PK_MOTION_MEMORY_SWAP_SHARED_BUILDARCH
	string "--host options on configure for Architecture"

endif # PK_MOTION_MEMORY_SWAP_SHARED
```

## package/MOTION-MEMORY/BiscuitOS-MOTION-MEMORY-TEMPORARY-MMIO/Kconfig
```kconfig
menuconfig PK_MOTION_MEMORY_TEMPORARY_MMIO
	bool "TEMPORARY MAPPING: MMIO"

if PK_MOTION_MEMORY_TEMPORARY_MMIO

config PK_MOTION_MEMORY_TEMPORARY_MMIO_VERSION
	default "default"
	string "verstion"

config PK_MOTION_MEMORY_TEMPORARY_MMIO_TAR
	default "tar.gz"
	string "tar type"

config PK_MOTION_MEMORY_TEMPORARY_MMIO_URL
	default "https://gitee.com/BiscuitOS_team/HardStack/raw/Gitee/MOTION/MEMORY/BiscuitOS-MOTION-MEMORY-TEMPORARY-MMIO"
	string "url"

config PK_MOTION_MEMORY_TEMPORARY_MMIO_GITHUB
	string "GitHub"

config PK_MOTION_MEMORY_TEMPORARY_MMIO_SRCFILE
	default "Kconfig  main.c  Makefile  Makefile.host  RunBiscuitOS.sh"
	string "Source code list"

config PK_MOTION_MEMORY_TEMPORARY_MMIO_CSRCFILE
	string "Compile source code list"

config PK_MOTION_MEMORY_TEMPORARY_MMIO_CONFIG
	string "CONFIG: Project Configure Options"

config PK_MOTION_MEMORY_TEMPORARY_MMIO_LIBPATH
	string "LIBS: Libraries to pass to the linker, e.g. -l<library>"

config PK_MOTION_MEMORY_TEMPORARY_MMIO_CPPFLAGS
	string "CPPFLAGS: C/C++ preprocessor flags, e.g. -I<include dir>"

config PK_MOTION_MEMORY_TEMPORARY_MMIO_DPKCONFIG
	string "PKG_CONFIG_PATH: Directories to add to pkg-config's search path"

config PK_MOTION_MEMORY_TEMPORARY_MMIO_CFLAGS
	string "CFLAGS: C compiler flags"

config PK_MOTION_MEMORY_TEMPORARY_MMIO_LDFLAGS
	string "LDFLAGS: Linker flags"

config PK_MOTION_MEMORY_TEMPORARY_MMIO_CXXFLAGS
	string "CXXFLAGS: C++ compiler flags"

config PK_MOTION_MEMORY_TEMPORARY_MMIO_ASFLAGS
	string "CCASFLAGS: assembler compiler flags (defaults to CFLAGS)"

config PK_MOTION_MEMORY_TEMPORARY_MMIO_BUILDARCH
	string "--host options on configure for Architecture"

endif # PK_MOTION_MEMORY_TEMPORARY_MMIO
```

## package/MOTION-MEMORY/BiscuitOS-MOTION-MEMORY-TEMPORARY-OSMEM/Kconfig
```kconfig
menuconfig PK_MOTION_MEMORY_TEMPORARY_OSMEM
	bool "TEMPORARY MAPPING: OSMEM"

if PK_MOTION_MEMORY_TEMPORARY_OSMEM

config PK_MOTION_MEMORY_TEMPORARY_OSMEM_VERSION
	default "default"
	string "verstion"

config PK_MOTION_MEMORY_TEMPORARY_OSMEM_TAR
	default "tar.gz"
	string "tar type"

config PK_MOTION_MEMORY_TEMPORARY_OSMEM_URL
	default "https://gitee.com/BiscuitOS_team/HardStack/raw/Gitee/MOTION/MEMORY/BiscuitOS-MOTION-MEMORY-TEMPORARY-OSMEM"
	string "url"

config PK_MOTION_MEMORY_TEMPORARY_OSMEM_GITHUB
	string "GitHub"

config PK_MOTION_MEMORY_TEMPORARY_OSMEM_SRCFILE
	default "Kconfig  main.c  Makefile  Makefile.host  RunBiscuitOS.sh"
	string "Source code list"

config PK_MOTION_MEMORY_TEMPORARY_OSMEM_CSRCFILE
	string "Compile source code list"

config PK_MOTION_MEMORY_TEMPORARY_OSMEM_CONFIG
	string "CONFIG: Project Configure Options"

config PK_MOTION_MEMORY_TEMPORARY_OSMEM_LIBPATH
	string "LIBS: Libraries to pass to the linker, e.g. -l<library>"

config PK_MOTION_MEMORY_TEMPORARY_OSMEM_CPPFLAGS
	string "CPPFLAGS: C/C++ preprocessor flags, e.g. -I<include dir>"

config PK_MOTION_MEMORY_TEMPORARY_OSMEM_DPKCONFIG
	string "PKG_CONFIG_PATH: Directories to add to pkg-config's search path"

config PK_MOTION_MEMORY_TEMPORARY_OSMEM_CFLAGS
	string "CFLAGS: C compiler flags"

config PK_MOTION_MEMORY_TEMPORARY_OSMEM_LDFLAGS
	string "LDFLAGS: Linker flags"

config PK_MOTION_MEMORY_TEMPORARY_OSMEM_CXXFLAGS
	string "CXXFLAGS: C++ compiler flags"

config PK_MOTION_MEMORY_TEMPORARY_OSMEM_ASFLAGS
	string "CCASFLAGS: assembler compiler flags (defaults to CFLAGS)"

config PK_MOTION_MEMORY_TEMPORARY_OSMEM_BUILDARCH
	string "--host options on configure for Architecture"

endif # PK_MOTION_MEMORY_TEMPORARY_OSMEM
```

## package/MOTION-MEMORY/BiscuitOS-MOTION-MEMORY-TEMPORARY-RSVDMEM/Kconfig
```kconfig
menuconfig PK_MOTION_MEMORY_TEMPORARY_RSVDMEM
	bool "TEMPORARY MAPPING: RSVDMEM"

if PK_MOTION_MEMORY_TEMPORARY_RSVDMEM

config PK_MOTION_MEMORY_TEMPORARY_RSVDMEM_VERSION
	default "default"
	string "verstion"

config PK_MOTION_MEMORY_TEMPORARY_RSVDMEM_TAR
	default "tar.gz"
	string "tar type"

config PK_MOTION_MEMORY_TEMPORARY_RSVDMEM_URL
	default "https://gitee.com/BiscuitOS_team/HardStack/raw/Gitee/MOTION/MEMORY/BiscuitOS-MOTION-MEMORY-TEMPORARY-RSVDMEM"
	string "url"

config PK_MOTION_MEMORY_TEMPORARY_RSVDMEM_GITHUB
	string "GitHub"

config PK_MOTION_MEMORY_TEMPORARY_RSVDMEM_SRCFILE
	default "Kconfig  main.c  Makefile  Makefile.host  RunBiscuitOS.sh"
	string "Source code list"

config PK_MOTION_MEMORY_TEMPORARY_RSVDMEM_CSRCFILE
	string "Compile source code list"

config PK_MOTION_MEMORY_TEMPORARY_RSVDMEM_CONFIG
	string "CONFIG: Project Configure Options"

config PK_MOTION_MEMORY_TEMPORARY_RSVDMEM_LIBPATH
	string "LIBS: Libraries to pass to the linker, e.g. -l<library>"

config PK_MOTION_MEMORY_TEMPORARY_RSVDMEM_CPPFLAGS
	string "CPPFLAGS: C/C++ preprocessor flags, e.g. -I<include dir>"

config PK_MOTION_MEMORY_TEMPORARY_RSVDMEM_DPKCONFIG
	string "PKG_CONFIG_PATH: Directories to add to pkg-config's search path"

config PK_MOTION_MEMORY_TEMPORARY_RSVDMEM_CFLAGS
	string "CFLAGS: C compiler flags"

config PK_MOTION_MEMORY_TEMPORARY_RSVDMEM_LDFLAGS
	string "LDFLAGS: Linker flags"

config PK_MOTION_MEMORY_TEMPORARY_RSVDMEM_CXXFLAGS
	string "CXXFLAGS: C++ compiler flags"

config PK_MOTION_MEMORY_TEMPORARY_RSVDMEM_ASFLAGS
	string "CCASFLAGS: assembler compiler flags (defaults to CFLAGS)"

config PK_MOTION_MEMORY_TEMPORARY_RSVDMEM_BUILDARCH
	string "--host options on configure for Architecture"

endif # PK_MOTION_MEMORY_TEMPORARY_RSVDMEM
```
