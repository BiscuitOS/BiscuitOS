## package/MOTION-MEMORY/BiscuitOS-MOTION-MEMORY-THP/Kconfig
```kconfig
menuconfig PK_MOTION_MEMORY_THP
	bool "THP: TRANSPARENT HUGEPAGE"

if PK_MOTION_MEMORY_THP

config PK_MOTION_MEMORY_THP_VERSION
	default "default"
	string "verstion"

config PK_MOTION_MEMORY_THP_TAR
	default "tar.gz"
	string "tar type"

config PK_MOTION_MEMORY_THP_URL
	default "https://gitee.com/BiscuitOS_team/HardStack/raw/Gitee/MOTION/MEMORY/BiscuitOS-MOTION-MEMORY-THP"
	string "url"

config PK_MOTION_MEMORY_THP_GITHUB
	string "GitHub"

config PK_MOTION_MEMORY_THP_SRCFILE
	default "main.c Makefile RunBiscuitOS.sh"
	string "Source code list"

config PK_MOTION_MEMORY_THP_CSRCFILE
	string "Compile source code list"

config PK_MOTION_MEMORY_THP_CONFIG
	string "CONFIG: Project Configure Options"

config PK_MOTION_MEMORY_THP_LIBPATH
	string "LIBS: Libraries to pass to the linker, e.g. -l<library>"

config PK_MOTION_MEMORY_THP_CPPFLAGS
	string "CPPFLAGS: C/C++ preprocessor flags, e.g. -I<include dir>"

config PK_MOTION_MEMORY_THP_DPKCONFIG
	string "PKG_CONFIG_PATH: Directories to add to pkg-config's search path"

config PK_MOTION_MEMORY_THP_CFLAGS
	string "CFLAGS: C compiler flags"

config PK_MOTION_MEMORY_THP_LDFLAGS
	string "LDFLAGS: Linker flags"

config PK_MOTION_MEMORY_THP_CXXFLAGS
	string "CXXFLAGS: C++ compiler flags"

config PK_MOTION_MEMORY_THP_ASFLAGS
	string "CCASFLAGS: assembler compiler flags (defaults to CFLAGS)"

config PK_MOTION_MEMORY_THP_BUILDARCH
	string "--host options on configure for Architecture"

endif # PK_MOTION_MEMORY_THP
```

## package/MOTION-MEMORY/BiscuitOS-MOTION-MEMORY-USER/Kconfig
```kconfig
menuconfig PK_MOTION_MEMORY_USER
	bool "USER PROCESS"

if PK_MOTION_MEMORY_USER

config PK_MOTION_MEMORY_USER_VERSION
	default "default"
	string "verstion"

config PK_MOTION_MEMORY_USER_TAR
	default "tar.gz"
	string "tar type"

config PK_MOTION_MEMORY_USER_URL
	default "https://gitee.com/BiscuitOS_team/HardStack/raw/Gitee/MOTION/MEMORY/BiscuitOS-MOTION-MEMORY-USER"
	string "url"

config PK_MOTION_MEMORY_USER_GITHUB
	string "GitHub"

config PK_MOTION_MEMORY_USER_SRCFILE
	default "main.c Makefile RunBiscuitOS.sh"
	string "Source code list"

config PK_MOTION_MEMORY_USER_CSRCFILE
	string "Compile source code list"

config PK_MOTION_MEMORY_USER_CONFIG
	string "CONFIG: Project Configure Options"

config PK_MOTION_MEMORY_USER_LIBPATH
	string "LIBS: Libraries to pass to the linker, e.g. -l<library>"

config PK_MOTION_MEMORY_USER_CPPFLAGS
	string "CPPFLAGS: C/C++ preprocessor flags, e.g. -I<include dir>"

config PK_MOTION_MEMORY_USER_DPKCONFIG
	string "PKG_CONFIG_PATH: Directories to add to pkg-config's search path"

config PK_MOTION_MEMORY_USER_CFLAGS
	string "CFLAGS: C compiler flags"

config PK_MOTION_MEMORY_USER_LDFLAGS
	string "LDFLAGS: Linker flags"

config PK_MOTION_MEMORY_USER_CXXFLAGS
	string "CXXFLAGS: C++ compiler flags"

config PK_MOTION_MEMORY_USER_ASFLAGS
	string "CCASFLAGS: assembler compiler flags (defaults to CFLAGS)"

config PK_MOTION_MEMORY_USER_BUILDARCH
	string "--host options on configure for Architecture"

endif # PK_MOTION_MEMORY_USER
```

## package/MOTION-MEMORY/BiscuitOS-MOTION-MEMORY-USERSPACE/Kconfig
```kconfig
menuconfig PK_MOTION_MEMORY_USERSPACE
	bool "USERSPACE"

if PK_MOTION_MEMORY_USERSPACE

config PK_MOTION_MEMORY_USERSPACE_VERSION
	default "default"
	string "verstion"

config PK_MOTION_MEMORY_USERSPACE_TAR
	default "tar.gz"
	string "tar type"

config PK_MOTION_MEMORY_USERSPACE_URL
	default "https://gitee.com/BiscuitOS_team/HardStack/raw/Gitee/MOTION/MEMORY/BiscuitOS-MOTION-MEMORY-USERSPACE"
	string "url"

config PK_MOTION_MEMORY_USERSPACE_GITHUB
	string "GitHub"

config PK_MOTION_MEMORY_USERSPACE_SRCFILE
	default "main.c Makefile RunBiscuitOS.sh"
	string "Source code list"

config PK_MOTION_MEMORY_USERSPACE_CSRCFILE
	string "Compile source code list"

config PK_MOTION_MEMORY_USERSPACE_CONFIG
	string "CONFIG: Project Configure Options"

config PK_MOTION_MEMORY_USERSPACE_LIBPATH
	string "LIBS: Libraries to pass to the linker, e.g. -l<library>"

config PK_MOTION_MEMORY_USERSPACE_CPPFLAGS
	string "CPPFLAGS: C/C++ preprocessor flags, e.g. -I<include dir>"

config PK_MOTION_MEMORY_USERSPACE_DPKCONFIG
	string "PKG_CONFIG_PATH: Directories to add to pkg-config's search path"

config PK_MOTION_MEMORY_USERSPACE_CFLAGS
	string "CFLAGS: C compiler flags"

config PK_MOTION_MEMORY_USERSPACE_LDFLAGS
	string "LDFLAGS: Linker flags"

config PK_MOTION_MEMORY_USERSPACE_CXXFLAGS
	string "CXXFLAGS: C++ compiler flags"

config PK_MOTION_MEMORY_USERSPACE_ASFLAGS
	string "CCASFLAGS: assembler compiler flags (defaults to CFLAGS)"

config PK_MOTION_MEMORY_USERSPACE_BUILDARCH
	string "--host options on configure for Architecture"

endif # PK_MOTION_MEMORY_USERSPACE
```

## package/MOTION-MEMORY/BiscuitOS-MOTION-MEMORY-VMALLOC/Kconfig
```kconfig
menuconfig PK_MOTION_MEMORY_VMALLOC
	bool "VMALLOC ALLOCATOR"

if PK_MOTION_MEMORY_VMALLOC

config PK_MOTION_MEMORY_VMALLOC_VERSION
	default "default"
	string "verstion"

config PK_MOTION_MEMORY_VMALLOC_TAR
	default "tar.gz"
	string "tar type"

config PK_MOTION_MEMORY_VMALLOC_URL
	default "https://gitee.com/BiscuitOS_team/HardStack/raw/Gitee/MOTION/MEMORY/BiscuitOS-MOTION-MEMORY-VMALLOC"
	string "url"

config PK_MOTION_MEMORY_VMALLOC_GITHUB
	string "GitHub"

config PK_MOTION_MEMORY_VMALLOC_SRCFILE
	default "Kconfig  main.c  Makefile  Makefile.host  RunBiscuitOS.sh"
	string "Source code list"

config PK_MOTION_MEMORY_VMALLOC_CSRCFILE
	string "Compile source code list"

config PK_MOTION_MEMORY_VMALLOC_CONFIG
	string "CONFIG: Project Configure Options"

config PK_MOTION_MEMORY_VMALLOC_LIBPATH
	string "LIBS: Libraries to pass to the linker, e.g. -l<library>"

config PK_MOTION_MEMORY_VMALLOC_CPPFLAGS
	string "CPPFLAGS: C/C++ preprocessor flags, e.g. -I<include dir>"

config PK_MOTION_MEMORY_VMALLOC_DPKCONFIG
	string "PKG_CONFIG_PATH: Directories to add to pkg-config's search path"

config PK_MOTION_MEMORY_VMALLOC_CFLAGS
	string "CFLAGS: C compiler flags"

config PK_MOTION_MEMORY_VMALLOC_LDFLAGS
	string "LDFLAGS: Linker flags"

config PK_MOTION_MEMORY_VMALLOC_CXXFLAGS
	string "CXXFLAGS: C++ compiler flags"

config PK_MOTION_MEMORY_VMALLOC_ASFLAGS
	string "CCASFLAGS: assembler compiler flags (defaults to CFLAGS)"

config PK_MOTION_MEMORY_VMALLOC_BUILDARCH
	string "--host options on configure for Architecture"

endif # PK_MOTION_MEMORY_VMALLOC
```

## package/MOTION-MEMORY/BiscuitOS-MOTION-MEMORY-ZONE/Kconfig
```kconfig
menuconfig PK_MOTION_MEMORY_ZONE
	bool "ZONE"

if PK_MOTION_MEMORY_ZONE

config PK_MOTION_MEMORY_ZONE_VERSION
	default "default"
	string "verstion"

config PK_MOTION_MEMORY_ZONE_TAR
	default "tar.gz"
	string "tar type"

config PK_MOTION_MEMORY_ZONE_URL
	default "https://gitee.com/BiscuitOS_team/HardStack/raw/Gitee/MOTION/MEMORY/BiscuitOS-MOTION-MEMORY-ZONE"
	string "url"

config PK_MOTION_MEMORY_ZONE_GITHUB
	string "GitHub"

config PK_MOTION_MEMORY_ZONE_SRCFILE
	default "Kconfig  main.c  Makefile  Makefile.host  RunBiscuitOS.sh"
	string "Source code list"

config PK_MOTION_MEMORY_ZONE_CSRCFILE
	string "Compile source code list"

config PK_MOTION_MEMORY_ZONE_CONFIG
	string "CONFIG: Project Configure Options"

config PK_MOTION_MEMORY_ZONE_LIBPATH
	string "LIBS: Libraries to pass to the linker, e.g. -l<library>"

config PK_MOTION_MEMORY_ZONE_CPPFLAGS
	string "CPPFLAGS: C/C++ preprocessor flags, e.g. -I<include dir>"

config PK_MOTION_MEMORY_ZONE_DPKCONFIG
	string "PKG_CONFIG_PATH: Directories to add to pkg-config's search path"

config PK_MOTION_MEMORY_ZONE_CFLAGS
	string "CFLAGS: C compiler flags"

config PK_MOTION_MEMORY_ZONE_LDFLAGS
	string "LDFLAGS: Linker flags"

config PK_MOTION_MEMORY_ZONE_CXXFLAGS
	string "CXXFLAGS: C++ compiler flags"

config PK_MOTION_MEMORY_ZONE_ASFLAGS
	string "CCASFLAGS: assembler compiler flags (defaults to CFLAGS)"

config PK_MOTION_MEMORY_ZONE_BUILDARCH
	string "--host options on configure for Architecture"

endif # PK_MOTION_MEMORY_ZONE
```

## package/MOTION-MEMORY/BiscuitOS-MOTION-MEMORY-ZSWAP-ANON/Kconfig
```kconfig
menuconfig PK_MOTION_MEMORY_ZSWAP_ANON
	bool "ZSWAP ANONYMOUS MEMORY"

if PK_MOTION_MEMORY_ZSWAP_ANON

config PK_MOTION_MEMORY_ZSWAP_ANON_VERSION
	default "default"
	string "verstion"

config PK_MOTION_MEMORY_ZSWAP_ANON_TAR
	default "tar.gz"
	string "tar type"

config PK_MOTION_MEMORY_ZSWAP_ANON_URL
	default "https://gitee.com/BiscuitOS_team/HardStack/raw/Gitee/MOTION/MEMORY/BiscuitOS-MOTION-MEMORY-ZSWAP-ANON"
	string "url"

config PK_MOTION_MEMORY_ZSWAP_ANON_GITHUB
	string "GitHub"

config PK_MOTION_MEMORY_ZSWAP_ANON_SRCFILE
	default "main.c Makefile RunBiscuitOS.sh"
	string "Source code list"

config PK_MOTION_MEMORY_ZSWAP_ANON_CSRCFILE
	string "Compile source code list"

config PK_MOTION_MEMORY_ZSWAP_ANON_CONFIG
	string "CONFIG: Project Configure Options"

config PK_MOTION_MEMORY_ZSWAP_ANON_LIBPATH
	string "LIBS: Libraries to pass to the linker, e.g. -l<library>"

config PK_MOTION_MEMORY_ZSWAP_ANON_CPPFLAGS
	string "CPPFLAGS: C/C++ preprocessor flags, e.g. -I<include dir>"

config PK_MOTION_MEMORY_ZSWAP_ANON_DPKCONFIG
	string "PKG_CONFIG_PATH: Directories to add to pkg-config's search path"

config PK_MOTION_MEMORY_ZSWAP_ANON_CFLAGS
	string "CFLAGS: C compiler flags"

config PK_MOTION_MEMORY_ZSWAP_ANON_LDFLAGS
	string "LDFLAGS: Linker flags"

config PK_MOTION_MEMORY_ZSWAP_ANON_CXXFLAGS
	string "CXXFLAGS: C++ compiler flags"

config PK_MOTION_MEMORY_ZSWAP_ANON_ASFLAGS
	string "CCASFLAGS: assembler compiler flags (defaults to CFLAGS)"

config PK_MOTION_MEMORY_ZSWAP_ANON_BUILDARCH
	string "--host options on configure for Architecture"

endif # PK_MOTION_MEMORY_ZSWAP_ANON
```

## package/MOTION-MEMORY/Kconfig
```kconfig
menuconfig PK_MOTION_MEMORY
	bool "Linux Dream Motion: MEMORY FOUDATION"

if PK_MOTION_MEMORY

# BUDDY
source package/MOTION-MEMORY/BiscuitOS-MOTION-MEMORY-BUDDY/Kconfig

# PCP
source package/MOTION-MEMORY/BiscuitOS-MOTION-MEMORY-PCP/Kconfig

# VMALLOC
source package/MOTION-MEMORY/BiscuitOS-MOTION-MEMORY-VMALLOC/Kconfig

# SLAB
source package/MOTION-MEMORY/BiscuitOS-MOTION-MEMORY-SLAB/Kconfig

# SLAB: GENERAL CACHE
source package/MOTION-MEMORY/BiscuitOS-MOTION-MEMORY-SLAB-GENERAL/Kconfig

# DMA
source package/MOTION-MEMORY/BiscuitOS-MOTION-MEMORY-DMA/Kconfig

# CMA
source package/MOTION-MEMORY/BiscuitOS-MOTION-MEMORY-CMA/Kconfig

# TEMPORARY: MMIO
source package/MOTION-MEMORY/BiscuitOS-MOTION-MEMORY-TEMPORARY-MMIO/Kconfig

# TEMPORARY: RSVDMEM
source package/MOTION-MEMORY/BiscuitOS-MOTION-MEMORY-TEMPORARY-RSVDMEM/Kconfig

# TEMPORARY: OSMEM
source package/MOTION-MEMORY/BiscuitOS-MOTION-MEMORY-TEMPORARY-OSMEM/Kconfig

# FIXEDMAP
source package/MOTION-MEMORY/BiscuitOS-MOTION-MEMORY-FIXEDMAP/Kconfig

# SWAP ANONYMOUS
source package/MOTION-MEMORY/BiscuitOS-MOTION-MEMORY-SWAP-ANON/Kconfig

# SWAP SHARED
source package/MOTION-MEMORY/BiscuitOS-MOTION-MEMORY-SWAP-SHARED/Kconfig

# ZSWAP ANONYMOUS
source package/MOTION-MEMORY/BiscuitOS-MOTION-MEMORY-ZSWAP-ANON/Kconfig

# ZSWAP SHARED
source package/MOTION-MEMORY/BiscuitOS-MOTION-MEMORY-ZSWAP-SHARED/Kconfig

# COW
source package/MOTION-MEMORY/BiscuitOS-MOTION-MEMORY-COW/Kconfig

# ANONYMOUS MEMORY
source package/MOTION-MEMORY/BiscuitOS-MOTION-MEMORY-ANONYMOUS-MEMORY/Kconfig

# SHARED MEMORY
source package/MOTION-MEMORY/BiscuitOS-MOTION-MEMORY-SHARED-MEMORY/Kconfig

# FILEMAPPED MEMORY
source package/MOTION-MEMORY/BiscuitOS-MOTION-MEMORY-FILEMAPPED-MEMORY/Kconfig

# PFNMAPPED MEMORY
source package/MOTION-MEMORY/BiscuitOS-MOTION-MEMORY-PFNMAPPED-MEMORY/Kconfig

# PREALLOC
source package/MOTION-MEMORY/BiscuitOS-MOTION-MEMORY-PREALLOC/Kconfig

# LAZYALLOC
source package/MOTION-MEMORY/BiscuitOS-MOTION-MEMORY-LAZYALLOC/Kconfig

# ONDEMAND
source package/MOTION-MEMORY/BiscuitOS-MOTION-MEMORY-ONDEMAND/Kconfig

# USERSPACE
source package/MOTION-MEMORY/BiscuitOS-MOTION-MEMORY-USERSPACE/Kconfig

# USER PROCESS
source package/MOTION-MEMORY/BiscuitOS-MOTION-MEMORY-USER/Kconfig

# ZONE
source package/MOTION-MEMORY/BiscuitOS-MOTION-MEMORY-ZONE/Kconfig

# RECLAIM: ANONYMOUS PAGE
source package/MOTION-MEMORY/BiscuitOS-MOTION-MEMORY-RECLAIM-ANONYMOUS/Kconfig

# RECLAIM: SHARED MEMORY
source package/MOTION-MEMORY/BiscuitOS-MOTION-MEMORY-RECLAIM-SHARED/Kconfig

# THP
source package/MOTION-MEMORY/BiscuitOS-MOTION-MEMORY-THP/Kconfig

# HUGETLB
source package/MOTION-MEMORY/BiscuitOS-MOTION-MEMORY-HUGETLB/Kconfig

# RMAP: ANONYMOUS MEMORY
source package/MOTION-MEMORY/BiscuitOS-MOTION-MEMORY-RMAP-ANONYMOUS/Kconfig

# RMAP: SHARED/FILEMAPPED MEMORY
source package/MOTION-MEMORY/BiscuitOS-MOTION-MEMORY-RMAP-SHARED/Kconfig

# OOM: USERSPACE
source package/MOTION-MEMORY/BiscuitOS-MOTION-MEMORY-OOM-USERSPACE/Kconfig

# OOM: KERNEL
source package/MOTION-MEMORY/BiscuitOS-MOTION-MEMORY-OOM-KERNEL/Kconfig

# ALLOCATOR: USERSPACE
source package/MOTION-MEMORY/BiscuitOS-MOTION-MEMORY-ALLOCATOR-USERSPACE/Kconfig

# ALLOCATOR: USERSPACE DEMO
source package/MOTION-MEMORY/BiscuitOS-MOTION-MEMORY-ALLOCATOR-UDEMO/Kconfig

# ALLOCATOR: KERNEL
source package/MOTION-MEMORY/BiscuitOS-MOTION-MEMORY-ALLOCATOR-KERNEL/Kconfig

# ALLOCATOR: KERNEL DEMO
source package/MOTION-MEMORY/BiscuitOS-MOTION-MEMORY-ALLOCATOR-KDEMO/Kconfig

# CRASH
source package/MOTION-MEMORY/BiscuitOS-MOTION-MEMORY-CRASH/Kconfig

# ASAN
source package/MOTION-MEMORY/BiscuitOS-MOTION-MEMORY-ASAN/Kconfig

# GDB CORE
source package/MOTION-MEMORY/BiscuitOS-MOTION-MEMORY-GDBCORE/Kconfig

endif # PK_MOTION_MEMORY
```
