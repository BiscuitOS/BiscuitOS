## package/MOTION-MEMORY/BiscuitOS-MOTION-MEMORY-FILEMAPPED-MEMORY/Kconfig
```kconfig
menuconfig PK_MOTION_MEMORY_FILEMAPPED_MEMORY
	bool "FILE-MAPPED MEMORY"

if PK_MOTION_MEMORY_FILEMAPPED_MEMORY

config PK_MOTION_MEMORY_FILEMAPPED_MEMORY_VERSION
	default "default"
	string "verstion"

config PK_MOTION_MEMORY_FILEMAPPED_MEMORY_TAR
	default "tar.gz"
	string "tar type"

config PK_MOTION_MEMORY_FILEMAPPED_MEMORY_URL
	default "https://gitee.com/BiscuitOS_team/HardStack/raw/Gitee/MOTION/MEMORY/BiscuitOS-MOTION-MEMORY-FILEMAPPED-MEMORY"
	string "url"

config PK_MOTION_MEMORY_FILEMAPPED_MEMORY_GITHUB
	string "GitHub"

config PK_MOTION_MEMORY_FILEMAPPED_MEMORY_SRCFILE
	default "main.c Makefile RunBiscuitOS.sh"
	string "Source code list"

config PK_MOTION_MEMORY_FILEMAPPED_MEMORY_CSRCFILE
	string "Compile source code list"

config PK_MOTION_MEMORY_FILEMAPPED_MEMORY_CONFIG
	string "CONFIG: Project Configure Options"

config PK_MOTION_MEMORY_FILEMAPPED_MEMORY_LIBPATH
	string "LIBS: Libraries to pass to the linker, e.g. -l<library>"

config PK_MOTION_MEMORY_FILEMAPPED_MEMORY_CPPFLAGS
	string "CPPFLAGS: C/C++ preprocessor flags, e.g. -I<include dir>"

config PK_MOTION_MEMORY_FILEMAPPED_MEMORY_DPKCONFIG
	string "PKG_CONFIG_PATH: Directories to add to pkg-config's search path"

config PK_MOTION_MEMORY_FILEMAPPED_MEMORY_CFLAGS
	string "CFLAGS: C compiler flags"

config PK_MOTION_MEMORY_FILEMAPPED_MEMORY_LDFLAGS
	string "LDFLAGS: Linker flags"

config PK_MOTION_MEMORY_FILEMAPPED_MEMORY_CXXFLAGS
	string "CXXFLAGS: C++ compiler flags"

config PK_MOTION_MEMORY_FILEMAPPED_MEMORY_ASFLAGS
	string "CCASFLAGS: assembler compiler flags (defaults to CFLAGS)"

config PK_MOTION_MEMORY_FILEMAPPED_MEMORY_BUILDARCH
	string "--host options on configure for Architecture"

endif # PK_MOTION_MEMORY_FILEMAPPED_MEMORY
```

## package/MOTION-MEMORY/BiscuitOS-MOTION-MEMORY-FIXEDMAP/Kconfig
```kconfig
menuconfig PK_MOTION_MEMORY_FIXEDMAP
	bool "FIXED MAPPING"

if PK_MOTION_MEMORY_FIXEDMAP

config PK_MOTION_MEMORY_FIXEDMAP_VERSION
	default "default"
	string "verstion"

config PK_MOTION_MEMORY_FIXEDMAP_TAR
	default "tar.gz"
	string "tar type"

config PK_MOTION_MEMORY_FIXEDMAP_URL
	default "https://gitee.com/BiscuitOS_team/HardStack/raw/Gitee/MOTION/MEMORY/BiscuitOS-MOTION-MEMORY-FIXEDMAP"
	string "url"

config PK_MOTION_MEMORY_FIXEDMAP_GITHUB
	string "GitHub"

config PK_MOTION_MEMORY_FIXEDMAP_SRCFILE
	default "Kconfig  main.c  Makefile  Makefile.host  RunBiscuitOS.sh"
	string "Source code list"

config PK_MOTION_MEMORY_FIXEDMAP_CSRCFILE
	string "Compile source code list"

config PK_MOTION_MEMORY_FIXEDMAP_CONFIG
	string "CONFIG: Project Configure Options"

config PK_MOTION_MEMORY_FIXEDMAP_LIBPATH
	string "LIBS: Libraries to pass to the linker, e.g. -l<library>"

config PK_MOTION_MEMORY_FIXEDMAP_CPPFLAGS
	string "CPPFLAGS: C/C++ preprocessor flags, e.g. -I<include dir>"

config PK_MOTION_MEMORY_FIXEDMAP_DPKCONFIG
	string "PKG_CONFIG_PATH: Directories to add to pkg-config's search path"

config PK_MOTION_MEMORY_FIXEDMAP_CFLAGS
	string "CFLAGS: C compiler flags"

config PK_MOTION_MEMORY_FIXEDMAP_LDFLAGS
	string "LDFLAGS: Linker flags"

config PK_MOTION_MEMORY_FIXEDMAP_CXXFLAGS
	string "CXXFLAGS: C++ compiler flags"

config PK_MOTION_MEMORY_FIXEDMAP_ASFLAGS
	string "CCASFLAGS: assembler compiler flags (defaults to CFLAGS)"

config PK_MOTION_MEMORY_FIXEDMAP_BUILDARCH
	string "--host options on configure for Architecture"

endif # PK_MOTION_MEMORY_FIXEDMAP
```

## package/MOTION-MEMORY/BiscuitOS-MOTION-MEMORY-GDBCORE/Kconfig
```kconfig
menuconfig PK_MOTION_MEMORY_GDBCORE
	bool "GDB CORE"

if PK_MOTION_MEMORY_GDBCORE

config PK_MOTION_MEMORY_GDBCORE_VERSION
	default "default"
	string "verstion"

config PK_MOTION_MEMORY_GDBCORE_TAR
	default "tar.gz"
	string "tar type"

config PK_MOTION_MEMORY_GDBCORE_URL
	default "https://gitee.com/BiscuitOS_team/HardStack/raw/Gitee/MOTION/MEMORY/BiscuitOS-MOTION-MEMORY-GDBCORE"
	string "url"

config PK_MOTION_MEMORY_GDBCORE_GITHUB
	string "GitHub"

config PK_MOTION_MEMORY_GDBCORE_SRCFILE
	default "main.c Makefile RunBiscuitOS.sh"
	string "Source code list"

config PK_MOTION_MEMORY_GDBCORE_CSRCFILE
	string "Compile source code list"

config PK_MOTION_MEMORY_GDBCORE_CONFIG
	string "CONFIG: Project Configure Options"

config PK_MOTION_MEMORY_GDBCORE_LIBPATH
	string "LIBS: Libraries to pass to the linker, e.g. -l<library>"

config PK_MOTION_MEMORY_GDBCORE_CPPFLAGS
	string "CPPFLAGS: C/C++ preprocessor flags, e.g. -I<include dir>"

config PK_MOTION_MEMORY_GDBCORE_DPKCONFIG
	string "PKG_CONFIG_PATH: Directories to add to pkg-config's search path"

config PK_MOTION_MEMORY_GDBCORE_CFLAGS
	string "CFLAGS: C compiler flags"

config PK_MOTION_MEMORY_GDBCORE_LDFLAGS
	string "LDFLAGS: Linker flags"

config PK_MOTION_MEMORY_GDBCORE_CXXFLAGS
	string "CXXFLAGS: C++ compiler flags"

config PK_MOTION_MEMORY_GDBCORE_ASFLAGS
	string "CCASFLAGS: assembler compiler flags (defaults to CFLAGS)"

config PK_MOTION_MEMORY_GDBCORE_BUILDARCH
	string "--host options on configure for Architecture"

endif # PK_MOTION_MEMORY_GDBCORE
```

## package/MOTION-MEMORY/BiscuitOS-MOTION-MEMORY-LAZYALLOC/Kconfig
```kconfig
menuconfig PK_MOTION_MEMORY_LAZYALLOC
	bool "LAZYALLOC"

if PK_MOTION_MEMORY_LAZYALLOC

config PK_MOTION_MEMORY_LAZYALLOC_VERSION
	default "default"
	string "verstion"

config PK_MOTION_MEMORY_LAZYALLOC_TAR
	default "tar.gz"
	string "tar type"

config PK_MOTION_MEMORY_LAZYALLOC_URL
	default "https://gitee.com/BiscuitOS_team/HardStack/raw/Gitee/MOTION/MEMORY/BiscuitOS-MOTION-MEMORY-LAZYALLOC"
	string "url"

config PK_MOTION_MEMORY_LAZYALLOC_GITHUB
	string "GitHub"

config PK_MOTION_MEMORY_LAZYALLOC_SRCFILE
	default "main.c Makefile RunBiscuitOS.sh"
	string "Source code list"

config PK_MOTION_MEMORY_LAZYALLOC_CSRCFILE
	string "Compile source code list"

config PK_MOTION_MEMORY_LAZYALLOC_CONFIG
	string "CONFIG: Project Configure Options"

config PK_MOTION_MEMORY_LAZYALLOC_LIBPATH
	string "LIBS: Libraries to pass to the linker, e.g. -l<library>"

config PK_MOTION_MEMORY_LAZYALLOC_CPPFLAGS
	string "CPPFLAGS: C/C++ preprocessor flags, e.g. -I<include dir>"

config PK_MOTION_MEMORY_LAZYALLOC_DPKCONFIG
	string "PKG_CONFIG_PATH: Directories to add to pkg-config's search path"

config PK_MOTION_MEMORY_LAZYALLOC_CFLAGS
	string "CFLAGS: C compiler flags"

config PK_MOTION_MEMORY_LAZYALLOC_LDFLAGS
	string "LDFLAGS: Linker flags"

config PK_MOTION_MEMORY_LAZYALLOC_CXXFLAGS
	string "CXXFLAGS: C++ compiler flags"

config PK_MOTION_MEMORY_LAZYALLOC_ASFLAGS
	string "CCASFLAGS: assembler compiler flags (defaults to CFLAGS)"

config PK_MOTION_MEMORY_LAZYALLOC_BUILDARCH
	string "--host options on configure for Architecture"

endif # PK_MOTION_MEMORY_LAZYALLOC
```

## package/MOTION-MEMORY/BiscuitOS-MOTION-MEMORY-ONDEMAND/Kconfig
```kconfig
menuconfig PK_MOTION_MEMORY_ONDEMAND
	bool "ONDEMAND"

if PK_MOTION_MEMORY_ONDEMAND

config PK_MOTION_MEMORY_ONDEMAND_VERSION
	default "default"
	string "verstion"

config PK_MOTION_MEMORY_ONDEMAND_TAR
	default "tar.gz"
	string "tar type"

config PK_MOTION_MEMORY_ONDEMAND_URL
	default "https://gitee.com/BiscuitOS_team/HardStack/raw/Gitee/MOTION/MEMORY/BiscuitOS-MOTION-MEMORY-ONDEMAND"
	string "url"

config PK_MOTION_MEMORY_ONDEMAND_GITHUB
	string "GitHub"

config PK_MOTION_MEMORY_ONDEMAND_SRCFILE
	default "main.c Makefile RunBiscuitOS.sh"
	string "Source code list"

config PK_MOTION_MEMORY_ONDEMAND_CSRCFILE
	string "Compile source code list"

config PK_MOTION_MEMORY_ONDEMAND_CONFIG
	string "CONFIG: Project Configure Options"

config PK_MOTION_MEMORY_ONDEMAND_LIBPATH
	string "LIBS: Libraries to pass to the linker, e.g. -l<library>"

config PK_MOTION_MEMORY_ONDEMAND_CPPFLAGS
	string "CPPFLAGS: C/C++ preprocessor flags, e.g. -I<include dir>"

config PK_MOTION_MEMORY_ONDEMAND_DPKCONFIG
	string "PKG_CONFIG_PATH: Directories to add to pkg-config's search path"

config PK_MOTION_MEMORY_ONDEMAND_CFLAGS
	string "CFLAGS: C compiler flags"

config PK_MOTION_MEMORY_ONDEMAND_LDFLAGS
	string "LDFLAGS: Linker flags"

config PK_MOTION_MEMORY_ONDEMAND_CXXFLAGS
	string "CXXFLAGS: C++ compiler flags"

config PK_MOTION_MEMORY_ONDEMAND_ASFLAGS
	string "CCASFLAGS: assembler compiler flags (defaults to CFLAGS)"

config PK_MOTION_MEMORY_ONDEMAND_BUILDARCH
	string "--host options on configure for Architecture"

endif # PK_MOTION_MEMORY_ONDEMAND
```

## package/MOTION-MEMORY/BiscuitOS-MOTION-MEMORY-OOM-KERNEL/Kconfig
```kconfig
menuconfig PK_MOTION_MEMORY_OOM_KERNEL
	bool "OOM FROM KERNEL"

if PK_MOTION_MEMORY_OOM_KERNEL

config PK_MOTION_MEMORY_OOM_KERNEL_VERSION
	default "default"
	string "verstion"

config PK_MOTION_MEMORY_OOM_KERNEL_TAR
	default "tar.gz"
	string "tar type"

config PK_MOTION_MEMORY_OOM_KERNEL_URL
	default "https://gitee.com/BiscuitOS_team/HardStack/raw/Gitee/MOTION/MEMORY/BiscuitOS-MOTION-MEMORY-OOM-KERNEL"
	string "url"

config PK_MOTION_MEMORY_OOM_KERNEL_GITHUB
	string "GitHub"

config PK_MOTION_MEMORY_OOM_KERNEL_SRCFILE
	default "Kconfig  main.c  Makefile  Makefile.host  RunBiscuitOS.sh"
	string "Source code list"

config PK_MOTION_MEMORY_OOM_KERNEL_CSRCFILE
	string "Compile source code list"

config PK_MOTION_MEMORY_OOM_KERNEL_CONFIG
	string "CONFIG: Project Configure Options"

config PK_MOTION_MEMORY_OOM_KERNEL_LIBPATH
	string "LIBS: Libraries to pass to the linker, e.g. -l<library>"

config PK_MOTION_MEMORY_OOM_KERNEL_CPPFLAGS
	string "CPPFLAGS: C/C++ preprocessor flags, e.g. -I<include dir>"

config PK_MOTION_MEMORY_OOM_KERNEL_DPKCONFIG
	string "PKG_CONFIG_PATH: Directories to add to pkg-config's search path"

config PK_MOTION_MEMORY_OOM_KERNEL_CFLAGS
	string "CFLAGS: C compiler flags"

config PK_MOTION_MEMORY_OOM_KERNEL_LDFLAGS
	string "LDFLAGS: Linker flags"

config PK_MOTION_MEMORY_OOM_KERNEL_CXXFLAGS
	string "CXXFLAGS: C++ compiler flags"

config PK_MOTION_MEMORY_OOM_KERNEL_ASFLAGS
	string "CCASFLAGS: assembler compiler flags (defaults to CFLAGS)"

config PK_MOTION_MEMORY_OOM_KERNEL_BUILDARCH
	string "--host options on configure for Architecture"

endif # PK_MOTION_MEMORY_OOM_KERNEL
```

## package/MOTION-MEMORY/BiscuitOS-MOTION-MEMORY-PCP/Kconfig
```kconfig
menuconfig PK_MOTION_MEMORY_PCP
	bool "PCP ALLOCATOR"

if PK_MOTION_MEMORY_PCP

config PK_MOTION_MEMORY_PCP_VERSION
	default "default"
	string "verstion"

config PK_MOTION_MEMORY_PCP_TAR
	default "tar.gz"
	string "tar type"

config PK_MOTION_MEMORY_PCP_URL
	default "https://gitee.com/BiscuitOS_team/HardStack/raw/Gitee/MOTION/MEMORY/BiscuitOS-MOTION-MEMORY-PCP"
	string "url"

config PK_MOTION_MEMORY_PCP_GITHUB
	string "GitHub"

config PK_MOTION_MEMORY_PCP_SRCFILE
	default "Kconfig  main.c  Makefile  Makefile.host  RunBiscuitOS.sh"
	string "Source code list"

config PK_MOTION_MEMORY_PCP_CSRCFILE
	string "Compile source code list"

config PK_MOTION_MEMORY_PCP_CONFIG
	string "CONFIG: Project Configure Options"

config PK_MOTION_MEMORY_PCP_LIBPATH
	string "LIBS: Libraries to pass to the linker, e.g. -l<library>"

config PK_MOTION_MEMORY_PCP_CPPFLAGS
	string "CPPFLAGS: C/C++ preprocessor flags, e.g. -I<include dir>"

config PK_MOTION_MEMORY_PCP_DPKCONFIG
	string "PKG_CONFIG_PATH: Directories to add to pkg-config's search path"

config PK_MOTION_MEMORY_PCP_CFLAGS
	string "CFLAGS: C compiler flags"

config PK_MOTION_MEMORY_PCP_LDFLAGS
	string "LDFLAGS: Linker flags"

config PK_MOTION_MEMORY_PCP_CXXFLAGS
	string "CXXFLAGS: C++ compiler flags"

config PK_MOTION_MEMORY_PCP_ASFLAGS
	string "CCASFLAGS: assembler compiler flags (defaults to CFLAGS)"

config PK_MOTION_MEMORY_PCP_BUILDARCH
	string "--host options on configure for Architecture"

endif # PK_MOTION_MEMORY_PCP
```

## package/MOTION-MEMORY/BiscuitOS-MOTION-MEMORY-PREALLOC/Kconfig
```kconfig
menuconfig PK_MOTION_MEMORY_PREALLOC
	bool "PREALLOC"

if PK_MOTION_MEMORY_PREALLOC

config PK_MOTION_MEMORY_PREALLOC_VERSION
	default "default"
	string "verstion"

config PK_MOTION_MEMORY_PREALLOC_TAR
	default "tar.gz"
	string "tar type"

config PK_MOTION_MEMORY_PREALLOC_URL
	default "https://gitee.com/BiscuitOS_team/HardStack/raw/Gitee/MOTION/MEMORY/BiscuitOS-MOTION-MEMORY-PREALLOC"
	string "url"

config PK_MOTION_MEMORY_PREALLOC_GITHUB
	string "GitHub"

config PK_MOTION_MEMORY_PREALLOC_SRCFILE
	default "main.c Makefile RunBiscuitOS.sh"
	string "Source code list"

config PK_MOTION_MEMORY_PREALLOC_CSRCFILE
	string "Compile source code list"

config PK_MOTION_MEMORY_PREALLOC_CONFIG
	string "CONFIG: Project Configure Options"

config PK_MOTION_MEMORY_PREALLOC_LIBPATH
	string "LIBS: Libraries to pass to the linker, e.g. -l<library>"

config PK_MOTION_MEMORY_PREALLOC_CPPFLAGS
	string "CPPFLAGS: C/C++ preprocessor flags, e.g. -I<include dir>"

config PK_MOTION_MEMORY_PREALLOC_DPKCONFIG
	string "PKG_CONFIG_PATH: Directories to add to pkg-config's search path"

config PK_MOTION_MEMORY_PREALLOC_CFLAGS
	string "CFLAGS: C compiler flags"

config PK_MOTION_MEMORY_PREALLOC_LDFLAGS
	string "LDFLAGS: Linker flags"

config PK_MOTION_MEMORY_PREALLOC_CXXFLAGS
	string "CXXFLAGS: C++ compiler flags"

config PK_MOTION_MEMORY_PREALLOC_ASFLAGS
	string "CCASFLAGS: assembler compiler flags (defaults to CFLAGS)"

config PK_MOTION_MEMORY_PREALLOC_BUILDARCH
	string "--host options on configure for Architecture"

endif # PK_MOTION_MEMORY_PREALLOC
```

## package/MOTION-MEMORY/BiscuitOS-MOTION-MEMORY-RECLAIM-SHARED/Kconfig
```kconfig
menuconfig PK_MOTION_MEMORY_RECLAIM_SHARED
	bool "RECLAIM SHARED MEMORY"

if PK_MOTION_MEMORY_RECLAIM_SHARED

config PK_MOTION_MEMORY_RECLAIM_SHARED_VERSION
	default "default"
	string "verstion"

config PK_MOTION_MEMORY_RECLAIM_SHARED_TAR
	default "tar.gz"
	string "tar type"

config PK_MOTION_MEMORY_RECLAIM_SHARED_URL
	default "https://gitee.com/BiscuitOS_team/HardStack/raw/Gitee/MOTION/MEMORY/BiscuitOS-MOTION-MEMORY-RECLAIM-SHARED"
	string "url"

config PK_MOTION_MEMORY_RECLAIM_SHARED_GITHUB
	string "GitHub"

config PK_MOTION_MEMORY_RECLAIM_SHARED_SRCFILE
	default "app.c  Kconfig  main.c  Makefile  Makefile.app  RunBiscuitOS.sh"
	string "Source code list"

config PK_MOTION_MEMORY_RECLAIM_SHARED_CSRCFILE
	string "Compile source code list"

config PK_MOTION_MEMORY_RECLAIM_SHARED_CONFIG
	string "CONFIG: Project Configure Options"

config PK_MOTION_MEMORY_RECLAIM_SHARED_LIBPATH
	string "LIBS: Libraries to pass to the linker, e.g. -l<library>"

config PK_MOTION_MEMORY_RECLAIM_SHARED_CPPFLAGS
	string "CPPFLAGS: C/C++ preprocessor flags, e.g. -I<include dir>"

config PK_MOTION_MEMORY_RECLAIM_SHARED_DPKCONFIG
	string "PKG_CONFIG_PATH: Directories to add to pkg-config's search path"

config PK_MOTION_MEMORY_RECLAIM_SHARED_CFLAGS
	string "CFLAGS: C compiler flags"

config PK_MOTION_MEMORY_RECLAIM_SHARED_LDFLAGS
	string "LDFLAGS: Linker flags"

config PK_MOTION_MEMORY_RECLAIM_SHARED_CXXFLAGS
	string "CXXFLAGS: C++ compiler flags"

config PK_MOTION_MEMORY_RECLAIM_SHARED_ASFLAGS
	string "CCASFLAGS: assembler compiler flags (defaults to CFLAGS)"

config PK_MOTION_MEMORY_RECLAIM_SHARED_BUILDARCH
	string "--host options on configure for Architecture"

endif # PK_MOTION_MEMORY_RECLAIM_SHARED
```
