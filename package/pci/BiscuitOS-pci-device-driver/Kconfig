## package/pci/BiscuitOS-pci-device-driver/Kconfig
```kconfig
menuconfig PK_PCI_COMMON_DD
	bool "PCI Common Device Driver Module"

if PK_PCI_COMMON_DD

config PK_PCI_COMMON_DD_VERSION
	default "default"
	string "verstion"

config PK_PCI_COMMON_DD_TAR
	default "tar.gz"
	string "tar type"

config PK_PCI_COMMON_DD_URL
	default "https://gitee.com/BiscuitOS_team/HardStack/raw/Gitee/Device-Driver/PCIe/BiscuitOS-pci-device-driver"
	string "url"

config PK_PCI_COMMON_DD_GITHUB
	string "GitHub"

config PK_PCI_COMMON_DD_SRCFILE
	default "main.c Kconfig Makefile README.md RunBiscuitOS.sh"
	string "Source code list"

config PK_PCI_COMMON_DD_CSRCFILE
	string "Compile source code list"

config PK_PCI_COMMON_DD_CONFIG
	string "CONFIG: Project Configure Options"

config PK_PCI_COMMON_DD_LIBPATH
	string "LIBS: Libraries to pass to the linker, e.g. -l<library>"

config PK_PCI_COMMON_DD_CPPFLAGS
	string "CPPFLAGS: C/C++ preprocessor flags, e.g. -I<include dir>"

config PK_PCI_COMMON_DD_DPKCONFIG
	string "PKG_CONFIG_PATH: Directories to add to pkg-config's search path"

config PK_PCI_COMMON_DD_CFLAGS
	string "CFLAGS: C compiler flags"

config PK_PCI_COMMON_DD_LDFLAGS
	string "LDFLAGS: Linker flags"

config PK_PCI_COMMON_DD_CXXFLAGS
	string "CXXFLAGS: C++ compiler flags"

config PK_PCI_COMMON_DD_ASFLAGS
	string "CCASFLAGS: assembler compiler flags (defaults to CFLAGS)"

config PK_PCI_COMMON_DD_BUILDARCH
	string "--host options on configure for Architecture"

endif # PK_PCI_COMMON_DD
```

## package/pci/Broiler-dma-intx/Kconfig
```kconfig
menuconfig PK_BROILER_DMA_INTX
	bool "Broiler DMA with INTX Interrupt"

if PK_BROILER_DMA_INTX

config PK_BROILER_DMA_INTX_VERSION
	default "default"
	string "verstion"

config PK_BROILER_DMA_INTX_TAR
	default "tar.gz"
	string "tar type"

config PK_BROILER_DMA_INTX_URL
	default "https://gitee.com/BiscuitOS_team/HardStack/raw/Gitee/Device-Driver/PCIe/Broiler-dma-intx"
	string "url"

config PK_BROILER_DMA_INTX_GITHUB
	string "GitHub"

config PK_BROILER_DMA_INTX_SRCFILE
	default "main.c Kconfig Makefile README.md RunBiscuitOS.sh Makefile.host"
	string "Source code list"

config PK_BROILER_DMA_INTX_CSRCFILE
	string "Compile source code list"

config PK_BROILER_DMA_INTX_CONFIG
	string "CONFIG: Project Configure Options"

config PK_BROILER_DMA_INTX_LIBPATH
	string "LIBS: Libraries to pass to the linker, e.g. -l<library>"

config PK_BROILER_DMA_INTX_CPPFLAGS
	string "CPPFLAGS: C/C++ preprocessor flags, e.g. -I<include dir>"

config PK_BROILER_DMA_INTX_DPKCONFIG
	string "PKG_CONFIG_PATH: Directories to add to pkg-config's search path"

config PK_BROILER_DMA_INTX_CFLAGS
	string "CFLAGS: C compiler flags"

config PK_BROILER_DMA_INTX_LDFLAGS
	string "LDFLAGS: Linker flags"

config PK_BROILER_DMA_INTX_CXXFLAGS
	string "CXXFLAGS: C++ compiler flags"

config PK_BROILER_DMA_INTX_ASFLAGS
	string "CCASFLAGS: assembler compiler flags (defaults to CFLAGS)"

config PK_BROILER_DMA_INTX_BUILDARCH
	string "--host options on configure for Architecture"

endif # PK_BROILER_DMA_INTX
```

## package/pci/Broiler-pci-device-driver/Kconfig
```kconfig
menuconfig PK_BROILER_PCI_DD
	bool "Broiler PCI Common Device Driver Module"

if PK_BROILER_PCI_DD

config PK_BROILER_PCI_DD_VERSION
	default "default"
	string "verstion"

config PK_BROILER_PCI_DD_TAR
	default "tar.gz"
	string "tar type"

config PK_BROILER_PCI_DD_URL
	default "https://gitee.com/BiscuitOS_team/HardStack/raw/Gitee/Device-Driver/PCIe/Broiler-pci-device-driver"
	string "url"

config PK_BROILER_PCI_DD_GITHUB
	string "GitHub"

config PK_BROILER_PCI_DD_SRCFILE
	default "main.c Kconfig Makefile README.md RunBiscuitOS.sh Makefile.host"
	string "Source code list"

config PK_BROILER_PCI_DD_CSRCFILE
	string "Compile source code list"

config PK_BROILER_PCI_DD_CONFIG
	string "CONFIG: Project Configure Options"

config PK_BROILER_PCI_DD_LIBPATH
	string "LIBS: Libraries to pass to the linker, e.g. -l<library>"

config PK_BROILER_PCI_DD_CPPFLAGS
	string "CPPFLAGS: C/C++ preprocessor flags, e.g. -I<include dir>"

config PK_BROILER_PCI_DD_DPKCONFIG
	string "PKG_CONFIG_PATH: Directories to add to pkg-config's search path"

config PK_BROILER_PCI_DD_CFLAGS
	string "CFLAGS: C compiler flags"

config PK_BROILER_PCI_DD_LDFLAGS
	string "LDFLAGS: Linker flags"

config PK_BROILER_PCI_DD_CXXFLAGS
	string "CXXFLAGS: C++ compiler flags"

config PK_BROILER_PCI_DD_ASFLAGS
	string "CCASFLAGS: assembler compiler flags (defaults to CFLAGS)"

config PK_BROILER_PCI_DD_BUILDARCH
	string "--host options on configure for Architecture"

endif # PK_BROILER_PCI_DD
```

## package/pci/Broiler-pci-intx-interrupt/Kconfig
```kconfig
menuconfig PK_BROILER_PCI_INTX
	bool "Broiler PCI INTX Interrupt"

if PK_BROILER_PCI_INTX

config PK_BROILER_PCI_INTX_VERSION
	default "default"
	string "verstion"

config PK_BROILER_PCI_INTX_TAR
	default "tar.gz"
	string "tar type"

config PK_BROILER_PCI_INTX_URL
	default "https://gitee.com/BiscuitOS_team/HardStack/raw/Gitee/Device-Driver/PCIe/Broiler-pci-intx-interrupt"
	string "url"

config PK_BROILER_PCI_INTX_GITHUB
	string "GitHub"

config PK_BROILER_PCI_INTX_SRCFILE
	default "main.c Kconfig Makefile README.md RunBiscuitOS.sh Makefile.host"
	string "Source code list"

config PK_BROILER_PCI_INTX_CSRCFILE
	string "Compile source code list"

config PK_BROILER_PCI_INTX_CONFIG
	string "CONFIG: Project Configure Options"

config PK_BROILER_PCI_INTX_LIBPATH
	string "LIBS: Libraries to pass to the linker, e.g. -l<library>"

config PK_BROILER_PCI_INTX_CPPFLAGS
	string "CPPFLAGS: C/C++ preprocessor flags, e.g. -I<include dir>"

config PK_BROILER_PCI_INTX_DPKCONFIG
	string "PKG_CONFIG_PATH: Directories to add to pkg-config's search path"

config PK_BROILER_PCI_INTX_CFLAGS
	string "CFLAGS: C compiler flags"

config PK_BROILER_PCI_INTX_LDFLAGS
	string "LDFLAGS: Linker flags"

config PK_BROILER_PCI_INTX_CXXFLAGS
	string "CXXFLAGS: C++ compiler flags"

config PK_BROILER_PCI_INTX_ASFLAGS
	string "CCASFLAGS: assembler compiler flags (defaults to CFLAGS)"

config PK_BROILER_PCI_INTX_BUILDARCH
	string "--host options on configure for Architecture"

endif # PK_BROILER_PCI_INTX
```

## package/pci/Broiler-pci-msi-interrupt/Kconfig
```kconfig
menuconfig PK_BROILER_PCI_MSI
	bool "Broiler PCI MSI Interrupt"

if PK_BROILER_PCI_MSI

config PK_BROILER_PCI_MSI_VERSION
	default "default"
	string "verstion"

config PK_BROILER_PCI_MSI_TAR
	default "tar.gz"
	string "tar type"

config PK_BROILER_PCI_MSI_URL
	default "https://gitee.com/BiscuitOS_team/HardStack/raw/Gitee/Device-Driver/PCIe/Broiler-pci-msi-interrupt"
	string "url"

config PK_BROILER_PCI_MSI_GITHUB
	string "GitHub"

config PK_BROILER_PCI_MSI_SRCFILE
	default "main.c Kconfig Makefile README.md RunBiscuitOS.sh Makefile.host"
	string "Source code list"

config PK_BROILER_PCI_MSI_CSRCFILE
	string "Compile source code list"

config PK_BROILER_PCI_MSI_CONFIG
	string "CONFIG: Project Configure Options"

config PK_BROILER_PCI_MSI_LIBPATH
	string "LIBS: Libraries to pass to the linker, e.g. -l<library>"

config PK_BROILER_PCI_MSI_CPPFLAGS
	string "CPPFLAGS: C/C++ preprocessor flags, e.g. -I<include dir>"

config PK_BROILER_PCI_MSI_DPKCONFIG
	string "PKG_CONFIG_PATH: Directories to add to pkg-config's search path"

config PK_BROILER_PCI_MSI_CFLAGS
	string "CFLAGS: C compiler flags"

config PK_BROILER_PCI_MSI_LDFLAGS
	string "LDFLAGS: Linker flags"

config PK_BROILER_PCI_MSI_CXXFLAGS
	string "CXXFLAGS: C++ compiler flags"

config PK_BROILER_PCI_MSI_ASFLAGS
	string "CCASFLAGS: assembler compiler flags (defaults to CFLAGS)"

config PK_BROILER_PCI_MSI_BUILDARCH
	string "--host options on configure for Architecture"

endif # PK_BROILER_PCI_MSI
```

## package/pci/Broiler-pci-msix-interrupt/Kconfig
```kconfig
menuconfig PK_BROILER_PCI_MSIX
	bool "Broiler PCI MSIX Interrupt"

if PK_BROILER_PCI_MSIX

config PK_BROILER_PCI_MSIX_VERSION
	default "default"
	string "verstion"

config PK_BROILER_PCI_MSIX_TAR
	default "tar.gz"
	string "tar type"

config PK_BROILER_PCI_MSIX_URL
	default "https://gitee.com/BiscuitOS_team/HardStack/raw/Gitee/Device-Driver/PCIe/Broiler-pci-msix-interrupt"
	string "url"

config PK_BROILER_PCI_MSIX_GITHUB
	string "GitHub"

config PK_BROILER_PCI_MSIX_SRCFILE
	default "main.c Kconfig Makefile README.md RunBiscuitOS.sh Makefile.host"
	string "Source code list"

config PK_BROILER_PCI_MSIX_CSRCFILE
	string "Compile source code list"

config PK_BROILER_PCI_MSIX_CONFIG
	string "CONFIG: Project Configure Options"

config PK_BROILER_PCI_MSIX_LIBPATH
	string "LIBS: Libraries to pass to the linker, e.g. -l<library>"

config PK_BROILER_PCI_MSIX_CPPFLAGS
	string "CPPFLAGS: C/C++ preprocessor flags, e.g. -I<include dir>"

config PK_BROILER_PCI_MSIX_DPKCONFIG
	string "PKG_CONFIG_PATH: Directories to add to pkg-config's search path"

config PK_BROILER_PCI_MSIX_CFLAGS
	string "CFLAGS: C compiler flags"

config PK_BROILER_PCI_MSIX_LDFLAGS
	string "LDFLAGS: Linker flags"

config PK_BROILER_PCI_MSIX_CXXFLAGS
	string "CXXFLAGS: C++ compiler flags"

config PK_BROILER_PCI_MSIX_ASFLAGS
	string "CCASFLAGS: assembler compiler flags (defaults to CFLAGS)"

config PK_BROILER_PCI_MSIX_BUILDARCH
	string "--host options on configure for Architecture"

endif # PK_BROILER_PCI_MSIX
```

## package/pci/Kconfig
```kconfig
menuconfig PK_PCI
	bool "PCI: Peripheral Component Interconnect"

if PK_PCI

# PCI Common Device Driver
source package/pci/BiscuitOS-pci-device-driver/Kconfig

# PCI Device QEMU emulate
source package/pci/BiscuitOS-pci-device-QEMU-emulate/Kconfig

# PCI Express Configuration via IO
source package/pci/BiscuitOS-PCI-Express-Configuration-IO/Kconfig

# DMA userland
source package/pci/BiscuitOS-dma-userland/Kconfig

# DMA Common Device Driver
source package/pci/BiscuitOS-dma-device-driver/Kconfig

# DMA Device QEMU emulate
source package/pci/BiscuitOS-dma-device-QEMU-emulate/Kconfig

# PCI TOOLS: pciutils
source package/pci/pciutils/Kconfig

# Broiler PCI Device Driver
source package/pci/Broiler-pci-device-driver/Kconfig

# Broiler PCI INTX Interrupt
source package/pci/Broiler-pci-intx-interrupt/Kconfig

# Broiler PCI MSI Interrupt
source package/pci/Broiler-pci-msi-interrupt/Kconfig

# Broiler PCI MSIX Interrupt
source package/pci/Broiler-pci-msix-interrupt/Kconfig

# Broiler DMA with INTX Interrupt
source package/pci/Broiler-dma-intx/Kconfig

# Broiler DMA with MSI Interrupt
source package/pci/Broiler-dma-msi/Kconfig

# Broiler DMA with MSIX Interrupt
source package/pci/Broiler-dma-msix/Kconfig

# QEMU DEVICE: PCI BAR
source package/pci/BiscuitOS-PCI-QEMU-DEVICE-BAR/Kconfig

# QEMU DEVICE: PCI MSI
source package/pci/BiscuitOS-PCI-QEMU-DEVICE-MSI/Kconfig

# QEMU DEVICE: PCI MSIX
source package/pci/BiscuitOS-PCI-QEMU-DEVICE-MSIX/Kconfig

# QEMU DEVICE: PCI INTX
source package/pci/BiscuitOS-PCI-QEMU-DEVICE-INTX/Kconfig

# QEMU DEVICE: PCI DMA MSIX
source package/pci/BiscuitOS-PCI-DMA-QEMU-DEVICE-MSIX/Kconfig

# QEMU DEVICE: PCI DMA MSI
source package/pci/BiscuitOS-PCI-DMA-QEMU-DEVICE-MSI/Kconfig

# QEMU DEVICE: PCI DMA INTX
source package/pci/BiscuitOS-PCI-DMA-QEMU-DEVICE-INTX/Kconfig

# QEMU DEVICE: DMA-BUF
source package/pci/BiscuitOS-PCI-DMA-BUF-QEMU-DEVICE/Kconfig

endif # PK_PCI
```

## package/pci/pciutils/Kconfig
```kconfig
menuconfig PK_PCIUTILS
	bool "PCI Utilities: lspci/setpci/update-pciids"

if PK_PCIUTILS

config PK_PCIUTILS_VERSION
	default "3.7.0"
	string "verstion"

config PK_PCIUTILS_TAR
	default "tar.gz"
	string "tar type"

config PK_PCIUTILS_URL
	default "http://mj.ucw.cz/download/linux/pci/"
	string "url"

config PK_PCIUTILS_GITHUB
	string "GitHub"

config PK_PCIUTILS_SRCFILE
	default "main.c Makefile"
	string "Source code list"

config PK_PCIUTILS_CSRCFILE
	string "Compile source code list"

config PK_PCIUTILS_CONFIG
	string "CONFIG: Project Configure Options"

config PK_PCIUTILS_LIBPATH
	string "LIBS: Libraries to pass to the linker, e.g. -l<library>"

config PK_PCIUTILS_CPPFLAGS
	string "CPPFLAGS: C/C++ preprocessor flags, e.g. -I<include dir>"

config PK_PCIUTILS_DPKCONFIG
	string "PKG_CONFIG_PATH: Directories to add to pkg-config's search path"

config PK_PCIUTILS_CFLAGS
	string "CFLAGS: C compiler flags"

config PK_PCIUTILS_LDFLAGS
	string "LDFLAGS: Linker flags"

config PK_PCIUTILS_CXXFLAGS
	string "CXXFLAGS: C++ compiler flags"

config PK_PCIUTILS_ASFLAGS
	string "CCASFLAGS: assembler compiler flags (defaults to CFLAGS)"

config PK_PCIUTILS_BUILDARCH
	string "--host options on configure for Architecture"

endif # PK_PCIUTILS
```

## package/pcre/Kconfig
```kconfig
menuconfig PK_PCRE
	bool "pcre"

if PK_PCRE

config PK_PCRE_VERSION
	default "8.41"
	string "verstion"

config PK_PCRE_TAR
	default "tar.gz"
	string "tar type"

config PK_PCRE_URL
	default "https://ftp.pcre.org/pub/pcre/"
	string "url"

config PK_PCRE_GITHUB
	string "GitHub"

config PK_PCRE_SRCFILE
	string "Source code list"

config PK_PCRE_CONFIG
	default "--enable-silent-rules --disable-static"
	string "CONFIG: Project Configure Options"

config PK_PCRE_LIBPATH
	string "LIBS: Libraries to pass to the linker, e.g. -l<library>"

config PK_PCRE_CPPFLAGS
	string "CPPFLAGS: C/C++ preprocessor flags, e.g. -I<include dir>"

config PK_PCRE_DPKCONFIG
	string "PKG_CONFIG_PATH: Directories to add to pkg-config's search path"

config PK_PCRE_CFLAGS
	string "CFLAGS: C compiler flags"

config PK_PCRE_LDFLAGS
	string "LDFLAGS: Linker flags"

config PK_PCRE_CXXFLAGS
	string "CXXFLAGS: C++ compiler flags"

config PK_PCRE_ASFLAGS
	string "CCASFLAGS: assembler compiler flags (defaults to CFLAGS)"

config PK_PCRE_BUILDARCH
	default "x86_64-unknown-linux-gnu"
	string "--host options on configure for Architecture"

endif # PK_PCRE
```

## package/percpu/DECLARE_PER_CPU_FIRST/Kconfig
```kconfig
menuconfig PK_DECLARE_PER_CPU_FIRST
	bool "DECLARE_PER_CPU_FIRST"

if PK_DECLARE_PER_CPU_FIRST

config PK_DECLARE_PER_CPU_FIRST_VERSION
	default "0.0.1"
	string "verstion"

config PK_DECLARE_PER_CPU_FIRST_TAR
	default "tar.gz"
	string "tar type"

config PK_DECLARE_PER_CPU_FIRST_URL
	default "https://gitee.com/BiscuitOS_team/HardStack/raw/Gitee/Algorithem/percpu/API/DECLARE_PER_CPU_FIRST"
	string "url"

config PK_DECLARE_PER_CPU_FIRST_GITHUB
	string "GitHub"

config PK_DECLARE_PER_CPU_FIRST_SRCFILE
	default "core.c Kconfig Makefile"
	string "Source code list"

config PK_DECLARE_PER_CPU_FIRST_CSRCFILE
	string "Compile source code list"

config PK_DECLARE_PER_CPU_FIRST_CONFIG
	string "CONFIG: Project Configure Options"

config PK_DECLARE_PER_CPU_FIRST_LIBPATH
	string "LIBS: Libraries to pass to the linker, e.g. -l<library>"

config PK_DECLARE_PER_CPU_FIRST_CPPFLAGS
	string "CPPFLAGS: C/C++ preprocessor flags, e.g. -I<include dir>"

config PK_DECLARE_PER_CPU_FIRST_DPKCONFIG
	string "PKG_CONFIG_PATH: Directories to add to pkg-config's search path"

config PK_DECLARE_PER_CPU_FIRST_CFLAGS
	string "CFLAGS: C compiler flags"

config PK_DECLARE_PER_CPU_FIRST_LDFLAGS
	string "LDFLAGS: Linker flags"

config PK_DECLARE_PER_CPU_FIRST_CXXFLAGS
	string "CXXFLAGS: C++ compiler flags"

config PK_DECLARE_PER_CPU_FIRST_ASFLAGS
	string "CCASFLAGS: assembler compiler flags (defaults to CFLAGS)"

config PK_DECLARE_PER_CPU_FIRST_BUILDARCH
	string "--host options on configure for Architecture"

endif # PK_DECLARE_PER_CPU_FIRST
```
