## package/percpu/DECLARE_PER_CPU_PAGE_ALIGNED/Kconfig
```kconfig
menuconfig PK_DECLARE_PER_CPU_PAGE_ALIGNED
	bool "DECLARE_PER_CPU_PAGE_ALIGNED"

if PK_DECLARE_PER_CPU_PAGE_ALIGNED

config PK_DECLARE_PER_CPU_PAGE_ALIGNED_VERSION
	default "0.0.1"
	string "verstion"

config PK_DECLARE_PER_CPU_PAGE_ALIGNED_TAR
	default "tar.gz"
	string "tar type"

config PK_DECLARE_PER_CPU_PAGE_ALIGNED_URL
	default "https://gitee.com/BiscuitOS_team/HardStack/raw/Gitee/Algorithem/percpu/API/DECLARE_PER_CPU_PAGE_ALIGNED"
	string "url"

config PK_DECLARE_PER_CPU_PAGE_ALIGNED_GITHUB
	string "GitHub"

config PK_DECLARE_PER_CPU_PAGE_ALIGNED_SRCFILE
	default "core.c Kconfig Makefile"
	string "Source code list"

config PK_DECLARE_PER_CPU_PAGE_ALIGNED_CSRCFILE
	string "Compile source code list"

config PK_DECLARE_PER_CPU_PAGE_ALIGNED_CONFIG
	string "CONFIG: Project Configure Options"

config PK_DECLARE_PER_CPU_PAGE_ALIGNED_LIBPATH
	string "LIBS: Libraries to pass to the linker, e.g. -l<library>"

config PK_DECLARE_PER_CPU_PAGE_ALIGNED_CPPFLAGS
	string "CPPFLAGS: C/C++ preprocessor flags, e.g. -I<include dir>"

config PK_DECLARE_PER_CPU_PAGE_ALIGNED_DPKCONFIG
	string "PKG_CONFIG_PATH: Directories to add to pkg-config's search path"

config PK_DECLARE_PER_CPU_PAGE_ALIGNED_CFLAGS
	string "CFLAGS: C compiler flags"

config PK_DECLARE_PER_CPU_PAGE_ALIGNED_LDFLAGS
	string "LDFLAGS: Linker flags"

config PK_DECLARE_PER_CPU_PAGE_ALIGNED_CXXFLAGS
	string "CXXFLAGS: C++ compiler flags"

config PK_DECLARE_PER_CPU_PAGE_ALIGNED_ASFLAGS
	string "CCASFLAGS: assembler compiler flags (defaults to CFLAGS)"

config PK_DECLARE_PER_CPU_PAGE_ALIGNED_BUILDARCH
	string "--host options on configure for Architecture"

endif # PK_DECLARE_PER_CPU_PAGE_ALIGNED
```

## package/percpu/DEFINE_PER_CPU/Kconfig
```kconfig
menuconfig PK_DEFINE_PER_CPU
	bool "DEFINE_PER_CPU"

if PK_DEFINE_PER_CPU

config PK_DEFINE_PER_CPU_VERSION
	default "0.0.1"
	string "verstion"

config PK_DEFINE_PER_CPU_TAR
	default "tar.gz"
	string "tar type"

config PK_DEFINE_PER_CPU_URL
	default "https://gitee.com/BiscuitOS_team/HardStack/raw/Gitee/Algorithem/percpu/API/DEFINE_PER_CPU"
	string "url"

config PK_DEFINE_PER_CPU_GITHUB
	string "GitHub"

config PK_DEFINE_PER_CPU_SRCFILE
	default "core.c Kconfig Makefile"
	string "Source code list"

config PK_DEFINE_PER_CPU_CSRCFILE
	string "Compile source code list"

config PK_DEFINE_PER_CPU_CONFIG
	string "CONFIG: Project Configure Options"

config PK_DEFINE_PER_CPU_LIBPATH
	string "LIBS: Libraries to pass to the linker, e.g. -l<library>"

config PK_DEFINE_PER_CPU_CPPFLAGS
	string "CPPFLAGS: C/C++ preprocessor flags, e.g. -I<include dir>"

config PK_DEFINE_PER_CPU_DPKCONFIG
	string "PKG_CONFIG_PATH: Directories to add to pkg-config's search path"

config PK_DEFINE_PER_CPU_CFLAGS
	string "CFLAGS: C compiler flags"

config PK_DEFINE_PER_CPU_LDFLAGS
	string "LDFLAGS: Linker flags"

config PK_DEFINE_PER_CPU_CXXFLAGS
	string "CXXFLAGS: C++ compiler flags"

config PK_DEFINE_PER_CPU_ASFLAGS
	string "CCASFLAGS: assembler compiler flags (defaults to CFLAGS)"

config PK_DEFINE_PER_CPU_BUILDARCH
	string "--host options on configure for Architecture"

endif # PK_DEFINE_PER_CPU
```

## package/percpu/DEFINE_PER_CPU_FIRST/Kconfig
```kconfig
menuconfig PK_DEFINE_PER_CPU_FIRST
	bool "DEFINE_PER_CPU_FIRST"

if PK_DEFINE_PER_CPU_FIRST

config PK_DEFINE_PER_CPU_FIRST_VERSION
	default "0.0.1"
	string "verstion"

config PK_DEFINE_PER_CPU_FIRST_TAR
	default "tar.gz"
	string "tar type"

config PK_DEFINE_PER_CPU_FIRST_URL
	default "https://gitee.com/BiscuitOS_team/HardStack/raw/Gitee/Algorithem/percpu/API/DEFINE_PER_CPU_FIRST"
	string "url"

config PK_DEFINE_PER_CPU_FIRST_GITHUB
	string "GitHub"

config PK_DEFINE_PER_CPU_FIRST_SRCFILE
	default "core.c Kconfig Makefile"
	string "Source code list"

config PK_DEFINE_PER_CPU_FIRST_CSRCFILE
	string "Compile source code list"

config PK_DEFINE_PER_CPU_FIRST_CONFIG
	string "CONFIG: Project Configure Options"

config PK_DEFINE_PER_CPU_FIRST_LIBPATH
	string "LIBS: Libraries to pass to the linker, e.g. -l<library>"

config PK_DEFINE_PER_CPU_FIRST_CPPFLAGS
	string "CPPFLAGS: C/C++ preprocessor flags, e.g. -I<include dir>"

config PK_DEFINE_PER_CPU_FIRST_DPKCONFIG
	string "PKG_CONFIG_PATH: Directories to add to pkg-config's search path"

config PK_DEFINE_PER_CPU_FIRST_CFLAGS
	string "CFLAGS: C compiler flags"

config PK_DEFINE_PER_CPU_FIRST_LDFLAGS
	string "LDFLAGS: Linker flags"

config PK_DEFINE_PER_CPU_FIRST_CXXFLAGS
	string "CXXFLAGS: C++ compiler flags"

config PK_DEFINE_PER_CPU_FIRST_ASFLAGS
	string "CCASFLAGS: assembler compiler flags (defaults to CFLAGS)"

config PK_DEFINE_PER_CPU_FIRST_BUILDARCH
	string "--host options on configure for Architecture"

endif # PK_DEFINE_PER_CPU_FIRST
```

## package/percpu/DEFINE_PER_CPU_SHARED_ALIGNED/Kconfig
```kconfig
menuconfig PK_DEFINE_PER_CPU_SHARED_ALIGNED
	bool "DEFINE_PER_CPU_SHARED_ALIGNED"

if PK_DEFINE_PER_CPU_SHARED_ALIGNED

config PK_DEFINE_PER_CPU_SHARED_ALIGNED_VERSION
	default "0.0.1"
	string "verstion"

config PK_DEFINE_PER_CPU_SHARED_ALIGNED_TAR
	default "tar.gz"
	string "tar type"

config PK_DEFINE_PER_CPU_SHARED_ALIGNED_URL
	default "https://gitee.com/BiscuitOS_team/HardStack/raw/Gitee/Algorithem/percpu/API/DEFINE_PER_CPU_SHARED_ALIGNED"
	string "url"

config PK_DEFINE_PER_CPU_SHARED_ALIGNED_GITHUB
	string "GitHub"

config PK_DEFINE_PER_CPU_SHARED_ALIGNED_SRCFILE
	default "core.c Kconfig Makefile"
	string "Source code list"

config PK_DEFINE_PER_CPU_SHARED_ALIGNED_CSRCFILE
	string "Compile source code list"

config PK_DEFINE_PER_CPU_SHARED_ALIGNED_CONFIG
	string "CONFIG: Project Configure Options"

config PK_DEFINE_PER_CPU_SHARED_ALIGNED_LIBPATH
	string "LIBS: Libraries to pass to the linker, e.g. -l<library>"

config PK_DEFINE_PER_CPU_SHARED_ALIGNED_CPPFLAGS
	string "CPPFLAGS: C/C++ preprocessor flags, e.g. -I<include dir>"

config PK_DEFINE_PER_CPU_SHARED_ALIGNED_DPKCONFIG
	string "PKG_CONFIG_PATH: Directories to add to pkg-config's search path"

config PK_DEFINE_PER_CPU_SHARED_ALIGNED_CFLAGS
	string "CFLAGS: C compiler flags"

config PK_DEFINE_PER_CPU_SHARED_ALIGNED_LDFLAGS
	string "LDFLAGS: Linker flags"

config PK_DEFINE_PER_CPU_SHARED_ALIGNED_CXXFLAGS
	string "CXXFLAGS: C++ compiler flags"

config PK_DEFINE_PER_CPU_SHARED_ALIGNED_ASFLAGS
	string "CCASFLAGS: assembler compiler flags (defaults to CFLAGS)"

config PK_DEFINE_PER_CPU_SHARED_ALIGNED_BUILDARCH
	string "--host options on configure for Architecture"

endif # PK_DEFINE_PER_CPU_SHARED_ALIGNED
```

## package/percpu/Kconfig
```kconfig
menuconfig PK_PERCPU
	bool "percpu"

if PK_PERCPU

# alloc_percpu
source package/percpu/alloc_percpu/Kconfig

# DECLARE_PER_CPU
source package/percpu/DECLARE_PER_CPU/Kconfig

# DECLARE_PER_CPU_FIRST
source package/percpu/DECLARE_PER_CPU_FIRST/Kconfig

# DECLARE_PER_CPU_PAGE_ALIGNED
source package/percpu/DECLARE_PER_CPU_PAGE_ALIGNED/Kconfig

# DECLARE_PER_CPU_SHARED_ALIGNED
source package/percpu/DECLARE_PER_CPU_SHARED_ALIGNED/Kconfig

# DEFINE_PER_CPU
source package/percpu/DEFINE_PER_CPU/Kconfig

# DEFINE_PER_CPU_FIRST
source package/percpu/DEFINE_PER_CPU_FIRST/Kconfig

# DEFINE_PER_CPU_PAGE_ALIGNED
source package/percpu/DEFINE_PER_CPU_PAGE_ALIGNED/Kconfig

# DEFINE_PER_CPU_SHARED_ALIGNED
source package/percpu/DEFINE_PER_CPU_SHARED_ALIGNED/Kconfig

# free_percpu
source package/percpu/free_percpu/Kconfig

# for_each_possible_cpu
source package/percpu/for_each_possible_cpu/Kconfig

# get_cpu_ptr
source package/percpu/get_cpu_ptr/Kconfig

# get_cpu_var
source package/percpu/get_cpu_var/Kconfig

# this_cpu_read
source package/percpu/this_cpu_read/Kconfig

# PERCPU(SMP) Allocator
source package/percpu/SMP_PERCPU_userspace/Kconfig

# PERCPU(UP) Allocator
source package/percpu/UP_PERCPU_userspace/Kconfig

# percpu
source package/percpu/percpu/Kconfig

# per_cpu
source package/percpu/per_cpu/Kconfig

# per_cpu_ptr
source package/percpu/per_cpu_ptr/Kconfig

# percpu_counter_dec
source package/percpu/percpu_counter_dec/Kconfig

# percpu_counter_inc
source package/percpu/percpu_counter_inc/Kconfig

# percpu_counter_init
source package/percpu/percpu_counter_init/Kconfig

# percpu_counter_sub
source package/percpu/percpu_counter_sub/Kconfig

# percpu_counter_sum
source package/percpu/percpu_counter_sum/Kconfig

# put_cpu_ptr
source package/percpu/put_cpu_ptr/Kconfig

# put_cpu_var
source package/percpu/put_cpu_var/Kconfig

# raw_cpu_ptr
source package/percpu/raw_cpu_ptr/Kconfig

endif # PK_PERCPU
```

## package/percpu/UP_PERCPU_userspace/Kconfig
```kconfig
menuconfig PK_UP_PERCPU_USERSPACE
	bool "PERCPU(UP) Memory Allocator on Userspace"

if PK_UP_PERCPU_USERSPACE

config PK_UP_PERCPU_USERSPACE_VERSION
	default "0.0.1"
	string "verstion"

config PK_UP_PERCPU_USERSPACE_TAR
	default "tar.gz"
	string "tar type"

config PK_UP_PERCPU_USERSPACE_URL
	default "https://gitee.com/BiscuitOS_team/HardStack/raw/Gitee/Memory-Allocator/PERCPU/UP_PERCPU_userspace"
	string "url"

config PK_UP_PERCPU_USERSPACE_GITHUB
	string "GitHub"

config PK_UP_PERCPU_USERSPACE_SRCFILE
	default "main.c Makefile README.md include/linux/biscuitos.h include/linux/bitmap.h include/linux/getorder.h include/linux/gfp.h include/linux/list.h include/linux/memblock.h include/linux/mm.h include/linux/percpu.h mm/bitmap.c mm/memblock.c mm/percpu.c"
	string "Source code list"

config PK_UP_PERCPU_USERSPACE_CSRCFILE
	string "Compile source code list"

config PK_UP_PERCPU_USERSPACE_CONFIG
	string "CONFIG: Project Configure Options"

config PK_UP_PERCPU_USERSPACE_LIBPATH
	string "LIBS: Libraries to pass to the linker, e.g. -l<library>"

config PK_UP_PERCPU_USERSPACE_CPPFLAGS
	string "CPPFLAGS: C/C++ preprocessor flags, e.g. -I<include dir>"

config PK_UP_PERCPU_USERSPACE_DPKCONFIG
	string "PKG_CONFIG_PATH: Directories to add to pkg-config's search path"

config PK_UP_PERCPU_USERSPACE_CFLAGS
	string "CFLAGS: C compiler flags"

config PK_UP_PERCPU_USERSPACE_LDFLAGS
	string "LDFLAGS: Linker flags"

config PK_UP_PERCPU_USERSPACE_CXXFLAGS
	string "CXXFLAGS: C++ compiler flags"

config PK_UP_PERCPU_USERSPACE_ASFLAGS
	string "CCASFLAGS: assembler compiler flags (defaults to CFLAGS)"

config PK_UP_PERCPU_USERSPACE_BUILDARCH
	string "--host options on configure for Architecture"

endif # PK_UP_PERCPU_USERSPACE
```

## package/percpu/for_each_possible_cpu/Kconfig
```kconfig
menuconfig PK_FEPC
	bool "for_each_possible_cpu"

if PK_FEPC

config PK_FEPC_VERSION
	default "0.0.1"
	string "verstion"

config PK_FEPC_TAR
	default "tar.gz"
	string "tar type"

config PK_FEPC_URL
	default "https://gitee.com/BiscuitOS_team/HardStack/raw/Gitee/Algorithem/percpu/API/for_each_possible_cpu"
	string "url"

config PK_FEPC_GITHUB
	string "GitHub"

config PK_FEPC_SRCFILE
	default "core.c Kconfig Makefile"
	string "Source code list"

config PK_FEPC_CSRCFILE
	string "Compile source code list"

config PK_FEPC_CONFIG
	string "CONFIG: Project Configure Options"

config PK_FEPC_LIBPATH
	string "LIBS: Libraries to pass to the linker, e.g. -l<library>"

config PK_FEPC_CPPFLAGS
	string "CPPFLAGS: C/C++ preprocessor flags, e.g. -I<include dir>"

config PK_FEPC_DPKCONFIG
	string "PKG_CONFIG_PATH: Directories to add to pkg-config's search path"

config PK_FEPC_CFLAGS
	string "CFLAGS: C compiler flags"

config PK_FEPC_LDFLAGS
	string "LDFLAGS: Linker flags"

config PK_FEPC_CXXFLAGS
	string "CXXFLAGS: C++ compiler flags"

config PK_FEPC_ASFLAGS
	string "CCASFLAGS: assembler compiler flags (defaults to CFLAGS)"

config PK_FEPC_BUILDARCH
	string "--host options on configure for Architecture"

endif # PK_FEPC
```

## package/percpu/free_percpu/Kconfig
```kconfig
menuconfig PK_FREE_PERCPU
	bool "free_percpu"

if PK_FREE_PERCPU

config PK_FREE_PERCPU_VERSION
	default "0.0.1"
	string "verstion"

config PK_FREE_PERCPU_TAR
	default "tar.gz"
	string "tar type"

config PK_FREE_PERCPU_URL
	default "https://gitee.com/BiscuitOS_team/HardStack/raw/Gitee/Algorithem/percpu/API/free_percpu"
	string "url"

config PK_FREE_PERCPU_GITHUB
	string "GitHub"

config PK_FREE_PERCPU_SRCFILE
	default "core.c Kconfig Makefile"
	string "Source code list"

config PK_FREE_PERCPU_CSRCFILE
	string "Compile source code list"

config PK_FREE_PERCPU_CONFIG
	string "CONFIG: Project Configure Options"

config PK_FREE_PERCPU_LIBPATH
	string "LIBS: Libraries to pass to the linker, e.g. -l<library>"

config PK_FREE_PERCPU_CPPFLAGS
	string "CPPFLAGS: C/C++ preprocessor flags, e.g. -I<include dir>"

config PK_FREE_PERCPU_DPKCONFIG
	string "PKG_CONFIG_PATH: Directories to add to pkg-config's search path"

config PK_FREE_PERCPU_CFLAGS
	string "CFLAGS: C compiler flags"

config PK_FREE_PERCPU_LDFLAGS
	string "LDFLAGS: Linker flags"

config PK_FREE_PERCPU_CXXFLAGS
	string "CXXFLAGS: C++ compiler flags"

config PK_FREE_PERCPU_ASFLAGS
	string "CCASFLAGS: assembler compiler flags (defaults to CFLAGS)"

config PK_FREE_PERCPU_BUILDARCH
	string "--host options on configure for Architecture"

endif # PK_FREE_PERCPU
```

## package/percpu/get_cpu_ptr/Kconfig
```kconfig
menuconfig PK_GET_CPU_PTR
	bool "get_cpu_ptr"

if PK_GET_CPU_PTR

config PK_GET_CPU_PTR_VERSION
	default "0.0.1"
	string "verstion"

config PK_GET_CPU_PTR_TAR
	default "tar.gz"
	string "tar type"

config PK_GET_CPU_PTR_URL
	default "https://gitee.com/BiscuitOS_team/HardStack/raw/Gitee/Algorithem/percpu/API/get_cpu_ptr"
	string "url"

config PK_GET_CPU_PTR_GITHUB
	string "GitHub"

config PK_GET_CPU_PTR_SRCFILE
	default "core.c Kconfig Makefile"
	string "Source code list"

config PK_GET_CPU_PTR_CSRCFILE
	string "Compile source code list"

config PK_GET_CPU_PTR_CONFIG
	string "CONFIG: Project Configure Options"

config PK_GET_CPU_PTR_LIBPATH
	string "LIBS: Libraries to pass to the linker, e.g. -l<library>"

config PK_GET_CPU_PTR_CPPFLAGS
	string "CPPFLAGS: C/C++ preprocessor flags, e.g. -I<include dir>"

config PK_GET_CPU_PTR_DPKCONFIG
	string "PKG_CONFIG_PATH: Directories to add to pkg-config's search path"

config PK_GET_CPU_PTR_CFLAGS
	string "CFLAGS: C compiler flags"

config PK_GET_CPU_PTR_LDFLAGS
	string "LDFLAGS: Linker flags"

config PK_GET_CPU_PTR_CXXFLAGS
	string "CXXFLAGS: C++ compiler flags"

config PK_GET_CPU_PTR_ASFLAGS
	string "CCASFLAGS: assembler compiler flags (defaults to CFLAGS)"

config PK_GET_CPU_PTR_BUILDARCH
	string "--host options on configure for Architecture"

endif # PK_GET_CPU_PTR
```

## package/percpu/get_cpu_var/Kconfig
```kconfig
menuconfig PK_GET_CPU_VAR
	bool "get_cpu_var"

if PK_GET_CPU_VAR

config PK_GET_CPU_VAR_VERSION
	default "0.0.1"
	string "verstion"

config PK_GET_CPU_VAR_TAR
	default "tar.gz"
	string "tar type"

config PK_GET_CPU_VAR_URL
	default "https://gitee.com/BiscuitOS_team/HardStack/raw/Gitee/Algorithem/percpu/API/get_cpu_var"
	string "url"

config PK_GET_CPU_VAR_GITHUB
	string "GitHub"

config PK_GET_CPU_VAR_SRCFILE
	default "core.c Kconfig Makefile"
	string "Source code list"

config PK_GET_CPU_VAR_CSRCFILE
	string "Compile source code list"

config PK_GET_CPU_VAR_CONFIG
	string "CONFIG: Project Configure Options"

config PK_GET_CPU_VAR_LIBPATH
	string "LIBS: Libraries to pass to the linker, e.g. -l<library>"

config PK_GET_CPU_VAR_CPPFLAGS
	string "CPPFLAGS: C/C++ preprocessor flags, e.g. -I<include dir>"

config PK_GET_CPU_VAR_DPKCONFIG
	string "PKG_CONFIG_PATH: Directories to add to pkg-config's search path"

config PK_GET_CPU_VAR_CFLAGS
	string "CFLAGS: C compiler flags"

config PK_GET_CPU_VAR_LDFLAGS
	string "LDFLAGS: Linker flags"

config PK_GET_CPU_VAR_CXXFLAGS
	string "CXXFLAGS: C++ compiler flags"

config PK_GET_CPU_VAR_ASFLAGS
	string "CCASFLAGS: assembler compiler flags (defaults to CFLAGS)"

config PK_GET_CPU_VAR_BUILDARCH
	string "--host options on configure for Architecture"

endif # PK_GET_CPU_VAR
```
