## package/percpu/per_cpu/Kconfig
```kconfig
menuconfig PK_PER_CPU_F
	bool "per_cpu"

if PK_PER_CPU_F

config PK_PER_CPU_F_VERSION
	default "0.0.1"
	string "verstion"

config PK_PER_CPU_F_TAR
	default "tar.gz"
	string "tar type"

config PK_PER_CPU_F_URL
	default "https://gitee.com/BiscuitOS_team/HardStack/raw/Gitee/Algorithem/percpu/API/per_cpu"
	string "url"

config PK_PER_CPU_F_GITHUB
	string "GitHub"

config PK_PER_CPU_F_SRCFILE
	default "core.c Kconfig Makefile"
	string "Source code list"

config PK_PER_CPU_F_CSRCFILE
	string "Compile source code list"

config PK_PER_CPU_F_CONFIG
	string "CONFIG: Project Configure Options"

config PK_PER_CPU_F_LIBPATH
	string "LIBS: Libraries to pass to the linker, e.g. -l<library>"

config PK_PER_CPU_F_CPPFLAGS
	string "CPPFLAGS: C/C++ preprocessor flags, e.g. -I<include dir>"

config PK_PER_CPU_F_DPKCONFIG
	string "PKG_CONFIG_PATH: Directories to add to pkg-config's search path"

config PK_PER_CPU_F_CFLAGS
	string "CFLAGS: C compiler flags"

config PK_PER_CPU_F_LDFLAGS
	string "LDFLAGS: Linker flags"

config PK_PER_CPU_F_CXXFLAGS
	string "CXXFLAGS: C++ compiler flags"

config PK_PER_CPU_F_ASFLAGS
	string "CCASFLAGS: assembler compiler flags (defaults to CFLAGS)"

config PK_PER_CPU_F_BUILDARCH
	string "--host options on configure for Architecture"

endif # PK_PER_CPU_F
```

## package/percpu/percpu/Kconfig
```kconfig
menuconfig PK_PERCPU_BASE
	bool "percpu standard usage"

if PK_PERCPU_BASE

config PK_PERCPU_BASE_VERSION
	default "0.0.1"
	string "verstion"

config PK_PERCPU_BASE_TAR
	default "tar.gz"
	string "tar type"

config PK_PERCPU_BASE_URL
	default "https://gitee.com/BiscuitOS_team/HardStack/raw/Gitee/Algorithem/percpu/base"
	string "url"

config PK_PERCPU_BASE_GITHUB
	string "GitHub"

config PK_PERCPU_BASE_SRCFILE
	default "core.c Kconfig Makefile"
	string "Source code list"

config PK_PERCPU_BASE_CSRCFILE
	string "Compile source code list"

config PK_PERCPU_BASE_CONFIG
	string "CONFIG: Project Configure Options"

config PK_PERCPU_BASE_LIBPATH
	string "LIBS: Libraries to pass to the linker, e.g. -l<library>"

config PK_PERCPU_BASE_CPPFLAGS
	string "CPPFLAGS: C/C++ preprocessor flags, e.g. -I<include dir>"

config PK_PERCPU_BASE_DPKCONFIG
	string "PKG_CONFIG_PATH: Directories to add to pkg-config's search path"

config PK_PERCPU_BASE_CFLAGS
	string "CFLAGS: C compiler flags"

config PK_PERCPU_BASE_LDFLAGS
	string "LDFLAGS: Linker flags"

config PK_PERCPU_BASE_CXXFLAGS
	string "CXXFLAGS: C++ compiler flags"

config PK_PERCPU_BASE_ASFLAGS
	string "CCASFLAGS: assembler compiler flags (defaults to CFLAGS)"

config PK_PERCPU_BASE_BUILDARCH
	string "--host options on configure for Architecture"

endif # PK_PERCPU_BASE
```

## package/percpu/percpu_counter_dec/Kconfig
```kconfig
menuconfig PK_PERCPU_COUNTER_DEC
	bool "percpu_counter_dec()"

if PK_PERCPU_COUNTER_DEC

config PK_PERCPU_COUNTER_DEC_VERSION
	default "0.0.1"
	string "verstion"

config PK_PERCPU_COUNTER_DEC_TAR
	default "tar.gz"
	string "tar type"

config PK_PERCPU_COUNTER_DEC_URL
	default "https://gitee.com/BiscuitOS_team/HardStack/raw/Gitee/Algorithem/percpu/API/percpu_counter_dec"
	string "url"

config PK_PERCPU_COUNTER_DEC_GITHUB
	string "GitHub"

config PK_PERCPU_COUNTER_DEC_SRCFILE
	default "core.c Kconfig Makefile"
	string "Source code list"

config PK_PERCPU_COUNTER_DEC_CSRCFILE
	string "Compile source code list"

config PK_PERCPU_COUNTER_DEC_CONFIG
	string "CONFIG: Project Configure Options"

config PK_PERCPU_COUNTER_DEC_LIBPATH
	string "LIBS: Libraries to pass to the linker, e.g. -l<library>"

config PK_PERCPU_COUNTER_DEC_CPPFLAGS
	string "CPPFLAGS: C/C++ preprocessor flags, e.g. -I<include dir>"

config PK_PERCPU_COUNTER_DEC_DPKCONFIG
	string "PKG_CONFIG_PATH: Directories to add to pkg-config's search path"

config PK_PERCPU_COUNTER_DEC_CFLAGS
	string "CFLAGS: C compiler flags"

config PK_PERCPU_COUNTER_DEC_LDFLAGS
	string "LDFLAGS: Linker flags"

config PK_PERCPU_COUNTER_DEC_CXXFLAGS
	string "CXXFLAGS: C++ compiler flags"

config PK_PERCPU_COUNTER_DEC_ASFLAGS
	string "CCASFLAGS: assembler compiler flags (defaults to CFLAGS)"

config PK_PERCPU_COUNTER_DEC_BUILDARCH
	string "--host options on configure for Architecture"

endif # PK_PERCPU_COUNTER_DEC
```

## package/percpu/percpu_counter_inc/Kconfig
```kconfig
menuconfig PK_PERCPU_COUNTER_INC
	bool "percpu_counter_inc()"

if PK_PERCPU_COUNTER_INC

config PK_PERCPU_COUNTER_INC_VERSION
	default "0.0.1"
	string "verstion"

config PK_PERCPU_COUNTER_INC_TAR
	default "tar.gz"
	string "tar type"

config PK_PERCPU_COUNTER_INC_URL
	default "https://gitee.com/BiscuitOS_team/HardStack/raw/Gitee/Algorithem/percpu/API/percpu_counter_inc"
	string "url"

config PK_PERCPU_COUNTER_INC_GITHUB
	string "GitHub"

config PK_PERCPU_COUNTER_INC_SRCFILE
	default "core.c Kconfig Makefile"
	string "Source code list"

config PK_PERCPU_COUNTER_INC_CSRCFILE
	string "Compile source code list"

config PK_PERCPU_COUNTER_INC_CONFIG
	string "CONFIG: Project Configure Options"

config PK_PERCPU_COUNTER_INC_LIBPATH
	string "LIBS: Libraries to pass to the linker, e.g. -l<library>"

config PK_PERCPU_COUNTER_INC_CPPFLAGS
	string "CPPFLAGS: C/C++ preprocessor flags, e.g. -I<include dir>"

config PK_PERCPU_COUNTER_INC_DPKCONFIG
	string "PKG_CONFIG_PATH: Directories to add to pkg-config's search path"

config PK_PERCPU_COUNTER_INC_CFLAGS
	string "CFLAGS: C compiler flags"

config PK_PERCPU_COUNTER_INC_LDFLAGS
	string "LDFLAGS: Linker flags"

config PK_PERCPU_COUNTER_INC_CXXFLAGS
	string "CXXFLAGS: C++ compiler flags"

config PK_PERCPU_COUNTER_INC_ASFLAGS
	string "CCASFLAGS: assembler compiler flags (defaults to CFLAGS)"

config PK_PERCPU_COUNTER_INC_BUILDARCH
	string "--host options on configure for Architecture"

endif # PK_PERCPU_COUNTER_INC
```

## package/percpu/percpu_counter_init/Kconfig
```kconfig
menuconfig PK_PERCPU_COUNTER_INIT
	bool "percpu_counter_init()"

if PK_PERCPU_COUNTER_INIT

config PK_PERCPU_COUNTER_INIT_VERSION
	default "0.0.1"
	string "verstion"

config PK_PERCPU_COUNTER_INIT_TAR
	default "tar.gz"
	string "tar type"

config PK_PERCPU_COUNTER_INIT_URL
	default "https://gitee.com/BiscuitOS_team/HardStack/raw/Gitee/Algorithem/percpu/API/percpu_counter_init"
	string "url"

config PK_PERCPU_COUNTER_INIT_GITHUB
	string "GitHub"

config PK_PERCPU_COUNTER_INIT_SRCFILE
	default "core.c Kconfig Makefile"
	string "Source code list"

config PK_PERCPU_COUNTER_INIT_CSRCFILE
	string "Compile source code list"

config PK_PERCPU_COUNTER_INIT_CONFIG
	string "CONFIG: Project Configure Options"

config PK_PERCPU_COUNTER_INIT_LIBPATH
	string "LIBS: Libraries to pass to the linker, e.g. -l<library>"

config PK_PERCPU_COUNTER_INIT_CPPFLAGS
	string "CPPFLAGS: C/C++ preprocessor flags, e.g. -I<include dir>"

config PK_PERCPU_COUNTER_INIT_DPKCONFIG
	string "PKG_CONFIG_PATH: Directories to add to pkg-config's search path"

config PK_PERCPU_COUNTER_INIT_CFLAGS
	string "CFLAGS: C compiler flags"

config PK_PERCPU_COUNTER_INIT_LDFLAGS
	string "LDFLAGS: Linker flags"

config PK_PERCPU_COUNTER_INIT_CXXFLAGS
	string "CXXFLAGS: C++ compiler flags"

config PK_PERCPU_COUNTER_INIT_ASFLAGS
	string "CCASFLAGS: assembler compiler flags (defaults to CFLAGS)"

config PK_PERCPU_COUNTER_INIT_BUILDARCH
	string "--host options on configure for Architecture"

endif # PK_PERCPU_COUNTER_INIT
```
