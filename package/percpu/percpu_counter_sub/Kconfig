## package/platform/platform_coreDTS_app/Kconfig
```kconfig
menuconfig PK_PLATFORM_COREDTS_APP
	select PK_PLATFORM_COREDTS_MOD
	bool "Platform Core with DTS Application"

if PK_PLATFORM_COREDTS_APP

config PK_PLATFORM_COREDTS_APP_VERSION
	default "0.0.1"
	string "verstion"

config PK_PLATFORM_COREDTS_APP_TAR
	default "tar.gz"
	string "tar type"

config PK_PLATFORM_COREDTS_APP_URL
	default "https://gitee.com/BiscuitOS_team/HardStack/raw/Gitee/Device-Driver/Platform/DTS/Base/userland"
	string "url"

config PK_PLATFORM_COREDTS_APP_GITHUB
	string "GitHub"

config PK_PLATFORM_COREDTS_APP_SRCFILE
	default "platform.c platform.sh Makefile"
	string "Source code list"

config PK_PLATFORM_COREDTS_APP_CSRCFILE
	string "Compile source code list"

config PK_PLATFORM_COREDTS_APP_CONFIG
	string "CONFIG: Project Configure Options"

config PK_PLATFORM_COREDTS_APP_LIBPATH
	string "LIBS: Libraries to pass to the linker, e.g. -l<library>"

config PK_PLATFORM_COREDTS_APP_CPPFLAGS
	string "CPPFLAGS: C/C++ preprocessor flags, e.g. -I<include dir>"

config PK_PLATFORM_COREDTS_APP_DPKCONFIG
	string "PKG_CONFIG_PATH: Directories to add to pkg-config's search path"

config PK_PLATFORM_COREDTS_APP_CFLAGS
	string "CFLAGS: C compiler flags"

config PK_PLATFORM_COREDTS_APP_LDFLAGS
	string "LDFLAGS: Linker flags"

config PK_PLATFORM_COREDTS_APP_CXXFLAGS
	string "CXXFLAGS: C++ compiler flags"

config PK_PLATFORM_COREDTS_APP_ASFLAGS
	string "CCASFLAGS: assembler compiler flags (defaults to CFLAGS)"

config PK_PLATFORM_COREDTS_APP_BUILDARCH
	string "--host options on configure for Architecture"

endif # PK_PLATFORM_COREDTS_APP
```

## package/platform/platform_core_app/Kconfig
```kconfig
menuconfig PK_PLATFORM_CORE_APP
	select PK_PLATFORM_CORE_MOD
	bool "Platform Core Application"

if PK_PLATFORM_CORE_APP

config PK_PLATFORM_CORE_APP_VERSION
	default "0.0.1"
	string "verstion"

config PK_PLATFORM_CORE_APP_TAR
	default "tar.gz"
	string "tar type"

config PK_PLATFORM_CORE_APP_URL
	default "https://gitee.com/BiscuitOS_team/HardStack/raw/Gitee/Device-Driver/Platform/nDTS/Base/userland"
	string "url"

config PK_PLATFORM_CORE_APP_GITHUB
	string "GitHub"

config PK_PLATFORM_CORE_APP_SRCFILE
	default "platform.c platform.sh Makefile"
	string "Source code list"

config PK_PLATFORM_CORE_APP_CSRCFILE
	string "Compile source code list"

config PK_PLATFORM_CORE_APP_CONFIG
	string "CONFIG: Project Configure Options"

config PK_PLATFORM_CORE_APP_LIBPATH
	string "LIBS: Libraries to pass to the linker, e.g. -l<library>"

config PK_PLATFORM_CORE_APP_CPPFLAGS
	string "CPPFLAGS: C/C++ preprocessor flags, e.g. -I<include dir>"

config PK_PLATFORM_CORE_APP_DPKCONFIG
	string "PKG_CONFIG_PATH: Directories to add to pkg-config's search path"

config PK_PLATFORM_CORE_APP_CFLAGS
	string "CFLAGS: C compiler flags"

config PK_PLATFORM_CORE_APP_LDFLAGS
	string "LDFLAGS: Linker flags"

config PK_PLATFORM_CORE_APP_CXXFLAGS
	string "CXXFLAGS: C++ compiler flags"

config PK_PLATFORM_CORE_APP_ASFLAGS
	string "CCASFLAGS: assembler compiler flags (defaults to CFLAGS)"

config PK_PLATFORM_CORE_APP_BUILDARCH
	string "--host options on configure for Architecture"

endif # PK_PLATFORM_CORE_APP
```

## package/platform/platform_core_module/Kconfig
```kconfig
menuconfig PK_PLATFORM_CORE_MOD
	bool "Platform Core Module"

if PK_PLATFORM_CORE_MOD

config PK_PLATFORM_CORE_MOD_VERSION
	default "0.0.1"
	string "verstion"

config PK_PLATFORM_CORE_MOD_TAR
	default "tar.gz"
	string "tar type"

config PK_PLATFORM_CORE_MOD_URL
	default "https://gitee.com/BiscuitOS_team/HardStack/raw/Gitee/Device-Driver/Platform/nDTS/Base/kernel"
	string "url"

config PK_PLATFORM_CORE_MOD_GITHUB
	string "GitHub"

config PK_PLATFORM_CORE_MOD_SRCFILE
	default "platform.c Kconfig Makefile"
	string "Source code list"

config PK_PLATFORM_CORE_MOD_CSRCFILE
	string "Compile source code list"

config PK_PLATFORM_CORE_MOD_CONFIG
	string "CONFIG: Project Configure Options"

config PK_PLATFORM_CORE_MOD_LIBPATH
	string "LIBS: Libraries to pass to the linker, e.g. -l<library>"

config PK_PLATFORM_CORE_MOD_CPPFLAGS
	string "CPPFLAGS: C/C++ preprocessor flags, e.g. -I<include dir>"

config PK_PLATFORM_CORE_MOD_DPKCONFIG
	string "PKG_CONFIG_PATH: Directories to add to pkg-config's search path"

config PK_PLATFORM_CORE_MOD_CFLAGS
	string "CFLAGS: C compiler flags"

config PK_PLATFORM_CORE_MOD_LDFLAGS
	string "LDFLAGS: Linker flags"

config PK_PLATFORM_CORE_MOD_CXXFLAGS
	string "CXXFLAGS: C++ compiler flags"

config PK_PLATFORM_CORE_MOD_ASFLAGS
	string "CCASFLAGS: assembler compiler flags (defaults to CFLAGS)"

config PK_PLATFORM_CORE_MOD_BUILDARCH
	string "--host options on configure for Architecture"

endif # PK_PLATFORM_CORE_MOD
```

## package/platform/platform_resDTS_app/Kconfig
```kconfig
menuconfig PK_PLATFORM_RESDTS_APP
	select PK_PLATFORM_RESDTS_MOD
	bool "Platform Resource with DTS Application"

if PK_PLATFORM_RESDTS_APP

config PK_PLATFORM_RESDTS_APP_VERSION
	default "0.0.1"
	string "verstion"

config PK_PLATFORM_RESDTS_APP_TAR
	default "tar.gz"
	string "tar type"

config PK_PLATFORM_RESDTS_APP_URL
	default "https://gitee.com/BiscuitOS_team/HardStack/raw/Gitee/Device-Driver/Platform/DTS/Resource/userland"
	string "url"

config PK_PLATFORM_RESDTS_APP_GITHUB
	string "GitHub"

config PK_PLATFORM_RESDTS_APP_SRCFILE
	default "platform.c platform.sh Makefile"
	string "Source code list"

config PK_PLATFORM_RESDTS_APP_CSRCFILE
	string "Compile source code list"

config PK_PLATFORM_RESDTS_APP_CONFIG
	string "CONFIG: Project Configure Options"

config PK_PLATFORM_RESDTS_APP_LIBPATH
	string "LIBS: Libraries to pass to the linker, e.g. -l<library>"

config PK_PLATFORM_RESDTS_APP_CPPFLAGS
	string "CPPFLAGS: C/C++ preprocessor flags, e.g. -I<include dir>"

config PK_PLATFORM_RESDTS_APP_DPKCONFIG
	string "PKG_CONFIG_PATH: Directories to add to pkg-config's search path"

config PK_PLATFORM_RESDTS_APP_CFLAGS
	string "CFLAGS: C compiler flags"

config PK_PLATFORM_RESDTS_APP_LDFLAGS
	string "LDFLAGS: Linker flags"

config PK_PLATFORM_RESDTS_APP_CXXFLAGS
	string "CXXFLAGS: C++ compiler flags"

config PK_PLATFORM_RESDTS_APP_ASFLAGS
	string "CCASFLAGS: assembler compiler flags (defaults to CFLAGS)"

config PK_PLATFORM_RESDTS_APP_BUILDARCH
	string "--host options on configure for Architecture"

endif # PK_PLATFORM_RESDTS_APP
```

## package/power_manager/Kconfig
```kconfig
menuconfig PK_POWER_MANAGER
	bool "Power Manager"

if PK_POWER_MANAGER

# Tirgger suspend
source package/power_manager/suspend-base/Kconfig

# Tirgger resume
source package/power_manager/resume-base/Kconfig

endif # PK_POWER_MANAGER
```

## package/power_manager/resume-base/Kconfig
```kconfig
menuconfig PK_PM_RESUME_BASE
	bool "Trigger Resume Demo"

if PK_PM_RESUME_BASE

config PK_PM_RESUME_BASE_VERSION
	default "0.0.1"
	string "verstion"

config PK_PM_RESUME_BASE_TAR
	default "tar.gz"
	string "tar type"

config PK_PM_RESUME_BASE_URL
	default "https://gitee.com/BiscuitOS_team/HardStack/raw/Gitee/SubSystem/power_manager/resume-demo"
	string "url"

config PK_PM_RESUME_BASE_GITHUB
	string "GitHub"

config PK_PM_RESUME_BASE_SRCFILE
	default "main.c Kconfig Makefile"
	string "Source code list"

config PK_PM_RESUME_BASE_CSRCFILE
	string "Compile source code list"

config PK_PM_RESUME_BASE_CONFIG
	string "CONFIG: Project Configure Options"

config PK_PM_RESUME_BASE_LIBPATH
	string "LIBS: Libraries to pass to the linker, e.g. -l<library>"

config PK_PM_RESUME_BASE_CPPFLAGS
	string "CPPFLAGS: C/C++ preprocessor flags, e.g. -I<include dir>"

config PK_PM_RESUME_BASE_DPKCONFIG
	string "PKG_CONFIG_PATH: Directories to add to pkg-config's search path"

config PK_PM_RESUME_BASE_CFLAGS
	string "CFLAGS: C compiler flags"

config PK_PM_RESUME_BASE_LDFLAGS
	string "LDFLAGS: Linker flags"

config PK_PM_RESUME_BASE_CXXFLAGS
	string "CXXFLAGS: C++ compiler flags"

config PK_PM_RESUME_BASE_ASFLAGS
	string "CCASFLAGS: assembler compiler flags (defaults to CFLAGS)"

config PK_PM_RESUME_BASE_BUILDARCH
	string "--host options on configure for Architecture"

endif # PK_PM_RESUME_BASE
```

## package/presentproto/Kconfig
```kconfig
menuconfig PK_PRESENTPROTO
	bool "presentproto"

if PK_PRESENTPROTO

config PK_PRESENTPROTO_VERSION
	default "1.1"
	string "verstion"

config PK_PRESENTPROTO_TAR
	default "tar.gz"
	string "tar type"

config PK_PRESENTPROTO_URL
	default "https://www.x.org/releases/individual/proto/"
	string "url"

config PK_PRESENTPROTO_GITHUB
	string "GitHub"

config PK_PRESENTPROTO_SRCFILE
	string "Source code list"

config PK_PRESENTPROTO_CONFIG
	default "--enable-silent-rules --disable-static"
	string "CONFIG: Project Configure Options"

config PK_PRESENTPROTO_LIBPATH
	string "LIBS: Libraries to pass to the linker, e.g. -l<library>"

config PK_PRESENTPROTO_CPPFLAGS
	string "CPPFLAGS: C/C++ preprocessor flags, e.g. -I<include dir>"

config PK_PRESENTPROTO_DPKCONFIG
	string "PKG_CONFIG_PATH: Directories to add to pkg-config's search path"

config PK_PRESENTPROTO_CFLAGS
	string "CFLAGS: C compiler flags"

config PK_PRESENTPROTO_LDFLAGS
	string "LDFLAGS: Linker flags"

config PK_PRESENTPROTO_CXXFLAGS
	string "CXXFLAGS: C++ compiler flags"

config PK_PRESENTPROTO_ASFLAGS
	string "CCASFLAGS: assembler compiler flags (defaults to CFLAGS)"

config PK_PRESENTPROTO_BUILDARCH
	default "x86_64-unknown-linux-gnu"
	string "--host options on configure for Architecture"

endif # PK_PRESENTPROTO
```

## package/qemu/Kconfig
```kconfig
menuconfig PK_QEMU_SYSTEM
	bool "qemu-system"

if PK_QEMU_SYSTEM

choice
	prompt "Source of Qemu source code"

config QEMU_SYSTEM_GITHUB
	bool "Qemu source code from github"

config QEMU_SYSTEM_DL
	bool "Qemu source code from external file"

config QEMU_SYSTEM_WGET
	bool "Qemu source code from wget"

endchoice

if QEMU_SYSTEM_DL

config QEMU_SYSTEM_DL_NAME
	string "External Qemu absolute path"

endif # QEMU_SYSTEM_DL

config QEMU_SYSTEM_VERSION
	string "qemu-system verstion"

config QEMU_SYSTEM_SRC
	int 
	default 1 if QEMU_SYSTEM_GITHUB
	default 2 if QEMU_SYSTEM_DL
	default 3 if QEMU_SYSTEM_WGET

endif # PK_QEMU_SYSTEM
```

## package/qt/Kconfig
```kconfig
menuconfig PK_QT
	select PK_GNU_NCURSES
	bool "Qt"

if PK_QT

config QT_VERSION
	default "5.9.2"
	string "verstion"

config QT_TAR
	default "tar.xz"
	string "tar type"

config QT_URL
	default "http://qt.mirrors.tds.net/qt/archive/qt/5.9/5.9.2/single/"
	string "url"

config QT_SRC
	string "source code list"

config QT_LDFLAGS
	string "LDFLAGS"

config QT_CFLAGS
	string "CFLAGS"

config QT_CONFIG
	string "configure"

config QT_PACKAGE_NAME
	default "qt-everywhere-opensource-src"
	string "package name"

endif # PK_QT
```

## package/randrproto/Kconfig
```kconfig
menuconfig PK_RANDRPROTO
	bool "randrproto"

if PK_RANDRPROTO

config PK_RANDRPROTO_VERSION
	default "1.5.0"
	string "verstion"

config PK_RANDRPROTO_TAR
	default "tar.gz"
	string "tar type"

config PK_RANDRPROTO_URL
	default "https://www.x.org/releases/individual/proto/"
	string "url"

config PK_RANDRPROTO_GITHUB
	string "GitHub"

config PK_RANDRPROTO_SRCFILE
	string "Source code list"

config PK_RANDRPROTO_CONFIG
	default "--enable-silent-rules --disable-static"
	string "CONFIG: Project Configure Options"

config PK_RANDRPROTO_LIBPATH
	string "LIBS: Libraries to pass to the linker, e.g. -l<library>"

config PK_RANDRPROTO_CPPFLAGS
	string "CPPFLAGS: C/C++ preprocessor flags, e.g. -I<include dir>"

config PK_RANDRPROTO_DPKCONFIG
	string "PKG_CONFIG_PATH: Directories to add to pkg-config's search path"

config PK_RANDRPROTO_CFLAGS
	string "CFLAGS: C compiler flags"

config PK_RANDRPROTO_LDFLAGS
	string "LDFLAGS: Linker flags"

config PK_RANDRPROTO_CXXFLAGS
	string "CXXFLAGS: C++ compiler flags"

config PK_RANDRPROTO_ASFLAGS
	string "CCASFLAGS: assembler compiler flags (defaults to CFLAGS)"

config PK_RANDRPROTO_BUILDARCH
	default "x86_64-unknown-linux-gnu"
	string "--host options on configure for Architecture"

endif # PK_RANDRPROTO
```

## package/rbtree/Kconfig
```kconfig
menuconfig PK_RBTREE
	bool "Red-Black Tree Algorithem"

if PK_RBTREE

# rb_link_node
source "package/rbtree/rb_link_node/Kconfig"

# rbtree Application
source "package/rbtree/rbtree_app/Kconfig"

endif # PK_RBTREE
```

## package/rbtree/rb_link_node/Kconfig
```kconfig
menuconfig PK_RB_LINK_NODE
	bool "rb_link_node"

if PK_RB_LINK_NODE

config PK_RB_LINK_NODE_VERSION
	default "0.0.1"
	string "verstion"

config PK_RB_LINK_NODE_TAR
	default "tar.gz"
	string "tar type"

config PK_RB_LINK_NODE_URL
	default "https://gitee.com/BiscuitOS_team/HardStack/raw/Gitee/Algorithem/tree/rb-tree/API/rb_link_node"
	string "url"

config PK_RB_LINK_NODE_GITHUB
	string "GitHub"

config PK_RB_LINK_NODE_SRCFILE
	default "rbtree.c README.md Makefile"
	string "Source code list"

config PK_RB_LINK_NODE_CSRCFILE
	string "Compile source code list"

config PK_RB_LINK_NODE_CONFIG
	string "CONFIG: Project Configure Options"

config PK_RB_LINK_NODE_LIBPATH
	string "LIBS: Libraries to pass to the linker, e.g. -l<library>"

config PK_RB_LINK_NODE_CPPFLAGS
	string "CPPFLAGS: C/C++ preprocessor flags, e.g. -I<include dir>"

config PK_RB_LINK_NODE_DPKCONFIG
	string "PKG_CONFIG_PATH: Directories to add to pkg-config's search path"

config PK_RB_LINK_NODE_CFLAGS
	string "CFLAGS: C compiler flags"

config PK_RB_LINK_NODE_LDFLAGS
	string "LDFLAGS: Linker flags"

config PK_RB_LINK_NODE_CXXFLAGS
	string "CXXFLAGS: C++ compiler flags"

config PK_RB_LINK_NODE_ASFLAGS
	string "CCASFLAGS: assembler compiler flags (defaults to CFLAGS)"

config PK_RB_LINK_NODE_BUILDARCH
	string "--host options on configure for Architecture"

endif # PK_RB_LINK_NODE
```

## package/rbtree/rbtree_app/Kconfig
```kconfig
menuconfig PK_RBTREE_APP
	bool "rbtree: Application"

if PK_RBTREE_APP

config PK_RBTREE_APP_VERSION
	default "0.0.1"
	string "verstion"

config PK_RBTREE_APP_TAR
	default "tar.gz"
	string "tar type"

config PK_RBTREE_APP_URL
	default "https://gitee.com/BiscuitOS_team/HardStack/raw/Gitee/Algorithem/tree/rb-tree/Basic"
	string "url"

config PK_RBTREE_APP_GITHUB
	string "GitHub"

config PK_RBTREE_APP_SRCFILE
	default "Makefile rb_run.c rbtree.c rbtree.h README.md"
	string "Source code list"

config PK_RBTREE_APP_CSRCFILE
	string "Compile source code list"

config PK_RBTREE_APP_CONFIG
	string "CONFIG: Project Configure Options"

config PK_RBTREE_APP_LIBPATH
	string "LIBS: Libraries to pass to the linker, e.g. -l<library>"

config PK_RBTREE_APP_CPPFLAGS
	string "CPPFLAGS: C/C++ preprocessor flags, e.g. -I<include dir>"

config PK_RBTREE_APP_DPKCONFIG
	string "PKG_CONFIG_PATH: Directories to add to pkg-config's search path"

config PK_RBTREE_APP_CFLAGS
	string "CFLAGS: C compiler flags"

config PK_RBTREE_APP_LDFLAGS
	string "LDFLAGS: Linker flags"

config PK_RBTREE_APP_CXXFLAGS
	string "CXXFLAGS: C++ compiler flags"

config PK_RBTREE_APP_ASFLAGS
	string "CCASFLAGS: assembler compiler flags (defaults to CFLAGS)"

config PK_RBTREE_APP_BUILDARCH
	string "--host options on configure for Architecture"

endif # PK_RBTREE_APP
```
