## package/recordproto/Kconfig
```kconfig
menuconfig PK_RECORDPROTO
	bool "recordproto"

if PK_RECORDPROTO

config PK_RECORDPROTO_VERSION
	default "1.14.2"
	string "verstion"

config PK_RECORDPROTO_TAR
	default "tar.gz"
	string "tar type"

config PK_RECORDPROTO_URL
	default "https://www.x.org/releases/individual/proto/"
	string "url"

config PK_RECORDPROTO_GITHUB
	string "GitHub"

config PK_RECORDPROTO_SRCFILE
	string "Source code list"

config PK_RECORDPROTO_CONFIG
	default "--enable-silent-rules --disable-static"
	string "CONFIG: Project Configure Options"

config PK_RECORDPROTO_LIBPATH
	string "LIBS: Libraries to pass to the linker, e.g. -l<library>"

config PK_RECORDPROTO_CPPFLAGS
	string "CPPFLAGS: C/C++ preprocessor flags, e.g. -I<include dir>"

config PK_RECORDPROTO_DPKCONFIG
	string "PKG_CONFIG_PATH: Directories to add to pkg-config's search path"

config PK_RECORDPROTO_CFLAGS
	string "CFLAGS: C compiler flags"

config PK_RECORDPROTO_LDFLAGS
	string "LDFLAGS: Linker flags"

config PK_RECORDPROTO_CXXFLAGS
	string "CXXFLAGS: C++ compiler flags"

config PK_RECORDPROTO_ASFLAGS
	string "CCASFLAGS: assembler compiler flags (defaults to CFLAGS)"

config PK_RECORDPROTO_BUILDARCH
	default "x86_64-unknown-linux-gnu"
	string "--host options on configure for Architecture"

endif # PK_RECORDPROTO
```
