## package/percpu/percpu_counter_sub/Kconfig
```kconfig
menuconfig PK_PERCPU_COUNTER_SUB
	bool "percpu_counter_sub()"

if PK_PERCPU_COUNTER_SUB

config PK_PERCPU_COUNTER_SUB_VERSION
	default "0.0.1"
	string "verstion"

config PK_PERCPU_COUNTER_SUB_TAR
	default "tar.gz"
	string "tar type"

config PK_PERCPU_COUNTER_SUB_URL
	default "https://gitee.com/BiscuitOS_team/HardStack/raw/Gitee/Algorithem/percpu/API/percpu_counter_sub"
	string "url"

config PK_PERCPU_COUNTER_SUB_GITHUB
	string "GitHub"

config PK_PERCPU_COUNTER_SUB_SRCFILE
	default "core.c Kconfig Makefile"
	string "Source code list"

config PK_PERCPU_COUNTER_SUB_CSRCFILE
	string "Compile source code list"

config PK_PERCPU_COUNTER_SUB_CONFIG
	string "CONFIG: Project Configure Options"

config PK_PERCPU_COUNTER_SUB_LIBPATH
	string "LIBS: Libraries to pass to the linker, e.g. -l<library>"

config PK_PERCPU_COUNTER_SUB_CPPFLAGS
	string "CPPFLAGS: C/C++ preprocessor flags, e.g. -I<include dir>"

config PK_PERCPU_COUNTER_SUB_DPKCONFIG
	string "PKG_CONFIG_PATH: Directories to add to pkg-config's search path"

config PK_PERCPU_COUNTER_SUB_CFLAGS
	string "CFLAGS: C compiler flags"

config PK_PERCPU_COUNTER_SUB_LDFLAGS
	string "LDFLAGS: Linker flags"

config PK_PERCPU_COUNTER_SUB_CXXFLAGS
	string "CXXFLAGS: C++ compiler flags"

config PK_PERCPU_COUNTER_SUB_ASFLAGS
	string "CCASFLAGS: assembler compiler flags (defaults to CFLAGS)"

config PK_PERCPU_COUNTER_SUB_BUILDARCH
	string "--host options on configure for Architecture"

endif # PK_PERCPU_COUNTER_SUB
```

## package/percpu/percpu_counter_sum/Kconfig
```kconfig
menuconfig PK_PERCPU_COUNTER_SUM
	bool "percpu_counter_sum()"

if PK_PERCPU_COUNTER_SUM

config PK_PERCPU_COUNTER_SUM_VERSION
	default "0.0.1"
	string "verstion"

config PK_PERCPU_COUNTER_SUM_TAR
	default "tar.gz"
	string "tar type"

config PK_PERCPU_COUNTER_SUM_URL
	default "https://gitee.com/BiscuitOS_team/HardStack/raw/Gitee/Algorithem/percpu/API/percpu_counter_sum"
	string "url"

config PK_PERCPU_COUNTER_SUM_GITHUB
	string "GitHub"

config PK_PERCPU_COUNTER_SUM_SRCFILE
	default "core.c Kconfig Makefile"
	string "Source code list"

config PK_PERCPU_COUNTER_SUM_CSRCFILE
	string "Compile source code list"

config PK_PERCPU_COUNTER_SUM_CONFIG
	string "CONFIG: Project Configure Options"

config PK_PERCPU_COUNTER_SUM_LIBPATH
	string "LIBS: Libraries to pass to the linker, e.g. -l<library>"

config PK_PERCPU_COUNTER_SUM_CPPFLAGS
	string "CPPFLAGS: C/C++ preprocessor flags, e.g. -I<include dir>"

config PK_PERCPU_COUNTER_SUM_DPKCONFIG
	string "PKG_CONFIG_PATH: Directories to add to pkg-config's search path"

config PK_PERCPU_COUNTER_SUM_CFLAGS
	string "CFLAGS: C compiler flags"

config PK_PERCPU_COUNTER_SUM_LDFLAGS
	string "LDFLAGS: Linker flags"

config PK_PERCPU_COUNTER_SUM_CXXFLAGS
	string "CXXFLAGS: C++ compiler flags"

config PK_PERCPU_COUNTER_SUM_ASFLAGS
	string "CCASFLAGS: assembler compiler flags (defaults to CFLAGS)"

config PK_PERCPU_COUNTER_SUM_BUILDARCH
	string "--host options on configure for Architecture"

endif # PK_PERCPU_COUNTER_SUM
```

## package/percpu/put_cpu_ptr/Kconfig
```kconfig
menuconfig PK_PUT_CPU_PTR
	bool "put_cpu_ptr"

if PK_PUT_CPU_PTR

config PK_PUT_CPU_PTR_VERSION
	default "0.0.1"
	string "verstion"

config PK_PUT_CPU_PTR_TAR
	default "tar.gz"
	string "tar type"

config PK_PUT_CPU_PTR_URL
	default "https://gitee.com/BiscuitOS_team/HardStack/raw/Gitee/Algorithem/percpu/API/put_cpu_ptr"
	string "url"

config PK_PUT_CPU_PTR_GITHUB
	string "GitHub"

config PK_PUT_CPU_PTR_SRCFILE
	default "core.c Kconfig Makefile"
	string "Source code list"

config PK_PUT_CPU_PTR_CSRCFILE
	string "Compile source code list"

config PK_PUT_CPU_PTR_CONFIG
	string "CONFIG: Project Configure Options"

config PK_PUT_CPU_PTR_LIBPATH
	string "LIBS: Libraries to pass to the linker, e.g. -l<library>"

config PK_PUT_CPU_PTR_CPPFLAGS
	string "CPPFLAGS: C/C++ preprocessor flags, e.g. -I<include dir>"

config PK_PUT_CPU_PTR_DPKCONFIG
	string "PKG_CONFIG_PATH: Directories to add to pkg-config's search path"

config PK_PUT_CPU_PTR_CFLAGS
	string "CFLAGS: C compiler flags"

config PK_PUT_CPU_PTR_LDFLAGS
	string "LDFLAGS: Linker flags"

config PK_PUT_CPU_PTR_CXXFLAGS
	string "CXXFLAGS: C++ compiler flags"

config PK_PUT_CPU_PTR_ASFLAGS
	string "CCASFLAGS: assembler compiler flags (defaults to CFLAGS)"

config PK_PUT_CPU_PTR_BUILDARCH
	string "--host options on configure for Architecture"

endif # PK_PUT_CPU_PTR
```

## package/percpu/this_cpu_read/Kconfig
```kconfig
menuconfig PK_THIS_CPU_READ
	bool "this_cpu_read"

if PK_THIS_CPU_READ

config PK_THIS_CPU_READ_VERSION
	default "0.0.1"
	string "verstion"

config PK_THIS_CPU_READ_TAR
	default "tar.gz"
	string "tar type"

config PK_THIS_CPU_READ_URL
	default "https://gitee.com/BiscuitOS_team/HardStack/raw/Gitee/Algorithem/percpu/API/this_cpu_read"
	string "url"

config PK_THIS_CPU_READ_GITHUB
	string "GitHub"

config PK_THIS_CPU_READ_SRCFILE
	default "core.c Kconfig Makefile"
	string "Source code list"

config PK_THIS_CPU_READ_CSRCFILE
	string "Compile source code list"

config PK_THIS_CPU_READ_CONFIG
	string "CONFIG: Project Configure Options"

config PK_THIS_CPU_READ_LIBPATH
	string "LIBS: Libraries to pass to the linker, e.g. -l<library>"

config PK_THIS_CPU_READ_CPPFLAGS
	string "CPPFLAGS: C/C++ preprocessor flags, e.g. -I<include dir>"

config PK_THIS_CPU_READ_DPKCONFIG
	string "PKG_CONFIG_PATH: Directories to add to pkg-config's search path"

config PK_THIS_CPU_READ_CFLAGS
	string "CFLAGS: C compiler flags"

config PK_THIS_CPU_READ_LDFLAGS
	string "LDFLAGS: Linker flags"

config PK_THIS_CPU_READ_CXXFLAGS
	string "CXXFLAGS: C++ compiler flags"

config PK_THIS_CPU_READ_ASFLAGS
	string "CCASFLAGS: assembler compiler flags (defaults to CFLAGS)"

config PK_THIS_CPU_READ_BUILDARCH
	string "--host options on configure for Architecture"

endif # PK_THIS_CPU_READ
```

## package/pgcache_scan/Kconfig
```kconfig
menuconfig PK_PGCACHE_SCAN
	bool "pgcache_scan"

if PK_PGCACHE_SCAN

config PK_PGCACHE_SCAN_VERSION
	default "0.0.1"
	string "verstion"

config PK_PGCACHE_SCAN_TAR
	default "tar.gz"
	string "tar type"

config PK_PGCACHE_SCAN_URL
	default "https://gitee.com/BiscuitOS_team/HardStack/raw/Gitee/Memory-Allocator/pagecache_scan"
	string "url"

config PK_PGCACHE_SCAN_GITHUB
	string "GitHub"

config PK_PGCACHE_SCAN_SRCFILE
	default "cache_scan.c extern.h include.h kernel.c Makefile pgcache_scan.h README.md RunBiscuitOS_pgcache_scan.sh sysctl.c"
	string "Source code list"

config PK_PGCACHE_SCAN_CSRCFILE
	string "Compile source code list"

config PK_PGCACHE_SCAN_CONFIG
	string "CONFIG: Project Configure Options"

config PK_PGCACHE_SCAN_LIBPATH
	string "LIBS: Libraries to pass to the linker, e.g. -l<library>"

config PK_PGCACHE_SCAN_CPPFLAGS
	string "CPPFLAGS: C/C++ preprocessor flags, e.g. -I<include dir>"

config PK_PGCACHE_SCAN_DPKCONFIG
	string "PKG_CONFIG_PATH: Directories to add to pkg-config's search path"

config PK_PGCACHE_SCAN_CFLAGS
	string "CFLAGS: C compiler flags"

config PK_PGCACHE_SCAN_LDFLAGS
	string "LDFLAGS: Linker flags"

config PK_PGCACHE_SCAN_CXXFLAGS
	string "CXXFLAGS: C++ compiler flags"

config PK_PGCACHE_SCAN_ASFLAGS
	string "CCASFLAGS: assembler compiler flags (defaults to CFLAGS)"

config PK_PGCACHE_SCAN_BUILDARCH
	string "--host options on configure for Architecture"

endif # PK_PGCACHE_SCAN
```

## package/pio/Broiler-Asynchronous-pio-PCI/Kconfig
```kconfig
menuconfig PK_PIO_ASYNC_PCI
	bool "Asychronous PIO PCI Driver for Broiler"

if PK_PIO_ASYNC_PCI

config PK_PIO_ASYNC_PCI_VERSION
	default "default"
	string "verstion"

config PK_PIO_ASYNC_PCI_TAR
	default "tar.gz"
	string "tar type"

config PK_PIO_ASYNC_PCI_URL
	default "https://gitee.com/BiscuitOS_team/HardStack/raw/Gitee/Memory-Allocator/PIO/Broiler-Asynchronous-pio-PCI"
	string "url"

config PK_PIO_ASYNC_PCI_GITHUB
	string "GitHub"

config PK_PIO_ASYNC_PCI_SRCFILE
	default "main.c Kconfig Makefile RunBiscuitOS.sh Makefile.host README.md"
	string "Source code list"

config PK_PIO_ASYNC_PCI_CSRCFILE
	string "Compile source code list"

config PK_PIO_ASYNC_PCI_CONFIG
	string "CONFIG: Project Configure Options"

config PK_PIO_ASYNC_PCI_LIBPATH
	string "LIBS: Libraries to pass to the linker, e.g. -l<library>"

config PK_PIO_ASYNC_PCI_CPPFLAGS
	string "CPPFLAGS: C/C++ preprocessor flags, e.g. -I<include dir>"

config PK_PIO_ASYNC_PCI_DPKCONFIG
	string "PKG_CONFIG_PATH: Directories to add to pkg-config's search path"

config PK_PIO_ASYNC_PCI_CFLAGS
	string "CFLAGS: C compiler flags"

config PK_PIO_ASYNC_PCI_LDFLAGS
	string "LDFLAGS: Linker flags"

config PK_PIO_ASYNC_PCI_CXXFLAGS
	string "CXXFLAGS: C++ compiler flags"

config PK_PIO_ASYNC_PCI_ASFLAGS
	string "CCASFLAGS: assembler compiler flags (defaults to CFLAGS)"

config PK_PIO_ASYNC_PCI_BUILDARCH
	string "--host options on configure for Architecture"

endif # PK_PIO_ASYNC_PCI
```

## package/pio/Broiler-Asynchronous-pio/Kconfig
```kconfig
menuconfig PK_PIO_ASYNC_BROILER
	bool "Asychronous PIO Driver for Broiler"

if PK_PIO_ASYNC_BROILER

config PK_PIO_ASYNC_BROILER_VERSION
	default "default"
	string "verstion"

config PK_PIO_ASYNC_BROILER_TAR
	default "tar.gz"
	string "tar type"

config PK_PIO_ASYNC_BROILER_URL
	default "https://gitee.com/BiscuitOS_team/HardStack/raw/Gitee/Memory-Allocator/PIO/Broiler-Asynchronous-pio"
	string "url"

config PK_PIO_ASYNC_BROILER_GITHUB
	string "GitHub"

config PK_PIO_ASYNC_BROILER_SRCFILE
	default "main.c Kconfig Makefile RunBiscuitOS.sh"
	string "Source code list"

config PK_PIO_ASYNC_BROILER_CSRCFILE
	string "Compile source code list"

config PK_PIO_ASYNC_BROILER_CONFIG
	string "CONFIG: Project Configure Options"

config PK_PIO_ASYNC_BROILER_LIBPATH
	string "LIBS: Libraries to pass to the linker, e.g. -l<library>"

config PK_PIO_ASYNC_BROILER_CPPFLAGS
	string "CPPFLAGS: C/C++ preprocessor flags, e.g. -I<include dir>"

config PK_PIO_ASYNC_BROILER_DPKCONFIG
	string "PKG_CONFIG_PATH: Directories to add to pkg-config's search path"

config PK_PIO_ASYNC_BROILER_CFLAGS
	string "CFLAGS: C compiler flags"

config PK_PIO_ASYNC_BROILER_LDFLAGS
	string "LDFLAGS: Linker flags"

config PK_PIO_ASYNC_BROILER_CXXFLAGS
	string "CXXFLAGS: C++ compiler flags"

config PK_PIO_ASYNC_BROILER_ASFLAGS
	string "CCASFLAGS: assembler compiler flags (defaults to CFLAGS)"

config PK_PIO_ASYNC_BROILER_BUILDARCH
	string "--host options on configure for Architecture"

endif # PK_PIO_ASYNC_BROILER
```

## package/pio/Kconfig
```kconfig
menuconfig PK_PIO
	bool "PIO: Programming Input/Output Model"

if PK_PIO

# Broiler Sychronous PIO
source package/pio/Broiler-Synchronous-pio/Kconfig

# Broiler Sychronous PIO In Kernel
source package/pio/Broiler-Synchronous-pio-In-Kernel/Kconfig

# Broiler Sychronous PIO In PCI
source package/pio/Broiler-Synchronous-pio-PCI/Kconfig

# Broiler Asychronous PIO
source package/pio/Broiler-Asynchronous-pio/Kconfig

endif # PK_PIO
```

## package/pixman/Kconfig
```kconfig
menuconfig PK_PIXMAN
	bool "pixman"

if PK_PIXMAN

config PK_PIXMAN_VERSION
	default "0.36.0"
	string "verstion"

config PK_PIXMAN_TAR
	default "tar.gz"
	string "tar type"

config PK_PIXMAN_URL
	default "https://ftp.osuosl.org/pub/blfs/conglomeration/pixman/"
	string "url"

config PK_PIXMAN_GITHUB
	string "GitHub"

config PK_PIXMAN_SRCFILE
	string "Source code list"

config PK_PIXMAN_CONFIG
	default "--enable-silent-rules --disable-static"
	string "CONFIG: Project Configure Options"

config PK_PIXMAN_LIBPATH
	string "LIBS: Libraries to pass to the linker, e.g. -l<library>"

config PK_PIXMAN_CPPFLAGS
	string "CPPFLAGS: C/C++ preprocessor flags, e.g. -I<include dir>"

config PK_PIXMAN_DPKCONFIG
	string "PKG_CONFIG_PATH: Directories to add to pkg-config's search path"

config PK_PIXMAN_CFLAGS
	string "CFLAGS: C compiler flags"

config PK_PIXMAN_LDFLAGS
	string "LDFLAGS: Linker flags"

config PK_PIXMAN_CXXFLAGS
	string "CXXFLAGS: C++ compiler flags"

config PK_PIXMAN_ASFLAGS
	string "CCASFLAGS: assembler compiler flags (defaults to CFLAGS)"

config PK_PIXMAN_BUILDARCH
	default "x86_64-unknown-linux-gnu"
	string "--host options on configure for Architecture"

endif # PK_PIXMAN
```

## package/platform/Kconfig
```kconfig
menuconfig PK_PLATFORM
	bool "Platofrm: Device Driver and Application"

if PK_PLATFORM

# LDD: Platform Attribute application
source package/platform/platform_attr_app/Kconfig

# LDD: Platform Attribute Module
source package/platform/platform_attr_module/Kconfig

# LDD: Platform Character modules
source package/platform/platform_char_module/Kconfig

# LDD: Platform Core application
source package/platform/platform_core_app/Kconfig

# LDD: Platform Core Module
source package/platform/platform_core_module/Kconfig

# LDD: Platform Core from DTS application
source package/platform/platform_coreDTS_app/Kconfig

# LDD: Platform Core from DTS Module
source package/platform/platform_coreDTS_module/Kconfig

# LDD: Platform Resource application
source package/platform/platform_res_app/Kconfig

# LDD: Platform Resource module
source package/platform/platform_res_module/Kconfig

# LDD: Platform Resource from DTS application
source package/platform/platform_resDTS_app/Kconfig

# LDD: Platform Resource from DTS module
source package/platform/platform_resDTS_module/Kconfig

# LDD: Platform Simple Module
source package/platform/platform_simple_module/Kconfig


endif # PK_PLATFORM
```

## package/platform/platform_attr_app/Kconfig
```kconfig
menuconfig PK_PLATFORM_ATTR_APP
	select PK_PLATFORM_ATTR_MOD
	bool "Platform Attribute Device Driver Application"

if PK_PLATFORM_ATTR_APP

config PK_PLATFORM_ATTR_APP_VERSION
	default "0.0.1"
	string "verstion"

config PK_PLATFORM_ATTR_APP_TAR
	default "tar.gz"
	string "tar type"

config PK_PLATFORM_ATTR_APP_URL
	default "https://gitee.com/BiscuitOS_team/HardStack/raw/Gitee/Device-Driver/Platform/Common/Attribute/userland"
	string "url"

config PK_PLATFORM_ATTR_APP_GITHUB
	string "GitHub"

config PK_PLATFORM_ATTR_APP_SRCFILE
	default "platform.c platform.sh Makefile"
	string "Source code list"

config PK_PLATFORM_ATTR_APP_CSRCFILE
	string "Compile source code list"

config PK_PLATFORM_ATTR_APP_CONFIG
	string "CONFIG: Project Configure Options"

config PK_PLATFORM_ATTR_APP_LIBPATH
	string "LIBS: Libraries to pass to the linker, e.g. -l<library>"

config PK_PLATFORM_ATTR_APP_CPPFLAGS
	string "CPPFLAGS: C/C++ preprocessor flags, e.g. -I<include dir>"

config PK_PLATFORM_ATTR_APP_DPKCONFIG
	string "PKG_CONFIG_PATH: Directories to add to pkg-config's search path"

config PK_PLATFORM_ATTR_APP_CFLAGS
	string "CFLAGS: C compiler flags"

config PK_PLATFORM_ATTR_APP_LDFLAGS
	string "LDFLAGS: Linker flags"

config PK_PLATFORM_ATTR_APP_CXXFLAGS
	string "CXXFLAGS: C++ compiler flags"

config PK_PLATFORM_ATTR_APP_ASFLAGS
	string "CCASFLAGS: assembler compiler flags (defaults to CFLAGS)"

config PK_PLATFORM_ATTR_APP_BUILDARCH
	string "--host options on configure for Architecture"

endif # PK_PLATFORM_ATTR_APP
```
