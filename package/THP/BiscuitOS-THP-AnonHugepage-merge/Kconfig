## package/TLB/BiscuitOS-TLB-FLUSH-MADV-COLD/Kconfig
```kconfig
menuconfig PK_TLB_FLUSH_MADVCOLD
	bool "TLB FLUSH on MADV_COLD"

if PK_TLB_FLUSH_MADVCOLD

config PK_TLB_FLUSH_MADVCOLD_VERSION
	default "default"
	string "verstion"

config PK_TLB_FLUSH_MADVCOLD_TAR
	default "tar.gz"
	string "tar type"

config PK_TLB_FLUSH_MADVCOLD_URL
	default "https://gitee.com/BiscuitOS_team/HardStack/raw/Gitee/Memory-Allocator/TLB/BiscuitOS-TLB-FLUSH-MADV-COLD"
	string "url"

config PK_TLB_FLUSH_MADVCOLD_GITHUB
	string "GitHub"

config PK_TLB_FLUSH_MADVCOLD_SRCFILE
	default "main.c Makefile"
	string "Source code list"

config PK_TLB_FLUSH_MADVCOLD_CSRCFILE
	string "Compile source code list"

config PK_TLB_FLUSH_MADVCOLD_CONFIG
	string "CONFIG: Project Configure Options"

config PK_TLB_FLUSH_MADVCOLD_LIBPATH
	string "LIBS: Libraries to pass to the linker, e.g. -l<library>"

config PK_TLB_FLUSH_MADVCOLD_CPPFLAGS
	string "CPPFLAGS: C/C++ preprocessor flags, e.g. -I<include dir>"

config PK_TLB_FLUSH_MADVCOLD_DPKCONFIG
	string "PKG_CONFIG_PATH: Directories to add to pkg-config's search path"

config PK_TLB_FLUSH_MADVCOLD_CFLAGS
	string "CFLAGS: C compiler flags"

config PK_TLB_FLUSH_MADVCOLD_LDFLAGS
	string "LDFLAGS: Linker flags"

config PK_TLB_FLUSH_MADVCOLD_CXXFLAGS
	string "CXXFLAGS: C++ compiler flags"

config PK_TLB_FLUSH_MADVCOLD_ASFLAGS
	string "CCASFLAGS: assembler compiler flags (defaults to CFLAGS)"

config PK_TLB_FLUSH_MADVCOLD_BUILDARCH
	string "--host options on configure for Architecture"

endif # PK_TLB_FLUSH_MADVCOLD
```

## package/TLB/BiscuitOS-TLB-FLUSH-MADV-DONTNEED/Kconfig
```kconfig
menuconfig PK_TLB_FLUSH_MADVDONTNEED
	bool "TLB FLUSH on MADV_DONTNEED"

if PK_TLB_FLUSH_MADVDONTNEED

config PK_TLB_FLUSH_MADVDONTNEED_VERSION
	default "default"
	string "verstion"

config PK_TLB_FLUSH_MADVDONTNEED_TAR
	default "tar.gz"
	string "tar type"

config PK_TLB_FLUSH_MADVDONTNEED_URL
	default "https://gitee.com/BiscuitOS_team/HardStack/raw/Gitee/Memory-Allocator/TLB/BiscuitOS-TLB-FLUSH-MADV-DONTNEED"
	string "url"

config PK_TLB_FLUSH_MADVDONTNEED_GITHUB
	string "GitHub"

config PK_TLB_FLUSH_MADVDONTNEED_SRCFILE
	default "main.c Makefile"
	string "Source code list"

config PK_TLB_FLUSH_MADVDONTNEED_CSRCFILE
	string "Compile source code list"

config PK_TLB_FLUSH_MADVDONTNEED_CONFIG
	string "CONFIG: Project Configure Options"

config PK_TLB_FLUSH_MADVDONTNEED_LIBPATH
	string "LIBS: Libraries to pass to the linker, e.g. -l<library>"

config PK_TLB_FLUSH_MADVDONTNEED_CPPFLAGS
	string "CPPFLAGS: C/C++ preprocessor flags, e.g. -I<include dir>"

config PK_TLB_FLUSH_MADVDONTNEED_DPKCONFIG
	string "PKG_CONFIG_PATH: Directories to add to pkg-config's search path"

config PK_TLB_FLUSH_MADVDONTNEED_CFLAGS
	string "CFLAGS: C compiler flags"

config PK_TLB_FLUSH_MADVDONTNEED_LDFLAGS
	string "LDFLAGS: Linker flags"

config PK_TLB_FLUSH_MADVDONTNEED_CXXFLAGS
	string "CXXFLAGS: C++ compiler flags"

config PK_TLB_FLUSH_MADVDONTNEED_ASFLAGS
	string "CCASFLAGS: assembler compiler flags (defaults to CFLAGS)"

config PK_TLB_FLUSH_MADVDONTNEED_BUILDARCH
	string "--host options on configure for Architecture"

endif # PK_TLB_FLUSH_MADVDONTNEED
```

## package/TLB/BiscuitOS-TLB-FLUSH-MADV-FREE/Kconfig
```kconfig
menuconfig PK_TLB_FLUSH_MADVFREE
	bool "TLB FLUSH on MADV_FREE"

if PK_TLB_FLUSH_MADVFREE

config PK_TLB_FLUSH_MADVFREE_VERSION
	default "default"
	string "verstion"

config PK_TLB_FLUSH_MADVFREE_TAR
	default "tar.gz"
	string "tar type"

config PK_TLB_FLUSH_MADVFREE_URL
	default "https://gitee.com/BiscuitOS_team/HardStack/raw/Gitee/Memory-Allocator/TLB/BiscuitOS-TLB-FLUSH-MADV-FREE"
	string "url"

config PK_TLB_FLUSH_MADVFREE_GITHUB
	string "GitHub"

config PK_TLB_FLUSH_MADVFREE_SRCFILE
	default "main.c Makefile"
	string "Source code list"

config PK_TLB_FLUSH_MADVFREE_CSRCFILE
	string "Compile source code list"

config PK_TLB_FLUSH_MADVFREE_CONFIG
	string "CONFIG: Project Configure Options"

config PK_TLB_FLUSH_MADVFREE_LIBPATH
	string "LIBS: Libraries to pass to the linker, e.g. -l<library>"

config PK_TLB_FLUSH_MADVFREE_CPPFLAGS
	string "CPPFLAGS: C/C++ preprocessor flags, e.g. -I<include dir>"

config PK_TLB_FLUSH_MADVFREE_DPKCONFIG
	string "PKG_CONFIG_PATH: Directories to add to pkg-config's search path"

config PK_TLB_FLUSH_MADVFREE_CFLAGS
	string "CFLAGS: C compiler flags"

config PK_TLB_FLUSH_MADVFREE_LDFLAGS
	string "LDFLAGS: Linker flags"

config PK_TLB_FLUSH_MADVFREE_CXXFLAGS
	string "CXXFLAGS: C++ compiler flags"

config PK_TLB_FLUSH_MADVFREE_ASFLAGS
	string "CCASFLAGS: assembler compiler flags (defaults to CFLAGS)"

config PK_TLB_FLUSH_MADVFREE_BUILDARCH
	string "--host options on configure for Architecture"

endif # PK_TLB_FLUSH_MADVFREE
```

## package/TLB/BiscuitOS-TLB-FLUSH-MADVISE/Kconfig
```kconfig
menuconfig PK_TLB_FLUSH_MADVISE
	bool "TLB FLUSH: Advise Free PageTable(madvise)"

if PK_TLB_FLUSH_MADVISE

config PK_TLB_FLUSH_MADVISE_VERSION
	default "default"
	string "verstion"

config PK_TLB_FLUSH_MADVISE_TAR
	default "tar.gz"
	string "tar type"

config PK_TLB_FLUSH_MADVISE_URL
	default "https://gitee.com/BiscuitOS_team/HardStack/raw/Gitee/Memory-Allocator/TLB/BiscuitOS-TLB-FLUSH-MADVISE"
	string "url"

config PK_TLB_FLUSH_MADVISE_GITHUB
	string "GitHub"

config PK_TLB_FLUSH_MADVISE_SRCFILE
	default "main.c Makefile"
	string "Source code list"

config PK_TLB_FLUSH_MADVISE_CSRCFILE
	string "Compile source code list"

config PK_TLB_FLUSH_MADVISE_CONFIG
	string "CONFIG: Project Configure Options"

config PK_TLB_FLUSH_MADVISE_LIBPATH
	string "LIBS: Libraries to pass to the linker, e.g. -l<library>"

config PK_TLB_FLUSH_MADVISE_CPPFLAGS
	string "CPPFLAGS: C/C++ preprocessor flags, e.g. -I<include dir>"

config PK_TLB_FLUSH_MADVISE_DPKCONFIG
	string "PKG_CONFIG_PATH: Directories to add to pkg-config's search path"

config PK_TLB_FLUSH_MADVISE_CFLAGS
	string "CFLAGS: C compiler flags"

config PK_TLB_FLUSH_MADVISE_LDFLAGS
	string "LDFLAGS: Linker flags"

config PK_TLB_FLUSH_MADVISE_CXXFLAGS
	string "CXXFLAGS: C++ compiler flags"

config PK_TLB_FLUSH_MADVISE_ASFLAGS
	string "CCASFLAGS: assembler compiler flags (defaults to CFLAGS)"

config PK_TLB_FLUSH_MADVISE_BUILDARCH
	string "--host options on configure for Architecture"

endif # PK_TLB_FLUSH_MADVISE
```

## package/TLB/BiscuitOS-TLB-FLUSH-MODIFY-PTE-APP/Kconfig
```kconfig
menuconfig PK_TLB_FLUSH_MDPTE_APP
	bool "Modify PTE with/without FLUSH TLB on Userspace"

if PK_TLB_FLUSH_MDPTE_APP

config PK_TLB_FLUSH_MDPTE_APP_VERSION
	default "default"
	string "verstion"

config PK_TLB_FLUSH_MDPTE_APP_TAR
	default "tar.gz"
	string "tar type"

config PK_TLB_FLUSH_MDPTE_APP_URL
	default "https://gitee.com/BiscuitOS_team/HardStack/raw/Gitee/Memory-Allocator/TLB/BiscuitOS-TLB-FLUSH-MODIFY-PTE-APP"
	string "url"

config PK_TLB_FLUSH_MDPTE_APP_GITHUB
	string "GitHub"

config PK_TLB_FLUSH_MDPTE_APP_SRCFILE
	default "main.c Makefile"
	string "Source code list"

config PK_TLB_FLUSH_MDPTE_APP_CSRCFILE
	string "Compile source code list"

config PK_TLB_FLUSH_MDPTE_APP_CONFIG
	string "CONFIG: Project Configure Options"

config PK_TLB_FLUSH_MDPTE_APP_LIBPATH
	string "LIBS: Libraries to pass to the linker, e.g. -l<library>"

config PK_TLB_FLUSH_MDPTE_APP_CPPFLAGS
	string "CPPFLAGS: C/C++ preprocessor flags, e.g. -I<include dir>"

config PK_TLB_FLUSH_MDPTE_APP_DPKCONFIG
	string "PKG_CONFIG_PATH: Directories to add to pkg-config's search path"

config PK_TLB_FLUSH_MDPTE_APP_CFLAGS
	string "CFLAGS: C compiler flags"

config PK_TLB_FLUSH_MDPTE_APP_LDFLAGS
	string "LDFLAGS: Linker flags"

config PK_TLB_FLUSH_MDPTE_APP_CXXFLAGS
	string "CXXFLAGS: C++ compiler flags"

config PK_TLB_FLUSH_MDPTE_APP_ASFLAGS
	string "CCASFLAGS: assembler compiler flags (defaults to CFLAGS)"

config PK_TLB_FLUSH_MDPTE_APP_BUILDARCH
	string "--host options on configure for Architecture"

endif # PK_TLB_FLUSH_MDPTE_APP
```

## package/TLB/BiscuitOS-TLB-FLUSH-MPROTECT/Kconfig
```kconfig
menuconfig PK_TLB_FLUSH_MPROTECT
	bool "TLB FLUSH: Adjust VMA Protection(mprotect)"

if PK_TLB_FLUSH_MPROTECT

config PK_TLB_FLUSH_MPROTECT_VERSION
	default "default"
	string "verstion"

config PK_TLB_FLUSH_MPROTECT_TAR
	default "tar.gz"
	string "tar type"

config PK_TLB_FLUSH_MPROTECT_URL
	default "https://gitee.com/BiscuitOS_team/HardStack/raw/Gitee/Memory-Allocator/TLB/BiscuitOS-TLB-FLUSH-MPROTECT"
	string "url"

config PK_TLB_FLUSH_MPROTECT_GITHUB
	string "GitHub"

config PK_TLB_FLUSH_MPROTECT_SRCFILE
	default "main.c Makefile"
	string "Source code list"

config PK_TLB_FLUSH_MPROTECT_CSRCFILE
	string "Compile source code list"

config PK_TLB_FLUSH_MPROTECT_CONFIG
	string "CONFIG: Project Configure Options"

config PK_TLB_FLUSH_MPROTECT_LIBPATH
	string "LIBS: Libraries to pass to the linker, e.g. -l<library>"

config PK_TLB_FLUSH_MPROTECT_CPPFLAGS
	string "CPPFLAGS: C/C++ preprocessor flags, e.g. -I<include dir>"

config PK_TLB_FLUSH_MPROTECT_DPKCONFIG
	string "PKG_CONFIG_PATH: Directories to add to pkg-config's search path"

config PK_TLB_FLUSH_MPROTECT_CFLAGS
	string "CFLAGS: C compiler flags"

config PK_TLB_FLUSH_MPROTECT_LDFLAGS
	string "LDFLAGS: Linker flags"

config PK_TLB_FLUSH_MPROTECT_CXXFLAGS
	string "CXXFLAGS: C++ compiler flags"

config PK_TLB_FLUSH_MPROTECT_ASFLAGS
	string "CCASFLAGS: assembler compiler flags (defaults to CFLAGS)"

config PK_TLB_FLUSH_MPROTECT_BUILDARCH
	string "--host options on configure for Architecture"

endif # PK_TLB_FLUSH_MPROTECT
```

## package/TLB/BiscuitOS-TLB-FLUSH-NOTIFY/Kconfig
```kconfig
menuconfig PK_TLB_FLUSH_NOTIFY
	select PK_TLB_FLUSH_APP
	bool "TLB FLUSH Notify Mechansim"

if PK_TLB_FLUSH_NOTIFY

config PK_TLB_FLUSH_NOTIFY_VERSION
	default "default"
	string "verstion"

config PK_TLB_FLUSH_NOTIFY_TAR
	default "tar.gz"
	string "tar type"

config PK_TLB_FLUSH_NOTIFY_URL
	default "https://gitee.com/BiscuitOS_team/HardStack/raw/Gitee/Memory-Allocator/TLB/BiscuitOS-TLB-FLUSH-NOTIFY"
	string "url"

config PK_TLB_FLUSH_NOTIFY_GITHUB
	string "GitHub"

config PK_TLB_FLUSH_NOTIFY_SRCFILE
	default "main.c Makefile Kconfig"
	string "Source code list"

config PK_TLB_FLUSH_NOTIFY_CSRCFILE
	string "Compile source code list"

config PK_TLB_FLUSH_NOTIFY_CONFIG
	string "CONFIG: Project Configure Options"

config PK_TLB_FLUSH_NOTIFY_LIBPATH
	string "LIBS: Libraries to pass to the linker, e.g. -l<library>"

config PK_TLB_FLUSH_NOTIFY_CPPFLAGS
	string "CPPFLAGS: C/C++ preprocessor flags, e.g. -I<include dir>"

config PK_TLB_FLUSH_NOTIFY_DPKCONFIG
	string "PKG_CONFIG_PATH: Directories to add to pkg-config's search path"

config PK_TLB_FLUSH_NOTIFY_CFLAGS
	string "CFLAGS: C compiler flags"

config PK_TLB_FLUSH_NOTIFY_LDFLAGS
	string "LDFLAGS: Linker flags"

config PK_TLB_FLUSH_NOTIFY_CXXFLAGS
	string "CXXFLAGS: C++ compiler flags"

config PK_TLB_FLUSH_NOTIFY_ASFLAGS
	string "CCASFLAGS: assembler compiler flags (defaults to CFLAGS)"

config PK_TLB_FLUSH_NOTIFY_BUILDARCH
	string "--host options on configure for Architecture"

endif # PK_TLB_FLUSH_NOTIFY
```

## package/TLB/BiscuitOS-TLB-SHOOTDOWN/Kconfig
```kconfig
menuconfig PK_TLB_SHOOTDOWN
	bool "TLB Shootdown"

if PK_TLB_SHOOTDOWN

config PK_TLB_SHOOTDOWN_VERSION
	default "default"
	string "verstion"

config PK_TLB_SHOOTDOWN_TAR
	default "tar.gz"
	string "tar type"

config PK_TLB_SHOOTDOWN_URL
	default "https://gitee.com/BiscuitOS_team/HardStack/raw/Gitee/Memory-Allocator/TLB/BiscuitOS-TLB-SHOOTDOWN"
	string "url"

config PK_TLB_SHOOTDOWN_GITHUB
	string "GitHub"

config PK_TLB_SHOOTDOWN_SRCFILE
	default "main.c Makefile"
	string "Source code list"

config PK_TLB_SHOOTDOWN_CSRCFILE
	string "Compile source code list"

config PK_TLB_SHOOTDOWN_CONFIG
	string "CONFIG: Project Configure Options"

config PK_TLB_SHOOTDOWN_LIBPATH
	string "LIBS: Libraries to pass to the linker, e.g. -l<library>"

config PK_TLB_SHOOTDOWN_CPPFLAGS
	string "CPPFLAGS: C/C++ preprocessor flags, e.g. -I<include dir>"

config PK_TLB_SHOOTDOWN_DPKCONFIG
	string "PKG_CONFIG_PATH: Directories to add to pkg-config's search path"

config PK_TLB_SHOOTDOWN_CFLAGS
	string "CFLAGS: C compiler flags"

config PK_TLB_SHOOTDOWN_LDFLAGS
	string "LDFLAGS: Linker flags"

config PK_TLB_SHOOTDOWN_CXXFLAGS
	string "CXXFLAGS: C++ compiler flags"

config PK_TLB_SHOOTDOWN_ASFLAGS
	string "CCASFLAGS: assembler compiler flags (defaults to CFLAGS)"

config PK_TLB_SHOOTDOWN_BUILDARCH
	string "--host options on configure for Architecture"

endif # PK_TLB_SHOOTDOWN
```

## package/TLB/Kconfig
```kconfig
menuconfig PK_TLB
	bool "TLB: Translation-Lookaside Buffer"

if PK_TLB

# TLB FLUSH
source package/TLB/BiscuitOS-TLB-FLUSH/Kconfig

# TLB FLUSH APP
source package/TLB/BiscuitOS-TLB-FLUSH-APP/Kconfig

# TLB FLUSH ALL
source package/TLB/BiscuitOS-TLB-FLUSH-ALL/Kconfig

# TLB FLUSH Notifier
source package/TLB/BiscuitOS-TLB-FLUSH-NOTIFY/Kconfig

# TLB FLUSH: mprotect
source package/TLB/BiscuitOS-TLB-FLUSH-MPROTECT/Kconfig

# TLB FLUSH: madvise
source package/TLB/BiscuitOS-TLB-FLUSH-MADVISE/Kconfig

# TLB FLUSH: MADV_FREE
source package/TLB/BiscuitOS-TLB-FLUSH-MADV-FREE/Kconfig

# TLB FLUSH: MADV_DONTNEED
source package/TLB/BiscuitOS-TLB-FLUSH-MADV-DONTNEED/Kconfig

# TLB FLUSH: MADV_PAGEOUT
source package/TLB/BiscuitOS-TLB-FLUSH-MADV-PAGEOUT/Kconfig

# TLB FLUSH: MADV_COLD
source package/TLB/BiscuitOS-TLB-FLUSH-MADV-COLD/Kconfig

# TLB SHOOTDOWN
source package/TLB/BiscuitOS-TLB-SHOOTDOWN/Kconfig

# MODIFY PTE
source package/TLB/BiscuitOS-TLB-FLUSH-MODIFY-PTE/Kconfig

# MODIFY PTE APP
source package/TLB/BiscuitOS-TLB-FLUSH-MODIFY-PTE-APP/Kconfig

# CPUID
source package/TLB/BiscuitOS-TLB-CPUID/Kconfig

endif # PK_TLB
```

## package/UIO/Kconfig
```kconfig
menuconfig PK_UIO
	bool "UIO: Userspace I/O Device Driver and Application"

if PK_UIO

# LDD: UIO Interrupt Application
source package/UIO/UIO_intr_app/Kconfig

# LDD: UIO Interrupt Device Driver module
source package/UIO/UIO_intr_module/Kconfig

# LDD: UIO memory Application
source package/UIO/UIO_mem_app/Kconfig

# LDD: UIO memory Device Driver module
source package/UIO/UIO_mem_module/Kconfig

endif # PK_UIO
```

## package/UIO/UIO_intr_app/Kconfig
```kconfig
menuconfig PK_UIO_INTR_APP
	select PK_UIO_INTR_MOD
	bool "UIO Interrupt Application"

if PK_UIO_INTR_APP

config PK_UIO_INTR_APP_VERSION
	default "0.0.1"
	string "verstion"

config PK_UIO_INTR_APP_TAR
	default "tar.gz"
	string "tar type"

config PK_UIO_INTR_APP_URL
	default "https://gitee.com/BiscuitOS_team/HardStack/raw/Gitee/Device-Driver/UIO/Interrupt/userland"
	string "url"

config PK_UIO_INTR_APP_GITHUB
	string "GitHub"

config PK_UIO_INTR_APP_SRCFILE
	default "UIO.c Makefile"
	string "Source code list"

config PK_UIO_INTR_APP_CSRCFILE
	string "Compile source code list"

config PK_UIO_INTR_APP_CONFIG
	string "CONFIG: Project Configure Options"

config PK_UIO_INTR_APP_LIBPATH
	string "LIBS: Libraries to pass to the linker, e.g. -l<library>"

config PK_UIO_INTR_APP_CPPFLAGS
	string "CPPFLAGS: C/C++ preprocessor flags, e.g. -I<include dir>"

config PK_UIO_INTR_APP_DPKCONFIG
	string "PKG_CONFIG_PATH: Directories to add to pkg-config's search path"

config PK_UIO_INTR_APP_CFLAGS
	string "CFLAGS: C compiler flags"

config PK_UIO_INTR_APP_LDFLAGS
	string "LDFLAGS: Linker flags"

config PK_UIO_INTR_APP_CXXFLAGS
	string "CXXFLAGS: C++ compiler flags"

config PK_UIO_INTR_APP_ASFLAGS
	string "CCASFLAGS: assembler compiler flags (defaults to CFLAGS)"

config PK_UIO_INTR_APP_BUILDARCH
	string "--host options on configure for Architecture"

endif # PK_UIO_INTR_APP
```
