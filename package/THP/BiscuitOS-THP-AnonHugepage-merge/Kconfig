## package/THP/BiscuitOS-THP-AnonHugepage-merge/Kconfig
```kconfig
menuconfig PK_THP_ANONHUGE_MERGE
	bool "THP: Merge Page to AnonHugepage"

if PK_THP_ANONHUGE_MERGE

config PK_THP_ANONHUGE_MERGE_VERSION
	default "default"
	string "verstion"

config PK_THP_ANONHUGE_MERGE_TAR
	default "tar.gz"
	string "tar type"

config PK_THP_ANONHUGE_MERGE_URL
	default "https://gitee.com/BiscuitOS_team/HardStack/raw/Gitee/Memory-Allocator/THP/BiscuitOS-THP-AnonHugepage-merge"
	string "url"

config PK_THP_ANONHUGE_MERGE_GITHUB
	string "GitHub"

config PK_THP_ANONHUGE_MERGE_SRCFILE
	default "main.c Makefile RunBiscuitOS.sh README.md"
	string "Source code list"

config PK_THP_ANONHUGE_MERGE_CSRCFILE
	string "Compile source code list"

config PK_THP_ANONHUGE_MERGE_CONFIG
	string "CONFIG: Project Configure Options"

config PK_THP_ANONHUGE_MERGE_LIBPATH
	string "LIBS: Libraries to pass to the linker, e.g. -l<library>"

config PK_THP_ANONHUGE_MERGE_CPPFLAGS
	string "CPPFLAGS: C/C++ preprocessor flags, e.g. -I<include dir>"

config PK_THP_ANONHUGE_MERGE_DPKCONFIG
	string "PKG_CONFIG_PATH: Directories to add to pkg-config's search path"

config PK_THP_ANONHUGE_MERGE_CFLAGS
	string "CFLAGS: C compiler flags"

config PK_THP_ANONHUGE_MERGE_LDFLAGS
	string "LDFLAGS: Linker flags"

config PK_THP_ANONHUGE_MERGE_CXXFLAGS
	string "CXXFLAGS: C++ compiler flags"

config PK_THP_ANONHUGE_MERGE_ASFLAGS
	string "CCASFLAGS: assembler compiler flags (defaults to CFLAGS)"

config PK_THP_ANONHUGE_MERGE_BUILDARCH
	string "--host options on configure for Architecture"

endif # PK_THP_ANONHUGE_MERGE
```

## package/THP/BiscuitOS-THP-AnonHugepage/Kconfig
```kconfig
menuconfig PK_THP_ANONHUGE
	bool "THP: Alloc an AnonHugepage"

if PK_THP_ANONHUGE

config PK_THP_ANONHUGE_VERSION
	default "default"
	string "verstion"

config PK_THP_ANONHUGE_TAR
	default "tar.gz"
	string "tar type"

config PK_THP_ANONHUGE_URL
	default "https://gitee.com/BiscuitOS_team/HardStack/raw/Gitee/Memory-Allocator/THP/BiscuitOS-THP-AnonHugepage"
	string "url"

config PK_THP_ANONHUGE_GITHUB
	string "GitHub"

config PK_THP_ANONHUGE_SRCFILE
	default "main.c Makefile RunBiscuitOS.sh README.md"
	string "Source code list"

config PK_THP_ANONHUGE_CSRCFILE
	string "Compile source code list"

config PK_THP_ANONHUGE_CONFIG
	string "CONFIG: Project Configure Options"

config PK_THP_ANONHUGE_LIBPATH
	string "LIBS: Libraries to pass to the linker, e.g. -l<library>"

config PK_THP_ANONHUGE_CPPFLAGS
	string "CPPFLAGS: C/C++ preprocessor flags, e.g. -I<include dir>"

config PK_THP_ANONHUGE_DPKCONFIG
	string "PKG_CONFIG_PATH: Directories to add to pkg-config's search path"

config PK_THP_ANONHUGE_CFLAGS
	string "CFLAGS: C compiler flags"

config PK_THP_ANONHUGE_LDFLAGS
	string "LDFLAGS: Linker flags"

config PK_THP_ANONHUGE_CXXFLAGS
	string "CXXFLAGS: C++ compiler flags"

config PK_THP_ANONHUGE_ASFLAGS
	string "CCASFLAGS: assembler compiler flags (defaults to CFLAGS)"

config PK_THP_ANONHUGE_BUILDARCH
	string "--host options on configure for Architecture"

endif # PK_THP_ANONHUGE
```

## package/THP/BiscuitOS-THP-ShmemHugepage-anonymous/Kconfig
```kconfig
menuconfig PK_THP_SHMEMHUGE_ANON
	bool "THP: Alloc an Anonymous ShmemHugepage"

if PK_THP_SHMEMHUGE_ANON

config PK_THP_SHMEMHUGE_ANON_VERSION
	default "default"
	string "verstion"

config PK_THP_SHMEMHUGE_ANON_TAR
	default "tar.gz"
	string "tar type"

config PK_THP_SHMEMHUGE_ANON_URL
	default "https://gitee.com/BiscuitOS_team/HardStack/raw/Gitee/Memory-Allocator/THP/BiscuitOS-THP-ShmemHugepage-anonymous"
	string "url"

config PK_THP_SHMEMHUGE_ANON_GITHUB
	string "GitHub"

config PK_THP_SHMEMHUGE_ANON_SRCFILE
	default "main.c Makefile RunBiscuitOS.sh README.md"
	string "Source code list"

config PK_THP_SHMEMHUGE_ANON_CSRCFILE
	string "Compile source code list"

config PK_THP_SHMEMHUGE_ANON_CONFIG
	string "CONFIG: Project Configure Options"

config PK_THP_SHMEMHUGE_ANON_LIBPATH
	string "LIBS: Libraries to pass to the linker, e.g. -l<library>"

config PK_THP_SHMEMHUGE_ANON_CPPFLAGS
	string "CPPFLAGS: C/C++ preprocessor flags, e.g. -I<include dir>"

config PK_THP_SHMEMHUGE_ANON_DPKCONFIG
	string "PKG_CONFIG_PATH: Directories to add to pkg-config's search path"

config PK_THP_SHMEMHUGE_ANON_CFLAGS
	string "CFLAGS: C compiler flags"

config PK_THP_SHMEMHUGE_ANON_LDFLAGS
	string "LDFLAGS: Linker flags"

config PK_THP_SHMEMHUGE_ANON_CXXFLAGS
	string "CXXFLAGS: C++ compiler flags"

config PK_THP_SHMEMHUGE_ANON_ASFLAGS
	string "CCASFLAGS: assembler compiler flags (defaults to CFLAGS)"

config PK_THP_SHMEMHUGE_ANON_BUILDARCH
	string "--host options on configure for Architecture"

endif # PK_THP_SHMEMHUGE_ANON
```

## package/THP/BiscuitOS-THP-ShmemHugepage-file-private/Kconfig
```kconfig
menuconfig PK_THP_SHMEMHUGE_FILE_PRIVATE
	bool "THP: Alloc an File Private ShmemHugepage"

if PK_THP_SHMEMHUGE_FILE_PRIVATE

config PK_THP_SHMEMHUGE_FILE_PRIVATE_VERSION
	default "default"
	string "verstion"

config PK_THP_SHMEMHUGE_FILE_PRIVATE_TAR
	default "tar.gz"
	string "tar type"

config PK_THP_SHMEMHUGE_FILE_PRIVATE_URL
	default "https://gitee.com/BiscuitOS_team/HardStack/raw/Gitee/Memory-Allocator/THP/BiscuitOS-THP-ShmemHugepage-file-private"
	string "url"

config PK_THP_SHMEMHUGE_FILE_PRIVATE_GITHUB
	string "GitHub"

config PK_THP_SHMEMHUGE_FILE_PRIVATE_SRCFILE
	default "main.c Makefile RunBiscuitOS.sh README.md"
	string "Source code list"

config PK_THP_SHMEMHUGE_FILE_PRIVATE_CSRCFILE
	string "Compile source code list"

config PK_THP_SHMEMHUGE_FILE_PRIVATE_CONFIG
	string "CONFIG: Project Configure Options"

config PK_THP_SHMEMHUGE_FILE_PRIVATE_LIBPATH
	string "LIBS: Libraries to pass to the linker, e.g. -l<library>"

config PK_THP_SHMEMHUGE_FILE_PRIVATE_CPPFLAGS
	string "CPPFLAGS: C/C++ preprocessor flags, e.g. -I<include dir>"

config PK_THP_SHMEMHUGE_FILE_PRIVATE_DPKCONFIG
	string "PKG_CONFIG_PATH: Directories to add to pkg-config's search path"

config PK_THP_SHMEMHUGE_FILE_PRIVATE_CFLAGS
	string "CFLAGS: C compiler flags"

config PK_THP_SHMEMHUGE_FILE_PRIVATE_LDFLAGS
	string "LDFLAGS: Linker flags"

config PK_THP_SHMEMHUGE_FILE_PRIVATE_CXXFLAGS
	string "CXXFLAGS: C++ compiler flags"

config PK_THP_SHMEMHUGE_FILE_PRIVATE_ASFLAGS
	string "CCASFLAGS: assembler compiler flags (defaults to CFLAGS)"

config PK_THP_SHMEMHUGE_FILE_PRIVATE_BUILDARCH
	string "--host options on configure for Architecture"

endif # PK_THP_SHMEMHUGE_FILE_PRIVATE
```

## package/THP/BiscuitOS-THP-ShmemHugepage-file-shared/Kconfig
```kconfig
menuconfig PK_THP_SHMEMHUGE_FILE_SHARED
	bool "THP: Alloc an File Shared ShmemHugepage"

if PK_THP_SHMEMHUGE_FILE_SHARED

config PK_THP_SHMEMHUGE_FILE_SHARED_VERSION
	default "default"
	string "verstion"

config PK_THP_SHMEMHUGE_FILE_SHARED_TAR
	default "tar.gz"
	string "tar type"

config PK_THP_SHMEMHUGE_FILE_SHARED_URL
	default "https://gitee.com/BiscuitOS_team/HardStack/raw/Gitee/Memory-Allocator/THP/BiscuitOS-THP-ShmemHugepage-file-shared"
	string "url"

config PK_THP_SHMEMHUGE_FILE_SHARED_GITHUB
	string "GitHub"

config PK_THP_SHMEMHUGE_FILE_SHARED_SRCFILE
	default "main.c Makefile RunBiscuitOS.sh README.md"
	string "Source code list"

config PK_THP_SHMEMHUGE_FILE_SHARED_CSRCFILE
	string "Compile source code list"

config PK_THP_SHMEMHUGE_FILE_SHARED_CONFIG
	string "CONFIG: Project Configure Options"

config PK_THP_SHMEMHUGE_FILE_SHARED_LIBPATH
	string "LIBS: Libraries to pass to the linker, e.g. -l<library>"

config PK_THP_SHMEMHUGE_FILE_SHARED_CPPFLAGS
	string "CPPFLAGS: C/C++ preprocessor flags, e.g. -I<include dir>"

config PK_THP_SHMEMHUGE_FILE_SHARED_DPKCONFIG
	string "PKG_CONFIG_PATH: Directories to add to pkg-config's search path"

config PK_THP_SHMEMHUGE_FILE_SHARED_CFLAGS
	string "CFLAGS: C compiler flags"

config PK_THP_SHMEMHUGE_FILE_SHARED_LDFLAGS
	string "LDFLAGS: Linker flags"

config PK_THP_SHMEMHUGE_FILE_SHARED_CXXFLAGS
	string "CXXFLAGS: C++ compiler flags"

config PK_THP_SHMEMHUGE_FILE_SHARED_ASFLAGS
	string "CCASFLAGS: assembler compiler flags (defaults to CFLAGS)"

config PK_THP_SHMEMHUGE_FILE_SHARED_BUILDARCH
	string "--host options on configure for Architecture"

endif # PK_THP_SHMEMHUGE_FILE_SHARED
```

## package/THP/BiscuitOS-THP-userspace/Kconfig
```kconfig
menuconfig PK_THP_USERSPACE
	bool "Trigger THP on userspace"

if PK_THP_USERSPACE

config PK_THP_USERSPACE_VERSION
	default "default"
	string "verstion"

config PK_THP_USERSPACE_TAR
	default "tar.gz"
	string "tar type"

config PK_THP_USERSPACE_URL
	default "https://gitee.com/BiscuitOS_team/HardStack/raw/Gitee/Memory-Allocator/THP/BiscuitOS-THP-userspace"
	string "url"

config PK_THP_USERSPACE_GITHUB
	string "GitHub"

config PK_THP_USERSPACE_SRCFILE
	default "main.c Makefile RunBiscuitOS.sh README.md"
	string "Source code list"

config PK_THP_USERSPACE_CSRCFILE
	string "Compile source code list"

config PK_THP_USERSPACE_CONFIG
	string "CONFIG: Project Configure Options"

config PK_THP_USERSPACE_LIBPATH
	string "LIBS: Libraries to pass to the linker, e.g. -l<library>"

config PK_THP_USERSPACE_CPPFLAGS
	string "CPPFLAGS: C/C++ preprocessor flags, e.g. -I<include dir>"

config PK_THP_USERSPACE_DPKCONFIG
	string "PKG_CONFIG_PATH: Directories to add to pkg-config's search path"

config PK_THP_USERSPACE_CFLAGS
	string "CFLAGS: C compiler flags"

config PK_THP_USERSPACE_LDFLAGS
	string "LDFLAGS: Linker flags"

config PK_THP_USERSPACE_CXXFLAGS
	string "CXXFLAGS: C++ compiler flags"

config PK_THP_USERSPACE_ASFLAGS
	string "CCASFLAGS: assembler compiler flags (defaults to CFLAGS)"

config PK_THP_USERSPACE_BUILDARCH
	string "--host options on configure for Architecture"

endif # PK_THP_USERSPACE
```

## package/THP/Kconfig
```kconfig
menuconfig PK_THP
	bool "THP: Transparent hugepage mechanism"

if PK_THP

# THP on userspace
source package/THP/BiscuitOS-THP-userspace/Kconfig

# ShmemHugepage on anonymous
source package/THP/BiscuitOS-THP-ShmemHugepage-anonymous/Kconfig

# ShmemHugepage on file shared
source package/THP/BiscuitOS-THP-ShmemHugepage-file-shared/Kconfig

# ShmemHugepage on file private
source package/THP/BiscuitOS-THP-ShmemHugepage-file-private/Kconfig

# AnonHugepage
source package/THP/BiscuitOS-THP-AnonHugepage/Kconfig

# AnonHugepage merge
source package/THP/BiscuitOS-THP-AnonHugepage-merge/Kconfig

# AnonHugepage madvise
source package/THP/BiscuitOS-THP-AnonHugepage-madvise/Kconfig

endif # PK_THP
```

## package/TLB/BiscuitOS-TLB-CPUID/Kconfig
```kconfig
menuconfig PK_TLB_CPUID
	bool "CPUID: Utility to read CPUIDs from x86 processors"

if PK_TLB_CPUID

config PK_TLB_CPUID_VERSION
	default "default"
	string "verstion"

config PK_TLB_CPUID_TAR
	default "tar.gz"
	string "tar type"

config PK_TLB_CPUID_URL
	default "https://gitee.com/BiscuitOS_team/HardStack/raw/Gitee/Memory-Allocator/TLB/BiscuitOS-TLB-CPUID"
	string "url"

config PK_TLB_CPUID_GITHUB
	string "GitHub"

config PK_TLB_CPUID_SRCFILE
	default "main.c Makefile"
	string "Source code list"

config PK_TLB_CPUID_CSRCFILE
	string "Compile source code list"

config PK_TLB_CPUID_CONFIG
	string "CONFIG: Project Configure Options"

config PK_TLB_CPUID_LIBPATH
	string "LIBS: Libraries to pass to the linker, e.g. -l<library>"

config PK_TLB_CPUID_CPPFLAGS
	string "CPPFLAGS: C/C++ preprocessor flags, e.g. -I<include dir>"

config PK_TLB_CPUID_DPKCONFIG
	string "PKG_CONFIG_PATH: Directories to add to pkg-config's search path"

config PK_TLB_CPUID_CFLAGS
	string "CFLAGS: C compiler flags"

config PK_TLB_CPUID_LDFLAGS
	string "LDFLAGS: Linker flags"

config PK_TLB_CPUID_CXXFLAGS
	string "CXXFLAGS: C++ compiler flags"

config PK_TLB_CPUID_ASFLAGS
	string "CCASFLAGS: assembler compiler flags (defaults to CFLAGS)"

config PK_TLB_CPUID_BUILDARCH
	string "--host options on configure for Architecture"

endif # PK_TLB_CPUID
```

## package/TLB/BiscuitOS-TLB-FLUSH-ALL/Kconfig
```kconfig
menuconfig PK_TLB_FLUSH_ALL
	bool "TLB FLUSH ALL"

if PK_TLB_FLUSH_ALL

config PK_TLB_FLUSH_ALL_VERSION
	default "default"
	string "verstion"

config PK_TLB_FLUSH_ALL_TAR
	default "tar.gz"
	string "tar type"

config PK_TLB_FLUSH_ALL_URL
	default "https://gitee.com/BiscuitOS_team/HardStack/raw/Gitee/Memory-Allocator/TLB/BiscuitOS-TLB-FLUSH-ALL"
	string "url"

config PK_TLB_FLUSH_ALL_GITHUB
	string "GitHub"

config PK_TLB_FLUSH_ALL_SRCFILE
	default "main.c Makefile Kconfig Makefile.host RunBiscuitOS.sh"
	string "Source code list"

config PK_TLB_FLUSH_ALL_CSRCFILE
	string "Compile source code list"

config PK_TLB_FLUSH_ALL_CONFIG
	string "CONFIG: Project Configure Options"

config PK_TLB_FLUSH_ALL_LIBPATH
	string "LIBS: Libraries to pass to the linker, e.g. -l<library>"

config PK_TLB_FLUSH_ALL_CPPFLAGS
	string "CPPFLAGS: C/C++ preprocessor flags, e.g. -I<include dir>"

config PK_TLB_FLUSH_ALL_DPKCONFIG
	string "PKG_CONFIG_PATH: Directories to add to pkg-config's search path"

config PK_TLB_FLUSH_ALL_CFLAGS
	string "CFLAGS: C compiler flags"

config PK_TLB_FLUSH_ALL_LDFLAGS
	string "LDFLAGS: Linker flags"

config PK_TLB_FLUSH_ALL_CXXFLAGS
	string "CXXFLAGS: C++ compiler flags"

config PK_TLB_FLUSH_ALL_ASFLAGS
	string "CCASFLAGS: assembler compiler flags (defaults to CFLAGS)"

config PK_TLB_FLUSH_ALL_BUILDARCH
	string "--host options on configure for Architecture"

endif # PK_TLB_FLUSH_ALL
```

## package/TLB/BiscuitOS-TLB-FLUSH-APP/Kconfig
```kconfig
menuconfig PK_TLB_FLUSH_APP
	bool "TLB FLUSH on Userspace"

if PK_TLB_FLUSH_APP

config PK_TLB_FLUSH_APP_VERSION
	default "default"
	string "verstion"

config PK_TLB_FLUSH_APP_TAR
	default "tar.gz"
	string "tar type"

config PK_TLB_FLUSH_APP_URL
	default "https://gitee.com/BiscuitOS_team/HardStack/raw/Gitee/Memory-Allocator/TLB/BiscuitOS-TLB-FLUSH-APP"
	string "url"

config PK_TLB_FLUSH_APP_GITHUB
	string "GitHub"

config PK_TLB_FLUSH_APP_SRCFILE
	default "main.c Makefile"
	string "Source code list"

config PK_TLB_FLUSH_APP_CSRCFILE
	string "Compile source code list"

config PK_TLB_FLUSH_APP_CONFIG
	string "CONFIG: Project Configure Options"

config PK_TLB_FLUSH_APP_LIBPATH
	string "LIBS: Libraries to pass to the linker, e.g. -l<library>"

config PK_TLB_FLUSH_APP_CPPFLAGS
	string "CPPFLAGS: C/C++ preprocessor flags, e.g. -I<include dir>"

config PK_TLB_FLUSH_APP_DPKCONFIG
	string "PKG_CONFIG_PATH: Directories to add to pkg-config's search path"

config PK_TLB_FLUSH_APP_CFLAGS
	string "CFLAGS: C compiler flags"

config PK_TLB_FLUSH_APP_LDFLAGS
	string "LDFLAGS: Linker flags"

config PK_TLB_FLUSH_APP_CXXFLAGS
	string "CXXFLAGS: C++ compiler flags"

config PK_TLB_FLUSH_APP_ASFLAGS
	string "CCASFLAGS: assembler compiler flags (defaults to CFLAGS)"

config PK_TLB_FLUSH_APP_BUILDARCH
	string "--host options on configure for Architecture"

endif # PK_TLB_FLUSH_APP
```
