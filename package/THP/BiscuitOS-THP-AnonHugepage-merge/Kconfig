## package/UIO/UIO_mem_app/Kconfig
```kconfig
menuconfig PK_UIO_MEM_APP
	select PK_UIO_MEM_MOD
	bool "UIO Memory Application"

if PK_UIO_MEM_APP

config PK_UIO_MEM_APP_VERSION
	default "0.0.1"
	string "verstion"

config PK_UIO_MEM_APP_TAR
	default "tar.gz"
	string "tar type"

config PK_UIO_MEM_APP_URL
	default "https://gitee.com/BiscuitOS_team/HardStack/raw/Gitee/Device-Driver/UIO/MEM/userland"
	string "url"

config PK_UIO_MEM_APP_GITHUB
	string "GitHub"

config PK_UIO_MEM_APP_SRCFILE
	default "UIO.c UIO.sh Makefile"
	string "Source code list"

config PK_UIO_MEM_APP_CSRCFILE
	string "Compile source code list"

config PK_UIO_MEM_APP_CONFIG
	string "CONFIG: Project Configure Options"

config PK_UIO_MEM_APP_LIBPATH
	string "LIBS: Libraries to pass to the linker, e.g. -l<library>"

config PK_UIO_MEM_APP_CPPFLAGS
	string "CPPFLAGS: C/C++ preprocessor flags, e.g. -I<include dir>"

config PK_UIO_MEM_APP_DPKCONFIG
	string "PKG_CONFIG_PATH: Directories to add to pkg-config's search path"

config PK_UIO_MEM_APP_CFLAGS
	string "CFLAGS: C compiler flags"

config PK_UIO_MEM_APP_LDFLAGS
	string "LDFLAGS: Linker flags"

config PK_UIO_MEM_APP_CXXFLAGS
	string "CXXFLAGS: C++ compiler flags"

config PK_UIO_MEM_APP_ASFLAGS
	string "CCASFLAGS: assembler compiler flags (defaults to CFLAGS)"

config PK_UIO_MEM_APP_BUILDARCH
	string "--host options on configure for Architecture"

endif # PK_UIO_MEM_APP
```

## package/UIO/UIO_mem_module/Kconfig
```kconfig
menuconfig PK_UIO_MEM_MOD
	bool "UIO Memory Device Driver Module"

if PK_UIO_MEM_MOD

config PK_UIO_MEM_MOD_VERSION
	default "0.0.1"
	string "verstion"

config PK_UIO_MEM_MOD_TAR
	default "tar.gz"
	string "tar type"

config PK_UIO_MEM_MOD_URL
	default "https://gitee.com/BiscuitOS_team/HardStack/raw/Gitee/Device-Driver/UIO/MEM/kernel"
	string "url"

config PK_UIO_MEM_MOD_GITHUB
	string "GitHub"

config PK_UIO_MEM_MOD_SRCFILE
	default "UIO.c Kconfig Makefile"
	string "Source code list"

config PK_UIO_MEM_MOD_CSRCFILE
	string "Compile source code list"

config PK_UIO_MEM_MOD_CONFIG
	string "CONFIG: Project Configure Options"

config PK_UIO_MEM_MOD_LIBPATH
	string "LIBS: Libraries to pass to the linker, e.g. -l<library>"

config PK_UIO_MEM_MOD_CPPFLAGS
	string "CPPFLAGS: C/C++ preprocessor flags, e.g. -I<include dir>"

config PK_UIO_MEM_MOD_DPKCONFIG
	string "PKG_CONFIG_PATH: Directories to add to pkg-config's search path"

config PK_UIO_MEM_MOD_CFLAGS
	string "CFLAGS: C compiler flags"

config PK_UIO_MEM_MOD_LDFLAGS
	string "LDFLAGS: Linker flags"

config PK_UIO_MEM_MOD_CXXFLAGS
	string "CXXFLAGS: C++ compiler flags"

config PK_UIO_MEM_MOD_ASFLAGS
	string "CCASFLAGS: assembler compiler flags (defaults to CFLAGS)"

config PK_UIO_MEM_MOD_BUILDARCH
	string "--host options on configure for Architecture"

endif # PK_UIO_MEM_MOD
```

## package/VFS/Anonymous-file-kernel/Kconfig
```kconfig
menuconfig PK_VFS_ANON_FILE_KERNEL
	bool "Anonymous File (Kernel Part+)"

if PK_VFS_ANON_FILE_KERNEL

config PK_VFS_ANON_FILE_KERNEL_VERSION
	default "0.0.1"
	string "verstion"

config PK_VFS_ANON_FILE_KERNEL_TAR
	default "tar.gz"
	string "tar type"

config PK_VFS_ANON_FILE_KERNEL_URL
	default "https://gitee.com/BiscuitOS_team/HardStack/raw/Gitee/fs/anonymous_file/anonymous_file/kernel"
	string "url"

config PK_VFS_ANON_FILE_KERNEL_GITHUB
	string "GitHub"

config PK_VFS_ANON_FILE_KERNEL_SRCFILE
	default "main.c Kconfig Makefile"
	string "Source code list"

config PK_VFS_ANON_FILE_KERNEL_CSRCFILE
	string "Compile source code list"

config PK_VFS_ANON_FILE_KERNEL_CONFIG
	string "CONFIG: Project Configure Options"

config PK_VFS_ANON_FILE_KERNEL_LIBPATH
	string "LIBS: Libraries to pass to the linker, e.g. -l<library>"

config PK_VFS_ANON_FILE_KERNEL_CPPFLAGS
	string "CPPFLAGS: C/C++ preprocessor flags, e.g. -I<include dir>"

config PK_VFS_ANON_FILE_KERNEL_DPKCONFIG
	string "PKG_CONFIG_PATH: Directories to add to pkg-config's search path"

config PK_VFS_ANON_FILE_KERNEL_CFLAGS
	string "CFLAGS: C compiler flags"

config PK_VFS_ANON_FILE_KERNEL_LDFLAGS
	string "LDFLAGS: Linker flags"

config PK_VFS_ANON_FILE_KERNEL_CXXFLAGS
	string "CXXFLAGS: C++ compiler flags"

config PK_VFS_ANON_FILE_KERNEL_ASFLAGS
	string "CCASFLAGS: assembler compiler flags (defaults to CFLAGS)"

config PK_VFS_ANON_FILE_KERNEL_BUILDARCH
	string "--host options on configure for Architecture"

endif # PK_VFS_ANON_FILE_KERNEL
```

## package/VFS/Anonymous-file-userspace/Kconfig
```kconfig
menuconfig PK_VFS_ANON_FILE_USER
	select PK_VFS_ANON_FILE_KERNEL
	bool "Anonymous file (Userspace Part+)"

if PK_VFS_ANON_FILE_USER

config PK_VFS_ANON_FILE_USER_VERSION
	default "0.0.1"
	string "verstion"

config PK_VFS_ANON_FILE_USER_TAR
	default "tar.gz"
	string "tar type"

config PK_VFS_ANON_FILE_USER_URL
	default "https://gitee.com/BiscuitOS_team/HardStack/raw/Gitee/fs/anonymous_file/anonymous_file/userspace"
	string "url"

config PK_VFS_ANON_FILE_USER_GITHUB
	string "GitHub"

config PK_VFS_ANON_FILE_USER_SRCFILE
	default "main.c Makefile"
	string "Source code list"

config PK_VFS_ANON_FILE_USER_CSRCFILE
	string "Compile source code list"

config PK_VFS_ANON_FILE_USER_CONFIG
	string "CONFIG: Project Configure Options"

config PK_VFS_ANON_FILE_USER_LIBPATH
	string "LIBS: Libraries to pass to the linker, e.g. -l<library>"

config PK_VFS_ANON_FILE_USER_CPPFLAGS
	string "CPPFLAGS: C/C++ preprocessor flags, e.g. -I<include dir>"

config PK_VFS_ANON_FILE_USER_DPKCONFIG
	string "PKG_CONFIG_PATH: Directories to add to pkg-config's search path"

config PK_VFS_ANON_FILE_USER_CFLAGS
	string "CFLAGS: C compiler flags"

config PK_VFS_ANON_FILE_USER_LDFLAGS
	string "LDFLAGS: Linker flags"

config PK_VFS_ANON_FILE_USER_CXXFLAGS
	string "CXXFLAGS: C++ compiler flags"

config PK_VFS_ANON_FILE_USER_ASFLAGS
	string "CCASFLAGS: assembler compiler flags (defaults to CFLAGS)"

config PK_VFS_ANON_FILE_USER_BUILDARCH
	string "--host options on configure for Architecture"

endif # PK_VFS_ANON_FILE_USER
```
