## package/CMA/CMA_monitor/Kconfig
```kconfig
menuconfig PK_CMA_MONITOR
	bool "CMA Monitor Module"

if PK_CMA_MONITOR

config PK_CMA_MONITOR_VERSION
	default "0.0.1"
	string "verstion"

config PK_CMA_MONITOR_TAR
	default "tar.gz"
	string "tar type"

config PK_CMA_MONITOR_URL
	default "https://gitee.com/BiscuitOS_team/HardStack/raw/Gitee/Device-Driver/CMA/monitor"
	string "url"

config PK_CMA_MONITOR_GITHUB
	string "GitHub"

config PK_CMA_MONITOR_SRCFILE
	default "cma_diagnosis.c 0001-CMA-export-sympol.patch"
	string "Source code list"

config PK_CMA_MONITOR_CSRCFILE
	string "Compile source code list"

config PK_CMA_MONITOR_CONFIG
	string "CONFIG: Project Configure Options"

config PK_CMA_MONITOR_LIBPATH
	string "LIBS: Libraries to pass to the linker, e.g. -l<library>"

config PK_CMA_MONITOR_CPPFLAGS
	string "CPPFLAGS: C/C++ preprocessor flags, e.g. -I<include dir>"

config PK_CMA_MONITOR_DPKCONFIG
	string "PKG_CONFIG_PATH: Directories to add to pkg-config's search path"

config PK_CMA_MONITOR_CFLAGS
	string "CFLAGS: C compiler flags"

config PK_CMA_MONITOR_LDFLAGS
	string "LDFLAGS: Linker flags"

config PK_CMA_MONITOR_CXXFLAGS
	string "CXXFLAGS: C++ compiler flags"

config PK_CMA_MONITOR_ASFLAGS
	string "CCASFLAGS: assembler compiler flags (defaults to CFLAGS)"

config PK_CMA_MONITOR_BUILDARCH
	string "--host options on configure for Architecture"

endif # PK_CMA_MONITOR
```

## package/CMA/CMA_zomb_app/Kconfig
```kconfig
menuconfig PK_CMA_ZOMB_APP
	select PK_CMA_ZOMB_MOD
	bool "CMA Zombies issue Application"

if PK_CMA_ZOMB_APP

config PK_CMA_ZOMB_APP_VERSION
	default "0.0.1"
	string "verstion"

config PK_CMA_ZOMB_APP_TAR
	default "tar.gz"
	string "tar type"

config PK_CMA_ZOMB_APP_URL
	default "https://gitee.com/BiscuitOS_team/HardStack/raw/Gitee/Device-Driver/CMA/Zombies/userland"
	string "url"

config PK_CMA_ZOMB_APP_GITHUB
	string "GitHub"

config PK_CMA_ZOMB_APP_SRCFILE
	default "cma.c cma.sh Makefile"
	string "Source code list"

config PK_CMA_ZOMB_APP_CSRCFILE
	string "Compile source code list"

config PK_CMA_ZOMB_APP_CONFIG
	string "CONFIG: Project Configure Options"

config PK_CMA_ZOMB_APP_LIBPATH
	string "LIBS: Libraries to pass to the linker, e.g. -l<library>"

config PK_CMA_ZOMB_APP_CPPFLAGS
	string "CPPFLAGS: C/C++ preprocessor flags, e.g. -I<include dir>"

config PK_CMA_ZOMB_APP_DPKCONFIG
	string "PKG_CONFIG_PATH: Directories to add to pkg-config's search path"

config PK_CMA_ZOMB_APP_CFLAGS
	string "CFLAGS: C compiler flags"

config PK_CMA_ZOMB_APP_LDFLAGS
	string "LDFLAGS: Linker flags"

config PK_CMA_ZOMB_APP_CXXFLAGS
	string "CXXFLAGS: C++ compiler flags"

config PK_CMA_ZOMB_APP_ASFLAGS
	string "CCASFLAGS: assembler compiler flags (defaults to CFLAGS)"

config PK_CMA_ZOMB_APP_BUILDARCH
	string "--host options on configure for Architecture"

endif # PK_CMA_ZOMB_APP
```

## package/CMA/Kconfig
```kconfig
menuconfig PK_CMA
	bool "CMA: Contiguous Memory Allocator"

if PK_CMA

# Contiguous Memory Allocate application
source package/CMA/CMA_app/Kconfig

# Contiguous Memory Allocate Module
source package/CMA/CMA_module/Kconfig

# CMA on special Area application
source package/CMA/CMA_area_app/Kconfig

# CMA on speical Area Module
source package/CMA/CMA_area_module/Kconfig

# CMA Debris Application
source package/CMA/CMA_debris_app/Kconfig

# CMA Debris Modules
source package/CMA/CMA_debris_module/Kconfig

# CMA Debris long Application
source package/CMA/CMA_debris_long_app/Kconfig

# CMA Debris long Modules
source package/CMA/CMA_debris_long_module/Kconfig

# CMA Monitor
source package/CMA/CMA_monitor/Kconfig

# CMA Zombies Application
source package/CMA/CMA_zomb_app/Kconfig

# CMA Zombies Modules
source package/CMA/CMA_zomb_module/Kconfig

# CMA Plants Application
source package/CMA/CMA_plant_app/Kconfig

# CMA Plants Modules
source package/CMA/CMA_plant_module/Kconfig

endif # PK_CMA
```

## package/DMA/BiscuitOS-DMA-DMABUF-with-QEMU-Device/Kconfig
```kconfig
menuconfig PK_DMA_DMABUF_QEMU_DEVICE
	bool "DMABUF: Video-Cpature with 2-GPUs"

if PK_DMA_DMABUF_QEMU_DEVICE

config PK_DMA_DMABUF_QEMU_DEVICE_VERSION
	default "default"
	string "verstion"

config PK_DMA_DMABUF_QEMU_DEVICE_TAR
	default "tar.gz"
	string "tar type"

config PK_DMA_DMABUF_QEMU_DEVICE_URL
	default "https://gitee.com/BiscuitOS_team/HardStack/raw/Gitee/Memory-Allocator/DMA-MEMORY/BiscuitOS-DMA-DMABUF-with-QEMU-Device"
	string "url"

config PK_DMA_DMABUF_QEMU_DEVICE_GITHUB
	string "GitHub"

config PK_DMA_DMABUF_QEMU_DEVICE_SRCFILE
	default "APP-Export-Capture.c APP-Import-GPUA.c APP-Import-GPUB.c DMABUF-Export-Capture.c DMABUF-Import-GPUA.c DMABUF-Import-GPUB.c Kconfig Makefile Makefile.host RunBiscuitOS.sh"
	string "Source code list"

config PK_DMA_DMABUF_QEMU_DEVICE_CSRCFILE
	string "Compile source code list"

config PK_DMA_DMABUF_QEMU_DEVICE_CONFIG
	string "CONFIG: Project Configure Options"

config PK_DMA_DMABUF_QEMU_DEVICE_LIBPATH
	string "LIBS: Libraries to pass to the linker, e.g. -l<library>"

config PK_DMA_DMABUF_QEMU_DEVICE_CPPFLAGS
	string "CPPFLAGS: C/C++ preprocessor flags, e.g. -I<include dir>"

config PK_DMA_DMABUF_QEMU_DEVICE_DPKCONFIG
	string "PKG_CONFIG_PATH: Directories to add to pkg-config's search path"

config PK_DMA_DMABUF_QEMU_DEVICE_CFLAGS
	string "CFLAGS: C compiler flags"

config PK_DMA_DMABUF_QEMU_DEVICE_LDFLAGS
	string "LDFLAGS: Linker flags"

config PK_DMA_DMABUF_QEMU_DEVICE_CXXFLAGS
	string "CXXFLAGS: C++ compiler flags"

config PK_DMA_DMABUF_QEMU_DEVICE_ASFLAGS
	string "CCASFLAGS: assembler compiler flags (defaults to CFLAGS)"

config PK_DMA_DMABUF_QEMU_DEVICE_BUILDARCH
	string "--host options on configure for Architecture"

endif # PK_DMA_DMABUF_QEMU_DEVICE
```

## package/DMA/BiscuitOS-DMA-DMABUF/Kconfig
```kconfig
menuconfig PK_DMA_DMABUF
	bool "DMABUF: Exportor and Multi-Importor Share DMABUF"

if PK_DMA_DMABUF

config PK_DMA_DMABUF_VERSION
	default "default"
	string "verstion"

config PK_DMA_DMABUF_TAR
	default "tar.gz"
	string "tar type"

config PK_DMA_DMABUF_URL
	default "https://gitee.com/BiscuitOS_team/HardStack/raw/Gitee/Memory-Allocator/DMA-MEMORY/BiscuitOS-DMA-DMABUF"
	string "url"

config PK_DMA_DMABUF_GITHUB
	string "GitHub"

config PK_DMA_DMABUF_SRCFILE
	default "DMABUF-export.c DMABUF-import.c export-app.c import-app0.c import-app1.c Kconfig Makefile Makefile.host RunBiscuitOS.sh"
	string "Source code list"

config PK_DMA_DMABUF_CSRCFILE
	string "Compile source code list"

config PK_DMA_DMABUF_CONFIG
	string "CONFIG: Project Configure Options"

config PK_DMA_DMABUF_LIBPATH
	string "LIBS: Libraries to pass to the linker, e.g. -l<library>"

config PK_DMA_DMABUF_CPPFLAGS
	string "CPPFLAGS: C/C++ preprocessor flags, e.g. -I<include dir>"

config PK_DMA_DMABUF_DPKCONFIG
	string "PKG_CONFIG_PATH: Directories to add to pkg-config's search path"

config PK_DMA_DMABUF_CFLAGS
	string "CFLAGS: C compiler flags"

config PK_DMA_DMABUF_LDFLAGS
	string "LDFLAGS: Linker flags"

config PK_DMA_DMABUF_CXXFLAGS
	string "CXXFLAGS: C++ compiler flags"

config PK_DMA_DMABUF_ASFLAGS
	string "CCASFLAGS: assembler compiler flags (defaults to CFLAGS)"

config PK_DMA_DMABUF_BUILDARCH
	string "--host options on configure for Architecture"

endif # PK_DMA_DMABUF
```

## package/DMA/BiscuitOS-DMA-MMAP-TO-USERSPACE-K/Kconfig
```kconfig
menuconfig PK_DMA_MMAP_TO_USERSPACE_K
	bool "DMA Kernel Stub for mapping into Userspace"

if PK_DMA_MMAP_TO_USERSPACE_K

config PK_DMA_MMAP_TO_USERSPACE_K_VERSION
	default "default"
	string "verstion"

config PK_DMA_MMAP_TO_USERSPACE_K_TAR
	default "tar.gz"
	string "tar type"

config PK_DMA_MMAP_TO_USERSPACE_K_URL
	default "https://gitee.com/BiscuitOS_team/HardStack/raw/Gitee/Memory-Allocator/DMA-MEMORY/BiscuitOS-DMA-MMAP-TO-USERSPACE-K"
	string "url"

config PK_DMA_MMAP_TO_USERSPACE_K_GITHUB
	string "GitHub"

config PK_DMA_MMAP_TO_USERSPACE_K_SRCFILE
	default "main.c Kconfig Makefile"
	string "Source code list"

config PK_DMA_MMAP_TO_USERSPACE_K_CSRCFILE
	string "Compile source code list"

config PK_DMA_MMAP_TO_USERSPACE_K_CONFIG
	string "CONFIG: Project Configure Options"

config PK_DMA_MMAP_TO_USERSPACE_K_LIBPATH
	string "LIBS: Libraries to pass to the linker, e.g. -l<library>"

config PK_DMA_MMAP_TO_USERSPACE_K_CPPFLAGS
	string "CPPFLAGS: C/C++ preprocessor flags, e.g. -I<include dir>"

config PK_DMA_MMAP_TO_USERSPACE_K_DPKCONFIG
	string "PKG_CONFIG_PATH: Directories to add to pkg-config's search path"

config PK_DMA_MMAP_TO_USERSPACE_K_CFLAGS
	string "CFLAGS: C compiler flags"

config PK_DMA_MMAP_TO_USERSPACE_K_LDFLAGS
	string "LDFLAGS: Linker flags"

config PK_DMA_MMAP_TO_USERSPACE_K_CXXFLAGS
	string "CXXFLAGS: C++ compiler flags"

config PK_DMA_MMAP_TO_USERSPACE_K_ASFLAGS
	string "CCASFLAGS: assembler compiler flags (defaults to CFLAGS)"

config PK_DMA_MMAP_TO_USERSPACE_K_BUILDARCH
	string "--host options on configure for Architecture"

endif # PK_DMA_MMAP_TO_USERSPACE_K
```

## package/DMA/BiscuitOS-DMA-MMAP-TO-USERSPACE/Kconfig
```kconfig
menuconfig PK_DMA_MMAP_TO_USERSPACE_U
	select PK_DMA_MMAP_TO_USERSPACE_K
	bool "Mapping DMA Memory into Userspace"

if PK_DMA_MMAP_TO_USERSPACE_U

config PK_DMA_MMAP_TO_USERSPACE_U_VERSION
	default "default"
	string "verstion"

config PK_DMA_MMAP_TO_USERSPACE_U_TAR
	default "tar.gz"
	string "tar type"

config PK_DMA_MMAP_TO_USERSPACE_U_URL
	default "https://gitee.com/BiscuitOS_team/HardStack/raw/Gitee/Memory-Allocator/DMA-MEMORY/BiscuitOS-DMA-MMAP-TO-USERSPACE"
	string "url"

config PK_DMA_MMAP_TO_USERSPACE_U_GITHUB
	string "GitHub"

config PK_DMA_MMAP_TO_USERSPACE_U_SRCFILE
	default "main.c Makefile"
	string "Source code list"

config PK_DMA_MMAP_TO_USERSPACE_U_CSRCFILE
	string "Compile source code list"

config PK_DMA_MMAP_TO_USERSPACE_U_CONFIG
	string "CONFIG: Project Configure Options"

config PK_DMA_MMAP_TO_USERSPACE_U_LIBPATH
	string "LIBS: Libraries to pass to the linker, e.g. -l<library>"

config PK_DMA_MMAP_TO_USERSPACE_U_CPPFLAGS
	string "CPPFLAGS: C/C++ preprocessor flags, e.g. -I<include dir>"

config PK_DMA_MMAP_TO_USERSPACE_U_DPKCONFIG
	string "PKG_CONFIG_PATH: Directories to add to pkg-config's search path"

config PK_DMA_MMAP_TO_USERSPACE_U_CFLAGS
	string "CFLAGS: C compiler flags"

config PK_DMA_MMAP_TO_USERSPACE_U_LDFLAGS
	string "LDFLAGS: Linker flags"

config PK_DMA_MMAP_TO_USERSPACE_U_CXXFLAGS
	string "CXXFLAGS: C++ compiler flags"

config PK_DMA_MMAP_TO_USERSPACE_U_ASFLAGS
	string "CCASFLAGS: assembler compiler flags (defaults to CFLAGS)"

config PK_DMA_MMAP_TO_USERSPACE_U_BUILDARCH
	string "--host options on configure for Architecture"

endif # PK_DMA_MMAP_TO_USERSPACE_U
```

## package/DMA/BiscuitOS-DMA-module/Kconfig
```kconfig
menuconfig PK_DMA_MOD
	bool "DMA Device Driver (QEMU+)"

if PK_DMA_MOD

config PK_DMA_MOD_VERSION
	default "default"
	string "verstion"

config PK_DMA_MOD_TAR
	default "tar.gz"
	string "tar type"

config PK_DMA_MOD_URL
	default "https://gitee.com/BiscuitOS_team/HardStack/raw/Gitee/Device-Driver/DMA/BiscuitOS-DMA-module"
	string "url"

config PK_DMA_MOD_GITHUB
	string "GitHub"

config PK_DMA_MOD_SRCFILE
	default "Kconfig Makefile main.c RunBiscuitOS.sh"
	string "Source code list"

config PK_DMA_MOD_CSRCFILE
	string "Compile source code list"

config PK_DMA_MOD_CONFIG
	string "CONFIG: Project Configure Options"

config PK_DMA_MOD_LIBPATH
	string "LIBS: Libraries to pass to the linker, e.g. -l<library>"

config PK_DMA_MOD_CPPFLAGS
	string "CPPFLAGS: C/C++ preprocessor flags, e.g. -I<include dir>"

config PK_DMA_MOD_DPKCONFIG
	string "PKG_CONFIG_PATH: Directories to add to pkg-config's search path"

config PK_DMA_MOD_CFLAGS
	string "CFLAGS: C compiler flags"

config PK_DMA_MOD_LDFLAGS
	string "LDFLAGS: Linker flags"

config PK_DMA_MOD_CXXFLAGS
	string "CXXFLAGS: C++ compiler flags"

config PK_DMA_MOD_ASFLAGS
	string "CCASFLAGS: assembler compiler flags (defaults to CFLAGS)"

config PK_DMA_MOD_BUILDARCH
	string "--host options on configure for Architecture"

endif # PK_DMA_MOD
```

## package/DMA/Kconfig
```kconfig
menuconfig PK_DMA
	bool "DMA: Coherent Memory Allocate"

if PK_DMA

# DMA DEVICE Memory To Userspace
source package/DMA/BiscuitOS-DMA-DEVICE-MMAP-TO-USERSPACE/Kconfig

# DMA DEVICE Memory On Userspace
source package/DMA/BiscuitOS-DMA-DEVICE-USE-ON-USERSPACE/Kconfig

# DMA Memory To Userspace
source package/DMA/BiscuitOS-DMA-MEMORY-MMAP-TO-USERSPACE/Kconfig

# DMA Memory On Userspace
source package/DMA/BiscuitOS-DMA-MEMORY-USE-ON-USERSPACE/Kconfig

# DMABUF
source package/DMA/BiscuitOS-DMA-DMABUF/Kconfig

# DMABUF with QEMU Device
source package/DMA/BiscuitOS-DMA-DMABUF-with-QEMU-Device/Kconfig

endif # PK_DMA
```

## package/DMA/dma_buf_app/Kconfig
```kconfig
menuconfig PK_DMA_BUF_APP
	select PK_DMA_BUF_MOD
	bool "DMA-Buffer (Coherent Memory Allocate) Application"

if PK_DMA_BUF_APP

config PK_DMA_BUF_APP_VERSION
	default "0.0.1"
	string "verstion"

config PK_DMA_BUF_APP_TAR
	default "tar.gz"
	string "tar type"

config PK_DMA_BUF_APP_URL
	default "https://gitee.com/BiscuitOS_team/HardStack/raw/Gitee/Device-Driver/DMA/DMA-buf/userland"
	string "url"

config PK_DMA_BUF_APP_GITHUB
	string "GitHub"

config PK_DMA_BUF_APP_SRCFILE
	default "dma-buf.c Makefile"
	string "Source code list"

config PK_DMA_BUF_APP_CSRCFILE
	string "Compile source code list"

config PK_DMA_BUF_APP_CONFIG
	string "CONFIG: Project Configure Options"

config PK_DMA_BUF_APP_LIBPATH
	string "LIBS: Libraries to pass to the linker, e.g. -l<library>"

config PK_DMA_BUF_APP_CPPFLAGS
	string "CPPFLAGS: C/C++ preprocessor flags, e.g. -I<include dir>"

config PK_DMA_BUF_APP_DPKCONFIG
	string "PKG_CONFIG_PATH: Directories to add to pkg-config's search path"

config PK_DMA_BUF_APP_CFLAGS
	string "CFLAGS: C compiler flags"

config PK_DMA_BUF_APP_LDFLAGS
	string "LDFLAGS: Linker flags"

config PK_DMA_BUF_APP_CXXFLAGS
	string "CXXFLAGS: C++ compiler flags"

config PK_DMA_BUF_APP_ASFLAGS
	string "CCASFLAGS: assembler compiler flags (defaults to CFLAGS)"

config PK_DMA_BUF_APP_BUILDARCH
	string "--host options on configure for Architecture"

endif # PK_DMA_BUF_APP
```

## package/DMA/dma_buf_module/Kconfig
```kconfig
menuconfig PK_DMA_BUF_MOD
	bool "DMA-Buffer Device Driver Module"

if PK_DMA_BUF_MOD

config PK_DMA_BUF_MOD_VERSION
	default "0.0.1"
	string "verstion"

config PK_DMA_BUF_MOD_TAR
	default "tar.gz"
	string "tar type"

config PK_DMA_BUF_MOD_URL
	default "https://gitee.com/BiscuitOS_team/HardStack/raw/Gitee/Device-Driver/DMA/DMA-buf/kernel"
	string "url"

config PK_DMA_BUF_MOD_GITHUB
	string "GitHub"

config PK_DMA_BUF_MOD_SRCFILE
	default "dma-buf.c Kconfig Makefile default.dts"
	string "Source code list"

config PK_DMA_BUF_MOD_CSRCFILE
	string "Compile source code list"

config PK_DMA_BUF_MOD_CONFIG
	string "CONFIG: Project Configure Options"

config PK_DMA_BUF_MOD_LIBPATH
	string "LIBS: Libraries to pass to the linker, e.g. -l<library>"

config PK_DMA_BUF_MOD_CPPFLAGS
	string "CPPFLAGS: C/C++ preprocessor flags, e.g. -I<include dir>"

config PK_DMA_BUF_MOD_DPKCONFIG
	string "PKG_CONFIG_PATH: Directories to add to pkg-config's search path"

config PK_DMA_BUF_MOD_CFLAGS
	string "CFLAGS: C compiler flags"

config PK_DMA_BUF_MOD_LDFLAGS
	string "LDFLAGS: Linker flags"

config PK_DMA_BUF_MOD_CXXFLAGS
	string "CXXFLAGS: C++ compiler flags"

config PK_DMA_BUF_MOD_ASFLAGS
	string "CCASFLAGS: assembler compiler flags (defaults to CFLAGS)"

config PK_DMA_BUF_MOD_BUILDARCH
	string "--host options on configure for Architecture"

endif # PK_DMA_BUF_MOD
```
