## package/DemoApo/Kconfig
```kconfig
menuconfig PK_APP_DEMO
	bool "Application Demo"

if PK_APP_DEMO

config PK_APP_DEMO_VERSION
	default "0.0.1"
	string "verstion"

config PK_APP_DEMO_TAR
	default "tar.gz"
	string "tar type"

config PK_APP_DEMO_URL
	default "https://raw.githubusercontent.com/BiscuitOS/HardStack/master/CodeSegment/demo/"
	string "url"

config PK_APP_DEMO_GITHUB
	string "GitHub"

config PK_APP_DEMO_SRCFILE
	default "demo.c Makefile"
	string "Source code list"

config PK_APP_DEMO_CSRCFILE
	string "Compile source code list"

config PK_APP_DEMO_CONFIG
	string "CONFIG: Project Configure Options"

config PK_APP_DEMO_LIBPATH
	string "LIBS: Libraries to pass to the linker, e.g. -l<library>"

config PK_APP_DEMO_CPPFLAGS
	string "CPPFLAGS: C/C++ preprocessor flags, e.g. -I<include dir>"

config PK_APP_DEMO_DPKCONFIG
	string "PKG_CONFIG_PATH: Directories to add to pkg-config's search path"

config PK_APP_DEMO_CFLAGS
	string "CFLAGS: C compiler flags"

config PK_APP_DEMO_LDFLAGS
	string "LDFLAGS: Linker flags"

config PK_APP_DEMO_CXXFLAGS
	string "CXXFLAGS: C++ compiler flags"

config PK_APP_DEMO_ASFLAGS
	string "CCASFLAGS: assembler compiler flags (defaults to CFLAGS)"

config PK_APP_DEMO_BUILDARCH
	string "--host options on configure for Architecture"

endif # PK_APP_DEMO
```

## package/EARLY-IOREMAP/BiscuitOS-EARLY-IOREMAP-copy_from_early_mem/Kconfig
```kconfig
menuconfig PK_EARLY_IOREMAP_CPYMEM
	bool "EARLY-IOREMAP API: copy_from_early_mem"

if PK_EARLY_IOREMAP_CPYMEM

config PK_EARLY_IOREMAP_CPYMEM_VERSION
	default "default"
	string "verstion"

config PK_EARLY_IOREMAP_CPYMEM_TAR
	default "tar.gz"
	string "tar type"

config PK_EARLY_IOREMAP_CPYMEM_URL
	default "https://gitee.com/BiscuitOS_team/HardStack/raw/Gitee/Memory-Allocator/EARLY-IOREMAP/BiscuitOS-EARLY-IOREMAP-copy_from_early_mem"
	string "url"

config PK_EARLY_IOREMAP_CPYMEM_GITHUB
	string "GitHub"

config PK_EARLY_IOREMAP_CPYMEM_SRCFILE
	default "main.c Kconfig Makefile BiscuitOS_Insert.bs"
	string "Source code list"

config PK_EARLY_IOREMAP_CPYMEM_CSRCFILE
	string "Compile source code list"

config PK_EARLY_IOREMAP_CPYMEM_CONFIG
	string "CONFIG: Project Configure Options"

config PK_EARLY_IOREMAP_CPYMEM_LIBPATH
	string "LIBS: Libraries to pass to the linker, e.g. -l<library>"

config PK_EARLY_IOREMAP_CPYMEM_CPPFLAGS
	string "CPPFLAGS: C/C++ preprocessor flags, e.g. -I<include dir>"

config PK_EARLY_IOREMAP_CPYMEM_DPKCONFIG
	string "PKG_CONFIG_PATH: Directories to add to pkg-config's search path"

config PK_EARLY_IOREMAP_CPYMEM_CFLAGS
	string "CFLAGS: C compiler flags"

config PK_EARLY_IOREMAP_CPYMEM_LDFLAGS
	string "LDFLAGS: Linker flags"

config PK_EARLY_IOREMAP_CPYMEM_CXXFLAGS
	string "CXXFLAGS: C++ compiler flags"

config PK_EARLY_IOREMAP_CPYMEM_ASFLAGS
	string "CCASFLAGS: assembler compiler flags (defaults to CFLAGS)"

config PK_EARLY_IOREMAP_CPYMEM_BUILDARCH
	string "--host options on configure for Architecture"

endif # PK_EARLY_IOREMAP_CPYMEM
```

## package/EARLY-IOREMAP/BiscuitOS-EARLY-IOREMAP-early_ioremap/Kconfig
```kconfig
menuconfig PK_EARLY_IOREMAP_IOREMAP
	bool "EARLY-IOREMAP API: early_ioremap"

if PK_EARLY_IOREMAP_IOREMAP

config PK_EARLY_IOREMAP_IOREMAP_VERSION
	default "default"
	string "verstion"

config PK_EARLY_IOREMAP_IOREMAP_TAR
	default "tar.gz"
	string "tar type"

config PK_EARLY_IOREMAP_IOREMAP_URL
	default "https://gitee.com/BiscuitOS_team/HardStack/raw/Gitee/Memory-Allocator/EARLY-IOREMAP/BiscuitOS-EARLY-IOREMAP-early_ioremap"
	string "url"

config PK_EARLY_IOREMAP_IOREMAP_GITHUB
	string "GitHub"

config PK_EARLY_IOREMAP_IOREMAP_SRCFILE
	default "main.c Kconfig Makefile BiscuitOS_Insert.bs"
	string "Source code list"

config PK_EARLY_IOREMAP_IOREMAP_CSRCFILE
	string "Compile source code list"

config PK_EARLY_IOREMAP_IOREMAP_CONFIG
	string "CONFIG: Project Configure Options"

config PK_EARLY_IOREMAP_IOREMAP_LIBPATH
	string "LIBS: Libraries to pass to the linker, e.g. -l<library>"

config PK_EARLY_IOREMAP_IOREMAP_CPPFLAGS
	string "CPPFLAGS: C/C++ preprocessor flags, e.g. -I<include dir>"

config PK_EARLY_IOREMAP_IOREMAP_DPKCONFIG
	string "PKG_CONFIG_PATH: Directories to add to pkg-config's search path"

config PK_EARLY_IOREMAP_IOREMAP_CFLAGS
	string "CFLAGS: C compiler flags"

config PK_EARLY_IOREMAP_IOREMAP_LDFLAGS
	string "LDFLAGS: Linker flags"

config PK_EARLY_IOREMAP_IOREMAP_CXXFLAGS
	string "CXXFLAGS: C++ compiler flags"

config PK_EARLY_IOREMAP_IOREMAP_ASFLAGS
	string "CCASFLAGS: assembler compiler flags (defaults to CFLAGS)"

config PK_EARLY_IOREMAP_IOREMAP_BUILDARCH
	string "--host options on configure for Architecture"

endif # PK_EARLY_IOREMAP_IOREMAP
```

## package/EARLY-IOREMAP/BiscuitOS-EARLY-IOREMAP-early_iounmap/Kconfig
```kconfig
menuconfig PK_EARLY_IOREMAP_IOUNMAP
	bool "EARLY-IOREMAP API: early_iounmap"

if PK_EARLY_IOREMAP_IOUNMAP

config PK_EARLY_IOREMAP_IOUNMAP_VERSION
	default "default"
	string "verstion"

config PK_EARLY_IOREMAP_IOUNMAP_TAR
	default "tar.gz"
	string "tar type"

config PK_EARLY_IOREMAP_IOUNMAP_URL
	default "https://gitee.com/BiscuitOS_team/HardStack/raw/Gitee/Memory-Allocator/EARLY-IOREMAP/BiscuitOS-EARLY-IOREMAP-early_iounmap"
	string "url"

config PK_EARLY_IOREMAP_IOUNMAP_GITHUB
	string "GitHub"

config PK_EARLY_IOREMAP_IOUNMAP_SRCFILE
	default "main.c Kconfig Makefile BiscuitOS_Insert.bs"
	string "Source code list"

config PK_EARLY_IOREMAP_IOUNMAP_CSRCFILE
	string "Compile source code list"

config PK_EARLY_IOREMAP_IOUNMAP_CONFIG
	string "CONFIG: Project Configure Options"

config PK_EARLY_IOREMAP_IOUNMAP_LIBPATH
	string "LIBS: Libraries to pass to the linker, e.g. -l<library>"

config PK_EARLY_IOREMAP_IOUNMAP_CPPFLAGS
	string "CPPFLAGS: C/C++ preprocessor flags, e.g. -I<include dir>"

config PK_EARLY_IOREMAP_IOUNMAP_DPKCONFIG
	string "PKG_CONFIG_PATH: Directories to add to pkg-config's search path"

config PK_EARLY_IOREMAP_IOUNMAP_CFLAGS
	string "CFLAGS: C compiler flags"

config PK_EARLY_IOREMAP_IOUNMAP_LDFLAGS
	string "LDFLAGS: Linker flags"

config PK_EARLY_IOREMAP_IOUNMAP_CXXFLAGS
	string "CXXFLAGS: C++ compiler flags"

config PK_EARLY_IOREMAP_IOUNMAP_ASFLAGS
	string "CCASFLAGS: assembler compiler flags (defaults to CFLAGS)"

config PK_EARLY_IOREMAP_IOUNMAP_BUILDARCH
	string "--host options on configure for Architecture"

endif # PK_EARLY_IOREMAP_IOUNMAP
```

## package/EARLY-IOREMAP/BiscuitOS-EARLY-IOREMAP-early_memremap/Kconfig
```kconfig
menuconfig PK_EARLY_IOREMAP_MEMREMAP
	bool "EARLY-IOREMAP API: early_memremap"

if PK_EARLY_IOREMAP_MEMREMAP

config PK_EARLY_IOREMAP_MEMREMAP_VERSION
	default "default"
	string "verstion"

config PK_EARLY_IOREMAP_MEMREMAP_TAR
	default "tar.gz"
	string "tar type"

config PK_EARLY_IOREMAP_MEMREMAP_URL
	default "https://gitee.com/BiscuitOS_team/HardStack/raw/Gitee/Memory-Allocator/EARLY-IOREMAP/BiscuitOS-EARLY-IOREMAP-early_memremap"
	string "url"

config PK_EARLY_IOREMAP_MEMREMAP_GITHUB
	string "GitHub"

config PK_EARLY_IOREMAP_MEMREMAP_SRCFILE
	default "main.c Kconfig Makefile BiscuitOS_Insert.bs"
	string "Source code list"

config PK_EARLY_IOREMAP_MEMREMAP_CSRCFILE
	string "Compile source code list"

config PK_EARLY_IOREMAP_MEMREMAP_CONFIG
	string "CONFIG: Project Configure Options"

config PK_EARLY_IOREMAP_MEMREMAP_LIBPATH
	string "LIBS: Libraries to pass to the linker, e.g. -l<library>"

config PK_EARLY_IOREMAP_MEMREMAP_CPPFLAGS
	string "CPPFLAGS: C/C++ preprocessor flags, e.g. -I<include dir>"

config PK_EARLY_IOREMAP_MEMREMAP_DPKCONFIG
	string "PKG_CONFIG_PATH: Directories to add to pkg-config's search path"

config PK_EARLY_IOREMAP_MEMREMAP_CFLAGS
	string "CFLAGS: C compiler flags"

config PK_EARLY_IOREMAP_MEMREMAP_LDFLAGS
	string "LDFLAGS: Linker flags"

config PK_EARLY_IOREMAP_MEMREMAP_CXXFLAGS
	string "CXXFLAGS: C++ compiler flags"

config PK_EARLY_IOREMAP_MEMREMAP_ASFLAGS
	string "CCASFLAGS: assembler compiler flags (defaults to CFLAGS)"

config PK_EARLY_IOREMAP_MEMREMAP_BUILDARCH
	string "--host options on configure for Architecture"

endif # PK_EARLY_IOREMAP_MEMREMAP
```

## package/EARLY-IOREMAP/BiscuitOS-EARLY-IOREMAP-early_memremap_prot/Kconfig
```kconfig
menuconfig PK_EARLY_IOREMAP_MEMREMAP_PROT
	bool "EARLY-IOREMAP API: early_memremap_prot"

if PK_EARLY_IOREMAP_MEMREMAP_PROT

config PK_EARLY_IOREMAP_MEMREMAP_PROT_VERSION
	default "default"
	string "verstion"

config PK_EARLY_IOREMAP_MEMREMAP_PROT_TAR
	default "tar.gz"
	string "tar type"

config PK_EARLY_IOREMAP_MEMREMAP_PROT_URL
	default "https://gitee.com/BiscuitOS_team/HardStack/raw/Gitee/Memory-Allocator/EARLY-IOREMAP/BiscuitOS-EARLY-IOREMAP-early_memremap_prot"
	string "url"

config PK_EARLY_IOREMAP_MEMREMAP_PROT_GITHUB
	string "GitHub"

config PK_EARLY_IOREMAP_MEMREMAP_PROT_SRCFILE
	default "main.c Kconfig Makefile BiscuitOS_Insert.bs"
	string "Source code list"

config PK_EARLY_IOREMAP_MEMREMAP_PROT_CSRCFILE
	string "Compile source code list"

config PK_EARLY_IOREMAP_MEMREMAP_PROT_CONFIG
	string "CONFIG: Project Configure Options"

config PK_EARLY_IOREMAP_MEMREMAP_PROT_LIBPATH
	string "LIBS: Libraries to pass to the linker, e.g. -l<library>"

config PK_EARLY_IOREMAP_MEMREMAP_PROT_CPPFLAGS
	string "CPPFLAGS: C/C++ preprocessor flags, e.g. -I<include dir>"

config PK_EARLY_IOREMAP_MEMREMAP_PROT_DPKCONFIG
	string "PKG_CONFIG_PATH: Directories to add to pkg-config's search path"

config PK_EARLY_IOREMAP_MEMREMAP_PROT_CFLAGS
	string "CFLAGS: C compiler flags"

config PK_EARLY_IOREMAP_MEMREMAP_PROT_LDFLAGS
	string "LDFLAGS: Linker flags"

config PK_EARLY_IOREMAP_MEMREMAP_PROT_CXXFLAGS
	string "CXXFLAGS: C++ compiler flags"

config PK_EARLY_IOREMAP_MEMREMAP_PROT_ASFLAGS
	string "CCASFLAGS: assembler compiler flags (defaults to CFLAGS)"

config PK_EARLY_IOREMAP_MEMREMAP_PROT_BUILDARCH
	string "--host options on configure for Architecture"

endif # PK_EARLY_IOREMAP_MEMREMAP_PROT
```

## package/EARLY-IOREMAP/BiscuitOS-EARLY-IOREMAP-early_memremap_ro/Kconfig
```kconfig
menuconfig PK_EARLY_IOREMAP_MEMREMAP_RO
	bool "EARLY-IOREMAP API: early_memremap_ro"

if PK_EARLY_IOREMAP_MEMREMAP_RO

config PK_EARLY_IOREMAP_MEMREMAP_RO_VERSION
	default "default"
	string "verstion"

config PK_EARLY_IOREMAP_MEMREMAP_RO_TAR
	default "tar.gz"
	string "tar type"

config PK_EARLY_IOREMAP_MEMREMAP_RO_URL
	default "https://gitee.com/BiscuitOS_team/HardStack/raw/Gitee/Memory-Allocator/EARLY-IOREMAP/BiscuitOS-EARLY-IOREMAP-early_memremap_ro"
	string "url"

config PK_EARLY_IOREMAP_MEMREMAP_RO_GITHUB
	string "GitHub"

config PK_EARLY_IOREMAP_MEMREMAP_RO_SRCFILE
	default "main.c Kconfig Makefile BiscuitOS_Insert.bs"
	string "Source code list"

config PK_EARLY_IOREMAP_MEMREMAP_RO_CSRCFILE
	string "Compile source code list"

config PK_EARLY_IOREMAP_MEMREMAP_RO_CONFIG
	string "CONFIG: Project Configure Options"

config PK_EARLY_IOREMAP_MEMREMAP_RO_LIBPATH
	string "LIBS: Libraries to pass to the linker, e.g. -l<library>"

config PK_EARLY_IOREMAP_MEMREMAP_RO_CPPFLAGS
	string "CPPFLAGS: C/C++ preprocessor flags, e.g. -I<include dir>"

config PK_EARLY_IOREMAP_MEMREMAP_RO_DPKCONFIG
	string "PKG_CONFIG_PATH: Directories to add to pkg-config's search path"

config PK_EARLY_IOREMAP_MEMREMAP_RO_CFLAGS
	string "CFLAGS: C compiler flags"

config PK_EARLY_IOREMAP_MEMREMAP_RO_LDFLAGS
	string "LDFLAGS: Linker flags"

config PK_EARLY_IOREMAP_MEMREMAP_RO_CXXFLAGS
	string "CXXFLAGS: C++ compiler flags"

config PK_EARLY_IOREMAP_MEMREMAP_RO_ASFLAGS
	string "CCASFLAGS: assembler compiler flags (defaults to CFLAGS)"

config PK_EARLY_IOREMAP_MEMREMAP_RO_BUILDARCH
	string "--host options on configure for Architecture"

endif # PK_EARLY_IOREMAP_MEMREMAP_RO
```

## package/EARLY-IOREMAP/BiscuitOS-EARLY-IOREMAP-early_memunmap/Kconfig
```kconfig
menuconfig PK_EARLY_IOREMAP_MEMUNMAP
	bool "EARLY-IOREMAP API: early_memunmap"

if PK_EARLY_IOREMAP_MEMUNMAP

config PK_EARLY_IOREMAP_MEMUNMAP_VERSION
	default "default"
	string "verstion"

config PK_EARLY_IOREMAP_MEMUNMAP_TAR
	default "tar.gz"
	string "tar type"

config PK_EARLY_IOREMAP_MEMUNMAP_URL
	default "https://gitee.com/BiscuitOS_team/HardStack/raw/Gitee/Memory-Allocator/EARLY-IOREMAP/BiscuitOS-EARLY-IOREMAP-early_memunmap"
	string "url"

config PK_EARLY_IOREMAP_MEMUNMAP_GITHUB
	string "GitHub"

config PK_EARLY_IOREMAP_MEMUNMAP_SRCFILE
	default "main.c Kconfig Makefile BiscuitOS_Insert.bs"
	string "Source code list"

config PK_EARLY_IOREMAP_MEMUNMAP_CSRCFILE
	string "Compile source code list"

config PK_EARLY_IOREMAP_MEMUNMAP_CONFIG
	string "CONFIG: Project Configure Options"

config PK_EARLY_IOREMAP_MEMUNMAP_LIBPATH
	string "LIBS: Libraries to pass to the linker, e.g. -l<library>"

config PK_EARLY_IOREMAP_MEMUNMAP_CPPFLAGS
	string "CPPFLAGS: C/C++ preprocessor flags, e.g. -I<include dir>"

config PK_EARLY_IOREMAP_MEMUNMAP_DPKCONFIG
	string "PKG_CONFIG_PATH: Directories to add to pkg-config's search path"

config PK_EARLY_IOREMAP_MEMUNMAP_CFLAGS
	string "CFLAGS: C compiler flags"

config PK_EARLY_IOREMAP_MEMUNMAP_LDFLAGS
	string "LDFLAGS: Linker flags"

config PK_EARLY_IOREMAP_MEMUNMAP_CXXFLAGS
	string "CXXFLAGS: C++ compiler flags"

config PK_EARLY_IOREMAP_MEMUNMAP_ASFLAGS
	string "CCASFLAGS: assembler compiler flags (defaults to CFLAGS)"

config PK_EARLY_IOREMAP_MEMUNMAP_BUILDARCH
	string "--host options on configure for Architecture"

endif # PK_EARLY_IOREMAP_MEMUNMAP
```

## package/EARLY-IOREMAP/Kconfig
```kconfig
menuconfig PK_EARLY_IOREMAP
	bool "EARLY-IOREMAP Memory Allocator"

if PK_EARLY_IOREMAP

# EARLY-IOREMAP API: copy_from_early_mem
source package/EARLY-IOREMAP/BiscuitOS-EARLY-IOREMAP-copy_from_early_mem/Kconfig

# EARLY-IOREMAP API: early_iounmap
source package/EARLY-IOREMAP/BiscuitOS-EARLY-IOREMAP-early_iounmap/Kconfig

# EARLY-IOREMAP API: early_ioremap
source package/EARLY-IOREMAP/BiscuitOS-EARLY-IOREMAP-early_ioremap/Kconfig

# EARLY-IOREMAP API: early_memunmap
source package/EARLY-IOREMAP/BiscuitOS-EARLY-IOREMAP-early_memunmap/Kconfig

# EARLY-IOREMAP API: early_memremap
source package/EARLY-IOREMAP/BiscuitOS-EARLY-IOREMAP-early_memremap/Kconfig

# EARLY-IOREMAP API: early_memremap_prot
source package/EARLY-IOREMAP/BiscuitOS-EARLY-IOREMAP-early_memremap_prot/Kconfig

# EARLY-IOREMAP API: early_memremap_ro
source package/EARLY-IOREMAP/BiscuitOS-EARLY-IOREMAP-early_memremap_ro/Kconfig

endif # PK_EARLY_IOREMAP
```

## package/FIXMAP/BiscuitOS-FIXMAP-__fix_to_virt/Kconfig
```kconfig
menuconfig PK_FIXMAP__FIX_TO_VIRT
	bool "FIXMAP API: __fix_to_virt()"

if PK_FIXMAP__FIX_TO_VIRT

config PK_FIXMAP__FIX_TO_VIRT_VERSION
	default "default"
	string "verstion"

config PK_FIXMAP__FIX_TO_VIRT_TAR
	default "tar.gz"
	string "tar type"

config PK_FIXMAP__FIX_TO_VIRT_URL
	default "https://gitee.com/BiscuitOS_team/HardStack/raw/Gitee/Memory-Allocator/FIXMAP/BiscuitOS-FIXMAP-__fix_to_virt"
	string "url"

config PK_FIXMAP__FIX_TO_VIRT_GITHUB
	string "GitHub"

config PK_FIXMAP__FIX_TO_VIRT_SRCFILE
	default "main.c Kconfig Makefile"
	string "Source code list"

config PK_FIXMAP__FIX_TO_VIRT_CSRCFILE
	string "Compile source code list"

config PK_FIXMAP__FIX_TO_VIRT_CONFIG
	string "CONFIG: Project Configure Options"

config PK_FIXMAP__FIX_TO_VIRT_LIBPATH
	string "LIBS: Libraries to pass to the linker, e.g. -l<library>"

config PK_FIXMAP__FIX_TO_VIRT_CPPFLAGS
	string "CPPFLAGS: C/C++ preprocessor flags, e.g. -I<include dir>"

config PK_FIXMAP__FIX_TO_VIRT_DPKCONFIG
	string "PKG_CONFIG_PATH: Directories to add to pkg-config's search path"

config PK_FIXMAP__FIX_TO_VIRT_CFLAGS
	string "CFLAGS: C compiler flags"

config PK_FIXMAP__FIX_TO_VIRT_LDFLAGS
	string "LDFLAGS: Linker flags"

config PK_FIXMAP__FIX_TO_VIRT_CXXFLAGS
	string "CXXFLAGS: C++ compiler flags"

config PK_FIXMAP__FIX_TO_VIRT_ASFLAGS
	string "CCASFLAGS: assembler compiler flags (defaults to CFLAGS)"

config PK_FIXMAP__FIX_TO_VIRT_BUILDARCH
	string "--host options on configure for Architecture"

endif # PK_FIXMAP__FIX_TO_VIRT
```
