## package/FIXMAP/BiscuitOS-FIXMAP-__set_fixmap/Kconfig
```kconfig
menuconfig PK_FIXMAP__SET_FIXMAP
	bool "FIXMAP API: __set_fixmap()"

if PK_FIXMAP__SET_FIXMAP

config PK_FIXMAP__SET_FIXMAP_VERSION
	default "default"
	string "verstion"

config PK_FIXMAP__SET_FIXMAP_TAR
	default "tar.gz"
	string "tar type"

config PK_FIXMAP__SET_FIXMAP_URL
	default "https://gitee.com/BiscuitOS_team/HardStack/raw/Gitee/Memory-Allocator/FIXMAP/BiscuitOS-FIXMAP-__set_fixmap"
	string "url"

config PK_FIXMAP__SET_FIXMAP_GITHUB
	string "GitHub"

config PK_FIXMAP__SET_FIXMAP_SRCFILE
	default "main.c Kconfig Makefile"
	string "Source code list"

config PK_FIXMAP__SET_FIXMAP_CSRCFILE
	string "Compile source code list"

config PK_FIXMAP__SET_FIXMAP_CONFIG
	string "CONFIG: Project Configure Options"

config PK_FIXMAP__SET_FIXMAP_LIBPATH
	string "LIBS: Libraries to pass to the linker, e.g. -l<library>"

config PK_FIXMAP__SET_FIXMAP_CPPFLAGS
	string "CPPFLAGS: C/C++ preprocessor flags, e.g. -I<include dir>"

config PK_FIXMAP__SET_FIXMAP_DPKCONFIG
	string "PKG_CONFIG_PATH: Directories to add to pkg-config's search path"

config PK_FIXMAP__SET_FIXMAP_CFLAGS
	string "CFLAGS: C compiler flags"

config PK_FIXMAP__SET_FIXMAP_LDFLAGS
	string "LDFLAGS: Linker flags"

config PK_FIXMAP__SET_FIXMAP_CXXFLAGS
	string "CXXFLAGS: C++ compiler flags"

config PK_FIXMAP__SET_FIXMAP_ASFLAGS
	string "CCASFLAGS: assembler compiler flags (defaults to CFLAGS)"

config PK_FIXMAP__SET_FIXMAP_BUILDARCH
	string "--host options on configure for Architecture"

endif # PK_FIXMAP__SET_FIXMAP
```

## package/FIXMAP/BiscuitOS-FIXMAP-__set_fixmap_offset/Kconfig
```kconfig
menuconfig PK_FIXMAP__SET_FIXMAP_OFFSET
	bool "FIXMAP API: __set_fixmap_offset()"

if PK_FIXMAP__SET_FIXMAP_OFFSET

config PK_FIXMAP__SET_FIXMAP_OFFSET_VERSION
	default "default"
	string "verstion"

config PK_FIXMAP__SET_FIXMAP_OFFSET_TAR
	default "tar.gz"
	string "tar type"

config PK_FIXMAP__SET_FIXMAP_OFFSET_URL
	default "https://gitee.com/BiscuitOS_team/HardStack/raw/Gitee/Memory-Allocator/FIXMAP/BiscuitOS-FIXMAP-__set_fixmap_offset"
	string "url"

config PK_FIXMAP__SET_FIXMAP_OFFSET_GITHUB
	string "GitHub"

config PK_FIXMAP__SET_FIXMAP_OFFSET_SRCFILE
	default "main.c Kconfig Makefile"
	string "Source code list"

config PK_FIXMAP__SET_FIXMAP_OFFSET_CSRCFILE
	string "Compile source code list"

config PK_FIXMAP__SET_FIXMAP_OFFSET_CONFIG
	string "CONFIG: Project Configure Options"

config PK_FIXMAP__SET_FIXMAP_OFFSET_LIBPATH
	string "LIBS: Libraries to pass to the linker, e.g. -l<library>"

config PK_FIXMAP__SET_FIXMAP_OFFSET_CPPFLAGS
	string "CPPFLAGS: C/C++ preprocessor flags, e.g. -I<include dir>"

config PK_FIXMAP__SET_FIXMAP_OFFSET_DPKCONFIG
	string "PKG_CONFIG_PATH: Directories to add to pkg-config's search path"

config PK_FIXMAP__SET_FIXMAP_OFFSET_CFLAGS
	string "CFLAGS: C compiler flags"

config PK_FIXMAP__SET_FIXMAP_OFFSET_LDFLAGS
	string "LDFLAGS: Linker flags"

config PK_FIXMAP__SET_FIXMAP_OFFSET_CXXFLAGS
	string "CXXFLAGS: C++ compiler flags"

config PK_FIXMAP__SET_FIXMAP_OFFSET_ASFLAGS
	string "CCASFLAGS: assembler compiler flags (defaults to CFLAGS)"

config PK_FIXMAP__SET_FIXMAP_OFFSET_BUILDARCH
	string "--host options on configure for Architecture"

endif # PK_FIXMAP__SET_FIXMAP_OFFSET
```

## package/FIXMAP/BiscuitOS-FIXMAP-__virt_to_fix/Kconfig
```kconfig
menuconfig PK_FIXMAP__VIRT_TO_FIX
	bool "FIXMAP API: __virt_to_fix()"

if PK_FIXMAP__VIRT_TO_FIX

config PK_FIXMAP__VIRT_TO_FIX_VERSION
	default "default"
	string "verstion"

config PK_FIXMAP__VIRT_TO_FIX_TAR
	default "tar.gz"
	string "tar type"

config PK_FIXMAP__VIRT_TO_FIX_URL
	default "https://gitee.com/BiscuitOS_team/HardStack/raw/Gitee/Memory-Allocator/FIXMAP/BiscuitOS-FIXMAP-__virt_to_fix"
	string "url"

config PK_FIXMAP__VIRT_TO_FIX_GITHUB
	string "GitHub"

config PK_FIXMAP__VIRT_TO_FIX_SRCFILE
	default "main.c Kconfig Makefile"
	string "Source code list"

config PK_FIXMAP__VIRT_TO_FIX_CSRCFILE
	string "Compile source code list"

config PK_FIXMAP__VIRT_TO_FIX_CONFIG
	string "CONFIG: Project Configure Options"

config PK_FIXMAP__VIRT_TO_FIX_LIBPATH
	string "LIBS: Libraries to pass to the linker, e.g. -l<library>"

config PK_FIXMAP__VIRT_TO_FIX_CPPFLAGS
	string "CPPFLAGS: C/C++ preprocessor flags, e.g. -I<include dir>"

config PK_FIXMAP__VIRT_TO_FIX_DPKCONFIG
	string "PKG_CONFIG_PATH: Directories to add to pkg-config's search path"

config PK_FIXMAP__VIRT_TO_FIX_CFLAGS
	string "CFLAGS: C compiler flags"

config PK_FIXMAP__VIRT_TO_FIX_LDFLAGS
	string "LDFLAGS: Linker flags"

config PK_FIXMAP__VIRT_TO_FIX_CXXFLAGS
	string "CXXFLAGS: C++ compiler flags"

config PK_FIXMAP__VIRT_TO_FIX_ASFLAGS
	string "CCASFLAGS: assembler compiler flags (defaults to CFLAGS)"

config PK_FIXMAP__VIRT_TO_FIX_BUILDARCH
	string "--host options on configure for Architecture"

endif # PK_FIXMAP__VIRT_TO_FIX
```

## package/FIXMAP/BiscuitOS-FIXMAP-clear_fixmap/Kconfig
```kconfig
menuconfig PK_FIXMAP_CLEAR_FIXMAP
	bool "FIXMAP API: clear_fixmap()"

if PK_FIXMAP_CLEAR_FIXMAP

config PK_FIXMAP_CLEAR_FIXMAP_VERSION
	default "default"
	string "verstion"

config PK_FIXMAP_CLEAR_FIXMAP_TAR
	default "tar.gz"
	string "tar type"

config PK_FIXMAP_CLEAR_FIXMAP_URL
	default "https://gitee.com/BiscuitOS_team/HardStack/raw/Gitee/Memory-Allocator/FIXMAP/BiscuitOS-FIXMAP-clear_fixmap"
	string "url"

config PK_FIXMAP_CLEAR_FIXMAP_GITHUB
	string "GitHub"

config PK_FIXMAP_CLEAR_FIXMAP_SRCFILE
	default "main.c Kconfig Makefile"
	string "Source code list"

config PK_FIXMAP_CLEAR_FIXMAP_CSRCFILE
	string "Compile source code list"

config PK_FIXMAP_CLEAR_FIXMAP_CONFIG
	string "CONFIG: Project Configure Options"

config PK_FIXMAP_CLEAR_FIXMAP_LIBPATH
	string "LIBS: Libraries to pass to the linker, e.g. -l<library>"

config PK_FIXMAP_CLEAR_FIXMAP_CPPFLAGS
	string "CPPFLAGS: C/C++ preprocessor flags, e.g. -I<include dir>"

config PK_FIXMAP_CLEAR_FIXMAP_DPKCONFIG
	string "PKG_CONFIG_PATH: Directories to add to pkg-config's search path"

config PK_FIXMAP_CLEAR_FIXMAP_CFLAGS
	string "CFLAGS: C compiler flags"

config PK_FIXMAP_CLEAR_FIXMAP_LDFLAGS
	string "LDFLAGS: Linker flags"

config PK_FIXMAP_CLEAR_FIXMAP_CXXFLAGS
	string "CXXFLAGS: C++ compiler flags"

config PK_FIXMAP_CLEAR_FIXMAP_ASFLAGS
	string "CCASFLAGS: assembler compiler flags (defaults to CFLAGS)"

config PK_FIXMAP_CLEAR_FIXMAP_BUILDARCH
	string "--host options on configure for Architecture"

endif # PK_FIXMAP_CLEAR_FIXMAP
```
