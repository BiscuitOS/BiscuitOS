## package/CACHE/BiscuitOS-CACHE-WT-MMIO-USERSPACE/Kconfig
```kconfig
menuconfig PK_CACHE_WT_MMIO_U
	bool "WriteThrough(WT): Mapping WT MMIO on Userspace"

if PK_CACHE_WT_MMIO_U

config PK_CACHE_WT_MMIO_U_VERSION
	default "default"
	string "verstion"

config PK_CACHE_WT_MMIO_U_TAR
	default "tar.gz"
	string "tar type"

config PK_CACHE_WT_MMIO_U_URL
	default "https://gitee.com/BiscuitOS_team/HardStack/raw/Gitee/Memory-Allocator/CACHE-MECH/BiscuitOS-CACHE-WT-MMIO-USERSPACE"
	string "url"

config PK_CACHE_WT_MMIO_U_GITHUB
	string "GitHub"

config PK_CACHE_WT_MMIO_U_SRCFILE
	default "app.c main.c Kconfig Makefile Makefile.host RunBiscuitOS.sh"
	string "Source code list"

config PK_CACHE_WT_MMIO_U_CSRCFILE
	string "Compile source code list"

config PK_CACHE_WT_MMIO_U_CONFIG
	string "CONFIG: Project Configure Options"

config PK_CACHE_WT_MMIO_U_LIBPATH
	string "LIBS: Libraries to pass to the linker, e.g. -l<library>"

config PK_CACHE_WT_MMIO_U_CPPFLAGS
	string "CPPFLAGS: C/C++ preprocessor flags, e.g. -I<include dir>"

config PK_CACHE_WT_MMIO_U_DPKCONFIG
	string "PKG_CONFIG_PATH: Directories to add to pkg-config's search path"

config PK_CACHE_WT_MMIO_U_CFLAGS
	string "CFLAGS: C compiler flags"

config PK_CACHE_WT_MMIO_U_LDFLAGS
	string "LDFLAGS: Linker flags"

config PK_CACHE_WT_MMIO_U_CXXFLAGS
	string "CXXFLAGS: C++ compiler flags"

config PK_CACHE_WT_MMIO_U_ASFLAGS
	string "CCASFLAGS: assembler compiler flags (defaults to CFLAGS)"

config PK_CACHE_WT_MMIO_U_BUILDARCH
	string "--host options on configure for Architecture"

endif # PK_CACHE_WT_MMIO_U
```

## package/CACHE/BiscuitOS-CACHE/Kconfig
```kconfig
menuconfig PK_CACHE0
	bool "CACHE on BiscuitOS"

if PK_CACHE0

config PK_CACHE0_VERSION
	default "default"
	string "verstion"

config PK_CACHE0_TAR
	default "tar.gz"
	string "tar type"

config PK_CACHE0_URL
	default "https://gitee.com/BiscuitOS_team/HardStack/raw/Gitee/Memory-Allocator/CACHE-MECH/BiscuitOS-CACHE"
	string "url"

config PK_CACHE0_GITHUB
	string "GitHub"

config PK_CACHE0_SRCFILE
	default "main.c Makefile RunBiscuitOS.sh"
	string "Source code list"

config PK_CACHE0_CSRCFILE
	string "Compile source code list"

config PK_CACHE0_CONFIG
	string "CONFIG: Project Configure Options"

config PK_CACHE0_LIBPATH
	string "LIBS: Libraries to pass to the linker, e.g. -l<library>"

config PK_CACHE0_CPPFLAGS
	string "CPPFLAGS: C/C++ preprocessor flags, e.g. -I<include dir>"

config PK_CACHE0_DPKCONFIG
	string "PKG_CONFIG_PATH: Directories to add to pkg-config's search path"

config PK_CACHE0_CFLAGS
	string "CFLAGS: C compiler flags"

config PK_CACHE0_LDFLAGS
	string "LDFLAGS: Linker flags"

config PK_CACHE0_CXXFLAGS
	string "CXXFLAGS: C++ compiler flags"

config PK_CACHE0_ASFLAGS
	string "CCASFLAGS: assembler compiler flags (defaults to CFLAGS)"

config PK_CACHE0_BUILDARCH
	string "--host options on configure for Architecture"

endif # PK_CACHE0
```

## package/CACHE/BiscuitOS-Intel-CMT-CAT/Kconfig
```kconfig
menuconfig PK_CACHE_INTEL_CMT_CAT
	bool "Intel CACHE tools: CMT and CAT U+"

if PK_CACHE_INTEL_CMT_CAT

config PK_CACHE_INTEL_CMT_CAT_VERSION
	default "github"
	string "verstion"

config PK_CACHE_INTEL_CMT_CAT_TAR
	default "tar.xz"
	string "tar type"

config PK_CACHE_INTEL_CMT_CAT_URL
	default "https://download.qemu.org/"
	string "url"

config PK_CACHE_INTEL_CMT_CAT_GITHUB
	default "https://gitee.com/mirrors_intel/intel-cmt-cat.git"
	string "github"

config PK_CACHE_INTEL_CMT_CAT_SRCFILE
	string "Source code list"

config PK_CACHE_INTEL_CMT_CAT_CONFIG
	default ""
	string "CONFIG: Project Configure Options"

config PK_CACHE_INTEL_CMT_CAT_LIBPATH
	string "LIBS: Libraries to pass to the linker, e.g. -l<library>"

config PK_CACHE_INTEL_CMT_CAT_CPPFLAGS
	string "CPPFLAGS: C/C++ preprocessor flags, e.g. -I<include dir>"

config PK_CACHE_INTEL_CMT_CAT_DPKCONFIG
	string "PKG_CONFIG_PATH: Directories to add to pkg-config's search path"

config PK_CACHE_INTEL_CMT_CAT_CFLAGS
	string "CFLAGS: C compiler flags"

config PK_CACHE_INTEL_CMT_CAT_LDFLAGS
	string "LDFLAGS: Linker flags"

config PK_CACHE_INTEL_CMT_CAT_CXXFLAGS
	string "CXXFLAGS: C++ compiler flags"

config PK_CACHE_INTEL_CMT_CAT_ASFLAGS
	string "CCASFLAGS: assembler compiler flags (defaults to CFLAGS)"

config PK_CACHE_INTEL_CMT_CAT_BUILDARCH
	default "x86_64-unknown-linux-gnu"
	string "--host options on configure for Architecture"

endif # PK_CACHE_INTEL_CMT_CAT
```

## package/CACHE/Kconfig
```kconfig
menuconfig PK_CACHE
	bool "CACHE"

if PK_CACHE

# Intel CMT/CAT
source package/CACHE/BiscuitOS-Intel-CMT-CAT/Kconfig

# UC-: MMIO on Userspace
source package/CACHE/BiscuitOS-CACHE-UNCACHED-MMIO-USERSPACE/Kconfig

# UC-: MMIO on Kernel
source package/CACHE/BiscuitOS-CACHE-UNCACHED-MMIO-KERNEL/Kconfig

# UC-: MEM on Kernel
source package/CACHE/BiscuitOS-CACHE-UNCACHED-MEM-KERNEL/Kconfig

# UC-: MEM on Userspace
source package/CACHE/BiscuitOS-CACHE-UNCACHED-MEM-USERSPACE/Kconfig

# UC:  MMIO on Kernel
source package/CACHE/BiscuitOS-CACHE-UNCACHE-MMIO-KERNEL/Kconfig

# UC:  MMIO on Userspace
source package/CACHE/BiscuitOS-CACHE-UNCACHE-MMIO-USERSPACE/Kconfig

# UC:  MEM on Kernel
source package/CACHE/BiscuitOS-CACHE-UNCACHE-MEM-KERNEL/Kconfig

# UC:  MEM on Userspace
source package/CACHE/BiscuitOS-CACHE-UNCACHE-MEM-USERSPACE/Kconfig

# WC:  MMIO on Kernel
source package/CACHE/BiscuitOS-CACHE-WC-MMIO-KERNEL/Kconfig

# WC:  MMIO on Userspace
source package/CACHE/BiscuitOS-CACHE-WC-MMIO-USERSPACE/Kconfig

# WC:  MEM on Kernel
source package/CACHE/BiscuitOS-CACHE-WC-MEM-KERNEL/Kconfig

# WC:  MEM on Userspace
source package/CACHE/BiscuitOS-CACHE-WC-MEM-USERSPACE/Kconfig

# WT:  MMIO on Kernel
source package/CACHE/BiscuitOS-CACHE-WT-MMIO-KERNEL/Kconfig

# WT:  MMIO on Userspace
source package/CACHE/BiscuitOS-CACHE-WT-MMIO-USERSPACE/Kconfig

# WT:  MEM on Kernel
source package/CACHE/BiscuitOS-CACHE-WT-MEM-KERNEL/Kconfig

# WT:  MEM on Userspace
source package/CACHE/BiscuitOS-CACHE-WT-MEM-USERSPACE/Kconfig

# WB:  MEM on Kernel
source package/CACHE/BiscuitOS-CACHE-WB-MEM-KERNEL/Kconfig

# WB:  MEM on Userspace
source package/CACHE/BiscuitOS-CACHE-WB-MEM-USERSPACE/Kconfig

# WB:  MMIO on Userspace
source package/CACHE/BiscuitOS-CACHE-WB-MMIO-USERSPACE/Kconfig

# WP:  MEM on Userspace
source package/CACHE/BiscuitOS-CACHE-WP-MEM-USERSPACE/Kconfig

# WP:  MMIO on Userspace
source package/CACHE/BiscuitOS-CACHE-WP-MMIO-USERSPACE/Kconfig

# Userspace Page: CACHE Memory on Userspace (Recommend)
source package/CACHE/BiscuitOS-CACHE-USER-PAGE-USERSPACE/Kconfig

# Userspace Page: Kernel Stub
source package/CACHE/BiscuitOS-CACHE-USER-PAGE-Kernel-Stub/Kconfig

# CACHE Instruction: CLFLUSH
source package/CACHE/BiscuitOS-CACHE-INSTRUCT-CLFLUSH/Kconfig

# CACHE Instruction: CLFLUSHOPT
source package/CACHE/BiscuitOS-CACHE-INSTRUCT-CLFLUSHOPT/Kconfig

# CACHE Instruction: CLWB
source package/CACHE/BiscuitOS-CACHE-INSTRUCT-CLWB/Kconfig

# CACHE Instruction: PREFETCH
source package/CACHE/BiscuitOS-CACHE-INSTRUCT-PREFETCH/Kconfig

# CACHE Instruction: PREFETCHW
source package/CACHE/BiscuitOS-CACHE-INSTRUCT-PREFETCHW/Kconfig

# CACHE Instruction: MOVNTI
source package/CACHE/BiscuitOS-CACHE-INSTRUCT-MOVNTI/Kconfig

# CACHE Instruction: WBINVD
source package/CACHE/BiscuitOS-CACHE-INSTRUCT-WBINVD/Kconfig

# CACHE Instruction: WBNOINVD
source package/CACHE/BiscuitOS-CACHE-INSTRUCT-WBNOINVD/Kconfig

# CACHE Instruction: INVD
source package/CACHE/BiscuitOS-CACHE-INSTRUCT-INVD/Kconfig

# CACHE Memory Type: MTRR and PAT (Userspace)
source package/CACHE/BiscuitOS-CACHE-MEMORY-TYPE-MTRR-PAT-U/Kconfig

# CACHE Memory Type: MTRR and PAT (Kernel)
source package/CACHE/BiscuitOS-CACHE-MEMORY-TYPE-MTRR-PAT-K/Kconfig

# CACHE Performace: WB Vs. UC
source package/CACHE/BiscuitOS-CACHE-PERFORMANCE-WB-VS-UC/Kconfig

# MTRRs: IOCTL READ
source package/CACHE/BiscuitOS-CACHE-MTRR-IOCTL-READ/Kconfig

# MTRRs: IOCTL WRITE
source package/CACHE/BiscuitOS-CACHE-MTRR-IOCTL-WRITE/Kconfig

# IOREMAP
source package/CACHE/BiscuitOS-CACHE-IOREMAP/Kconfig

# IOREMAP Change MEMTYPE
source package/CACHE/BiscuitOS-CACHE-IOREMAP-CHANGE-MEMTYPE/Kconfig

# RAM: Default
source package/CACHE/BiscuitOS-CACHE-RAM/Kconfig

# RAM: Direct-Mapping
source package/CACHE/BiscuitOS-CACHE-RAM-DIRECT-MAPPING/Kconfig

# RAM: DEVMEM
source package/CACHE/BiscuitOS-CACHE-RAM-DEVMEM/Kconfig

# RAM: DEVMEM with Page-Fault
source package/CACHE/BiscuitOS-CACHE-RAM-DEVMEM-PAGE-FAULT/Kconfig

# RAM: RSVDMEM
source package/CACHE/BiscuitOS-CACHE-RAM-RSVDMEM/Kconfig

# RAM: VMALLOC
source package/CACHE/BiscuitOS-CACHE-RAM-VMALLOC/Kconfig

# MMIO
source package/CACHE/BiscuitOS-CACHE-MMIO/Kconfig

# DEVMMIO
source package/CACHE/BiscuitOS-CACHE-DEVMMIO/Kconfig

# CACHE MODE Coherent: RSVDMEM
source package/CACHE/BiscuitOS-CACHE-MODE-COHERENT-RSVDMEM/Kconfig

# CACHE MODE Coherent: DEVMEM
source package/CACHE/BiscuitOS-CACHE-MODE-COHERENT-DEVMEM/Kconfig

# CACHE MODE Coherent: DEVMEM on PAGE Fault
source package/CACHE/BiscuitOS-CACHE-MODE-COHERENT-DEVMEM-PAGE-FAULT/Kconfig

# CACHE MODE Coherent: OSMEM
source package/CACHE/BiscuitOS-CACHE-MODE-COHERENT-OSMEM/Kconfig

# CACHE MODE Coherent: DEVMMIO
source package/CACHE/BiscuitOS-CACHE-MODE-COHERENT-DEVMMIO/Kconfig

# CACHE SCENE: IOVEC
source package/CACHE/BiscuitOS-CACHE-SCENE-IOVEC/Kconfig

# CACHE SCENE: IOVEC NOCACHE
source package/CACHE/BiscuitOS-CACHE-SCENE-IOVEC-NOCACHE/Kconfig

# CACHE SCENE: IOVEC NOCACHE and FLUSH CACHE
source package/CACHE/BiscuitOS-CACHE-SCENE-IOVEC-NOCACHE-FLUSH-CACHE/Kconfig

# CACHE SCENE: MEMCPY FLUSH CACHE
source package/CACHE/BiscuitOS-CACHE-SCENE-MEMCPY-FLUSH-CACHE/Kconfig

# CACHE SCENE: MEMCPY PAGE FLUSH CACHE
source package/CACHE/BiscuitOS-CACHE-SCENE-MEMCPY-PAGE-FLUSH-CACHE/Kconfig

# CACHE SCENE: copy_{from}_user
source package/CACHE/BiscuitOS-CACHE-SCENE-COPY-USER/Kconfig

# CACHE SCENE: copy_{from}_user Userspace
source package/CACHE/BiscuitOS-CACHE-SCENE-COPY-USER-USERSPACE/Kconfig

# CACHE SCENE: copy_{from}_user Flush CACHE
source package/CACHE/BiscuitOS-CACHE-SCENE-COPY-USER-FLUSH-CACHE/Kconfig

# CACHE SCENE: copy_{from}_user NOCACHE
source package/CACHE/BiscuitOS-CACHE-SCENE-COPY-USER-NOCACHE/Kconfig

# FLUSH CACHE: CLFLUSH on Userspace
source package/CACHE/BiscuitOS-CACHE-FLUSH-CACHE-CLFLUSH-USERSPACE/Kconfig

# FLUSH CACHE: WBINVD on Userspace
source package/CACHE/BiscuitOS-CACHE-FLUSH-CACHE-WBINVD-USERSPACE/Kconfig

# FLUSH CACHE: Flush for Alias
source package/CACHE/BiscuitOS-CACHE-FLUSH-CACHE-Alias/Kconfig

# FLUSH CACHE: Flush for DMA
source package/CACHE/BiscuitOS-CACHE-FLUSH-CACHE-DMA/Kconfig

# FLUSH CACHE: Flush for MOVNTI
source package/CACHE/BiscuitOS-CACHE-FLUSH-CACHE-MOVNTI/Kconfig

# FLUSH CACHE: Flush for THREAD
source package/CACHE/BiscuitOS-CACHE-FLUSH-CACHE-THREAD/Kconfig

# Page-Table
source package/CACHE/BiscuitOS-CACHE-PAGE-TABLE/Kconfig

# Page-Table: RSVDMEM 2MiB APP
source package/CACHE/BiscuitOS-CACHE-PAGE-TABLE-RSVDMEM-2M-APP/Kconfig

# Page-Table: RSVDMEM 2MiB
source package/CACHE/BiscuitOS-CACHE-PAGE-TABLE-RSVDMEM-2M/Kconfig

# Page-Table: RSVDMEM 1Gig APP
source package/CACHE/BiscuitOS-CACHE-PAGE-TABLE-RSVDMEM-1G-APP/Kconfig

# Page-Table: RSVDMEM 1Gig
source package/CACHE/BiscuitOS-CACHE-PAGE-TABLE-RSVDMEM-1G/Kconfig

# Allocator: PERMANENT
source package/CACHE/BiscuitOS-CACHE-ALLOC-PERMANENT/Kconfig

# Allocator: VMALLOC
source package/CACHE/BiscuitOS-CACHE-ALLOC-VMALLOC/Kconfig

# Allocator: EARLY IO/RSVDMEM
source package/CACHE/BiscuitOS-CACHE-ALLOC-EARLY-IORSVDMEM/Kconfig

# CPA
source package/CACHE/BiscuitOS-CACHE-CPA/Kconfig

endif # PK_CACHE
```

## package/CMA/CMA_app/Kconfig
```kconfig
menuconfig PK_CMA_APP
	select PK_CMA_MOD
	bool "CMA (Contiguous Memory Allocate) Application"

if PK_CMA_APP

config PK_CMA_APP_VERSION
	default "0.0.1"
	string "verstion"

config PK_CMA_APP_TAR
	default "tar.gz"
	string "tar type"

config PK_CMA_APP_URL
	default "https://gitee.com/BiscuitOS_team/HardStack/raw/Gitee/Device-Driver/CMA/Base/userland"
	string "url"

config PK_CMA_APP_GITHUB
	string "GitHub"

config PK_CMA_APP_SRCFILE
	default "cma.c cma.sh Makefile"
	string "Source code list"

config PK_CMA_APP_CSRCFILE
	string "Compile source code list"

config PK_CMA_APP_CONFIG
	string "CONFIG: Project Configure Options"

config PK_CMA_APP_LIBPATH
	string "LIBS: Libraries to pass to the linker, e.g. -l<library>"

config PK_CMA_APP_CPPFLAGS
	string "CPPFLAGS: C/C++ preprocessor flags, e.g. -I<include dir>"

config PK_CMA_APP_DPKCONFIG
	string "PKG_CONFIG_PATH: Directories to add to pkg-config's search path"

config PK_CMA_APP_CFLAGS
	string "CFLAGS: C compiler flags"

config PK_CMA_APP_LDFLAGS
	string "LDFLAGS: Linker flags"

config PK_CMA_APP_CXXFLAGS
	string "CXXFLAGS: C++ compiler flags"

config PK_CMA_APP_ASFLAGS
	string "CCASFLAGS: assembler compiler flags (defaults to CFLAGS)"

config PK_CMA_APP_BUILDARCH
	string "--host options on configure for Architecture"

endif # PK_CMA_APP
```

## package/CMA/CMA_debris_app/Kconfig
```kconfig
menuconfig PK_CMA_DEBRIS_APP
	select PK_CMA_DEBRIS_MOD
	bool "CMA Debris issue Application"

if PK_CMA_DEBRIS_APP

config PK_CMA_DEBRIS_APP_VERSION
	default "0.0.1"
	string "verstion"

config PK_CMA_DEBRIS_APP_TAR
	default "tar.gz"
	string "tar type"

config PK_CMA_DEBRIS_APP_URL
	default "https://gitee.com/BiscuitOS_team/HardStack/raw/Gitee/Device-Driver/CMA/Debris/userland"
	string "url"

config PK_CMA_DEBRIS_APP_GITHUB
	string "GitHub"

config PK_CMA_DEBRIS_APP_SRCFILE
	default "cma.c cma.sh Makefile"
	string "Source code list"

config PK_CMA_DEBRIS_APP_CSRCFILE
	string "Compile source code list"

config PK_CMA_DEBRIS_APP_CONFIG
	string "CONFIG: Project Configure Options"

config PK_CMA_DEBRIS_APP_LIBPATH
	string "LIBS: Libraries to pass to the linker, e.g. -l<library>"

config PK_CMA_DEBRIS_APP_CPPFLAGS
	string "CPPFLAGS: C/C++ preprocessor flags, e.g. -I<include dir>"

config PK_CMA_DEBRIS_APP_DPKCONFIG
	string "PKG_CONFIG_PATH: Directories to add to pkg-config's search path"

config PK_CMA_DEBRIS_APP_CFLAGS
	string "CFLAGS: C compiler flags"

config PK_CMA_DEBRIS_APP_LDFLAGS
	string "LDFLAGS: Linker flags"

config PK_CMA_DEBRIS_APP_CXXFLAGS
	string "CXXFLAGS: C++ compiler flags"

config PK_CMA_DEBRIS_APP_ASFLAGS
	string "CCASFLAGS: assembler compiler flags (defaults to CFLAGS)"

config PK_CMA_DEBRIS_APP_BUILDARCH
	string "--host options on configure for Architecture"

endif # PK_CMA_DEBRIS_APP
```

## package/CMA/CMA_debris_long_app/Kconfig
```kconfig
menuconfig PK_CMA_DEBRIS_LONG_APP
	select PK_CMA_DEBRIS_LONG_MOD
	bool "CMA Debris: Keep valid length for allocating Application"

if PK_CMA_DEBRIS_LONG_APP

config PK_CMA_DEBRIS_LONG_APP_VERSION
	default "0.0.1"
	string "verstion"

config PK_CMA_DEBRIS_LONG_APP_TAR
	default "tar.gz"
	string "tar type"

config PK_CMA_DEBRIS_LONG_APP_URL
	default "https://gitee.com/BiscuitOS_team/HardStack/raw/Gitee/Device-Driver/CMA/Debris_long/userland"
	string "url"

config PK_CMA_DEBRIS_LONG_APP_GITHUB
	string "GitHub"

config PK_CMA_DEBRIS_LONG_APP_SRCFILE
	default "cma.c cma.sh Makefile"
	string "Source code list"

config PK_CMA_DEBRIS_LONG_APP_CSRCFILE
	string "Compile source code list"

config PK_CMA_DEBRIS_LONG_APP_CONFIG
	string "CONFIG: Project Configure Options"

config PK_CMA_DEBRIS_LONG_APP_LIBPATH
	string "LIBS: Libraries to pass to the linker, e.g. -l<library>"

config PK_CMA_DEBRIS_LONG_APP_CPPFLAGS
	string "CPPFLAGS: C/C++ preprocessor flags, e.g. -I<include dir>"

config PK_CMA_DEBRIS_LONG_APP_DPKCONFIG
	string "PKG_CONFIG_PATH: Directories to add to pkg-config's search path"

config PK_CMA_DEBRIS_LONG_APP_CFLAGS
	string "CFLAGS: C compiler flags"

config PK_CMA_DEBRIS_LONG_APP_LDFLAGS
	string "LDFLAGS: Linker flags"

config PK_CMA_DEBRIS_LONG_APP_CXXFLAGS
	string "CXXFLAGS: C++ compiler flags"

config PK_CMA_DEBRIS_LONG_APP_ASFLAGS
	string "CCASFLAGS: assembler compiler flags (defaults to CFLAGS)"

config PK_CMA_DEBRIS_LONG_APP_BUILDARCH
	string "--host options on configure for Architecture"

endif # PK_CMA_DEBRIS_LONG_APP
```
