## package/CACHE/BiscuitOS-CACHE-TOOLS-PAPI/Kconfig
```kconfig
menuconfig PK_CACHE_TOOLS_PAPI
	bool "Analysis/Diagnosis Tools: PAPI"

if PK_CACHE_TOOLS_PAPI

config PK_CACHE_TOOLS_PAPI_VERSION
	default "default"
	string "verstion"

config PK_CACHE_TOOLS_PAPI_TAR
	default "tar.gz"
	string "tar type"

config PK_CACHE_TOOLS_PAPI_URL
	default "https://gitee.com/BiscuitOS_team/HardStack/raw/Gitee/Memory-Allocator/CACHE-MECH/BiscuitOS-CACHE-TOOLS-PAPI"
	string "url"

config PK_CACHE_TOOLS_PAPI_GITHUB
	string "GitHub"

config PK_CACHE_TOOLS_PAPI_SRCFILE
	default "main.c Makefile"
	string "Source code list"

config PK_CACHE_TOOLS_PAPI_CSRCFILE
	string "Compile source code list"

config PK_CACHE_TOOLS_PAPI_CONFIG
	string "CONFIG: Project Configure Options"

config PK_CACHE_TOOLS_PAPI_LIBPATH
	string "LIBS: Libraries to pass to the linker, e.g. -l<library>"

config PK_CACHE_TOOLS_PAPI_CPPFLAGS
	string "CPPFLAGS: C/C++ preprocessor flags, e.g. -I<include dir>"

config PK_CACHE_TOOLS_PAPI_DPKCONFIG
	string "PKG_CONFIG_PATH: Directories to add to pkg-config's search path"

config PK_CACHE_TOOLS_PAPI_CFLAGS
	string "CFLAGS: C compiler flags"

config PK_CACHE_TOOLS_PAPI_LDFLAGS
	string "LDFLAGS: Linker flags"

config PK_CACHE_TOOLS_PAPI_CXXFLAGS
	string "CXXFLAGS: C++ compiler flags"

config PK_CACHE_TOOLS_PAPI_ASFLAGS
	string "CCASFLAGS: assembler compiler flags (defaults to CFLAGS)"

config PK_CACHE_TOOLS_PAPI_BUILDARCH
	string "--host options on configure for Architecture"

endif # PK_CACHE_TOOLS_PAPI
```

## package/CACHE/BiscuitOS-CACHE-TOOLS-PERF/Kconfig
```kconfig
menuconfig PK_CACHE_TOOLS_PERF
	select PK_LINUX_PERF
	bool "Analysis/Diagnosis Tools: Perf"

if PK_CACHE_TOOLS_PERF

config PK_CACHE_TOOLS_PERF_VERSION
	default "default"
	string "verstion"

config PK_CACHE_TOOLS_PERF_TAR
	default "tar.gz"
	string "tar type"

config PK_CACHE_TOOLS_PERF_URL
	default "https://gitee.com/BiscuitOS_team/HardStack/raw/Gitee/Memory-Allocator/CACHE-MECH/BiscuitOS-CACHE-TOOLS-PERF"
	string "url"

config PK_CACHE_TOOLS_PERF_GITHUB
	string "GitHub"

config PK_CACHE_TOOLS_PERF_SRCFILE
	default "main-A.c main-B.c Makefile"
	string "Source code list"

config PK_CACHE_TOOLS_PERF_CSRCFILE
	string "Compile source code list"

config PK_CACHE_TOOLS_PERF_CONFIG
	string "CONFIG: Project Configure Options"

config PK_CACHE_TOOLS_PERF_LIBPATH
	string "LIBS: Libraries to pass to the linker, e.g. -l<library>"

config PK_CACHE_TOOLS_PERF_CPPFLAGS
	string "CPPFLAGS: C/C++ preprocessor flags, e.g. -I<include dir>"

config PK_CACHE_TOOLS_PERF_DPKCONFIG
	string "PKG_CONFIG_PATH: Directories to add to pkg-config's search path"

config PK_CACHE_TOOLS_PERF_CFLAGS
	string "CFLAGS: C compiler flags"

config PK_CACHE_TOOLS_PERF_LDFLAGS
	string "LDFLAGS: Linker flags"

config PK_CACHE_TOOLS_PERF_CXXFLAGS
	string "CXXFLAGS: C++ compiler flags"

config PK_CACHE_TOOLS_PERF_ASFLAGS
	string "CCASFLAGS: assembler compiler flags (defaults to CFLAGS)"

config PK_CACHE_TOOLS_PERF_BUILDARCH
	string "--host options on configure for Architecture"

endif # PK_CACHE_TOOLS_PERF
```

## package/CACHE/BiscuitOS-CACHE-TOOLS-VALGRIND/Kconfig
```kconfig
menuconfig PK_CACHE_TOOLS_VALGRIND
	bool "Analysis/Diagnosis Tools: Valgrind"

if PK_CACHE_TOOLS_VALGRIND

config PK_CACHE_TOOLS_VALGRIND_VERSION
	default "default"
	string "verstion"

config PK_CACHE_TOOLS_VALGRIND_TAR
	default "tar.gz"
	string "tar type"

config PK_CACHE_TOOLS_VALGRIND_URL
	default "https://gitee.com/BiscuitOS_team/HardStack/raw/Gitee/Memory-Allocator/CACHE-MECH/BiscuitOS-CACHE-TOOLS-VALGRIND"
	string "url"

config PK_CACHE_TOOLS_VALGRIND_GITHUB
	string "GitHub"

config PK_CACHE_TOOLS_VALGRIND_SRCFILE
	default "main-A.c main-B.c Makefile"
	string "Source code list"

config PK_CACHE_TOOLS_VALGRIND_CSRCFILE
	string "Compile source code list"

config PK_CACHE_TOOLS_VALGRIND_CONFIG
	string "CONFIG: Project Configure Options"

config PK_CACHE_TOOLS_VALGRIND_LIBPATH
	string "LIBS: Libraries to pass to the linker, e.g. -l<library>"

config PK_CACHE_TOOLS_VALGRIND_CPPFLAGS
	string "CPPFLAGS: C/C++ preprocessor flags, e.g. -I<include dir>"

config PK_CACHE_TOOLS_VALGRIND_DPKCONFIG
	string "PKG_CONFIG_PATH: Directories to add to pkg-config's search path"

config PK_CACHE_TOOLS_VALGRIND_CFLAGS
	string "CFLAGS: C compiler flags"

config PK_CACHE_TOOLS_VALGRIND_LDFLAGS
	string "LDFLAGS: Linker flags"

config PK_CACHE_TOOLS_VALGRIND_CXXFLAGS
	string "CXXFLAGS: C++ compiler flags"

config PK_CACHE_TOOLS_VALGRIND_ASFLAGS
	string "CCASFLAGS: assembler compiler flags (defaults to CFLAGS)"

config PK_CACHE_TOOLS_VALGRIND_BUILDARCH
	string "--host options on configure for Architecture"

endif # PK_CACHE_TOOLS_VALGRIND
```

## package/CACHE/BiscuitOS-CACHE-UNCACHE-IOREMAP-with-MEM/Kconfig
```kconfig
menuconfig PK_CACHE_UC_IOREMAP_MEM
	bool "UNCACHE(UC):  ioremap_uc() with MEM on Kernel"

if PK_CACHE_UC_IOREMAP_MEM

config PK_CACHE_UC_IOREMAP_MEM_VERSION
	default "default"
	string "verstion"

config PK_CACHE_UC_IOREMAP_MEM_TAR
	default "tar.gz"
	string "tar type"

config PK_CACHE_UC_IOREMAP_MEM_URL
	default "https://gitee.com/BiscuitOS_team/HardStack/raw/Gitee/Memory-Allocator/CACHE-MECH/BiscuitOS-CACHE-UNCACHE-IOREMAP-with-MEM"
	string "url"

config PK_CACHE_UC_IOREMAP_MEM_GITHUB
	string "GitHub"

config PK_CACHE_UC_IOREMAP_MEM_SRCFILE
	default "main.c Kconfig Makefile Makefile.host RunBiscuitOS.sh"
	string "Source code list"

config PK_CACHE_UC_IOREMAP_MEM_CSRCFILE
	string "Compile source code list"

config PK_CACHE_UC_IOREMAP_MEM_CONFIG
	string "CONFIG: Project Configure Options"

config PK_CACHE_UC_IOREMAP_MEM_LIBPATH
	string "LIBS: Libraries to pass to the linker, e.g. -l<library>"

config PK_CACHE_UC_IOREMAP_MEM_CPPFLAGS
	string "CPPFLAGS: C/C++ preprocessor flags, e.g. -I<include dir>"

config PK_CACHE_UC_IOREMAP_MEM_DPKCONFIG
	string "PKG_CONFIG_PATH: Directories to add to pkg-config's search path"

config PK_CACHE_UC_IOREMAP_MEM_CFLAGS
	string "CFLAGS: C compiler flags"

config PK_CACHE_UC_IOREMAP_MEM_LDFLAGS
	string "LDFLAGS: Linker flags"

config PK_CACHE_UC_IOREMAP_MEM_CXXFLAGS
	string "CXXFLAGS: C++ compiler flags"

config PK_CACHE_UC_IOREMAP_MEM_ASFLAGS
	string "CCASFLAGS: assembler compiler flags (defaults to CFLAGS)"

config PK_CACHE_UC_IOREMAP_MEM_BUILDARCH
	string "--host options on configure for Architecture"

endif # PK_CACHE_UC_IOREMAP_MEM
```

## package/CACHE/BiscuitOS-CACHE-UNCACHE-MEM-KERNEL/Kconfig
```kconfig
menuconfig PK_CACHE_UC_MEM_K
	bool "UNCACHE(UC): Mapping UC Memory on Kernel"

if PK_CACHE_UC_MEM_K

config PK_CACHE_UC_MEM_K_VERSION
	default "default"
	string "verstion"

config PK_CACHE_UC_MEM_K_TAR
	default "tar.gz"
	string "tar type"

config PK_CACHE_UC_MEM_K_URL
	default "https://gitee.com/BiscuitOS_team/HardStack/raw/Gitee/Memory-Allocator/CACHE-MECH/BiscuitOS-CACHE-UNCACHE-MEM-KERNEL"
	string "url"

config PK_CACHE_UC_MEM_K_GITHUB
	string "GitHub"

config PK_CACHE_UC_MEM_K_SRCFILE
	default "main.c Kconfig Makefile 000-set_memory_ucx.patch"
	string "Source code list"

config PK_CACHE_UC_MEM_K_CSRCFILE
	string "Compile source code list"

config PK_CACHE_UC_MEM_K_CONFIG
	string "CONFIG: Project Configure Options"

config PK_CACHE_UC_MEM_K_LIBPATH
	string "LIBS: Libraries to pass to the linker, e.g. -l<library>"

config PK_CACHE_UC_MEM_K_CPPFLAGS
	string "CPPFLAGS: C/C++ preprocessor flags, e.g. -I<include dir>"

config PK_CACHE_UC_MEM_K_DPKCONFIG
	string "PKG_CONFIG_PATH: Directories to add to pkg-config's search path"

config PK_CACHE_UC_MEM_K_CFLAGS
	string "CFLAGS: C compiler flags"

config PK_CACHE_UC_MEM_K_LDFLAGS
	string "LDFLAGS: Linker flags"

config PK_CACHE_UC_MEM_K_CXXFLAGS
	string "CXXFLAGS: C++ compiler flags"

config PK_CACHE_UC_MEM_K_ASFLAGS
	string "CCASFLAGS: assembler compiler flags (defaults to CFLAGS)"

config PK_CACHE_UC_MEM_K_BUILDARCH
	string "--host options on configure for Architecture"

endif # PK_CACHE_UC_MEM_K
```

## package/CACHE/BiscuitOS-CACHE-UNCACHED-IOREMAP-with-MMIO/Kconfig
```kconfig
menuconfig PK_CACHE_UCD_IOREMAP_MMIO
	bool "UNCACHE(UC-): ioremap() with MMIO on Kernel"

if PK_CACHE_UCD_IOREMAP_MMIO

config PK_CACHE_UCD_IOREMAP_MMIO_VERSION
	default "default"
	string "verstion"

config PK_CACHE_UCD_IOREMAP_MMIO_TAR
	default "tar.gz"
	string "tar type"

config PK_CACHE_UCD_IOREMAP_MMIO_URL
	default "https://gitee.com/BiscuitOS_team/HardStack/raw/Gitee/Memory-Allocator/CACHE-MECH/BiscuitOS-CACHE-UNCACHED-IOREMAP-with-MMIO"
	string "url"

config PK_CACHE_UCD_IOREMAP_MMIO_GITHUB
	string "GitHub"

config PK_CACHE_UCD_IOREMAP_MMIO_SRCFILE
	default "main.c Kconfig Makefile Makefile.host RunBiscuitOS.sh"
	string "Source code list"

config PK_CACHE_UCD_IOREMAP_MMIO_CSRCFILE
	string "Compile source code list"

config PK_CACHE_UCD_IOREMAP_MMIO_CONFIG
	string "CONFIG: Project Configure Options"

config PK_CACHE_UCD_IOREMAP_MMIO_LIBPATH
	string "LIBS: Libraries to pass to the linker, e.g. -l<library>"

config PK_CACHE_UCD_IOREMAP_MMIO_CPPFLAGS
	string "CPPFLAGS: C/C++ preprocessor flags, e.g. -I<include dir>"

config PK_CACHE_UCD_IOREMAP_MMIO_DPKCONFIG
	string "PKG_CONFIG_PATH: Directories to add to pkg-config's search path"

config PK_CACHE_UCD_IOREMAP_MMIO_CFLAGS
	string "CFLAGS: C compiler flags"

config PK_CACHE_UCD_IOREMAP_MMIO_LDFLAGS
	string "LDFLAGS: Linker flags"

config PK_CACHE_UCD_IOREMAP_MMIO_CXXFLAGS
	string "CXXFLAGS: C++ compiler flags"

config PK_CACHE_UCD_IOREMAP_MMIO_ASFLAGS
	string "CCASFLAGS: assembler compiler flags (defaults to CFLAGS)"

config PK_CACHE_UCD_IOREMAP_MMIO_BUILDARCH
	string "--host options on configure for Architecture"

endif # PK_CACHE_UCD_IOREMAP_MMIO
```

## package/CACHE/BiscuitOS-CACHE-UNCACHED-MMIO-KERNEL/Kconfig
```kconfig
menuconfig PK_CACHE_UCD_MMIO_K
	bool "UNCACHED(UC-): Mapping UC- MMIO on Kernel"

if PK_CACHE_UCD_MMIO_K

config PK_CACHE_UCD_MMIO_K_VERSION
	default "default"
	string "verstion"

config PK_CACHE_UCD_MMIO_K_TAR
	default "tar.gz"
	string "tar type"

config PK_CACHE_UCD_MMIO_K_URL
	default "https://gitee.com/BiscuitOS_team/HardStack/raw/Gitee/Memory-Allocator/CACHE-MECH/BiscuitOS-CACHE-UNCACHED-MMIO-KERNEL"
	string "url"

config PK_CACHE_UCD_MMIO_K_GITHUB
	string "GitHub"

config PK_CACHE_UCD_MMIO_K_SRCFILE
	default "main.c Kconfig Makefile Makefile.host RunBiscuitOS.sh"
	string "Source code list"

config PK_CACHE_UCD_MMIO_K_CSRCFILE
	string "Compile source code list"

config PK_CACHE_UCD_MMIO_K_CONFIG
	string "CONFIG: Project Configure Options"

config PK_CACHE_UCD_MMIO_K_LIBPATH
	string "LIBS: Libraries to pass to the linker, e.g. -l<library>"

config PK_CACHE_UCD_MMIO_K_CPPFLAGS
	string "CPPFLAGS: C/C++ preprocessor flags, e.g. -I<include dir>"

config PK_CACHE_UCD_MMIO_K_DPKCONFIG
	string "PKG_CONFIG_PATH: Directories to add to pkg-config's search path"

config PK_CACHE_UCD_MMIO_K_CFLAGS
	string "CFLAGS: C compiler flags"

config PK_CACHE_UCD_MMIO_K_LDFLAGS
	string "LDFLAGS: Linker flags"

config PK_CACHE_UCD_MMIO_K_CXXFLAGS
	string "CXXFLAGS: C++ compiler flags"

config PK_CACHE_UCD_MMIO_K_ASFLAGS
	string "CCASFLAGS: assembler compiler flags (defaults to CFLAGS)"

config PK_CACHE_UCD_MMIO_K_BUILDARCH
	string "--host options on configure for Architecture"

endif # PK_CACHE_UCD_MMIO_K
```

## package/CACHE/BiscuitOS-CACHE-USER-PAGE-USERSPACE/Kconfig
```kconfig
menuconfig PK_CACHE_USER_PAGE_USERSPACE
	select PK_CACHE_USER_PAGE_KERNEL_STUB
	bool "CACHE Memory into Userspace (Recommand)"

if PK_CACHE_USER_PAGE_USERSPACE

config PK_CACHE_USER_PAGE_USERSPACE_VERSION
	default "default"
	string "verstion"

config PK_CACHE_USER_PAGE_USERSPACE_TAR
	default "tar.gz"
	string "tar type"

config PK_CACHE_USER_PAGE_USERSPACE_URL
	default "https://gitee.com/BiscuitOS_team/HardStack/raw/Gitee/Memory-Allocator/CACHE-MECH/BiscuitOS-CACHE-USER-PAGE-USERSPACE"
	string "url"

config PK_CACHE_USER_PAGE_USERSPACE_GITHUB
	string "GitHub"

config PK_CACHE_USER_PAGE_USERSPACE_SRCFILE
	default "main.c Makefile"
	string "Source code list"

config PK_CACHE_USER_PAGE_USERSPACE_CSRCFILE
	string "Compile source code list"

config PK_CACHE_USER_PAGE_USERSPACE_CONFIG
	string "CONFIG: Project Configure Options"

config PK_CACHE_USER_PAGE_USERSPACE_LIBPATH
	string "LIBS: Libraries to pass to the linker, e.g. -l<library>"

config PK_CACHE_USER_PAGE_USERSPACE_CPPFLAGS
	string "CPPFLAGS: C/C++ preprocessor flags, e.g. -I<include dir>"

config PK_CACHE_USER_PAGE_USERSPACE_DPKCONFIG
	string "PKG_CONFIG_PATH: Directories to add to pkg-config's search path"

config PK_CACHE_USER_PAGE_USERSPACE_CFLAGS
	string "CFLAGS: C compiler flags"

config PK_CACHE_USER_PAGE_USERSPACE_LDFLAGS
	string "LDFLAGS: Linker flags"

config PK_CACHE_USER_PAGE_USERSPACE_CXXFLAGS
	string "CXXFLAGS: C++ compiler flags"

config PK_CACHE_USER_PAGE_USERSPACE_ASFLAGS
	string "CCASFLAGS: assembler compiler flags (defaults to CFLAGS)"

config PK_CACHE_USER_PAGE_USERSPACE_BUILDARCH
	string "--host options on configure for Architecture"

endif # PK_CACHE_USER_PAGE_USERSPACE
```

## package/CACHE/BiscuitOS-CACHE-WB-MEM-USERSPACE/Kconfig
```kconfig
menuconfig PK_CACHE_WB_MEM_U
	select PK_CACHE_USER_PAGE_KERNEL_STUB
	bool "WriteBack(WB): Mapping WB Memory on Userspace"

if PK_CACHE_WB_MEM_U

config PK_CACHE_WB_MEM_U_VERSION
	default "default"
	string "verstion"

config PK_CACHE_WB_MEM_U_TAR
	default "tar.gz"
	string "tar type"

config PK_CACHE_WB_MEM_U_URL
	default "https://gitee.com/BiscuitOS_team/HardStack/raw/Gitee/Memory-Allocator/CACHE-MECH/BiscuitOS-CACHE-WB-MEM-USERSPACE"
	string "url"

config PK_CACHE_WB_MEM_U_GITHUB
	string "GitHub"

config PK_CACHE_WB_MEM_U_SRCFILE
	default "main.c Makefile"
	string "Source code list"

config PK_CACHE_WB_MEM_U_CSRCFILE
	string "Compile source code list"

config PK_CACHE_WB_MEM_U_CONFIG
	string "CONFIG: Project Configure Options"

config PK_CACHE_WB_MEM_U_LIBPATH
	string "LIBS: Libraries to pass to the linker, e.g. -l<library>"

config PK_CACHE_WB_MEM_U_CPPFLAGS
	string "CPPFLAGS: C/C++ preprocessor flags, e.g. -I<include dir>"

config PK_CACHE_WB_MEM_U_DPKCONFIG
	string "PKG_CONFIG_PATH: Directories to add to pkg-config's search path"

config PK_CACHE_WB_MEM_U_CFLAGS
	string "CFLAGS: C compiler flags"

config PK_CACHE_WB_MEM_U_LDFLAGS
	string "LDFLAGS: Linker flags"

config PK_CACHE_WB_MEM_U_CXXFLAGS
	string "CXXFLAGS: C++ compiler flags"

config PK_CACHE_WB_MEM_U_ASFLAGS
	string "CCASFLAGS: assembler compiler flags (defaults to CFLAGS)"

config PK_CACHE_WB_MEM_U_BUILDARCH
	string "--host options on configure for Architecture"

endif # PK_CACHE_WB_MEM_U
```
