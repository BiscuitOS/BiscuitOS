## package/CACHE/BiscuitOS-CACHE-SCENE-COPY-USER-NOCACHE/Kconfig
```kconfig
menuconfig PK_CACHE_SCENE_COPY_USER_NC
	bool "CACHE SCENE: copy_{from}_user NOCACHE"

if PK_CACHE_SCENE_COPY_USER_NC

config PK_CACHE_SCENE_COPY_USER_NC_VERSION
	default "default"
	string "verstion"

config PK_CACHE_SCENE_COPY_USER_NC_TAR
	default "tar.gz"
	string "tar type"

config PK_CACHE_SCENE_COPY_USER_NC_URL
	default "https://gitee.com/BiscuitOS_team/HardStack/raw/Gitee/Memory-Allocator/CACHE-MECH/BiscuitOS-CACHE-SCENE-COPY-USER-NOCACHE"
	string "url"

config PK_CACHE_SCENE_COPY_USER_NC_GITHUB
	string "GitHub"

config PK_CACHE_SCENE_COPY_USER_NC_SRCFILE
	default "app.c main.c Kconfig Makefile Makefile.host RunBiscuitOS.sh"
	string "Source code list"

config PK_CACHE_SCENE_COPY_USER_NC_CSRCFILE
	string "Compile source code list"

config PK_CACHE_SCENE_COPY_USER_NC_CONFIG
	string "CONFIG: Project Configure Options"

config PK_CACHE_SCENE_COPY_USER_NC_LIBPATH
	string "LIBS: Libraries to pass to the linker, e.g. -l<library>"

config PK_CACHE_SCENE_COPY_USER_NC_CPPFLAGS
	string "CPPFLAGS: C/C++ preprocessor flags, e.g. -I<include dir>"

config PK_CACHE_SCENE_COPY_USER_NC_DPKCONFIG
	string "PKG_CONFIG_PATH: Directories to add to pkg-config's search path"

config PK_CACHE_SCENE_COPY_USER_NC_CFLAGS
	string "CFLAGS: C compiler flags"

config PK_CACHE_SCENE_COPY_USER_NC_LDFLAGS
	string "LDFLAGS: Linker flags"

config PK_CACHE_SCENE_COPY_USER_NC_CXXFLAGS
	string "CXXFLAGS: C++ compiler flags"

config PK_CACHE_SCENE_COPY_USER_NC_ASFLAGS
	string "CCASFLAGS: assembler compiler flags (defaults to CFLAGS)"

config PK_CACHE_SCENE_COPY_USER_NC_BUILDARCH
	string "--host options on configure for Architecture"

endif # PK_CACHE_SCENE_COPY_USER_NC
```

## package/CACHE/BiscuitOS-CACHE-SCENE-COPY-USER-USERSPACE/Kconfig
```kconfig
menuconfig PK_CACHE_SCENE_COPY_USER_U
	select PK_CACHE_SCENE_COPY_USER_FC
	bool "CACHE SCENE: copy_{from}_user Userspace"

if PK_CACHE_SCENE_COPY_USER_U

config PK_CACHE_SCENE_COPY_USER_U_VERSION
	default "default"
	string "verstion"

config PK_CACHE_SCENE_COPY_USER_U_TAR
	default "tar.gz"
	string "tar type"

config PK_CACHE_SCENE_COPY_USER_U_URL
	default "https://gitee.com/BiscuitOS_team/HardStack/raw/Gitee/Memory-Allocator/CACHE-MECH/BiscuitOS-CACHE-SCENE-COPY-USER-USERSPACE"
	string "url"

config PK_CACHE_SCENE_COPY_USER_U_GITHUB
	string "GitHub"

config PK_CACHE_SCENE_COPY_USER_U_SRCFILE
	default "main.c Makefile"
	string "Source code list"

config PK_CACHE_SCENE_COPY_USER_U_CSRCFILE
	string "Compile source code list"

config PK_CACHE_SCENE_COPY_USER_U_CONFIG
	string "CONFIG: Project Configure Options"

config PK_CACHE_SCENE_COPY_USER_U_LIBPATH
	string "LIBS: Libraries to pass to the linker, e.g. -l<library>"

config PK_CACHE_SCENE_COPY_USER_U_CPPFLAGS
	string "CPPFLAGS: C/C++ preprocessor flags, e.g. -I<include dir>"

config PK_CACHE_SCENE_COPY_USER_U_DPKCONFIG
	string "PKG_CONFIG_PATH: Directories to add to pkg-config's search path"

config PK_CACHE_SCENE_COPY_USER_U_CFLAGS
	string "CFLAGS: C compiler flags"

config PK_CACHE_SCENE_COPY_USER_U_LDFLAGS
	string "LDFLAGS: Linker flags"

config PK_CACHE_SCENE_COPY_USER_U_CXXFLAGS
	string "CXXFLAGS: C++ compiler flags"

config PK_CACHE_SCENE_COPY_USER_U_ASFLAGS
	string "CCASFLAGS: assembler compiler flags (defaults to CFLAGS)"

config PK_CACHE_SCENE_COPY_USER_U_BUILDARCH
	string "--host options on configure for Architecture"

endif # PK_CACHE_SCENE_COPY_USER_U
```

## package/CACHE/BiscuitOS-CACHE-SCENE-COPY-USER/Kconfig
```kconfig
menuconfig PK_CACHE_SCENE_COPY_USER
	bool "CACHE SCENE: copy_{from}_user [Default]"

if PK_CACHE_SCENE_COPY_USER

config PK_CACHE_SCENE_COPY_USER_VERSION
	default "default"
	string "verstion"

config PK_CACHE_SCENE_COPY_USER_TAR
	default "tar.gz"
	string "tar type"

config PK_CACHE_SCENE_COPY_USER_URL
	default "https://gitee.com/BiscuitOS_team/HardStack/raw/Gitee/Memory-Allocator/CACHE-MECH/BiscuitOS-CACHE-SCENE-COPY-USER"
	string "url"

config PK_CACHE_SCENE_COPY_USER_GITHUB
	string "GitHub"

config PK_CACHE_SCENE_COPY_USER_SRCFILE
	default "app.c main.c Kconfig Makefile Makefile.host RunBiscuitOS.sh"
	string "Source code list"

config PK_CACHE_SCENE_COPY_USER_CSRCFILE
	string "Compile source code list"

config PK_CACHE_SCENE_COPY_USER_CONFIG
	string "CONFIG: Project Configure Options"

config PK_CACHE_SCENE_COPY_USER_LIBPATH
	string "LIBS: Libraries to pass to the linker, e.g. -l<library>"

config PK_CACHE_SCENE_COPY_USER_CPPFLAGS
	string "CPPFLAGS: C/C++ preprocessor flags, e.g. -I<include dir>"

config PK_CACHE_SCENE_COPY_USER_DPKCONFIG
	string "PKG_CONFIG_PATH: Directories to add to pkg-config's search path"

config PK_CACHE_SCENE_COPY_USER_CFLAGS
	string "CFLAGS: C compiler flags"

config PK_CACHE_SCENE_COPY_USER_LDFLAGS
	string "LDFLAGS: Linker flags"

config PK_CACHE_SCENE_COPY_USER_CXXFLAGS
	string "CXXFLAGS: C++ compiler flags"

config PK_CACHE_SCENE_COPY_USER_ASFLAGS
	string "CCASFLAGS: assembler compiler flags (defaults to CFLAGS)"

config PK_CACHE_SCENE_COPY_USER_BUILDARCH
	string "--host options on configure for Architecture"

endif # PK_CACHE_SCENE_COPY_USER
```

## package/CACHE/BiscuitOS-CACHE-SCENE-IOVEC-NOCACHE/Kconfig
```kconfig
menuconfig PK_CACHE_SCENE_IOVEC_NOCACHE
	bool "CACHE SCENE: IOVEC NOCACHE Copy Data from Userspcae"

if PK_CACHE_SCENE_IOVEC_NOCACHE

config PK_CACHE_SCENE_IOVEC_NOCACHE_VERSION
	default "default"
	string "verstion"

config PK_CACHE_SCENE_IOVEC_NOCACHE_TAR
	default "tar.gz"
	string "tar type"

config PK_CACHE_SCENE_IOVEC_NOCACHE_URL
	default "https://gitee.com/BiscuitOS_team/HardStack/raw/Gitee/Memory-Allocator/CACHE-MECH/BiscuitOS-CACHE-SCENE-IOVEC-NOCACHE"
	string "url"

config PK_CACHE_SCENE_IOVEC_NOCACHE_GITHUB
	string "GitHub"

config PK_CACHE_SCENE_IOVEC_NOCACHE_SRCFILE
	default "app.c main.c Kconfig Makefile Makefile.host RunBiscuitOS.sh"
	string "Source code list"

config PK_CACHE_SCENE_IOVEC_NOCACHE_CSRCFILE
	string "Compile source code list"

config PK_CACHE_SCENE_IOVEC_NOCACHE_CONFIG
	string "CONFIG: Project Configure Options"

config PK_CACHE_SCENE_IOVEC_NOCACHE_LIBPATH
	string "LIBS: Libraries to pass to the linker, e.g. -l<library>"

config PK_CACHE_SCENE_IOVEC_NOCACHE_CPPFLAGS
	string "CPPFLAGS: C/C++ preprocessor flags, e.g. -I<include dir>"

config PK_CACHE_SCENE_IOVEC_NOCACHE_DPKCONFIG
	string "PKG_CONFIG_PATH: Directories to add to pkg-config's search path"

config PK_CACHE_SCENE_IOVEC_NOCACHE_CFLAGS
	string "CFLAGS: C compiler flags"

config PK_CACHE_SCENE_IOVEC_NOCACHE_LDFLAGS
	string "LDFLAGS: Linker flags"

config PK_CACHE_SCENE_IOVEC_NOCACHE_CXXFLAGS
	string "CXXFLAGS: C++ compiler flags"

config PK_CACHE_SCENE_IOVEC_NOCACHE_ASFLAGS
	string "CCASFLAGS: assembler compiler flags (defaults to CFLAGS)"

config PK_CACHE_SCENE_IOVEC_NOCACHE_BUILDARCH
	string "--host options on configure for Architecture"

endif # PK_CACHE_SCENE_IOVEC_NOCACHE
```

## package/CACHE/BiscuitOS-CACHE-SCENE-IOVEC/Kconfig
```kconfig
menuconfig PK_CACHE_SCENE_IOVEC
	bool "CACHE SCENE: IOVEC Copy Data from Userspcae[Default]"

if PK_CACHE_SCENE_IOVEC

config PK_CACHE_SCENE_IOVEC_VERSION
	default "default"
	string "verstion"

config PK_CACHE_SCENE_IOVEC_TAR
	default "tar.gz"
	string "tar type"

config PK_CACHE_SCENE_IOVEC_URL
	default "https://gitee.com/BiscuitOS_team/HardStack/raw/Gitee/Memory-Allocator/CACHE-MECH/BiscuitOS-CACHE-SCENE-IOVEC"
	string "url"

config PK_CACHE_SCENE_IOVEC_GITHUB
	string "GitHub"

config PK_CACHE_SCENE_IOVEC_SRCFILE
	default "app.c main.c Kconfig Makefile Makefile.host RunBiscuitOS.sh"
	string "Source code list"

config PK_CACHE_SCENE_IOVEC_CSRCFILE
	string "Compile source code list"

config PK_CACHE_SCENE_IOVEC_CONFIG
	string "CONFIG: Project Configure Options"

config PK_CACHE_SCENE_IOVEC_LIBPATH
	string "LIBS: Libraries to pass to the linker, e.g. -l<library>"

config PK_CACHE_SCENE_IOVEC_CPPFLAGS
	string "CPPFLAGS: C/C++ preprocessor flags, e.g. -I<include dir>"

config PK_CACHE_SCENE_IOVEC_DPKCONFIG
	string "PKG_CONFIG_PATH: Directories to add to pkg-config's search path"

config PK_CACHE_SCENE_IOVEC_CFLAGS
	string "CFLAGS: C compiler flags"

config PK_CACHE_SCENE_IOVEC_LDFLAGS
	string "LDFLAGS: Linker flags"

config PK_CACHE_SCENE_IOVEC_CXXFLAGS
	string "CXXFLAGS: C++ compiler flags"

config PK_CACHE_SCENE_IOVEC_ASFLAGS
	string "CCASFLAGS: assembler compiler flags (defaults to CFLAGS)"

config PK_CACHE_SCENE_IOVEC_BUILDARCH
	string "--host options on configure for Architecture"

endif # PK_CACHE_SCENE_IOVEC
```

## package/CACHE/BiscuitOS-CACHE-SCENE-MEMCPY-PAGE-FLUSH-CACHE/Kconfig
```kconfig
menuconfig PK_CACHE_SCENE_MEMCPY_PAGE_FC
	bool "CACHE SCENE: MEMCPY with Flush CACHE"

if PK_CACHE_SCENE_MEMCPY_PAGE_FC

config PK_CACHE_SCENE_MEMCPY_PAGE_FC_VERSION
	default "default"
	string "verstion"

config PK_CACHE_SCENE_MEMCPY_PAGE_FC_TAR
	default "tar.gz"
	string "tar type"

config PK_CACHE_SCENE_MEMCPY_PAGE_FC_URL
	default "https://gitee.com/BiscuitOS_team/HardStack/raw/Gitee/Memory-Allocator/CACHE-MECH/BiscuitOS-CACHE-SCENE-MEMCPY-PAGE-FLUSH-CACHE"
	string "url"

config PK_CACHE_SCENE_MEMCPY_PAGE_FC_GITHUB
	string "GitHub"

config PK_CACHE_SCENE_MEMCPY_PAGE_FC_SRCFILE
	default "main.c Kconfig Makefile"
	string "Source code list"

config PK_CACHE_SCENE_MEMCPY_PAGE_FC_CSRCFILE
	string "Compile source code list"

config PK_CACHE_SCENE_MEMCPY_PAGE_FC_CONFIG
	string "CONFIG: Project Configure Options"

config PK_CACHE_SCENE_MEMCPY_PAGE_FC_LIBPATH
	string "LIBS: Libraries to pass to the linker, e.g. -l<library>"

config PK_CACHE_SCENE_MEMCPY_PAGE_FC_CPPFLAGS
	string "CPPFLAGS: C/C++ preprocessor flags, e.g. -I<include dir>"

config PK_CACHE_SCENE_MEMCPY_PAGE_FC_DPKCONFIG
	string "PKG_CONFIG_PATH: Directories to add to pkg-config's search path"

config PK_CACHE_SCENE_MEMCPY_PAGE_FC_CFLAGS
	string "CFLAGS: C compiler flags"

config PK_CACHE_SCENE_MEMCPY_PAGE_FC_LDFLAGS
	string "LDFLAGS: Linker flags"

config PK_CACHE_SCENE_MEMCPY_PAGE_FC_CXXFLAGS
	string "CXXFLAGS: C++ compiler flags"

config PK_CACHE_SCENE_MEMCPY_PAGE_FC_ASFLAGS
	string "CCASFLAGS: assembler compiler flags (defaults to CFLAGS)"

config PK_CACHE_SCENE_MEMCPY_PAGE_FC_BUILDARCH
	string "--host options on configure for Architecture"

endif # PK_CACHE_SCENE_MEMCPY_PAGE_FC
```

## package/CACHE/BiscuitOS-CACHE-SPLIT-LOCK/Kconfig
```kconfig
menuconfig PK_CACHE_SPLIT_LOCK
	bool "Split lock detect"

if PK_CACHE_SPLIT_LOCK

config PK_CACHE_SPLIT_LOCK_VERSION
	default "default"
	string "verstion"

config PK_CACHE_SPLIT_LOCK_TAR
	default "tar.gz"
	string "tar type"

config PK_CACHE_SPLIT_LOCK_URL
	default "https://gitee.com/BiscuitOS_team/HardStack/raw/Gitee/Memory-Allocator/CACHE-MECH/BiscuitOS-CACHE-SPLIT-LOCK"
	string "url"

config PK_CACHE_SPLIT_LOCK_GITHUB
	string "GitHub"

config PK_CACHE_SPLIT_LOCK_SRCFILE
	default "main.cMakefile"
	string "Source code list"

config PK_CACHE_SPLIT_LOCK_CSRCFILE
	string "Compile source code list"

config PK_CACHE_SPLIT_LOCK_CONFIG
	string "CONFIG: Project Configure Options"

config PK_CACHE_SPLIT_LOCK_LIBPATH
	string "LIBS: Libraries to pass to the linker, e.g. -l<library>"

config PK_CACHE_SPLIT_LOCK_CPPFLAGS
	string "CPPFLAGS: C/C++ preprocessor flags, e.g. -I<include dir>"

config PK_CACHE_SPLIT_LOCK_DPKCONFIG
	string "PKG_CONFIG_PATH: Directories to add to pkg-config's search path"

config PK_CACHE_SPLIT_LOCK_CFLAGS
	string "CFLAGS: C compiler flags"

config PK_CACHE_SPLIT_LOCK_LDFLAGS
	string "LDFLAGS: Linker flags"

config PK_CACHE_SPLIT_LOCK_CXXFLAGS
	string "CXXFLAGS: C++ compiler flags"

config PK_CACHE_SPLIT_LOCK_ASFLAGS
	string "CCASFLAGS: assembler compiler flags (defaults to CFLAGS)"

config PK_CACHE_SPLIT_LOCK_BUILDARCH
	string "--host options on configure for Architecture"

endif # PK_CACHE_SPLIT_LOCK
```

## package/CACHE/BiscuitOS-CACHE-TOOLS-LIKWID/Kconfig
```kconfig
menuconfig PK_CACHE_TOOLS_LIKWID
	bool "Analysis/Diagnosis Tools: Likwid"

if PK_CACHE_TOOLS_LIKWID

config PK_CACHE_TOOLS_LIKWID_VERSION
	default "default"
	string "verstion"

config PK_CACHE_TOOLS_LIKWID_TAR
	default "tar.gz"
	string "tar type"

config PK_CACHE_TOOLS_LIKWID_URL
	default "https://gitee.com/BiscuitOS_team/HardStack/raw/Gitee/Memory-Allocator/CACHE-MECH/BiscuitOS-CACHE-TOOLS-LIKWID"
	string "url"

config PK_CACHE_TOOLS_LIKWID_GITHUB
	string "GitHub"

config PK_CACHE_TOOLS_LIKWID_SRCFILE
	default "main.c Makefile"
	string "Source code list"

config PK_CACHE_TOOLS_LIKWID_CSRCFILE
	string "Compile source code list"

config PK_CACHE_TOOLS_LIKWID_CONFIG
	string "CONFIG: Project Configure Options"

config PK_CACHE_TOOLS_LIKWID_LIBPATH
	string "LIBS: Libraries to pass to the linker, e.g. -l<library>"

config PK_CACHE_TOOLS_LIKWID_CPPFLAGS
	string "CPPFLAGS: C/C++ preprocessor flags, e.g. -I<include dir>"

config PK_CACHE_TOOLS_LIKWID_DPKCONFIG
	string "PKG_CONFIG_PATH: Directories to add to pkg-config's search path"

config PK_CACHE_TOOLS_LIKWID_CFLAGS
	string "CFLAGS: C compiler flags"

config PK_CACHE_TOOLS_LIKWID_LDFLAGS
	string "LDFLAGS: Linker flags"

config PK_CACHE_TOOLS_LIKWID_CXXFLAGS
	string "CXXFLAGS: C++ compiler flags"

config PK_CACHE_TOOLS_LIKWID_ASFLAGS
	string "CCASFLAGS: assembler compiler flags (defaults to CFLAGS)"

config PK_CACHE_TOOLS_LIKWID_BUILDARCH
	string "--host options on configure for Architecture"

endif # PK_CACHE_TOOLS_LIKWID
```

## package/CACHE/BiscuitOS-CACHE-TOOLS-PAPI-COST/Kconfig
```kconfig
menuconfig PK_CACHE_TOOLS_PAPI_COST
	bool "Analysis/Diagnosis Tools: PAPI-COST"

if PK_CACHE_TOOLS_PAPI_COST

config PK_CACHE_TOOLS_PAPI_COST_VERSION
	default "default"
	string "verstion"

config PK_CACHE_TOOLS_PAPI_COST_TAR
	default "tar.gz"
	string "tar type"

config PK_CACHE_TOOLS_PAPI_COST_URL
	default "https://gitee.com/BiscuitOS_team/HardStack/raw/Gitee/Memory-Allocator/CACHE-MECH/BiscuitOS-CACHE-TOOLS-PAPI-COST"
	string "url"

config PK_CACHE_TOOLS_PAPI_COST_GITHUB
	string "GitHub"

config PK_CACHE_TOOLS_PAPI_COST_SRCFILE
	default "main.c Makefile"
	string "Source code list"

config PK_CACHE_TOOLS_PAPI_COST_CSRCFILE
	string "Compile source code list"

config PK_CACHE_TOOLS_PAPI_COST_CONFIG
	string "CONFIG: Project Configure Options"

config PK_CACHE_TOOLS_PAPI_COST_LIBPATH
	string "LIBS: Libraries to pass to the linker, e.g. -l<library>"

config PK_CACHE_TOOLS_PAPI_COST_CPPFLAGS
	string "CPPFLAGS: C/C++ preprocessor flags, e.g. -I<include dir>"

config PK_CACHE_TOOLS_PAPI_COST_DPKCONFIG
	string "PKG_CONFIG_PATH: Directories to add to pkg-config's search path"

config PK_CACHE_TOOLS_PAPI_COST_CFLAGS
	string "CFLAGS: C compiler flags"

config PK_CACHE_TOOLS_PAPI_COST_LDFLAGS
	string "LDFLAGS: Linker flags"

config PK_CACHE_TOOLS_PAPI_COST_CXXFLAGS
	string "CXXFLAGS: C++ compiler flags"

config PK_CACHE_TOOLS_PAPI_COST_ASFLAGS
	string "CCASFLAGS: assembler compiler flags (defaults to CFLAGS)"

config PK_CACHE_TOOLS_PAPI_COST_BUILDARCH
	string "--host options on configure for Architecture"

endif # PK_CACHE_TOOLS_PAPI_COST
```
