## package/CACHE/BiscuitOS-CACHE-INSTRUCT-WBINVD/Kconfig
```kconfig
menuconfig PK_CACHE_INSTRUCT_WBINVD
	bool "CACHE Instruction(X86): WBINVD - WriteBack and Invalidate CACHE"

if PK_CACHE_INSTRUCT_WBINVD

config PK_CACHE_INSTRUCT_WBINVD_VERSION
	default "default"
	string "verstion"

config PK_CACHE_INSTRUCT_WBINVD_TAR
	default "tar.gz"
	string "tar type"

config PK_CACHE_INSTRUCT_WBINVD_URL
	default "https://gitee.com/BiscuitOS_team/HardStack/raw/Gitee/Memory-Allocator/CACHE-MECH/BiscuitOS-CACHE-INSTRUCT-WBINVD"
	string "url"

config PK_CACHE_INSTRUCT_WBINVD_GITHUB
	string "GitHub"

config PK_CACHE_INSTRUCT_WBINVD_SRCFILE
	default "main.c Kconfig Makefile Makefile.host RunBiscuitOS.sh"
	string "Source code list"

config PK_CACHE_INSTRUCT_WBINVD_CSRCFILE
	string "Compile source code list"

config PK_CACHE_INSTRUCT_WBINVD_CONFIG
	string "CONFIG: Project Configure Options"

config PK_CACHE_INSTRUCT_WBINVD_LIBPATH
	string "LIBS: Libraries to pass to the linker, e.g. -l<library>"

config PK_CACHE_INSTRUCT_WBINVD_CPPFLAGS
	string "CPPFLAGS: C/C++ preprocessor flags, e.g. -I<include dir>"

config PK_CACHE_INSTRUCT_WBINVD_DPKCONFIG
	string "PKG_CONFIG_PATH: Directories to add to pkg-config's search path"

config PK_CACHE_INSTRUCT_WBINVD_CFLAGS
	string "CFLAGS: C compiler flags"

config PK_CACHE_INSTRUCT_WBINVD_LDFLAGS
	string "LDFLAGS: Linker flags"

config PK_CACHE_INSTRUCT_WBINVD_CXXFLAGS
	string "CXXFLAGS: C++ compiler flags"

config PK_CACHE_INSTRUCT_WBINVD_ASFLAGS
	string "CCASFLAGS: assembler compiler flags (defaults to CFLAGS)"

config PK_CACHE_INSTRUCT_WBINVD_BUILDARCH
	string "--host options on configure for Architecture"

endif # PK_CACHE_INSTRUCT_WBINVD
```

## package/CACHE/BiscuitOS-CACHE-INSTRUCT-WBNOINVD/Kconfig
```kconfig
menuconfig PK_CACHE_INSTRUCT_WBNOINVD
	bool "CACHE Instruction(X86): WBNOINVD - WriteBack and Don't Invalidate CACHE"

if PK_CACHE_INSTRUCT_WBNOINVD

config PK_CACHE_INSTRUCT_WBNOINVD_VERSION
	default "default"
	string "verstion"

config PK_CACHE_INSTRUCT_WBNOINVD_TAR
	default "tar.gz"
	string "tar type"

config PK_CACHE_INSTRUCT_WBNOINVD_URL
	default "https://gitee.com/BiscuitOS_team/HardStack/raw/Gitee/Memory-Allocator/CACHE-MECH/BiscuitOS-CACHE-INSTRUCT-WBNOINVD"
	string "url"

config PK_CACHE_INSTRUCT_WBNOINVD_GITHUB
	string "GitHub"

config PK_CACHE_INSTRUCT_WBNOINVD_SRCFILE
	default "main.c Kconfig Makefile Makefile.host RunBiscuitOS.sh"
	string "Source code list"

config PK_CACHE_INSTRUCT_WBNOINVD_CSRCFILE
	string "Compile source code list"

config PK_CACHE_INSTRUCT_WBNOINVD_CONFIG
	string "CONFIG: Project Configure Options"

config PK_CACHE_INSTRUCT_WBNOINVD_LIBPATH
	string "LIBS: Libraries to pass to the linker, e.g. -l<library>"

config PK_CACHE_INSTRUCT_WBNOINVD_CPPFLAGS
	string "CPPFLAGS: C/C++ preprocessor flags, e.g. -I<include dir>"

config PK_CACHE_INSTRUCT_WBNOINVD_DPKCONFIG
	string "PKG_CONFIG_PATH: Directories to add to pkg-config's search path"

config PK_CACHE_INSTRUCT_WBNOINVD_CFLAGS
	string "CFLAGS: C compiler flags"

config PK_CACHE_INSTRUCT_WBNOINVD_LDFLAGS
	string "LDFLAGS: Linker flags"

config PK_CACHE_INSTRUCT_WBNOINVD_CXXFLAGS
	string "CXXFLAGS: C++ compiler flags"

config PK_CACHE_INSTRUCT_WBNOINVD_ASFLAGS
	string "CCASFLAGS: assembler compiler flags (defaults to CFLAGS)"

config PK_CACHE_INSTRUCT_WBNOINVD_BUILDARCH
	string "--host options on configure for Architecture"

endif # PK_CACHE_INSTRUCT_WBNOINVD
```

## package/CACHE/BiscuitOS-CACHE-IOREMAP-CHANGE-MEMTYPE/Kconfig
```kconfig
menuconfig PK_CACHE_IOREMAP_CHANGE_MEMTYPE
	bool "IOREMAP: Change CACHE Mode with IOREMAP Mechanism"

if PK_CACHE_IOREMAP_CHANGE_MEMTYPE

config PK_CACHE_IOREMAP_CHANGE_MEMTYPE_VERSION
	default "default"
	string "verstion"

config PK_CACHE_IOREMAP_CHANGE_MEMTYPE_TAR
	default "tar.gz"
	string "tar type"

config PK_CACHE_IOREMAP_CHANGE_MEMTYPE_URL
	default "https://gitee.com/BiscuitOS_team/HardStack/raw/Gitee/Memory-Allocator/CACHE-MECH/BiscuitOS-CACHE-IOREMAP-CHANGE-MEMTYPE"
	string "url"

config PK_CACHE_IOREMAP_CHANGE_MEMTYPE_GITHUB
	string "GitHub"

config PK_CACHE_IOREMAP_CHANGE_MEMTYPE_SRCFILE
	default "app.c main.c Kconfig Makefile Makefile.host RunBiscuitOS.sh"
	string "Source code list"

config PK_CACHE_IOREMAP_CHANGE_MEMTYPE_CSRCFILE
	string "Compile source code list"

config PK_CACHE_IOREMAP_CHANGE_MEMTYPE_CONFIG
	string "CONFIG: Project Configure Options"

config PK_CACHE_IOREMAP_CHANGE_MEMTYPE_LIBPATH
	string "LIBS: Libraries to pass to the linker, e.g. -l<library>"

config PK_CACHE_IOREMAP_CHANGE_MEMTYPE_CPPFLAGS
	string "CPPFLAGS: C/C++ preprocessor flags, e.g. -I<include dir>"

config PK_CACHE_IOREMAP_CHANGE_MEMTYPE_DPKCONFIG
	string "PKG_CONFIG_PATH: Directories to add to pkg-config's search path"

config PK_CACHE_IOREMAP_CHANGE_MEMTYPE_CFLAGS
	string "CFLAGS: C compiler flags"

config PK_CACHE_IOREMAP_CHANGE_MEMTYPE_LDFLAGS
	string "LDFLAGS: Linker flags"

config PK_CACHE_IOREMAP_CHANGE_MEMTYPE_CXXFLAGS
	string "CXXFLAGS: C++ compiler flags"

config PK_CACHE_IOREMAP_CHANGE_MEMTYPE_ASFLAGS
	string "CCASFLAGS: assembler compiler flags (defaults to CFLAGS)"

config PK_CACHE_IOREMAP_CHANGE_MEMTYPE_BUILDARCH
	string "--host options on configure for Architecture"

endif # PK_CACHE_IOREMAP_CHANGE_MEMTYPE
```

## package/CACHE/BiscuitOS-CACHE-IOREMAP/Kconfig
```kconfig
menuconfig PK_CACHE_IOREMAP
	bool "IOREMAP: CACHE MODE with IOREMAP Mechanism"

if PK_CACHE_IOREMAP

config PK_CACHE_IOREMAP_VERSION
	default "default"
	string "verstion"

config PK_CACHE_IOREMAP_TAR
	default "tar.gz"
	string "tar type"

config PK_CACHE_IOREMAP_URL
	default "https://gitee.com/BiscuitOS_team/HardStack/raw/Gitee/Memory-Allocator/CACHE-MECH/BiscuitOS-CACHE-IOREMAP"
	string "url"

config PK_CACHE_IOREMAP_GITHUB
	string "GitHub"

config PK_CACHE_IOREMAP_SRCFILE
	default "app.c main.c Kconfig Makefile Makefile.host RunBiscuitOS.sh"
	string "Source code list"

config PK_CACHE_IOREMAP_CSRCFILE
	string "Compile source code list"

config PK_CACHE_IOREMAP_CONFIG
	string "CONFIG: Project Configure Options"

config PK_CACHE_IOREMAP_LIBPATH
	string "LIBS: Libraries to pass to the linker, e.g. -l<library>"

config PK_CACHE_IOREMAP_CPPFLAGS
	string "CPPFLAGS: C/C++ preprocessor flags, e.g. -I<include dir>"

config PK_CACHE_IOREMAP_DPKCONFIG
	string "PKG_CONFIG_PATH: Directories to add to pkg-config's search path"

config PK_CACHE_IOREMAP_CFLAGS
	string "CFLAGS: C compiler flags"

config PK_CACHE_IOREMAP_LDFLAGS
	string "LDFLAGS: Linker flags"

config PK_CACHE_IOREMAP_CXXFLAGS
	string "CXXFLAGS: C++ compiler flags"

config PK_CACHE_IOREMAP_ASFLAGS
	string "CCASFLAGS: assembler compiler flags (defaults to CFLAGS)"

config PK_CACHE_IOREMAP_BUILDARCH
	string "--host options on configure for Architecture"

endif # PK_CACHE_IOREMAP
```

## package/CACHE/BiscuitOS-CACHE-MEMORY/Kconfig
```kconfig
menuconfig PK_CACHE_MEMORY
	bool "RAM: CACHE MODE with RAM (Recommend)"

if PK_CACHE_MEMORY

config PK_CACHE_MEMORY_VERSION
	default "default"
	string "verstion"

config PK_CACHE_MEMORY_TAR
	default "tar.gz"
	string "tar type"

config PK_CACHE_MEMORY_URL
	default "https://gitee.com/BiscuitOS_team/HardStack/raw/Gitee/Memory-Allocator/CACHE-MECH/BiscuitOS-CACHE-MEMORY"
	string "url"

config PK_CACHE_MEMORY_GITHUB
	string "GitHub"

config PK_CACHE_MEMORY_SRCFILE
	default "app.c main.c Kconfig Makefile Makefile.host RunBiscuitOS.sh"
	string "Source code list"

config PK_CACHE_MEMORY_CSRCFILE
	string "Compile source code list"

config PK_CACHE_MEMORY_CONFIG
	string "CONFIG: Project Configure Options"

config PK_CACHE_MEMORY_LIBPATH
	string "LIBS: Libraries to pass to the linker, e.g. -l<library>"

config PK_CACHE_MEMORY_CPPFLAGS
	string "CPPFLAGS: C/C++ preprocessor flags, e.g. -I<include dir>"

config PK_CACHE_MEMORY_DPKCONFIG
	string "PKG_CONFIG_PATH: Directories to add to pkg-config's search path"

config PK_CACHE_MEMORY_CFLAGS
	string "CFLAGS: C compiler flags"

config PK_CACHE_MEMORY_LDFLAGS
	string "LDFLAGS: Linker flags"

config PK_CACHE_MEMORY_CXXFLAGS
	string "CXXFLAGS: C++ compiler flags"

config PK_CACHE_MEMORY_ASFLAGS
	string "CCASFLAGS: assembler compiler flags (defaults to CFLAGS)"

config PK_CACHE_MEMORY_BUILDARCH
	string "--host options on configure for Architecture"

endif # PK_CACHE_MEMORY
```

## package/CACHE/BiscuitOS-CACHE-MODE-COHERENT-DEVMEM/Kconfig
```kconfig
menuconfig PK_CACHE_MODE_COHERENT_DEVMEM
	bool "Coherent: CACHE MODE Coherent for DEVMEM"

if PK_CACHE_MODE_COHERENT_DEVMEM

config PK_CACHE_MODE_COHERENT_DEVMEM_VERSION
	default "default"
	string "verstion"

config PK_CACHE_MODE_COHERENT_DEVMEM_TAR
	default "tar.gz"
	string "tar type"

config PK_CACHE_MODE_COHERENT_DEVMEM_URL
	default "https://gitee.com/BiscuitOS_team/HardStack/raw/Gitee/Memory-Allocator/CACHE-MECH/BiscuitOS-CACHE-MODE-COHERENT-DEVMEM"
	string "url"

config PK_CACHE_MODE_COHERENT_DEVMEM_GITHUB
	string "GitHub"

config PK_CACHE_MODE_COHERENT_DEVMEM_SRCFILE
	default "app.c app1.c main.c Kconfig Makefile Makefile.host RunBiscuitOS.sh"
	string "Source code list"

config PK_CACHE_MODE_COHERENT_DEVMEM_CSRCFILE
	string "Compile source code list"

config PK_CACHE_MODE_COHERENT_DEVMEM_CONFIG
	string "CONFIG: Project Configure Options"

config PK_CACHE_MODE_COHERENT_DEVMEM_LIBPATH
	string "LIBS: Libraries to pass to the linker, e.g. -l<library>"

config PK_CACHE_MODE_COHERENT_DEVMEM_CPPFLAGS
	string "CPPFLAGS: C/C++ preprocessor flags, e.g. -I<include dir>"

config PK_CACHE_MODE_COHERENT_DEVMEM_DPKCONFIG
	string "PKG_CONFIG_PATH: Directories to add to pkg-config's search path"

config PK_CACHE_MODE_COHERENT_DEVMEM_CFLAGS
	string "CFLAGS: C compiler flags"

config PK_CACHE_MODE_COHERENT_DEVMEM_LDFLAGS
	string "LDFLAGS: Linker flags"

config PK_CACHE_MODE_COHERENT_DEVMEM_CXXFLAGS
	string "CXXFLAGS: C++ compiler flags"

config PK_CACHE_MODE_COHERENT_DEVMEM_ASFLAGS
	string "CCASFLAGS: assembler compiler flags (defaults to CFLAGS)"

config PK_CACHE_MODE_COHERENT_DEVMEM_BUILDARCH
	string "--host options on configure for Architecture"

endif # PK_CACHE_MODE_COHERENT_DEVMEM
```

## package/CACHE/BiscuitOS-CACHE-MODE-COHERENT-DEVMMIO/Kconfig
```kconfig
menuconfig PK_CACHE_MODE_COHERENT_DEVMMIO
	bool "Coherent: CACHE MODE Coherent for DEVMMIO"

if PK_CACHE_MODE_COHERENT_DEVMMIO

config PK_CACHE_MODE_COHERENT_DEVMMIO_VERSION
	default "default"
	string "verstion"

config PK_CACHE_MODE_COHERENT_DEVMMIO_TAR
	default "tar.gz"
	string "tar type"

config PK_CACHE_MODE_COHERENT_DEVMMIO_URL
	default "https://gitee.com/BiscuitOS_team/HardStack/raw/Gitee/Memory-Allocator/CACHE-MECH/BiscuitOS-CACHE-MODE-COHERENT-DEVMMIO"
	string "url"

config PK_CACHE_MODE_COHERENT_DEVMMIO_GITHUB
	string "GitHub"

config PK_CACHE_MODE_COHERENT_DEVMMIO_SRCFILE
	default "app.c app1.c main.c Kconfig Makefile Makefile.host RunBiscuitOS.sh"
	string "Source code list"

config PK_CACHE_MODE_COHERENT_DEVMMIO_CSRCFILE
	string "Compile source code list"

config PK_CACHE_MODE_COHERENT_DEVMMIO_CONFIG
	string "CONFIG: Project Configure Options"

config PK_CACHE_MODE_COHERENT_DEVMMIO_LIBPATH
	string "LIBS: Libraries to pass to the linker, e.g. -l<library>"

config PK_CACHE_MODE_COHERENT_DEVMMIO_CPPFLAGS
	string "CPPFLAGS: C/C++ preprocessor flags, e.g. -I<include dir>"

config PK_CACHE_MODE_COHERENT_DEVMMIO_DPKCONFIG
	string "PKG_CONFIG_PATH: Directories to add to pkg-config's search path"

config PK_CACHE_MODE_COHERENT_DEVMMIO_CFLAGS
	string "CFLAGS: C compiler flags"

config PK_CACHE_MODE_COHERENT_DEVMMIO_LDFLAGS
	string "LDFLAGS: Linker flags"

config PK_CACHE_MODE_COHERENT_DEVMMIO_CXXFLAGS
	string "CXXFLAGS: C++ compiler flags"

config PK_CACHE_MODE_COHERENT_DEVMMIO_ASFLAGS
	string "CCASFLAGS: assembler compiler flags (defaults to CFLAGS)"

config PK_CACHE_MODE_COHERENT_DEVMMIO_BUILDARCH
	string "--host options on configure for Architecture"

endif # PK_CACHE_MODE_COHERENT_DEVMMIO
```

## package/CACHE/BiscuitOS-CACHE-MODE-COHERENT-OSMEM/Kconfig
```kconfig
menuconfig PK_CACHE_MODE_COHERENT_OSMEM
	bool "Coherent: CACHE MODE Coherent for OSMEM"

if PK_CACHE_MODE_COHERENT_OSMEM

config PK_CACHE_MODE_COHERENT_OSMEM_VERSION
	default "default"
	string "verstion"

config PK_CACHE_MODE_COHERENT_OSMEM_TAR
	default "tar.gz"
	string "tar type"

config PK_CACHE_MODE_COHERENT_OSMEM_URL
	default "https://gitee.com/BiscuitOS_team/HardStack/raw/Gitee/Memory-Allocator/CACHE-MECH/BiscuitOS-CACHE-MODE-COHERENT-OSMEM"
	string "url"

config PK_CACHE_MODE_COHERENT_OSMEM_GITHUB
	string "GitHub"

config PK_CACHE_MODE_COHERENT_OSMEM_SRCFILE
	default "app.c app1.c main.c Kconfig Makefile Makefile.host RunBiscuitOS.sh"
	string "Source code list"

config PK_CACHE_MODE_COHERENT_OSMEM_CSRCFILE
	string "Compile source code list"

config PK_CACHE_MODE_COHERENT_OSMEM_CONFIG
	string "CONFIG: Project Configure Options"

config PK_CACHE_MODE_COHERENT_OSMEM_LIBPATH
	string "LIBS: Libraries to pass to the linker, e.g. -l<library>"

config PK_CACHE_MODE_COHERENT_OSMEM_CPPFLAGS
	string "CPPFLAGS: C/C++ preprocessor flags, e.g. -I<include dir>"

config PK_CACHE_MODE_COHERENT_OSMEM_DPKCONFIG
	string "PKG_CONFIG_PATH: Directories to add to pkg-config's search path"

config PK_CACHE_MODE_COHERENT_OSMEM_CFLAGS
	string "CFLAGS: C compiler flags"

config PK_CACHE_MODE_COHERENT_OSMEM_LDFLAGS
	string "LDFLAGS: Linker flags"

config PK_CACHE_MODE_COHERENT_OSMEM_CXXFLAGS
	string "CXXFLAGS: C++ compiler flags"

config PK_CACHE_MODE_COHERENT_OSMEM_ASFLAGS
	string "CCASFLAGS: assembler compiler flags (defaults to CFLAGS)"

config PK_CACHE_MODE_COHERENT_OSMEM_BUILDARCH
	string "--host options on configure for Architecture"

endif # PK_CACHE_MODE_COHERENT_OSMEM
```

## package/CACHE/BiscuitOS-CACHE-MTRR-IOCTL-READ/Kconfig
```kconfig
menuconfig PK_CACHE_MTRR_IOCTL_READ
	bool "MTRRs: Read MTRRs via IOCTL on Userspace"

if PK_CACHE_MTRR_IOCTL_READ

config PK_CACHE_MTRR_IOCTL_READ_VERSION
	default "default"
	string "verstion"

config PK_CACHE_MTRR_IOCTL_READ_TAR
	default "tar.gz"
	string "tar type"

config PK_CACHE_MTRR_IOCTL_READ_URL
	default "https://gitee.com/BiscuitOS_team/HardStack/raw/Gitee/Memory-Allocator/CACHE-MECH/BiscuitOS-CACHE-MTRR-IOCTL-READ"
	string "url"

config PK_CACHE_MTRR_IOCTL_READ_GITHUB
	string "GitHub"

config PK_CACHE_MTRR_IOCTL_READ_SRCFILE
	default "main.c Makefile"
	string "Source code list"

config PK_CACHE_MTRR_IOCTL_READ_CSRCFILE
	string "Compile source code list"

config PK_CACHE_MTRR_IOCTL_READ_CONFIG
	string "CONFIG: Project Configure Options"

config PK_CACHE_MTRR_IOCTL_READ_LIBPATH
	string "LIBS: Libraries to pass to the linker, e.g. -l<library>"

config PK_CACHE_MTRR_IOCTL_READ_CPPFLAGS
	string "CPPFLAGS: C/C++ preprocessor flags, e.g. -I<include dir>"

config PK_CACHE_MTRR_IOCTL_READ_DPKCONFIG
	string "PKG_CONFIG_PATH: Directories to add to pkg-config's search path"

config PK_CACHE_MTRR_IOCTL_READ_CFLAGS
	string "CFLAGS: C compiler flags"

config PK_CACHE_MTRR_IOCTL_READ_LDFLAGS
	string "LDFLAGS: Linker flags"

config PK_CACHE_MTRR_IOCTL_READ_CXXFLAGS
	string "CXXFLAGS: C++ compiler flags"

config PK_CACHE_MTRR_IOCTL_READ_ASFLAGS
	string "CCASFLAGS: assembler compiler flags (defaults to CFLAGS)"

config PK_CACHE_MTRR_IOCTL_READ_BUILDARCH
	string "--host options on configure for Architecture"

endif # PK_CACHE_MTRR_IOCTL_READ
```
