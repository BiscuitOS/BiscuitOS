## package/CACHE/BiscuitOS-CACHE-RAM-DEVMEM-PAGE-FAULT/Kconfig
```kconfig
menuconfig PK_CACHE_RAM_DEVMEM_PF
	bool "RAM: CACHE Mode on DEVMEM Page-Faulting"

if PK_CACHE_RAM_DEVMEM_PF

config PK_CACHE_RAM_DEVMEM_PF_VERSION
	default "default"
	string "verstion"

config PK_CACHE_RAM_DEVMEM_PF_TAR
	default "tar.gz"
	string "tar type"

config PK_CACHE_RAM_DEVMEM_PF_URL
	default "https://gitee.com/BiscuitOS_team/HardStack/raw/Gitee/Memory-Allocator/CACHE-MECH/BiscuitOS-CACHE-RAM-DEVMEM-PAGE-FAULT"
	string "url"

config PK_CACHE_RAM_DEVMEM_PF_GITHUB
	string "GitHub"

config PK_CACHE_RAM_DEVMEM_PF_SRCFILE
	default "app.c main.c Kconfig Makefile Makefile.host RunBiscuitOS.sh"
	string "Source code list"

config PK_CACHE_RAM_DEVMEM_PF_CSRCFILE
	string "Compile source code list"

config PK_CACHE_RAM_DEVMEM_PF_CONFIG
	string "CONFIG: Project Configure Options"

config PK_CACHE_RAM_DEVMEM_PF_LIBPATH
	string "LIBS: Libraries to pass to the linker, e.g. -l<library>"

config PK_CACHE_RAM_DEVMEM_PF_CPPFLAGS
	string "CPPFLAGS: C/C++ preprocessor flags, e.g. -I<include dir>"

config PK_CACHE_RAM_DEVMEM_PF_DPKCONFIG
	string "PKG_CONFIG_PATH: Directories to add to pkg-config's search path"

config PK_CACHE_RAM_DEVMEM_PF_CFLAGS
	string "CFLAGS: C compiler flags"

config PK_CACHE_RAM_DEVMEM_PF_LDFLAGS
	string "LDFLAGS: Linker flags"

config PK_CACHE_RAM_DEVMEM_PF_CXXFLAGS
	string "CXXFLAGS: C++ compiler flags"

config PK_CACHE_RAM_DEVMEM_PF_ASFLAGS
	string "CCASFLAGS: assembler compiler flags (defaults to CFLAGS)"

config PK_CACHE_RAM_DEVMEM_PF_BUILDARCH
	string "--host options on configure for Architecture"

endif # PK_CACHE_RAM_DEVMEM_PF
```

## package/CACHE/BiscuitOS-CACHE-RAM-DEVMEM/Kconfig
```kconfig
menuconfig PK_CACHE_RAM_DEVMEM
	bool "RAM: CACHE Mode on DEVMEM"

if PK_CACHE_RAM_DEVMEM

config PK_CACHE_RAM_DEVMEM_VERSION
	default "default"
	string "verstion"

config PK_CACHE_RAM_DEVMEM_TAR
	default "tar.gz"
	string "tar type"

config PK_CACHE_RAM_DEVMEM_URL
	default "https://gitee.com/BiscuitOS_team/HardStack/raw/Gitee/Memory-Allocator/CACHE-MECH/BiscuitOS-CACHE-RAM-DEVMEM"
	string "url"

config PK_CACHE_RAM_DEVMEM_GITHUB
	string "GitHub"

config PK_CACHE_RAM_DEVMEM_SRCFILE
	default "app.c main.c Kconfig Makefile Makefile.host RunBiscuitOS.sh"
	string "Source code list"

config PK_CACHE_RAM_DEVMEM_CSRCFILE
	string "Compile source code list"

config PK_CACHE_RAM_DEVMEM_CONFIG
	string "CONFIG: Project Configure Options"

config PK_CACHE_RAM_DEVMEM_LIBPATH
	string "LIBS: Libraries to pass to the linker, e.g. -l<library>"

config PK_CACHE_RAM_DEVMEM_CPPFLAGS
	string "CPPFLAGS: C/C++ preprocessor flags, e.g. -I<include dir>"

config PK_CACHE_RAM_DEVMEM_DPKCONFIG
	string "PKG_CONFIG_PATH: Directories to add to pkg-config's search path"

config PK_CACHE_RAM_DEVMEM_CFLAGS
	string "CFLAGS: C compiler flags"

config PK_CACHE_RAM_DEVMEM_LDFLAGS
	string "LDFLAGS: Linker flags"

config PK_CACHE_RAM_DEVMEM_CXXFLAGS
	string "CXXFLAGS: C++ compiler flags"

config PK_CACHE_RAM_DEVMEM_ASFLAGS
	string "CCASFLAGS: assembler compiler flags (defaults to CFLAGS)"

config PK_CACHE_RAM_DEVMEM_BUILDARCH
	string "--host options on configure for Architecture"

endif # PK_CACHE_RAM_DEVMEM
```

## package/CACHE/BiscuitOS-CACHE-RAM-DIRECT-MAPPING/Kconfig
```kconfig
menuconfig PK_CACHE_RAM_DIRECTM
	bool "RAM: CACHE Mode on Direct Mapping Area"

if PK_CACHE_RAM_DIRECTM

config PK_CACHE_RAM_DIRECTM_VERSION
	default "default"
	string "verstion"

config PK_CACHE_RAM_DIRECTM_TAR
	default "tar.gz"
	string "tar type"

config PK_CACHE_RAM_DIRECTM_URL
	default "https://gitee.com/BiscuitOS_team/HardStack/raw/Gitee/Memory-Allocator/CACHE-MECH/BiscuitOS-CACHE-RAM-DIRECT-MAPPING"
	string "url"

config PK_CACHE_RAM_DIRECTM_GITHUB
	string "GitHub"

config PK_CACHE_RAM_DIRECTM_SRCFILE
	default "main.c Kconfig Makefile Makefile.host RunBiscuitOS.sh"
	string "Source code list"

config PK_CACHE_RAM_DIRECTM_CSRCFILE
	string "Compile source code list"

config PK_CACHE_RAM_DIRECTM_CONFIG
	string "CONFIG: Project Configure Options"

config PK_CACHE_RAM_DIRECTM_LIBPATH
	string "LIBS: Libraries to pass to the linker, e.g. -l<library>"

config PK_CACHE_RAM_DIRECTM_CPPFLAGS
	string "CPPFLAGS: C/C++ preprocessor flags, e.g. -I<include dir>"

config PK_CACHE_RAM_DIRECTM_DPKCONFIG
	string "PKG_CONFIG_PATH: Directories to add to pkg-config's search path"

config PK_CACHE_RAM_DIRECTM_CFLAGS
	string "CFLAGS: C compiler flags"

config PK_CACHE_RAM_DIRECTM_LDFLAGS
	string "LDFLAGS: Linker flags"

config PK_CACHE_RAM_DIRECTM_CXXFLAGS
	string "CXXFLAGS: C++ compiler flags"

config PK_CACHE_RAM_DIRECTM_ASFLAGS
	string "CCASFLAGS: assembler compiler flags (defaults to CFLAGS)"

config PK_CACHE_RAM_DIRECTM_BUILDARCH
	string "--host options on configure for Architecture"

endif # PK_CACHE_RAM_DIRECTM
```

## package/CACHE/BiscuitOS-CACHE-RAM-RSVDMEM/Kconfig
```kconfig
menuconfig PK_CACHE_RAM_RSVDMEM
	bool "RAM: CACHE Mode on RSVDMEM"

if PK_CACHE_RAM_RSVDMEM

config PK_CACHE_RAM_RSVDMEM_VERSION
	default "default"
	string "verstion"

config PK_CACHE_RAM_RSVDMEM_TAR
	default "tar.gz"
	string "tar type"

config PK_CACHE_RAM_RSVDMEM_URL
	default "https://gitee.com/BiscuitOS_team/HardStack/raw/Gitee/Memory-Allocator/CACHE-MECH/BiscuitOS-CACHE-RAM-RSVDMEM"
	string "url"

config PK_CACHE_RAM_RSVDMEM_GITHUB
	string "GitHub"

config PK_CACHE_RAM_RSVDMEM_SRCFILE
	default "app.c main.c Kconfig Makefile Makefile.host RunBiscuitOS.sh"
	string "Source code list"

config PK_CACHE_RAM_RSVDMEM_CSRCFILE
	string "Compile source code list"

config PK_CACHE_RAM_RSVDMEM_CONFIG
	string "CONFIG: Project Configure Options"

config PK_CACHE_RAM_RSVDMEM_LIBPATH
	string "LIBS: Libraries to pass to the linker, e.g. -l<library>"

config PK_CACHE_RAM_RSVDMEM_CPPFLAGS
	string "CPPFLAGS: C/C++ preprocessor flags, e.g. -I<include dir>"

config PK_CACHE_RAM_RSVDMEM_DPKCONFIG
	string "PKG_CONFIG_PATH: Directories to add to pkg-config's search path"

config PK_CACHE_RAM_RSVDMEM_CFLAGS
	string "CFLAGS: C compiler flags"

config PK_CACHE_RAM_RSVDMEM_LDFLAGS
	string "LDFLAGS: Linker flags"

config PK_CACHE_RAM_RSVDMEM_CXXFLAGS
	string "CXXFLAGS: C++ compiler flags"

config PK_CACHE_RAM_RSVDMEM_ASFLAGS
	string "CCASFLAGS: assembler compiler flags (defaults to CFLAGS)"

config PK_CACHE_RAM_RSVDMEM_BUILDARCH
	string "--host options on configure for Architecture"

endif # PK_CACHE_RAM_RSVDMEM
```

## package/CACHE/BiscuitOS-CACHE-RAM-VMALLOC/Kconfig
```kconfig
menuconfig PK_CACHE_RAM_VMALLOC
	bool "RAM: CACHE Mode on VMALLOC"

if PK_CACHE_RAM_VMALLOC

config PK_CACHE_RAM_VMALLOC_VERSION
	default "default"
	string "verstion"

config PK_CACHE_RAM_VMALLOC_TAR
	default "tar.gz"
	string "tar type"

config PK_CACHE_RAM_VMALLOC_URL
	default "https://gitee.com/BiscuitOS_team/HardStack/raw/Gitee/Memory-Allocator/CACHE-MECH/BiscuitOS-CACHE-RAM-VMALLOC"
	string "url"

config PK_CACHE_RAM_VMALLOC_GITHUB
	string "GitHub"

config PK_CACHE_RAM_VMALLOC_SRCFILE
	default "app.c main.c Kconfig Makefile Makefile.host RunBiscuitOS.sh"
	string "Source code list"

config PK_CACHE_RAM_VMALLOC_CSRCFILE
	string "Compile source code list"

config PK_CACHE_RAM_VMALLOC_CONFIG
	string "CONFIG: Project Configure Options"

config PK_CACHE_RAM_VMALLOC_LIBPATH
	string "LIBS: Libraries to pass to the linker, e.g. -l<library>"

config PK_CACHE_RAM_VMALLOC_CPPFLAGS
	string "CPPFLAGS: C/C++ preprocessor flags, e.g. -I<include dir>"

config PK_CACHE_RAM_VMALLOC_DPKCONFIG
	string "PKG_CONFIG_PATH: Directories to add to pkg-config's search path"

config PK_CACHE_RAM_VMALLOC_CFLAGS
	string "CFLAGS: C compiler flags"

config PK_CACHE_RAM_VMALLOC_LDFLAGS
	string "LDFLAGS: Linker flags"

config PK_CACHE_RAM_VMALLOC_CXXFLAGS
	string "CXXFLAGS: C++ compiler flags"

config PK_CACHE_RAM_VMALLOC_ASFLAGS
	string "CCASFLAGS: assembler compiler flags (defaults to CFLAGS)"

config PK_CACHE_RAM_VMALLOC_BUILDARCH
	string "--host options on configure for Architecture"

endif # PK_CACHE_RAM_VMALLOC
```

## package/CACHE/BiscuitOS-CACHE-RAM/Kconfig
```kconfig
menuconfig PK_CACHE_RAM
	bool "RAM: CACHE Mode on Default RAM"

if PK_CACHE_RAM

config PK_CACHE_RAM_VERSION
	default "default"
	string "verstion"

config PK_CACHE_RAM_TAR
	default "tar.gz"
	string "tar type"

config PK_CACHE_RAM_URL
	default "https://gitee.com/BiscuitOS_team/HardStack/raw/Gitee/Memory-Allocator/CACHE-MECH/BiscuitOS-CACHE-RAM"
	string "url"

config PK_CACHE_RAM_GITHUB
	string "GitHub"

config PK_CACHE_RAM_SRCFILE
	default "main.c Makefile"
	string "Source code list"

config PK_CACHE_RAM_CSRCFILE
	string "Compile source code list"

config PK_CACHE_RAM_CONFIG
	string "CONFIG: Project Configure Options"

config PK_CACHE_RAM_LIBPATH
	string "LIBS: Libraries to pass to the linker, e.g. -l<library>"

config PK_CACHE_RAM_CPPFLAGS
	string "CPPFLAGS: C/C++ preprocessor flags, e.g. -I<include dir>"

config PK_CACHE_RAM_DPKCONFIG
	string "PKG_CONFIG_PATH: Directories to add to pkg-config's search path"

config PK_CACHE_RAM_CFLAGS
	string "CFLAGS: C compiler flags"

config PK_CACHE_RAM_LDFLAGS
	string "LDFLAGS: Linker flags"

config PK_CACHE_RAM_CXXFLAGS
	string "CXXFLAGS: C++ compiler flags"

config PK_CACHE_RAM_ASFLAGS
	string "CCASFLAGS: assembler compiler flags (defaults to CFLAGS)"

config PK_CACHE_RAM_BUILDARCH
	string "--host options on configure for Architecture"

endif # PK_CACHE_RAM
```

## package/CACHE/BiscuitOS-CACHE-SCENE-COPY-USER-FLUSH-CACHE/Kconfig
```kconfig
menuconfig PK_CACHE_SCENE_COPY_USER_FC
	bool "CACHE SCENE: copy_{from}_user Flush CACHE"

if PK_CACHE_SCENE_COPY_USER_FC

config PK_CACHE_SCENE_COPY_USER_FC_VERSION
	default "default"
	string "verstion"

config PK_CACHE_SCENE_COPY_USER_FC_TAR
	default "tar.gz"
	string "tar type"

config PK_CACHE_SCENE_COPY_USER_FC_URL
	default "https://gitee.com/BiscuitOS_team/HardStack/raw/Gitee/Memory-Allocator/CACHE-MECH/BiscuitOS-CACHE-SCENE-COPY-USER-FLUSH-CACHE"
	string "url"

config PK_CACHE_SCENE_COPY_USER_FC_GITHUB
	string "GitHub"

config PK_CACHE_SCENE_COPY_USER_FC_SRCFILE
	default "main.c Kconfig Makefile"
	string "Source code list"

config PK_CACHE_SCENE_COPY_USER_FC_CSRCFILE
	string "Compile source code list"

config PK_CACHE_SCENE_COPY_USER_FC_CONFIG
	string "CONFIG: Project Configure Options"

config PK_CACHE_SCENE_COPY_USER_FC_LIBPATH
	string "LIBS: Libraries to pass to the linker, e.g. -l<library>"

config PK_CACHE_SCENE_COPY_USER_FC_CPPFLAGS
	string "CPPFLAGS: C/C++ preprocessor flags, e.g. -I<include dir>"

config PK_CACHE_SCENE_COPY_USER_FC_DPKCONFIG
	string "PKG_CONFIG_PATH: Directories to add to pkg-config's search path"

config PK_CACHE_SCENE_COPY_USER_FC_CFLAGS
	string "CFLAGS: C compiler flags"

config PK_CACHE_SCENE_COPY_USER_FC_LDFLAGS
	string "LDFLAGS: Linker flags"

config PK_CACHE_SCENE_COPY_USER_FC_CXXFLAGS
	string "CXXFLAGS: C++ compiler flags"

config PK_CACHE_SCENE_COPY_USER_FC_ASFLAGS
	string "CCASFLAGS: assembler compiler flags (defaults to CFLAGS)"

config PK_CACHE_SCENE_COPY_USER_FC_BUILDARCH
	string "--host options on configure for Architecture"

endif # PK_CACHE_SCENE_COPY_USER_FC
```
