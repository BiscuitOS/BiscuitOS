## package/CACHE/BiscuitOS-CACHE-MTRR-IOCTL-WRITE/Kconfig
```kconfig
menuconfig PK_CACHE_MTRR_IOCTL_WRITE
	bool "MTRRs: Write MTRRs via IOCTL on Userspace"

if PK_CACHE_MTRR_IOCTL_WRITE

config PK_CACHE_MTRR_IOCTL_WRITE_VERSION
	default "default"
	string "verstion"

config PK_CACHE_MTRR_IOCTL_WRITE_TAR
	default "tar.gz"
	string "tar type"

config PK_CACHE_MTRR_IOCTL_WRITE_URL
	default "https://gitee.com/BiscuitOS_team/HardStack/raw/Gitee/Memory-Allocator/CACHE-MECH/BiscuitOS-CACHE-MTRR-IOCTL-WRITE"
	string "url"

config PK_CACHE_MTRR_IOCTL_WRITE_GITHUB
	string "GitHub"

config PK_CACHE_MTRR_IOCTL_WRITE_SRCFILE
	default "main.c Makefile"
	string "Source code list"

config PK_CACHE_MTRR_IOCTL_WRITE_CSRCFILE
	string "Compile source code list"

config PK_CACHE_MTRR_IOCTL_WRITE_CONFIG
	string "CONFIG: Project Configure Options"

config PK_CACHE_MTRR_IOCTL_WRITE_LIBPATH
	string "LIBS: Libraries to pass to the linker, e.g. -l<library>"

config PK_CACHE_MTRR_IOCTL_WRITE_CPPFLAGS
	string "CPPFLAGS: C/C++ preprocessor flags, e.g. -I<include dir>"

config PK_CACHE_MTRR_IOCTL_WRITE_DPKCONFIG
	string "PKG_CONFIG_PATH: Directories to add to pkg-config's search path"

config PK_CACHE_MTRR_IOCTL_WRITE_CFLAGS
	string "CFLAGS: C compiler flags"

config PK_CACHE_MTRR_IOCTL_WRITE_LDFLAGS
	string "LDFLAGS: Linker flags"

config PK_CACHE_MTRR_IOCTL_WRITE_CXXFLAGS
	string "CXXFLAGS: C++ compiler flags"

config PK_CACHE_MTRR_IOCTL_WRITE_ASFLAGS
	string "CCASFLAGS: assembler compiler flags (defaults to CFLAGS)"

config PK_CACHE_MTRR_IOCTL_WRITE_BUILDARCH
	string "--host options on configure for Architecture"

endif # PK_CACHE_MTRR_IOCTL_WRITE
```

## package/CACHE/BiscuitOS-CACHE-PAGE-TABLE-RSVDMEM-1G-APP/Kconfig
```kconfig
menuconfig PK_CACHE_PAGE_TABLE_RSVDMEM_1G_APP
	select PK_CACHE_PAGE_TABLE_RSVDMEM_1G
	bool "PAGE Table: Setup CACHE Mode on 1Gig RSVDMEM APP"

if PK_CACHE_PAGE_TABLE_RSVDMEM_1G_APP

config PK_CACHE_PAGE_TABLE_RSVDMEM_1G_APP_VERSION
	default "default"
	string "verstion"

config PK_CACHE_PAGE_TABLE_RSVDMEM_1G_APP_TAR
	default "tar.gz"
	string "tar type"

config PK_CACHE_PAGE_TABLE_RSVDMEM_1G_APP_URL
	default "https://gitee.com/BiscuitOS_team/HardStack/raw/Gitee/Memory-Allocator/CACHE-MECH/BiscuitOS-CACHE-PAGE-TABLE-RSVDMEM-1G-APP"
	string "url"

config PK_CACHE_PAGE_TABLE_RSVDMEM_1G_APP_GITHUB
	string "GitHub"

config PK_CACHE_PAGE_TABLE_RSVDMEM_1G_APP_SRCFILE
	default "main.c Makefile"
	string "Source code list"

config PK_CACHE_PAGE_TABLE_RSVDMEM_1G_APP_CSRCFILE
	string "Compile source code list"

config PK_CACHE_PAGE_TABLE_RSVDMEM_1G_APP_CONFIG
	string "CONFIG: Project Configure Options"

config PK_CACHE_PAGE_TABLE_RSVDMEM_1G_APP_LIBPATH
	string "LIBS: Libraries to pass to the linker, e.g. -l<library>"

config PK_CACHE_PAGE_TABLE_RSVDMEM_1G_APP_CPPFLAGS
	string "CPPFLAGS: C/C++ preprocessor flags, e.g. -I<include dir>"

config PK_CACHE_PAGE_TABLE_RSVDMEM_1G_APP_DPKCONFIG
	string "PKG_CONFIG_PATH: Directories to add to pkg-config's search path"

config PK_CACHE_PAGE_TABLE_RSVDMEM_1G_APP_CFLAGS
	string "CFLAGS: C compiler flags"

config PK_CACHE_PAGE_TABLE_RSVDMEM_1G_APP_LDFLAGS
	string "LDFLAGS: Linker flags"

config PK_CACHE_PAGE_TABLE_RSVDMEM_1G_APP_CXXFLAGS
	string "CXXFLAGS: C++ compiler flags"

config PK_CACHE_PAGE_TABLE_RSVDMEM_1G_APP_ASFLAGS
	string "CCASFLAGS: assembler compiler flags (defaults to CFLAGS)"

config PK_CACHE_PAGE_TABLE_RSVDMEM_1G_APP_BUILDARCH
	string "--host options on configure for Architecture"

endif # PK_CACHE_PAGE_TABLE_RSVDMEM_1G_APP
```

## package/CACHE/BiscuitOS-CACHE-PAGE-TABLE-RSVDMEM-1G/Kconfig
```kconfig
menuconfig PK_CACHE_PAGE_TABLE_RSVDMEM_1G
	bool "PAGE Table: Setup CACHE Mode on 1Gig RSVDMEM"

if PK_CACHE_PAGE_TABLE_RSVDMEM_1G

config PK_CACHE_PAGE_TABLE_RSVDMEM_1G_VERSION
	default "default"
	string "verstion"

config PK_CACHE_PAGE_TABLE_RSVDMEM_1G_TAR
	default "tar.gz"
	string "tar type"

config PK_CACHE_PAGE_TABLE_RSVDMEM_1G_URL
	default "https://gitee.com/BiscuitOS_team/HardStack/raw/Gitee/Memory-Allocator/CACHE-MECH/BiscuitOS-CACHE-PAGE-TABLE-RSVDMEM-1G"
	string "url"

config PK_CACHE_PAGE_TABLE_RSVDMEM_1G_GITHUB
	string "GitHub"

config PK_CACHE_PAGE_TABLE_RSVDMEM_1G_SRCFILE
	default "main.c Kconfig Makefile"
	string "Source code list"

config PK_CACHE_PAGE_TABLE_RSVDMEM_1G_CSRCFILE
	string "Compile source code list"

config PK_CACHE_PAGE_TABLE_RSVDMEM_1G_CONFIG
	string "CONFIG: Project Configure Options"

config PK_CACHE_PAGE_TABLE_RSVDMEM_1G_LIBPATH
	string "LIBS: Libraries to pass to the linker, e.g. -l<library>"

config PK_CACHE_PAGE_TABLE_RSVDMEM_1G_CPPFLAGS
	string "CPPFLAGS: C/C++ preprocessor flags, e.g. -I<include dir>"

config PK_CACHE_PAGE_TABLE_RSVDMEM_1G_DPKCONFIG
	string "PKG_CONFIG_PATH: Directories to add to pkg-config's search path"

config PK_CACHE_PAGE_TABLE_RSVDMEM_1G_CFLAGS
	string "CFLAGS: C compiler flags"

config PK_CACHE_PAGE_TABLE_RSVDMEM_1G_LDFLAGS
	string "LDFLAGS: Linker flags"

config PK_CACHE_PAGE_TABLE_RSVDMEM_1G_CXXFLAGS
	string "CXXFLAGS: C++ compiler flags"

config PK_CACHE_PAGE_TABLE_RSVDMEM_1G_ASFLAGS
	string "CCASFLAGS: assembler compiler flags (defaults to CFLAGS)"

config PK_CACHE_PAGE_TABLE_RSVDMEM_1G_BUILDARCH
	string "--host options on configure for Architecture"

endif # PK_CACHE_PAGE_TABLE_RSVDMEM_1G
```

## package/CACHE/BiscuitOS-CACHE-PAGE-TABLE-RSVDMEM-2M-APP/Kconfig
```kconfig
menuconfig PK_CACHE_PAGE_TABLE_RSVDMEM_2M_APP
	select PK_CACHE_PAGE_TABLE_RSVDMEM_2M
	bool "PAGE Table: Setup CACHE Mode on 2MiB RSVDMEM APP"

if PK_CACHE_PAGE_TABLE_RSVDMEM_2M_APP

config PK_CACHE_PAGE_TABLE_RSVDMEM_2M_APP_VERSION
	default "default"
	string "verstion"

config PK_CACHE_PAGE_TABLE_RSVDMEM_2M_APP_TAR
	default "tar.gz"
	string "tar type"

config PK_CACHE_PAGE_TABLE_RSVDMEM_2M_APP_URL
	default "https://gitee.com/BiscuitOS_team/HardStack/raw/Gitee/Memory-Allocator/CACHE-MECH/BiscuitOS-CACHE-PAGE-TABLE-RSVDMEM-2M-APP"
	string "url"

config PK_CACHE_PAGE_TABLE_RSVDMEM_2M_APP_GITHUB
	string "GitHub"

config PK_CACHE_PAGE_TABLE_RSVDMEM_2M_APP_SRCFILE
	default "main.c Makefile"
	string "Source code list"

config PK_CACHE_PAGE_TABLE_RSVDMEM_2M_APP_CSRCFILE
	string "Compile source code list"

config PK_CACHE_PAGE_TABLE_RSVDMEM_2M_APP_CONFIG
	string "CONFIG: Project Configure Options"

config PK_CACHE_PAGE_TABLE_RSVDMEM_2M_APP_LIBPATH
	string "LIBS: Libraries to pass to the linker, e.g. -l<library>"

config PK_CACHE_PAGE_TABLE_RSVDMEM_2M_APP_CPPFLAGS
	string "CPPFLAGS: C/C++ preprocessor flags, e.g. -I<include dir>"

config PK_CACHE_PAGE_TABLE_RSVDMEM_2M_APP_DPKCONFIG
	string "PKG_CONFIG_PATH: Directories to add to pkg-config's search path"

config PK_CACHE_PAGE_TABLE_RSVDMEM_2M_APP_CFLAGS
	string "CFLAGS: C compiler flags"

config PK_CACHE_PAGE_TABLE_RSVDMEM_2M_APP_LDFLAGS
	string "LDFLAGS: Linker flags"

config PK_CACHE_PAGE_TABLE_RSVDMEM_2M_APP_CXXFLAGS
	string "CXXFLAGS: C++ compiler flags"

config PK_CACHE_PAGE_TABLE_RSVDMEM_2M_APP_ASFLAGS
	string "CCASFLAGS: assembler compiler flags (defaults to CFLAGS)"

config PK_CACHE_PAGE_TABLE_RSVDMEM_2M_APP_BUILDARCH
	string "--host options on configure for Architecture"

endif # PK_CACHE_PAGE_TABLE_RSVDMEM_2M_APP
```

## package/CACHE/BiscuitOS-CACHE-PAGE-TABLE-RSVDMEM-2M/Kconfig
```kconfig
menuconfig PK_CACHE_PAGE_TABLE_RSVDMEM_2M
	bool "PAGE Table: Setup CACHE Mode on 2MiB RSVDMEM"

if PK_CACHE_PAGE_TABLE_RSVDMEM_2M

config PK_CACHE_PAGE_TABLE_RSVDMEM_2M_VERSION
	default "default"
	string "verstion"

config PK_CACHE_PAGE_TABLE_RSVDMEM_2M_TAR
	default "tar.gz"
	string "tar type"

config PK_CACHE_PAGE_TABLE_RSVDMEM_2M_URL
	default "https://gitee.com/BiscuitOS_team/HardStack/raw/Gitee/Memory-Allocator/CACHE-MECH/BiscuitOS-CACHE-PAGE-TABLE-RSVDMEM-2M"
	string "url"

config PK_CACHE_PAGE_TABLE_RSVDMEM_2M_GITHUB
	string "GitHub"

config PK_CACHE_PAGE_TABLE_RSVDMEM_2M_SRCFILE
	default "main.c Kconfig Makefile"
	string "Source code list"

config PK_CACHE_PAGE_TABLE_RSVDMEM_2M_CSRCFILE
	string "Compile source code list"

config PK_CACHE_PAGE_TABLE_RSVDMEM_2M_CONFIG
	string "CONFIG: Project Configure Options"

config PK_CACHE_PAGE_TABLE_RSVDMEM_2M_LIBPATH
	string "LIBS: Libraries to pass to the linker, e.g. -l<library>"

config PK_CACHE_PAGE_TABLE_RSVDMEM_2M_CPPFLAGS
	string "CPPFLAGS: C/C++ preprocessor flags, e.g. -I<include dir>"

config PK_CACHE_PAGE_TABLE_RSVDMEM_2M_DPKCONFIG
	string "PKG_CONFIG_PATH: Directories to add to pkg-config's search path"

config PK_CACHE_PAGE_TABLE_RSVDMEM_2M_CFLAGS
	string "CFLAGS: C compiler flags"

config PK_CACHE_PAGE_TABLE_RSVDMEM_2M_LDFLAGS
	string "LDFLAGS: Linker flags"

config PK_CACHE_PAGE_TABLE_RSVDMEM_2M_CXXFLAGS
	string "CXXFLAGS: C++ compiler flags"

config PK_CACHE_PAGE_TABLE_RSVDMEM_2M_ASFLAGS
	string "CCASFLAGS: assembler compiler flags (defaults to CFLAGS)"

config PK_CACHE_PAGE_TABLE_RSVDMEM_2M_BUILDARCH
	string "--host options on configure for Architecture"

endif # PK_CACHE_PAGE_TABLE_RSVDMEM_2M
```

## package/CACHE/BiscuitOS-CACHE-PAGE-TABLE/Kconfig
```kconfig
menuconfig PK_CACHE_PAGE_TABLE
	bool "PAGE Table: Setup CACHE Mode [Default]"

if PK_CACHE_PAGE_TABLE

config PK_CACHE_PAGE_TABLE_VERSION
	default "default"
	string "verstion"

config PK_CACHE_PAGE_TABLE_TAR
	default "tar.gz"
	string "tar type"

config PK_CACHE_PAGE_TABLE_URL
	default "https://gitee.com/BiscuitOS_team/HardStack/raw/Gitee/Memory-Allocator/CACHE-MECH/BiscuitOS-CACHE-PAGE-TABLE"
	string "url"

config PK_CACHE_PAGE_TABLE_GITHUB
	string "GitHub"

config PK_CACHE_PAGE_TABLE_SRCFILE
	default "app.c main.c Kconfig Makefile Makefile.host RunBiscuitOS.sh"
	string "Source code list"

config PK_CACHE_PAGE_TABLE_CSRCFILE
	string "Compile source code list"

config PK_CACHE_PAGE_TABLE_CONFIG
	string "CONFIG: Project Configure Options"

config PK_CACHE_PAGE_TABLE_LIBPATH
	string "LIBS: Libraries to pass to the linker, e.g. -l<library>"

config PK_CACHE_PAGE_TABLE_CPPFLAGS
	string "CPPFLAGS: C/C++ preprocessor flags, e.g. -I<include dir>"

config PK_CACHE_PAGE_TABLE_DPKCONFIG
	string "PKG_CONFIG_PATH: Directories to add to pkg-config's search path"

config PK_CACHE_PAGE_TABLE_CFLAGS
	string "CFLAGS: C compiler flags"

config PK_CACHE_PAGE_TABLE_LDFLAGS
	string "LDFLAGS: Linker flags"

config PK_CACHE_PAGE_TABLE_CXXFLAGS
	string "CXXFLAGS: C++ compiler flags"

config PK_CACHE_PAGE_TABLE_ASFLAGS
	string "CCASFLAGS: assembler compiler flags (defaults to CFLAGS)"

config PK_CACHE_PAGE_TABLE_BUILDARCH
	string "--host options on configure for Architecture"

endif # PK_CACHE_PAGE_TABLE
```

## package/CACHE/BiscuitOS-CACHE-PERFORMANCE-FALSE-SHARING/Kconfig
```kconfig
menuconfig PK_CACHE_PERFORMANCE_FALSE_SHARING
	bool "Performance: False Sharing"

if PK_CACHE_PERFORMANCE_FALSE_SHARING

config PK_CACHE_PERFORMANCE_FALSE_SHARING_VERSION
	default "default"
	string "verstion"

config PK_CACHE_PERFORMANCE_FALSE_SHARING_TAR
	default "tar.gz"
	string "tar type"

config PK_CACHE_PERFORMANCE_FALSE_SHARING_URL
	default "https://gitee.com/BiscuitOS_team/HardStack/raw/Gitee/Memory-Allocator/CACHE-MECH/BiscuitOS-CACHE-PERFORMANCE-FALSE-SHARING"
	string "url"

config PK_CACHE_PERFORMANCE_FALSE_SHARING_GITHUB
	string "GitHub"

config PK_CACHE_PERFORMANCE_FALSE_SHARING_SRCFILE
	default "main-A.c main-B.c Kconfig Makefile Makefile.host RunBiscuitOS.sh"
	string "Source code list"

config PK_CACHE_PERFORMANCE_FALSE_SHARING_CSRCFILE
	string "Compile source code list"

config PK_CACHE_PERFORMANCE_FALSE_SHARING_CONFIG
	string "CONFIG: Project Configure Options"

config PK_CACHE_PERFORMANCE_FALSE_SHARING_LIBPATH
	string "LIBS: Libraries to pass to the linker, e.g. -l<library>"

config PK_CACHE_PERFORMANCE_FALSE_SHARING_CPPFLAGS
	string "CPPFLAGS: C/C++ preprocessor flags, e.g. -I<include dir>"

config PK_CACHE_PERFORMANCE_FALSE_SHARING_DPKCONFIG
	string "PKG_CONFIG_PATH: Directories to add to pkg-config's search path"

config PK_CACHE_PERFORMANCE_FALSE_SHARING_CFLAGS
	string "CFLAGS: C compiler flags"

config PK_CACHE_PERFORMANCE_FALSE_SHARING_LDFLAGS
	string "LDFLAGS: Linker flags"

config PK_CACHE_PERFORMANCE_FALSE_SHARING_CXXFLAGS
	string "CXXFLAGS: C++ compiler flags"

config PK_CACHE_PERFORMANCE_FALSE_SHARING_ASFLAGS
	string "CCASFLAGS: assembler compiler flags (defaults to CFLAGS)"

config PK_CACHE_PERFORMANCE_FALSE_SHARING_BUILDARCH
	string "--host options on configure for Architecture"

endif # PK_CACHE_PERFORMANCE_FALSE_SHARING
```

## package/CACHE/BiscuitOS-CACHE-PERFORMANCE-PREFETCH/Kconfig
```kconfig
menuconfig PK_CACHE_PERFORMANCE_PREFETCH
	bool "Performance: Prefetch"

if PK_CACHE_PERFORMANCE_PREFETCH

config PK_CACHE_PERFORMANCE_PREFETCH_VERSION
	default "default"
	string "verstion"

config PK_CACHE_PERFORMANCE_PREFETCH_TAR
	default "tar.gz"
	string "tar type"

config PK_CACHE_PERFORMANCE_PREFETCH_URL
	default "https://gitee.com/BiscuitOS_team/HardStack/raw/Gitee/Memory-Allocator/CACHE-MECH/BiscuitOS-CACHE-PERFORMANCE-PREFETCH"
	string "url"

config PK_CACHE_PERFORMANCE_PREFETCH_GITHUB
	string "GitHub"

config PK_CACHE_PERFORMANCE_PREFETCH_SRCFILE
	default "main.c Makefile RunBiscuitOS.sh"
	string "Source code list"

config PK_CACHE_PERFORMANCE_PREFETCH_CSRCFILE
	string "Compile source code list"

config PK_CACHE_PERFORMANCE_PREFETCH_CONFIG
	string "CONFIG: Project Configure Options"

config PK_CACHE_PERFORMANCE_PREFETCH_LIBPATH
	string "LIBS: Libraries to pass to the linker, e.g. -l<library>"

config PK_CACHE_PERFORMANCE_PREFETCH_CPPFLAGS
	string "CPPFLAGS: C/C++ preprocessor flags, e.g. -I<include dir>"

config PK_CACHE_PERFORMANCE_PREFETCH_DPKCONFIG
	string "PKG_CONFIG_PATH: Directories to add to pkg-config's search path"

config PK_CACHE_PERFORMANCE_PREFETCH_CFLAGS
	string "CFLAGS: C compiler flags"

config PK_CACHE_PERFORMANCE_PREFETCH_LDFLAGS
	string "LDFLAGS: Linker flags"

config PK_CACHE_PERFORMANCE_PREFETCH_CXXFLAGS
	string "CXXFLAGS: C++ compiler flags"

config PK_CACHE_PERFORMANCE_PREFETCH_ASFLAGS
	string "CCASFLAGS: assembler compiler flags (defaults to CFLAGS)"

config PK_CACHE_PERFORMANCE_PREFETCH_BUILDARCH
	string "--host options on configure for Architecture"

endif # PK_CACHE_PERFORMANCE_PREFETCH
```

## package/CACHE/BiscuitOS-CACHE-PERFORMANCE-WB-VS-UC/Kconfig
```kconfig
menuconfig PK_CACHE_PERFORMANCE_WB_UC
	select PK_CACHE_USER_PAGE_KERNEL_STUB
	bool "CACHE Performance: WB Vs. UC on Normal Memory"

if PK_CACHE_PERFORMANCE_WB_UC

config PK_CACHE_PERFORMANCE_WB_UC_VERSION
	default "default"
	string "verstion"

config PK_CACHE_PERFORMANCE_WB_UC_TAR
	default "tar.gz"
	string "tar type"

config PK_CACHE_PERFORMANCE_WB_UC_URL
	default "https://gitee.com/BiscuitOS_team/HardStack/raw/Gitee/Memory-Allocator/CACHE-MECH/BiscuitOS-CACHE-PERFORMANCE-WB-VS-UC"
	string "url"

config PK_CACHE_PERFORMANCE_WB_UC_GITHUB
	string "GitHub"

config PK_CACHE_PERFORMANCE_WB_UC_SRCFILE
	default "main.c Makefile"
	string "Source code list"

config PK_CACHE_PERFORMANCE_WB_UC_CSRCFILE
	string "Compile source code list"

config PK_CACHE_PERFORMANCE_WB_UC_CONFIG
	string "CONFIG: Project Configure Options"

config PK_CACHE_PERFORMANCE_WB_UC_LIBPATH
	string "LIBS: Libraries to pass to the linker, e.g. -l<library>"

config PK_CACHE_PERFORMANCE_WB_UC_CPPFLAGS
	string "CPPFLAGS: C/C++ preprocessor flags, e.g. -I<include dir>"

config PK_CACHE_PERFORMANCE_WB_UC_DPKCONFIG
	string "PKG_CONFIG_PATH: Directories to add to pkg-config's search path"

config PK_CACHE_PERFORMANCE_WB_UC_CFLAGS
	string "CFLAGS: C compiler flags"

config PK_CACHE_PERFORMANCE_WB_UC_LDFLAGS
	string "LDFLAGS: Linker flags"

config PK_CACHE_PERFORMANCE_WB_UC_CXXFLAGS
	string "CXXFLAGS: C++ compiler flags"

config PK_CACHE_PERFORMANCE_WB_UC_ASFLAGS
	string "CCASFLAGS: assembler compiler flags (defaults to CFLAGS)"

config PK_CACHE_PERFORMANCE_WB_UC_BUILDARCH
	string "--host options on configure for Architecture"

endif # PK_CACHE_PERFORMANCE_WB_UC
```
