## package/MEMORY-MMAP/BiscuitOS-MEMORY-MMAP-VMA-VM-NORESERVE/Kconfig
```kconfig
menuconfig PK_MEMORY_MMAP_VMA_VM_NORESERVE
	bool "Memory Mapping: VMA VM_NORESERVE"

if PK_MEMORY_MMAP_VMA_VM_NORESERVE

config PK_MEMORY_MMAP_VMA_VM_NORESERVE_VERSION
	default "default"
	string "verstion"

config PK_MEMORY_MMAP_VMA_VM_NORESERVE_TAR
	default "tar.gz"
	string "tar type"

config PK_MEMORY_MMAP_VMA_VM_NORESERVE_URL
	default "https://gitee.com/BiscuitOS_team/HardStack/raw/Gitee/Memory-Allocator/MMAP-MECH/BiscuitOS-MEMORY-MMAP-VMA-VM-NORESERVE"
	string "url"

config PK_MEMORY_MMAP_VMA_VM_NORESERVE_GITHUB
	string "GitHub"

config PK_MEMORY_MMAP_VMA_VM_NORESERVE_SRCFILE
	default "main.c Makefile RunBiscuitOS.sh"
	string "Source code list"

config PK_MEMORY_MMAP_VMA_VM_NORESERVE_CSRCFILE
	string "Compile source code list"

config PK_MEMORY_MMAP_VMA_VM_NORESERVE_CONFIG
	string "CONFIG: Project Configure Options"

config PK_MEMORY_MMAP_VMA_VM_NORESERVE_LIBPATH
	string "LIBS: Libraries to pass to the linker, e.g. -l<library>"

config PK_MEMORY_MMAP_VMA_VM_NORESERVE_CPPFLAGS
	string "CPPFLAGS: C/C++ preprocessor flags, e.g. -I<include dir>"

config PK_MEMORY_MMAP_VMA_VM_NORESERVE_DPKCONFIG
	string "PKG_CONFIG_PATH: Directories to add to pkg-config's search path"

config PK_MEMORY_MMAP_VMA_VM_NORESERVE_CFLAGS
	string "CFLAGS: C compiler flags"

config PK_MEMORY_MMAP_VMA_VM_NORESERVE_LDFLAGS
	string "LDFLAGS: Linker flags"

config PK_MEMORY_MMAP_VMA_VM_NORESERVE_CXXFLAGS
	string "CXXFLAGS: C++ compiler flags"

config PK_MEMORY_MMAP_VMA_VM_NORESERVE_ASFLAGS
	string "CCASFLAGS: assembler compiler flags (defaults to CFLAGS)"

config PK_MEMORY_MMAP_VMA_VM_NORESERVE_BUILDARCH
	string "--host options on configure for Architecture"

endif # PK_MEMORY_MMAP_VMA_VM_NORESERVE
```

## package/MEMORY-MMAP/BiscuitOS-MEMORY-MMAP-VMA-VM-PFNMAP/Kconfig
```kconfig
menuconfig PK_MEMORY_MMAP_VMA_VM_PFNMAP
	bool "Memory Mapping: VMA VM_PFNMAP"

if PK_MEMORY_MMAP_VMA_VM_PFNMAP

config PK_MEMORY_MMAP_VMA_VM_PFNMAP_VERSION
	default "default"
	string "verstion"

config PK_MEMORY_MMAP_VMA_VM_PFNMAP_TAR
	default "tar.gz"
	string "tar type"

config PK_MEMORY_MMAP_VMA_VM_PFNMAP_URL
	default "https://gitee.com/BiscuitOS_team/HardStack/raw/Gitee/Memory-Allocator/MMAP-MECH/BiscuitOS-MEMORY-MMAP-VMA-VM-PFNMAP"
	string "url"

config PK_MEMORY_MMAP_VMA_VM_PFNMAP_GITHUB
	string "GitHub"

config PK_MEMORY_MMAP_VMA_VM_PFNMAP_SRCFILE
	default "main.c Makefile RunBiscuitOS.sh"
	string "Source code list"

config PK_MEMORY_MMAP_VMA_VM_PFNMAP_CSRCFILE
	string "Compile source code list"

config PK_MEMORY_MMAP_VMA_VM_PFNMAP_CONFIG
	string "CONFIG: Project Configure Options"

config PK_MEMORY_MMAP_VMA_VM_PFNMAP_LIBPATH
	string "LIBS: Libraries to pass to the linker, e.g. -l<library>"

config PK_MEMORY_MMAP_VMA_VM_PFNMAP_CPPFLAGS
	string "CPPFLAGS: C/C++ preprocessor flags, e.g. -I<include dir>"

config PK_MEMORY_MMAP_VMA_VM_PFNMAP_DPKCONFIG
	string "PKG_CONFIG_PATH: Directories to add to pkg-config's search path"

config PK_MEMORY_MMAP_VMA_VM_PFNMAP_CFLAGS
	string "CFLAGS: C compiler flags"

config PK_MEMORY_MMAP_VMA_VM_PFNMAP_LDFLAGS
	string "LDFLAGS: Linker flags"

config PK_MEMORY_MMAP_VMA_VM_PFNMAP_CXXFLAGS
	string "CXXFLAGS: C++ compiler flags"

config PK_MEMORY_MMAP_VMA_VM_PFNMAP_ASFLAGS
	string "CCASFLAGS: assembler compiler flags (defaults to CFLAGS)"

config PK_MEMORY_MMAP_VMA_VM_PFNMAP_BUILDARCH
	string "--host options on configure for Architecture"

endif # PK_MEMORY_MMAP_VMA_VM_PFNMAP
```

## package/MEMORY-MMAP/BiscuitOS-MEMORY-MMAP-VMA-VM-RAND-READ/Kconfig
```kconfig
menuconfig PK_MEMORY_MMAP_VMA_VM_RAND_READ
	bool "Memory Mapping: VMA VM_RAND_READ"

if PK_MEMORY_MMAP_VMA_VM_RAND_READ

config PK_MEMORY_MMAP_VMA_VM_RAND_READ_VERSION
	default "default"
	string "verstion"

config PK_MEMORY_MMAP_VMA_VM_RAND_READ_TAR
	default "tar.gz"
	string "tar type"

config PK_MEMORY_MMAP_VMA_VM_RAND_READ_URL
	default "https://gitee.com/BiscuitOS_team/HardStack/raw/Gitee/Memory-Allocator/MMAP-MECH/BiscuitOS-MEMORY-MMAP-VMA-VM-RAND-READ"
	string "url"

config PK_MEMORY_MMAP_VMA_VM_RAND_READ_GITHUB
	string "GitHub"

config PK_MEMORY_MMAP_VMA_VM_RAND_READ_SRCFILE
	default "main.c Makefile RunBiscuitOS.sh"
	string "Source code list"

config PK_MEMORY_MMAP_VMA_VM_RAND_READ_CSRCFILE
	string "Compile source code list"

config PK_MEMORY_MMAP_VMA_VM_RAND_READ_CONFIG
	string "CONFIG: Project Configure Options"

config PK_MEMORY_MMAP_VMA_VM_RAND_READ_LIBPATH
	string "LIBS: Libraries to pass to the linker, e.g. -l<library>"

config PK_MEMORY_MMAP_VMA_VM_RAND_READ_CPPFLAGS
	string "CPPFLAGS: C/C++ preprocessor flags, e.g. -I<include dir>"

config PK_MEMORY_MMAP_VMA_VM_RAND_READ_DPKCONFIG
	string "PKG_CONFIG_PATH: Directories to add to pkg-config's search path"

config PK_MEMORY_MMAP_VMA_VM_RAND_READ_CFLAGS
	string "CFLAGS: C compiler flags"

config PK_MEMORY_MMAP_VMA_VM_RAND_READ_LDFLAGS
	string "LDFLAGS: Linker flags"

config PK_MEMORY_MMAP_VMA_VM_RAND_READ_CXXFLAGS
	string "CXXFLAGS: C++ compiler flags"

config PK_MEMORY_MMAP_VMA_VM_RAND_READ_ASFLAGS
	string "CCASFLAGS: assembler compiler flags (defaults to CFLAGS)"

config PK_MEMORY_MMAP_VMA_VM_RAND_READ_BUILDARCH
	string "--host options on configure for Architecture"

endif # PK_MEMORY_MMAP_VMA_VM_RAND_READ
```

## package/MEMORY-MMAP/BiscuitOS-MEMORY-MMAP-VMA-VM-RB/Kconfig
```kconfig
menuconfig PK_MEMORY_MMAP_VMA_VM_RB
	bool "Memory Mapping: VMA VM_RB/RB_SUBTREE_GAP"

if PK_MEMORY_MMAP_VMA_VM_RB

config PK_MEMORY_MMAP_VMA_VM_RB_VERSION
	default "default"
	string "verstion"

config PK_MEMORY_MMAP_VMA_VM_RB_TAR
	default "tar.gz"
	string "tar type"

config PK_MEMORY_MMAP_VMA_VM_RB_URL
	default "https://gitee.com/BiscuitOS_team/HardStack/raw/Gitee/Memory-Allocator/MMAP-MECH/BiscuitOS-MEMORY-MMAP-VMA-VM-RB"
	string "url"

config PK_MEMORY_MMAP_VMA_VM_RB_GITHUB
	string "GitHub"

config PK_MEMORY_MMAP_VMA_VM_RB_SRCFILE
	default "app.c  Kconfig  main.c  Makefile  Makefile.host  RunBiscuitOS.sh"
	string "Source code list"

config PK_MEMORY_MMAP_VMA_VM_RB_CSRCFILE
	string "Compile source code list"

config PK_MEMORY_MMAP_VMA_VM_RB_CONFIG
	string "CONFIG: Project Configure Options"

config PK_MEMORY_MMAP_VMA_VM_RB_LIBPATH
	string "LIBS: Libraries to pass to the linker, e.g. -l<library>"

config PK_MEMORY_MMAP_VMA_VM_RB_CPPFLAGS
	string "CPPFLAGS: C/C++ preprocessor flags, e.g. -I<include dir>"

config PK_MEMORY_MMAP_VMA_VM_RB_DPKCONFIG
	string "PKG_CONFIG_PATH: Directories to add to pkg-config's search path"

config PK_MEMORY_MMAP_VMA_VM_RB_CFLAGS
	string "CFLAGS: C compiler flags"

config PK_MEMORY_MMAP_VMA_VM_RB_LDFLAGS
	string "LDFLAGS: Linker flags"

config PK_MEMORY_MMAP_VMA_VM_RB_CXXFLAGS
	string "CXXFLAGS: C++ compiler flags"

config PK_MEMORY_MMAP_VMA_VM_RB_ASFLAGS
	string "CCASFLAGS: assembler compiler flags (defaults to CFLAGS)"

config PK_MEMORY_MMAP_VMA_VM_RB_BUILDARCH
	string "--host options on configure for Architecture"

endif # PK_MEMORY_MMAP_VMA_VM_RB
```

## package/MEMORY-MMAP/BiscuitOS-MEMORY-MMAP-VMA-VM-SEQ-READ/Kconfig
```kconfig
menuconfig PK_MEMORY_MMAP_VMA_VM_SEQ_READ
	bool "Memory Mapping: VMA VM_SEQ_READ"

if PK_MEMORY_MMAP_VMA_VM_SEQ_READ

config PK_MEMORY_MMAP_VMA_VM_SEQ_READ_VERSION
	default "default"
	string "verstion"

config PK_MEMORY_MMAP_VMA_VM_SEQ_READ_TAR
	default "tar.gz"
	string "tar type"

config PK_MEMORY_MMAP_VMA_VM_SEQ_READ_URL
	default "https://gitee.com/BiscuitOS_team/HardStack/raw/Gitee/Memory-Allocator/MMAP-MECH/BiscuitOS-MEMORY-MMAP-VMA-VM-SEQ-READ"
	string "url"

config PK_MEMORY_MMAP_VMA_VM_SEQ_READ_GITHUB
	string "GitHub"

config PK_MEMORY_MMAP_VMA_VM_SEQ_READ_SRCFILE
	default "main.c Makefile RunBiscuitOS.sh"
	string "Source code list"

config PK_MEMORY_MMAP_VMA_VM_SEQ_READ_CSRCFILE
	string "Compile source code list"

config PK_MEMORY_MMAP_VMA_VM_SEQ_READ_CONFIG
	string "CONFIG: Project Configure Options"

config PK_MEMORY_MMAP_VMA_VM_SEQ_READ_LIBPATH
	string "LIBS: Libraries to pass to the linker, e.g. -l<library>"

config PK_MEMORY_MMAP_VMA_VM_SEQ_READ_CPPFLAGS
	string "CPPFLAGS: C/C++ preprocessor flags, e.g. -I<include dir>"

config PK_MEMORY_MMAP_VMA_VM_SEQ_READ_DPKCONFIG
	string "PKG_CONFIG_PATH: Directories to add to pkg-config's search path"

config PK_MEMORY_MMAP_VMA_VM_SEQ_READ_CFLAGS
	string "CFLAGS: C compiler flags"

config PK_MEMORY_MMAP_VMA_VM_SEQ_READ_LDFLAGS
	string "LDFLAGS: Linker flags"

config PK_MEMORY_MMAP_VMA_VM_SEQ_READ_CXXFLAGS
	string "CXXFLAGS: C++ compiler flags"

config PK_MEMORY_MMAP_VMA_VM_SEQ_READ_ASFLAGS
	string "CCASFLAGS: assembler compiler flags (defaults to CFLAGS)"

config PK_MEMORY_MMAP_VMA_VM_SEQ_READ_BUILDARCH
	string "--host options on configure for Architecture"

endif # PK_MEMORY_MMAP_VMA_VM_SEQ_READ
```

## package/MEMORY-MMAP/BiscuitOS-MEMORY-MMAP-VMA-VM-SHARED-RB/Kconfig
```kconfig
menuconfig PK_MEMORY_MMAP_VMA_VM_SHARED_RB
	bool "Memory Mapping: VMA SHARED.RB/SHARED.RB_SUBTREE_LAST"

if PK_MEMORY_MMAP_VMA_VM_SHARED_RB

config PK_MEMORY_MMAP_VMA_VM_SHARED_RB_VERSION
	default "default"
	string "verstion"

config PK_MEMORY_MMAP_VMA_VM_SHARED_RB_TAR
	default "tar.gz"
	string "tar type"

config PK_MEMORY_MMAP_VMA_VM_SHARED_RB_URL
	default "https://gitee.com/BiscuitOS_team/HardStack/raw/Gitee/Memory-Allocator/MMAP-MECH/BiscuitOS-MEMORY-MMAP-VMA-VM-SHARED-RB"
	string "url"

config PK_MEMORY_MMAP_VMA_VM_SHARED_RB_GITHUB
	string "GitHub"

config PK_MEMORY_MMAP_VMA_VM_SHARED_RB_SRCFILE
	default "app.c  Kconfig  main.c  Makefile  Makefile.app  RunBiscuitOS.sh"
	string "Source code list"

config PK_MEMORY_MMAP_VMA_VM_SHARED_RB_CSRCFILE
	string "Compile source code list"

config PK_MEMORY_MMAP_VMA_VM_SHARED_RB_CONFIG
	string "CONFIG: Project Configure Options"

config PK_MEMORY_MMAP_VMA_VM_SHARED_RB_LIBPATH
	string "LIBS: Libraries to pass to the linker, e.g. -l<library>"

config PK_MEMORY_MMAP_VMA_VM_SHARED_RB_CPPFLAGS
	string "CPPFLAGS: C/C++ preprocessor flags, e.g. -I<include dir>"

config PK_MEMORY_MMAP_VMA_VM_SHARED_RB_DPKCONFIG
	string "PKG_CONFIG_PATH: Directories to add to pkg-config's search path"

config PK_MEMORY_MMAP_VMA_VM_SHARED_RB_CFLAGS
	string "CFLAGS: C compiler flags"

config PK_MEMORY_MMAP_VMA_VM_SHARED_RB_LDFLAGS
	string "LDFLAGS: Linker flags"

config PK_MEMORY_MMAP_VMA_VM_SHARED_RB_CXXFLAGS
	string "CXXFLAGS: C++ compiler flags"

config PK_MEMORY_MMAP_VMA_VM_SHARED_RB_ASFLAGS
	string "CCASFLAGS: assembler compiler flags (defaults to CFLAGS)"

config PK_MEMORY_MMAP_VMA_VM_SHARED_RB_BUILDARCH
	string "--host options on configure for Architecture"

endif # PK_MEMORY_MMAP_VMA_VM_SHARED_RB
```

## package/MEMORY-MMAP/BiscuitOS-MEMORY-MMAP-VMA-VM-SOFTDIRTY/Kconfig
```kconfig
menuconfig PK_MEMORY_MMAP_VMA_VM_SOFTDIRTY
	bool "Memory Mapping: VMA VM_SOFTDIRTY"

if PK_MEMORY_MMAP_VMA_VM_SOFTDIRTY

config PK_MEMORY_MMAP_VMA_VM_SOFTDIRTY_VERSION
	default "default"
	string "verstion"

config PK_MEMORY_MMAP_VMA_VM_SOFTDIRTY_TAR
	default "tar.gz"
	string "tar type"

config PK_MEMORY_MMAP_VMA_VM_SOFTDIRTY_URL
	default "https://gitee.com/BiscuitOS_team/HardStack/raw/Gitee/Memory-Allocator/MMAP-MECH/BiscuitOS-MEMORY-MMAP-VMA-VM-SOFTDIRTY"
	string "url"

config PK_MEMORY_MMAP_VMA_VM_SOFTDIRTY_GITHUB
	string "GitHub"

config PK_MEMORY_MMAP_VMA_VM_SOFTDIRTY_SRCFILE
	default "main.c Makefile RunBiscuitOS.sh"
	string "Source code list"

config PK_MEMORY_MMAP_VMA_VM_SOFTDIRTY_CSRCFILE
	string "Compile source code list"

config PK_MEMORY_MMAP_VMA_VM_SOFTDIRTY_CONFIG
	string "CONFIG: Project Configure Options"

config PK_MEMORY_MMAP_VMA_VM_SOFTDIRTY_LIBPATH
	string "LIBS: Libraries to pass to the linker, e.g. -l<library>"

config PK_MEMORY_MMAP_VMA_VM_SOFTDIRTY_CPPFLAGS
	string "CPPFLAGS: C/C++ preprocessor flags, e.g. -I<include dir>"

config PK_MEMORY_MMAP_VMA_VM_SOFTDIRTY_DPKCONFIG
	string "PKG_CONFIG_PATH: Directories to add to pkg-config's search path"

config PK_MEMORY_MMAP_VMA_VM_SOFTDIRTY_CFLAGS
	string "CFLAGS: C compiler flags"

config PK_MEMORY_MMAP_VMA_VM_SOFTDIRTY_LDFLAGS
	string "LDFLAGS: Linker flags"

config PK_MEMORY_MMAP_VMA_VM_SOFTDIRTY_CXXFLAGS
	string "CXXFLAGS: C++ compiler flags"

config PK_MEMORY_MMAP_VMA_VM_SOFTDIRTY_ASFLAGS
	string "CCASFLAGS: assembler compiler flags (defaults to CFLAGS)"

config PK_MEMORY_MMAP_VMA_VM_SOFTDIRTY_BUILDARCH
	string "--host options on configure for Architecture"

endif # PK_MEMORY_MMAP_VMA_VM_SOFTDIRTY
```

## package/MEMORY-MMAP/BiscuitOS-MEMORY-MMAP-VMA-VM-UFFD-MISSING/Kconfig
```kconfig
menuconfig PK_MEMORY_MMAP_VMA_VM_UFFD_MISSING
	bool "Memory Mapping: VMA VM_UFFD_MISSING"

if PK_MEMORY_MMAP_VMA_VM_UFFD_MISSING

config PK_MEMORY_MMAP_VMA_VM_UFFD_MISSING_VERSION
	default "default"
	string "verstion"

config PK_MEMORY_MMAP_VMA_VM_UFFD_MISSING_TAR
	default "tar.gz"
	string "tar type"

config PK_MEMORY_MMAP_VMA_VM_UFFD_MISSING_URL
	default "https://gitee.com/BiscuitOS_team/HardStack/raw/Gitee/Memory-Allocator/MMAP-MECH/BiscuitOS-MEMORY-MMAP-VMA-VM-UFFD-MISSING"
	string "url"

config PK_MEMORY_MMAP_VMA_VM_UFFD_MISSING_GITHUB
	string "GitHub"

config PK_MEMORY_MMAP_VMA_VM_UFFD_MISSING_SRCFILE
	default "main.c Makefile RunBiscuitOS.sh"
	string "Source code list"

config PK_MEMORY_MMAP_VMA_VM_UFFD_MISSING_CSRCFILE
	string "Compile source code list"

config PK_MEMORY_MMAP_VMA_VM_UFFD_MISSING_CONFIG
	string "CONFIG: Project Configure Options"

config PK_MEMORY_MMAP_VMA_VM_UFFD_MISSING_LIBPATH
	string "LIBS: Libraries to pass to the linker, e.g. -l<library>"

config PK_MEMORY_MMAP_VMA_VM_UFFD_MISSING_CPPFLAGS
	string "CPPFLAGS: C/C++ preprocessor flags, e.g. -I<include dir>"

config PK_MEMORY_MMAP_VMA_VM_UFFD_MISSING_DPKCONFIG
	string "PKG_CONFIG_PATH: Directories to add to pkg-config's search path"

config PK_MEMORY_MMAP_VMA_VM_UFFD_MISSING_CFLAGS
	string "CFLAGS: C compiler flags"

config PK_MEMORY_MMAP_VMA_VM_UFFD_MISSING_LDFLAGS
	string "LDFLAGS: Linker flags"

config PK_MEMORY_MMAP_VMA_VM_UFFD_MISSING_CXXFLAGS
	string "CXXFLAGS: C++ compiler flags"

config PK_MEMORY_MMAP_VMA_VM_UFFD_MISSING_ASFLAGS
	string "CCASFLAGS: assembler compiler flags (defaults to CFLAGS)"

config PK_MEMORY_MMAP_VMA_VM_UFFD_MISSING_BUILDARCH
	string "--host options on configure for Architecture"

endif # PK_MEMORY_MMAP_VMA_VM_UFFD_MISSING
```

## package/MEMORY-MMAP/BiscuitOS-MEMORY-MMAP-VMA-VM-WRITE/Kconfig
```kconfig
menuconfig PK_MEMORY_MMAP_VMA_VM_WRITE
	bool "Memory Mapping: VMA VM_WRITE"

if PK_MEMORY_MMAP_VMA_VM_WRITE

config PK_MEMORY_MMAP_VMA_VM_WRITE_VERSION
	default "default"
	string "verstion"

config PK_MEMORY_MMAP_VMA_VM_WRITE_TAR
	default "tar.gz"
	string "tar type"

config PK_MEMORY_MMAP_VMA_VM_WRITE_URL
	default "https://gitee.com/BiscuitOS_team/HardStack/raw/Gitee/Memory-Allocator/MMAP-MECH/BiscuitOS-MEMORY-MMAP-VMA-VM-WRITE"
	string "url"

config PK_MEMORY_MMAP_VMA_VM_WRITE_GITHUB
	string "GitHub"

config PK_MEMORY_MMAP_VMA_VM_WRITE_SRCFILE
	default "main.c Makefile RunBiscuitOS.sh"
	string "Source code list"

config PK_MEMORY_MMAP_VMA_VM_WRITE_CSRCFILE
	string "Compile source code list"

config PK_MEMORY_MMAP_VMA_VM_WRITE_CONFIG
	string "CONFIG: Project Configure Options"

config PK_MEMORY_MMAP_VMA_VM_WRITE_LIBPATH
	string "LIBS: Libraries to pass to the linker, e.g. -l<library>"

config PK_MEMORY_MMAP_VMA_VM_WRITE_CPPFLAGS
	string "CPPFLAGS: C/C++ preprocessor flags, e.g. -I<include dir>"

config PK_MEMORY_MMAP_VMA_VM_WRITE_DPKCONFIG
	string "PKG_CONFIG_PATH: Directories to add to pkg-config's search path"

config PK_MEMORY_MMAP_VMA_VM_WRITE_CFLAGS
	string "CFLAGS: C compiler flags"

config PK_MEMORY_MMAP_VMA_VM_WRITE_LDFLAGS
	string "LDFLAGS: Linker flags"

config PK_MEMORY_MMAP_VMA_VM_WRITE_CXXFLAGS
	string "CXXFLAGS: C++ compiler flags"

config PK_MEMORY_MMAP_VMA_VM_WRITE_ASFLAGS
	string "CCASFLAGS: assembler compiler flags (defaults to CFLAGS)"

config PK_MEMORY_MMAP_VMA_VM_WRITE_BUILDARCH
	string "--host options on configure for Architecture"

endif # PK_MEMORY_MMAP_VMA_VM_WRITE
```
