## package/MEMORY-MMAP/BiscuitOS-MEMORY-MMAP-SPECIAL-MAPPING/Kconfig
```kconfig
menuconfig PK_MEMORY_MMAP_SPECIAL_MAPPING
	bool "Memory Mapping: SPECIAL MAPPING"

if PK_MEMORY_MMAP_SPECIAL_MAPPING

config PK_MEMORY_MMAP_SPECIAL_MAPPING_VERSION
	default "default"
	string "verstion"

config PK_MEMORY_MMAP_SPECIAL_MAPPING_TAR
	default "tar.gz"
	string "tar type"

config PK_MEMORY_MMAP_SPECIAL_MAPPING_URL
	default "https://gitee.com/BiscuitOS_team/HardStack/raw/Gitee/Memory-Allocator/MMAP-MECH/BiscuitOS-MEMORY-MMAP-SPECIAL-MAPPING"
	string "url"

config PK_MEMORY_MMAP_SPECIAL_MAPPING_GITHUB
	string "GitHub"

config PK_MEMORY_MMAP_SPECIAL_MAPPING_SRCFILE
	default "app.c  Kconfig  main.c  Makefile  Makefile.app  RunBiscuitOS.sh"
	string "Source code list"

config PK_MEMORY_MMAP_SPECIAL_MAPPING_CSRCFILE
	string "Compile source code list"

config PK_MEMORY_MMAP_SPECIAL_MAPPING_CONFIG
	string "CONFIG: Project Configure Options"

config PK_MEMORY_MMAP_SPECIAL_MAPPING_LIBPATH
	string "LIBS: Libraries to pass to the linker, e.g. -l<library>"

config PK_MEMORY_MMAP_SPECIAL_MAPPING_CPPFLAGS
	string "CPPFLAGS: C/C++ preprocessor flags, e.g. -I<include dir>"

config PK_MEMORY_MMAP_SPECIAL_MAPPING_DPKCONFIG
	string "PKG_CONFIG_PATH: Directories to add to pkg-config's search path"

config PK_MEMORY_MMAP_SPECIAL_MAPPING_CFLAGS
	string "CFLAGS: C compiler flags"

config PK_MEMORY_MMAP_SPECIAL_MAPPING_LDFLAGS
	string "LDFLAGS: Linker flags"

config PK_MEMORY_MMAP_SPECIAL_MAPPING_CXXFLAGS
	string "CXXFLAGS: C++ compiler flags"

config PK_MEMORY_MMAP_SPECIAL_MAPPING_ASFLAGS
	string "CCASFLAGS: assembler compiler flags (defaults to CFLAGS)"

config PK_MEMORY_MMAP_SPECIAL_MAPPING_BUILDARCH
	string "--host options on configure for Architecture"

endif # PK_MEMORY_MMAP_SPECIAL_MAPPING
```

## package/MEMORY-MMAP/BiscuitOS-MEMORY-MMAP-VMA-VM-AV/Kconfig
```kconfig
menuconfig PK_MEMORY_MMAP_VMA_VM_AV
	bool "Memory Mapping: VMA AV/AVC"

if PK_MEMORY_MMAP_VMA_VM_AV

config PK_MEMORY_MMAP_VMA_VM_AV_VERSION
	default "default"
	string "verstion"

config PK_MEMORY_MMAP_VMA_VM_AV_TAR
	default "tar.gz"
	string "tar type"

config PK_MEMORY_MMAP_VMA_VM_AV_URL
	default "https://gitee.com/BiscuitOS_team/HardStack/raw/Gitee/Memory-Allocator/MMAP-MECH/BiscuitOS-MEMORY-MMAP-VMA-VM-AV"
	string "url"

config PK_MEMORY_MMAP_VMA_VM_AV_GITHUB
	string "GitHub"

config PK_MEMORY_MMAP_VMA_VM_AV_SRCFILE
	default "app.c  Kconfig  main.c  Makefile  Makefile.app  RunBiscuitOS.sh"
	string "Source code list"

config PK_MEMORY_MMAP_VMA_VM_AV_CSRCFILE
	string "Compile source code list"

config PK_MEMORY_MMAP_VMA_VM_AV_CONFIG
	string "CONFIG: Project Configure Options"

config PK_MEMORY_MMAP_VMA_VM_AV_LIBPATH
	string "LIBS: Libraries to pass to the linker, e.g. -l<library>"

config PK_MEMORY_MMAP_VMA_VM_AV_CPPFLAGS
	string "CPPFLAGS: C/C++ preprocessor flags, e.g. -I<include dir>"

config PK_MEMORY_MMAP_VMA_VM_AV_DPKCONFIG
	string "PKG_CONFIG_PATH: Directories to add to pkg-config's search path"

config PK_MEMORY_MMAP_VMA_VM_AV_CFLAGS
	string "CFLAGS: C compiler flags"

config PK_MEMORY_MMAP_VMA_VM_AV_LDFLAGS
	string "LDFLAGS: Linker flags"

config PK_MEMORY_MMAP_VMA_VM_AV_CXXFLAGS
	string "CXXFLAGS: C++ compiler flags"

config PK_MEMORY_MMAP_VMA_VM_AV_ASFLAGS
	string "CCASFLAGS: assembler compiler flags (defaults to CFLAGS)"

config PK_MEMORY_MMAP_VMA_VM_AV_BUILDARCH
	string "--host options on configure for Architecture"

endif # PK_MEMORY_MMAP_VMA_VM_AV
```

## package/MEMORY-MMAP/BiscuitOS-MEMORY-MMAP-VMA-VM-DONTDUMP/Kconfig
```kconfig
menuconfig PK_MEMORY_MMAP_VMA_VM_DONTDUMP
	bool "Memory Mapping: VMA VM_DONTDUMP"

if PK_MEMORY_MMAP_VMA_VM_DONTDUMP

config PK_MEMORY_MMAP_VMA_VM_DONTDUMP_VERSION
	default "default"
	string "verstion"

config PK_MEMORY_MMAP_VMA_VM_DONTDUMP_TAR
	default "tar.gz"
	string "tar type"

config PK_MEMORY_MMAP_VMA_VM_DONTDUMP_URL
	default "https://gitee.com/BiscuitOS_team/HardStack/raw/Gitee/Memory-Allocator/MMAP-MECH/BiscuitOS-MEMORY-MMAP-VMA-VM-DONTDUMP"
	string "url"

config PK_MEMORY_MMAP_VMA_VM_DONTDUMP_GITHUB
	string "GitHub"

config PK_MEMORY_MMAP_VMA_VM_DONTDUMP_SRCFILE
	default "main.c Makefile RunBiscuitOS.sh"
	string "Source code list"

config PK_MEMORY_MMAP_VMA_VM_DONTDUMP_CSRCFILE
	string "Compile source code list"

config PK_MEMORY_MMAP_VMA_VM_DONTDUMP_CONFIG
	string "CONFIG: Project Configure Options"

config PK_MEMORY_MMAP_VMA_VM_DONTDUMP_LIBPATH
	string "LIBS: Libraries to pass to the linker, e.g. -l<library>"

config PK_MEMORY_MMAP_VMA_VM_DONTDUMP_CPPFLAGS
	string "CPPFLAGS: C/C++ preprocessor flags, e.g. -I<include dir>"

config PK_MEMORY_MMAP_VMA_VM_DONTDUMP_DPKCONFIG
	string "PKG_CONFIG_PATH: Directories to add to pkg-config's search path"

config PK_MEMORY_MMAP_VMA_VM_DONTDUMP_CFLAGS
	string "CFLAGS: C compiler flags"

config PK_MEMORY_MMAP_VMA_VM_DONTDUMP_LDFLAGS
	string "LDFLAGS: Linker flags"

config PK_MEMORY_MMAP_VMA_VM_DONTDUMP_CXXFLAGS
	string "CXXFLAGS: C++ compiler flags"

config PK_MEMORY_MMAP_VMA_VM_DONTDUMP_ASFLAGS
	string "CCASFLAGS: assembler compiler flags (defaults to CFLAGS)"

config PK_MEMORY_MMAP_VMA_VM_DONTDUMP_BUILDARCH
	string "--host options on configure for Architecture"

endif # PK_MEMORY_MMAP_VMA_VM_DONTDUMP
```

## package/MEMORY-MMAP/BiscuitOS-MEMORY-MMAP-VMA-VM-EXEC/Kconfig
```kconfig
menuconfig PK_MEMORY_MMAP_VMA_VM_EXEC
	bool "Memory Mapping: VMA VM_EXEC"

if PK_MEMORY_MMAP_VMA_VM_EXEC

config PK_MEMORY_MMAP_VMA_VM_EXEC_VERSION
	default "default"
	string "verstion"

config PK_MEMORY_MMAP_VMA_VM_EXEC_TAR
	default "tar.gz"
	string "tar type"

config PK_MEMORY_MMAP_VMA_VM_EXEC_URL
	default "https://gitee.com/BiscuitOS_team/HardStack/raw/Gitee/Memory-Allocator/MMAP-MECH/BiscuitOS-MEMORY-MMAP-VMA-VM-EXEC"
	string "url"

config PK_MEMORY_MMAP_VMA_VM_EXEC_GITHUB
	string "GitHub"

config PK_MEMORY_MMAP_VMA_VM_EXEC_SRCFILE
	default "main.c Makefile RunBiscuitOS.sh"
	string "Source code list"

config PK_MEMORY_MMAP_VMA_VM_EXEC_CSRCFILE
	string "Compile source code list"

config PK_MEMORY_MMAP_VMA_VM_EXEC_CONFIG
	string "CONFIG: Project Configure Options"

config PK_MEMORY_MMAP_VMA_VM_EXEC_LIBPATH
	string "LIBS: Libraries to pass to the linker, e.g. -l<library>"

config PK_MEMORY_MMAP_VMA_VM_EXEC_CPPFLAGS
	string "CPPFLAGS: C/C++ preprocessor flags, e.g. -I<include dir>"

config PK_MEMORY_MMAP_VMA_VM_EXEC_DPKCONFIG
	string "PKG_CONFIG_PATH: Directories to add to pkg-config's search path"

config PK_MEMORY_MMAP_VMA_VM_EXEC_CFLAGS
	string "CFLAGS: C compiler flags"

config PK_MEMORY_MMAP_VMA_VM_EXEC_LDFLAGS
	string "LDFLAGS: Linker flags"

config PK_MEMORY_MMAP_VMA_VM_EXEC_CXXFLAGS
	string "CXXFLAGS: C++ compiler flags"

config PK_MEMORY_MMAP_VMA_VM_EXEC_ASFLAGS
	string "CCASFLAGS: assembler compiler flags (defaults to CFLAGS)"

config PK_MEMORY_MMAP_VMA_VM_EXEC_BUILDARCH
	string "--host options on configure for Architecture"

endif # PK_MEMORY_MMAP_VMA_VM_EXEC
```

## package/MEMORY-MMAP/BiscuitOS-MEMORY-MMAP-VMA-VM-GROWSDOWN/Kconfig
```kconfig
menuconfig PK_MEMORY_MMAP_VMA_VM_GROWSDOWN
	bool "Memory Mapping: VMA VM_GROWSDOWN"

if PK_MEMORY_MMAP_VMA_VM_GROWSDOWN

config PK_MEMORY_MMAP_VMA_VM_GROWSDOWN_VERSION
	default "default"
	string "verstion"

config PK_MEMORY_MMAP_VMA_VM_GROWSDOWN_TAR
	default "tar.gz"
	string "tar type"

config PK_MEMORY_MMAP_VMA_VM_GROWSDOWN_URL
	default "https://gitee.com/BiscuitOS_team/HardStack/raw/Gitee/Memory-Allocator/MMAP-MECH/BiscuitOS-MEMORY-MMAP-VMA-VM-GROWSDOWN"
	string "url"

config PK_MEMORY_MMAP_VMA_VM_GROWSDOWN_GITHUB
	string "GitHub"

config PK_MEMORY_MMAP_VMA_VM_GROWSDOWN_SRCFILE
	default "main.c Makefile RunBiscuitOS.sh"
	string "Source code list"

config PK_MEMORY_MMAP_VMA_VM_GROWSDOWN_CSRCFILE
	string "Compile source code list"

config PK_MEMORY_MMAP_VMA_VM_GROWSDOWN_CONFIG
	string "CONFIG: Project Configure Options"

config PK_MEMORY_MMAP_VMA_VM_GROWSDOWN_LIBPATH
	string "LIBS: Libraries to pass to the linker, e.g. -l<library>"

config PK_MEMORY_MMAP_VMA_VM_GROWSDOWN_CPPFLAGS
	string "CPPFLAGS: C/C++ preprocessor flags, e.g. -I<include dir>"

config PK_MEMORY_MMAP_VMA_VM_GROWSDOWN_DPKCONFIG
	string "PKG_CONFIG_PATH: Directories to add to pkg-config's search path"

config PK_MEMORY_MMAP_VMA_VM_GROWSDOWN_CFLAGS
	string "CFLAGS: C compiler flags"

config PK_MEMORY_MMAP_VMA_VM_GROWSDOWN_LDFLAGS
	string "LDFLAGS: Linker flags"

config PK_MEMORY_MMAP_VMA_VM_GROWSDOWN_CXXFLAGS
	string "CXXFLAGS: C++ compiler flags"

config PK_MEMORY_MMAP_VMA_VM_GROWSDOWN_ASFLAGS
	string "CCASFLAGS: assembler compiler flags (defaults to CFLAGS)"

config PK_MEMORY_MMAP_VMA_VM_GROWSDOWN_BUILDARCH
	string "--host options on configure for Architecture"

endif # PK_MEMORY_MMAP_VMA_VM_GROWSDOWN
```

## package/MEMORY-MMAP/BiscuitOS-MEMORY-MMAP-VMA-VM-LOCKED/Kconfig
```kconfig
menuconfig PK_MEMORY_MMAP_VMA_VM_LOCKED
	bool "Memory Mapping: VMA VM_LOCKED"

if PK_MEMORY_MMAP_VMA_VM_LOCKED

config PK_MEMORY_MMAP_VMA_VM_LOCKED_VERSION
	default "default"
	string "verstion"

config PK_MEMORY_MMAP_VMA_VM_LOCKED_TAR
	default "tar.gz"
	string "tar type"

config PK_MEMORY_MMAP_VMA_VM_LOCKED_URL
	default "https://gitee.com/BiscuitOS_team/HardStack/raw/Gitee/Memory-Allocator/MMAP-MECH/BiscuitOS-MEMORY-MMAP-VMA-VM-LOCKED"
	string "url"

config PK_MEMORY_MMAP_VMA_VM_LOCKED_GITHUB
	string "GitHub"

config PK_MEMORY_MMAP_VMA_VM_LOCKED_SRCFILE
	default "main.c Makefile RunBiscuitOS.sh"
	string "Source code list"

config PK_MEMORY_MMAP_VMA_VM_LOCKED_CSRCFILE
	string "Compile source code list"

config PK_MEMORY_MMAP_VMA_VM_LOCKED_CONFIG
	string "CONFIG: Project Configure Options"

config PK_MEMORY_MMAP_VMA_VM_LOCKED_LIBPATH
	string "LIBS: Libraries to pass to the linker, e.g. -l<library>"

config PK_MEMORY_MMAP_VMA_VM_LOCKED_CPPFLAGS
	string "CPPFLAGS: C/C++ preprocessor flags, e.g. -I<include dir>"

config PK_MEMORY_MMAP_VMA_VM_LOCKED_DPKCONFIG
	string "PKG_CONFIG_PATH: Directories to add to pkg-config's search path"

config PK_MEMORY_MMAP_VMA_VM_LOCKED_CFLAGS
	string "CFLAGS: C compiler flags"

config PK_MEMORY_MMAP_VMA_VM_LOCKED_LDFLAGS
	string "LDFLAGS: Linker flags"

config PK_MEMORY_MMAP_VMA_VM_LOCKED_CXXFLAGS
	string "CXXFLAGS: C++ compiler flags"

config PK_MEMORY_MMAP_VMA_VM_LOCKED_ASFLAGS
	string "CCASFLAGS: assembler compiler flags (defaults to CFLAGS)"

config PK_MEMORY_MMAP_VMA_VM_LOCKED_BUILDARCH
	string "--host options on configure for Architecture"

endif # PK_MEMORY_MMAP_VMA_VM_LOCKED
```

## package/MEMORY-MMAP/BiscuitOS-MEMORY-MMAP-VMA-VM-LOCKONFAULT/Kconfig
```kconfig
menuconfig PK_MEMORY_MMAP_VMA_VM_LOCKONFAULT
	bool "Memory Mapping: VMA VM_LOCKONFAULT"

if PK_MEMORY_MMAP_VMA_VM_LOCKONFAULT

config PK_MEMORY_MMAP_VMA_VM_LOCKONFAULT_VERSION
	default "default"
	string "verstion"

config PK_MEMORY_MMAP_VMA_VM_LOCKONFAULT_TAR
	default "tar.gz"
	string "tar type"

config PK_MEMORY_MMAP_VMA_VM_LOCKONFAULT_URL
	default "https://gitee.com/BiscuitOS_team/HardStack/raw/Gitee/Memory-Allocator/MMAP-MECH/BiscuitOS-MEMORY-MMAP-VMA-VM-LOCKONFAULT"
	string "url"

config PK_MEMORY_MMAP_VMA_VM_LOCKONFAULT_GITHUB
	string "GitHub"

config PK_MEMORY_MMAP_VMA_VM_LOCKONFAULT_SRCFILE
	default "main.c Makefile RunBiscuitOS.sh"
	string "Source code list"

config PK_MEMORY_MMAP_VMA_VM_LOCKONFAULT_CSRCFILE
	string "Compile source code list"

config PK_MEMORY_MMAP_VMA_VM_LOCKONFAULT_CONFIG
	string "CONFIG: Project Configure Options"

config PK_MEMORY_MMAP_VMA_VM_LOCKONFAULT_LIBPATH
	string "LIBS: Libraries to pass to the linker, e.g. -l<library>"

config PK_MEMORY_MMAP_VMA_VM_LOCKONFAULT_CPPFLAGS
	string "CPPFLAGS: C/C++ preprocessor flags, e.g. -I<include dir>"

config PK_MEMORY_MMAP_VMA_VM_LOCKONFAULT_DPKCONFIG
	string "PKG_CONFIG_PATH: Directories to add to pkg-config's search path"

config PK_MEMORY_MMAP_VMA_VM_LOCKONFAULT_CFLAGS
	string "CFLAGS: C compiler flags"

config PK_MEMORY_MMAP_VMA_VM_LOCKONFAULT_LDFLAGS
	string "LDFLAGS: Linker flags"

config PK_MEMORY_MMAP_VMA_VM_LOCKONFAULT_CXXFLAGS
	string "CXXFLAGS: C++ compiler flags"

config PK_MEMORY_MMAP_VMA_VM_LOCKONFAULT_ASFLAGS
	string "CCASFLAGS: assembler compiler flags (defaults to CFLAGS)"

config PK_MEMORY_MMAP_VMA_VM_LOCKONFAULT_BUILDARCH
	string "--host options on configure for Architecture"

endif # PK_MEMORY_MMAP_VMA_VM_LOCKONFAULT
```

## package/MEMORY-MMAP/BiscuitOS-MEMORY-MMAP-VMA-VM-MAYEXEC/Kconfig
```kconfig
menuconfig PK_MEMORY_MMAP_VMA_VM_MAYEXEC
	bool "Memory Mapping: VMA VM_MAYEXEC"

if PK_MEMORY_MMAP_VMA_VM_MAYEXEC

config PK_MEMORY_MMAP_VMA_VM_MAYEXEC_VERSION
	default "default"
	string "verstion"

config PK_MEMORY_MMAP_VMA_VM_MAYEXEC_TAR
	default "tar.gz"
	string "tar type"

config PK_MEMORY_MMAP_VMA_VM_MAYEXEC_URL
	default "https://gitee.com/BiscuitOS_team/HardStack/raw/Gitee/Memory-Allocator/MMAP-MECH/BiscuitOS-MEMORY-MMAP-VMA-VM-MAYEXEC"
	string "url"

config PK_MEMORY_MMAP_VMA_VM_MAYEXEC_GITHUB
	string "GitHub"

config PK_MEMORY_MMAP_VMA_VM_MAYEXEC_SRCFILE
	default "main.c Makefile RunBiscuitOS.sh"
	string "Source code list"

config PK_MEMORY_MMAP_VMA_VM_MAYEXEC_CSRCFILE
	string "Compile source code list"

config PK_MEMORY_MMAP_VMA_VM_MAYEXEC_CONFIG
	string "CONFIG: Project Configure Options"

config PK_MEMORY_MMAP_VMA_VM_MAYEXEC_LIBPATH
	string "LIBS: Libraries to pass to the linker, e.g. -l<library>"

config PK_MEMORY_MMAP_VMA_VM_MAYEXEC_CPPFLAGS
	string "CPPFLAGS: C/C++ preprocessor flags, e.g. -I<include dir>"

config PK_MEMORY_MMAP_VMA_VM_MAYEXEC_DPKCONFIG
	string "PKG_CONFIG_PATH: Directories to add to pkg-config's search path"

config PK_MEMORY_MMAP_VMA_VM_MAYEXEC_CFLAGS
	string "CFLAGS: C compiler flags"

config PK_MEMORY_MMAP_VMA_VM_MAYEXEC_LDFLAGS
	string "LDFLAGS: Linker flags"

config PK_MEMORY_MMAP_VMA_VM_MAYEXEC_CXXFLAGS
	string "CXXFLAGS: C++ compiler flags"

config PK_MEMORY_MMAP_VMA_VM_MAYEXEC_ASFLAGS
	string "CCASFLAGS: assembler compiler flags (defaults to CFLAGS)"

config PK_MEMORY_MMAP_VMA_VM_MAYEXEC_BUILDARCH
	string "--host options on configure for Architecture"

endif # PK_MEMORY_MMAP_VMA_VM_MAYEXEC
```

## package/MEMORY-MMAP/BiscuitOS-MEMORY-MMAP-VMA-VM-MAYSHARE/Kconfig
```kconfig
menuconfig PK_MEMORY_MMAP_VMA_VM_MAYSHARE
	bool "Memory Mapping: VMA VM_MAYSHARE"

if PK_MEMORY_MMAP_VMA_VM_MAYSHARE

config PK_MEMORY_MMAP_VMA_VM_MAYSHARE_VERSION
	default "default"
	string "verstion"

config PK_MEMORY_MMAP_VMA_VM_MAYSHARE_TAR
	default "tar.gz"
	string "tar type"

config PK_MEMORY_MMAP_VMA_VM_MAYSHARE_URL
	default "https://gitee.com/BiscuitOS_team/HardStack/raw/Gitee/Memory-Allocator/MMAP-MECH/BiscuitOS-MEMORY-MMAP-VMA-VM-MAYSHARE"
	string "url"

config PK_MEMORY_MMAP_VMA_VM_MAYSHARE_GITHUB
	string "GitHub"

config PK_MEMORY_MMAP_VMA_VM_MAYSHARE_SRCFILE
	default "main.c Makefile RunBiscuitOS.sh"
	string "Source code list"

config PK_MEMORY_MMAP_VMA_VM_MAYSHARE_CSRCFILE
	string "Compile source code list"

config PK_MEMORY_MMAP_VMA_VM_MAYSHARE_CONFIG
	string "CONFIG: Project Configure Options"

config PK_MEMORY_MMAP_VMA_VM_MAYSHARE_LIBPATH
	string "LIBS: Libraries to pass to the linker, e.g. -l<library>"

config PK_MEMORY_MMAP_VMA_VM_MAYSHARE_CPPFLAGS
	string "CPPFLAGS: C/C++ preprocessor flags, e.g. -I<include dir>"

config PK_MEMORY_MMAP_VMA_VM_MAYSHARE_DPKCONFIG
	string "PKG_CONFIG_PATH: Directories to add to pkg-config's search path"

config PK_MEMORY_MMAP_VMA_VM_MAYSHARE_CFLAGS
	string "CFLAGS: C compiler flags"

config PK_MEMORY_MMAP_VMA_VM_MAYSHARE_LDFLAGS
	string "LDFLAGS: Linker flags"

config PK_MEMORY_MMAP_VMA_VM_MAYSHARE_CXXFLAGS
	string "CXXFLAGS: C++ compiler flags"

config PK_MEMORY_MMAP_VMA_VM_MAYSHARE_ASFLAGS
	string "CCASFLAGS: assembler compiler flags (defaults to CFLAGS)"

config PK_MEMORY_MMAP_VMA_VM_MAYSHARE_BUILDARCH
	string "--host options on configure for Architecture"

endif # PK_MEMORY_MMAP_VMA_VM_MAYSHARE
```
