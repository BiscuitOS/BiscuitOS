## package/MEMORY-MMAP/BiscuitOS-MEMORY-MMAP-VMOPS-CLOSE/Kconfig
```kconfig
menuconfig PK_MEMORY_MMAP_VMOPS_CLOSE
	bool "Memory Mapping: VMOPS -> close"

if PK_MEMORY_MMAP_VMOPS_CLOSE

config PK_MEMORY_MMAP_VMOPS_CLOSE_VERSION
	default "default"
	string "verstion"

config PK_MEMORY_MMAP_VMOPS_CLOSE_TAR
	default "tar.gz"
	string "tar type"

config PK_MEMORY_MMAP_VMOPS_CLOSE_URL
	default "https://gitee.com/BiscuitOS_team/HardStack/raw/Gitee/Memory-Allocator/MMAP-MECH/BiscuitOS-MEMORY-MMAP-VMOPS-CLOSE"
	string "url"

config PK_MEMORY_MMAP_VMOPS_CLOSE_GITHUB
	string "GitHub"

config PK_MEMORY_MMAP_VMOPS_CLOSE_SRCFILE
	default "app.c Kconfig main.c Makefile Makefile.host RunBiscuitOS.sh"
	string "Source code list"

config PK_MEMORY_MMAP_VMOPS_CLOSE_CSRCFILE
	string "Compile source code list"

config PK_MEMORY_MMAP_VMOPS_CLOSE_CONFIG
	string "CONFIG: Project Configure Options"

config PK_MEMORY_MMAP_VMOPS_CLOSE_LIBPATH
	string "LIBS: Libraries to pass to the linker, e.g. -l<library>"

config PK_MEMORY_MMAP_VMOPS_CLOSE_CPPFLAGS
	string "CPPFLAGS: C/C++ preprocessor flags, e.g. -I<include dir>"

config PK_MEMORY_MMAP_VMOPS_CLOSE_DPKCONFIG
	string "PKG_CONFIG_PATH: Directories to add to pkg-config's search path"

config PK_MEMORY_MMAP_VMOPS_CLOSE_CFLAGS
	string "CFLAGS: C compiler flags"

config PK_MEMORY_MMAP_VMOPS_CLOSE_LDFLAGS
	string "LDFLAGS: Linker flags"

config PK_MEMORY_MMAP_VMOPS_CLOSE_CXXFLAGS
	string "CXXFLAGS: C++ compiler flags"

config PK_MEMORY_MMAP_VMOPS_CLOSE_ASFLAGS
	string "CCASFLAGS: assembler compiler flags (defaults to CFLAGS)"

config PK_MEMORY_MMAP_VMOPS_CLOSE_BUILDARCH
	string "--host options on configure for Architecture"

endif # PK_MEMORY_MMAP_VMOPS_CLOSE
```

## package/MEMORY-MMAP/BiscuitOS-MEMORY-MMAP-VMOPS-FAULT/Kconfig
```kconfig
menuconfig PK_MEMORY_MMAP_VMOPS_FAULT
	bool "Memory Mapping: VMOPS -> fault"

if PK_MEMORY_MMAP_VMOPS_FAULT

config PK_MEMORY_MMAP_VMOPS_FAULT_VERSION
	default "default"
	string "verstion"

config PK_MEMORY_MMAP_VMOPS_FAULT_TAR
	default "tar.gz"
	string "tar type"

config PK_MEMORY_MMAP_VMOPS_FAULT_URL
	default "https://gitee.com/BiscuitOS_team/HardStack/raw/Gitee/Memory-Allocator/MMAP-MECH/BiscuitOS-MEMORY-MMAP-VMOPS-FAULT"
	string "url"

config PK_MEMORY_MMAP_VMOPS_FAULT_GITHUB
	string "GitHub"

config PK_MEMORY_MMAP_VMOPS_FAULT_SRCFILE
	default "app.c Kconfig main.c Makefile Makefile.host RunBiscuitOS.sh"
	string "Source code list"

config PK_MEMORY_MMAP_VMOPS_FAULT_CSRCFILE
	string "Compile source code list"

config PK_MEMORY_MMAP_VMOPS_FAULT_CONFIG
	string "CONFIG: Project Configure Options"

config PK_MEMORY_MMAP_VMOPS_FAULT_LIBPATH
	string "LIBS: Libraries to pass to the linker, e.g. -l<library>"

config PK_MEMORY_MMAP_VMOPS_FAULT_CPPFLAGS
	string "CPPFLAGS: C/C++ preprocessor flags, e.g. -I<include dir>"

config PK_MEMORY_MMAP_VMOPS_FAULT_DPKCONFIG
	string "PKG_CONFIG_PATH: Directories to add to pkg-config's search path"

config PK_MEMORY_MMAP_VMOPS_FAULT_CFLAGS
	string "CFLAGS: C compiler flags"

config PK_MEMORY_MMAP_VMOPS_FAULT_LDFLAGS
	string "LDFLAGS: Linker flags"

config PK_MEMORY_MMAP_VMOPS_FAULT_CXXFLAGS
	string "CXXFLAGS: C++ compiler flags"

config PK_MEMORY_MMAP_VMOPS_FAULT_ASFLAGS
	string "CCASFLAGS: assembler compiler flags (defaults to CFLAGS)"

config PK_MEMORY_MMAP_VMOPS_FAULT_BUILDARCH
	string "--host options on configure for Architecture"

endif # PK_MEMORY_MMAP_VMOPS_FAULT
```

## package/MEMORY-MMAP/BiscuitOS-MEMORY-MMAP-VMOPS-OPEN/Kconfig
```kconfig
menuconfig PK_MEMORY_MMAP_VMOPS_OPEN
	bool "Memory Mapping: VMOPS -> open"

if PK_MEMORY_MMAP_VMOPS_OPEN

config PK_MEMORY_MMAP_VMOPS_OPEN_VERSION
	default "default"
	string "verstion"

config PK_MEMORY_MMAP_VMOPS_OPEN_TAR
	default "tar.gz"
	string "tar type"

config PK_MEMORY_MMAP_VMOPS_OPEN_URL
	default "https://gitee.com/BiscuitOS_team/HardStack/raw/Gitee/Memory-Allocator/MMAP-MECH/BiscuitOS-MEMORY-MMAP-VMOPS-OPEN"
	string "url"

config PK_MEMORY_MMAP_VMOPS_OPEN_GITHUB
	string "GitHub"

config PK_MEMORY_MMAP_VMOPS_OPEN_SRCFILE
	default "app.c Kconfig main.c Makefile Makefile.host RunBiscuitOS.sh"
	string "Source code list"

config PK_MEMORY_MMAP_VMOPS_OPEN_CSRCFILE
	string "Compile source code list"

config PK_MEMORY_MMAP_VMOPS_OPEN_CONFIG
	string "CONFIG: Project Configure Options"

config PK_MEMORY_MMAP_VMOPS_OPEN_LIBPATH
	string "LIBS: Libraries to pass to the linker, e.g. -l<library>"

config PK_MEMORY_MMAP_VMOPS_OPEN_CPPFLAGS
	string "CPPFLAGS: C/C++ preprocessor flags, e.g. -I<include dir>"

config PK_MEMORY_MMAP_VMOPS_OPEN_DPKCONFIG
	string "PKG_CONFIG_PATH: Directories to add to pkg-config's search path"

config PK_MEMORY_MMAP_VMOPS_OPEN_CFLAGS
	string "CFLAGS: C compiler flags"

config PK_MEMORY_MMAP_VMOPS_OPEN_LDFLAGS
	string "LDFLAGS: Linker flags"

config PK_MEMORY_MMAP_VMOPS_OPEN_CXXFLAGS
	string "CXXFLAGS: C++ compiler flags"

config PK_MEMORY_MMAP_VMOPS_OPEN_ASFLAGS
	string "CCASFLAGS: assembler compiler flags (defaults to CFLAGS)"

config PK_MEMORY_MMAP_VMOPS_OPEN_BUILDARCH
	string "--host options on configure for Architecture"

endif # PK_MEMORY_MMAP_VMOPS_OPEN
```

## package/MEMORY-MMAP/BiscuitOS-MEMORY-MMAP/Kconfig
```kconfig
menuconfig PK_MEMORY_MMAP_DEFAULT
	bool "Memory Mapping"

if PK_MEMORY_MMAP_DEFAULT

config PK_MEMORY_MMAP_DEFAULT_VERSION
	default "default"
	string "verstion"

config PK_MEMORY_MMAP_DEFAULT_TAR
	default "tar.gz"
	string "tar type"

config PK_MEMORY_MMAP_DEFAULT_URL
	default "https://gitee.com/BiscuitOS_team/HardStack/raw/Gitee/Memory-Allocator/MMAP-MECH/BiscuitOS-MEMORY-MMAP"
	string "url"

config PK_MEMORY_MMAP_DEFAULT_GITHUB
	string "GitHub"

config PK_MEMORY_MMAP_DEFAULT_SRCFILE
	default "main.c Makefile RunBiscuitOS.sh"
	string "Source code list"

config PK_MEMORY_MMAP_DEFAULT_CSRCFILE
	string "Compile source code list"

config PK_MEMORY_MMAP_DEFAULT_CONFIG
	string "CONFIG: Project Configure Options"

config PK_MEMORY_MMAP_DEFAULT_LIBPATH
	string "LIBS: Libraries to pass to the linker, e.g. -l<library>"

config PK_MEMORY_MMAP_DEFAULT_CPPFLAGS
	string "CPPFLAGS: C/C++ preprocessor flags, e.g. -I<include dir>"

config PK_MEMORY_MMAP_DEFAULT_DPKCONFIG
	string "PKG_CONFIG_PATH: Directories to add to pkg-config's search path"

config PK_MEMORY_MMAP_DEFAULT_CFLAGS
	string "CFLAGS: C compiler flags"

config PK_MEMORY_MMAP_DEFAULT_LDFLAGS
	string "LDFLAGS: Linker flags"

config PK_MEMORY_MMAP_DEFAULT_CXXFLAGS
	string "CXXFLAGS: C++ compiler flags"

config PK_MEMORY_MMAP_DEFAULT_ASFLAGS
	string "CCASFLAGS: assembler compiler flags (defaults to CFLAGS)"

config PK_MEMORY_MMAP_DEFAULT_BUILDARCH
	string "--host options on configure for Architecture"

endif # PK_MEMORY_MMAP_DEFAULT
```

## package/MEMORY-MMAP/Kconfig
```kconfig
menuconfig PK_MEMORY_MMAP
	bool "Memory Mapping Mechanism"

if PK_MEMORY_MMAP

# MEMORY MMAP
source package/MEMORY-MMAP/BiscuitOS-MEMORY-MMAP/Kconfig

# MEMORY MMAP: FLAGS MAP_PRIVATE
source package/MEMORY-MMAP/BiscuitOS-MEMORY-MMAP-MAP-PRIVATE/Kconfig

# MEMORY MMAP: FLAGS MAP_PRIVATE with FILE
source package/MEMORY-MMAP/BiscuitOS-MEMORY-MMAP-MAP-PRIVATE-FILE/Kconfig

# MEMORY MMAP: FLAGS MAP_SHARED
source package/MEMORY-MMAP/BiscuitOS-MEMORY-MMAP-MAP-SHARED/Kconfig

# MEMORY MMAP: FLAGS MAP_SHARED_VALIDATE
source package/MEMORY-MMAP/BiscuitOS-MEMORY-MMAP-MAP-SHARED-VALIDATE/Kconfig

# MEMORY MMAP: FLAGS MAP_ANONYMOUS
source package/MEMORY-MMAP/BiscuitOS-MEMORY-MMAP-MAP-ANONYMOUS/Kconfig

# MEMORY MMAP: FLAGS MAP_NONBLOCK
source package/MEMORY-MMAP/BiscuitOS-MEMORY-MMAP-MAP-NONBLOCK/Kconfig

# MEMORY MMAP: FLAGS MAP_STACK
source package/MEMORY-MMAP/BiscuitOS-MEMORY-MMAP-MAP-STACK/Kconfig

# MEMORY MMAP: FLAGS MAP_HUGETLB
source package/MEMORY-MMAP/BiscuitOS-MEMORY-MMAP-MAP-HUGETLB/Kconfig

# MEMORY MMAP: FLAGS MAP_LOCKED
source package/MEMORY-MMAP/BiscuitOS-MEMORY-MMAP-MAP-LOCKED/Kconfig

# MEMORY MMAP: FLAGS MAP_POPULATE
source package/MEMORY-MMAP/BiscuitOS-MEMORY-MMAP-MAP-POPULATE/Kconfig

# MEMORY MMAP: FLAGS MAP_FIXED
source package/MEMORY-MMAP/BiscuitOS-MEMORY-MMAP-MAP-FIXED/Kconfig

# MEMORY MMAP: FLAGS MAP_GROWSDOWN
source package/MEMORY-MMAP/BiscuitOS-MEMORY-MMAP-MAP-GROWSDOWN/Kconfig

# MEMORY MMAP: FLAGS MAP_SYNC
source package/MEMORY-MMAP/BiscuitOS-MEMORY-MMAP-MAP-SYNC/Kconfig

# MEMORY MMAP: FLAGS MAP_NORESERVE
source package/MEMORY-MMAP/BiscuitOS-MEMORY-MMAP-MAP-NORESERVE/Kconfig

# MEMORY MMAP: FLAGS MAP_FIXED_NOREPLACE
source package/MEMORY-MMAP/BiscuitOS-MEMORY-MMAP-MAP-FIXED-NOREPLACE/Kconfig

# MEMORY MMAP: FLAGS MAP_UNINITIALIZED
source package/MEMORY-MMAP/BiscuitOS-MEMORY-MMAP-MAP-UNINITIALIZED/Kconfig

# MEMORY MMAP: VMA VM_NEXT/VM_PREV
source package/MEMORY-MMAP/BiscuitOS-MEMORY-MMAP-VMA-VM-NEXT/Kconfig

# MEMORY MMAP: VMA VM_RB/RB_SUBTREE_GAP
source package/MEMORY-MMAP/BiscuitOS-MEMORY-MMAP-VMA-VM-RB/Kconfig

# MEMORY MMAP: VMA AV/AVC
source package/MEMORY-MMAP/BiscuitOS-MEMORY-MMAP-VMA-VM-AV/Kconfig

# MEMORY MMAP: VMA SHARED.RB/SHARED.RB_SUBTREE_LAST
source package/MEMORY-MMAP/BiscuitOS-MEMORY-MMAP-VMA-VM-SHARED-RB/Kconfig

# MEMORY MMAP: VMA VM_SHARED
source package/MEMORY-MMAP/BiscuitOS-MEMORY-MMAP-VMA-VM-SHARED/Kconfig

# MEMORY MMAP: VMA VM_MAYSHARE
source package/MEMORY-MMAP/BiscuitOS-MEMORY-MMAP-VMA-VM-MAYSHARE/Kconfig

# MEMORY MMAP: VMA VM_READ
source package/MEMORY-MMAP/BiscuitOS-MEMORY-MMAP-VMA-VM-READ/Kconfig

# MEMORY MMAP: VMA VM_WRITE
source package/MEMORY-MMAP/BiscuitOS-MEMORY-MMAP-VMA-VM-WRITE/Kconfig

# MEMORY MMAP: VMA VM_EXEC
source package/MEMORY-MMAP/BiscuitOS-MEMORY-MMAP-VMA-VM-EXEC/Kconfig

# MEMORY MMAP: VMA VM_MAYEXEC
source package/MEMORY-MMAP/BiscuitOS-MEMORY-MMAP-VMA-VM-MAYEXEC/Kconfig

# MEMORY MMAP: VMA VM_GROWSDOWN
source package/MEMORY-MMAP/BiscuitOS-MEMORY-MMAP-VMA-VM-GROWSDOWN/Kconfig

# MEMORY MMAP: VMA VM_SYNC
source package/MEMORY-MMAP/BiscuitOS-MEMORY-MMAP-VMA-VM-SYNC/Kconfig

# MEMORY MMAP: VMA VM_PFNMAP
source package/MEMORY-MMAP/BiscuitOS-MEMORY-MMAP-VMA-VM-PFNMAP/Kconfig

# MEMORY MMAP: VMA VM_IO
source package/MEMORY-MMAP/BiscuitOS-MEMORY-MMAP-VMA-VM-IO/Kconfig

# MEMORY MMAP: VMA VM_DONTEXPAND
source package/MEMORY-MMAP/BiscuitOS-MEMORY-MMAP-VMA-VM-DONTEXPAND/Kconfig

# MEMORY MMAP: VMA VM_DONTDUMP
source package/MEMORY-MMAP/BiscuitOS-MEMORY-MMAP-VMA-VM-DONTDUMP/Kconfig

# MEMORY MMAP: VMA VM_UFFD_MISSING
source package/MEMORY-MMAP/BiscuitOS-MEMORY-MMAP-VMA-VM-UFFD-MISSING/Kconfig

# MEMORY MMAP: VMA VM_UFFD_WP
source package/MEMORY-MMAP/BiscuitOS-MEMORY-MMAP-VMA-VM-UFFD-WP/Kconfig

# MEMORY MMAP: VMA VM_LOCKED
source package/MEMORY-MMAP/BiscuitOS-MEMORY-MMAP-VMA-VM-LOCKED/Kconfig

# MEMORY MMAP: VMA VM_LOCKONFAULT
source package/MEMORY-MMAP/BiscuitOS-MEMORY-MMAP-VMA-VM-LOCKONFAULT/Kconfig

# MEMORY MMAP: VMA VM_SEQ_READ
source package/MEMORY-MMAP/BiscuitOS-MEMORY-MMAP-VMA-VM-SEQ-READ/Kconfig

# MEMORY MMAP: VMA VM_RAND_READ
source package/MEMORY-MMAP/BiscuitOS-MEMORY-MMAP-VMA-VM-RAND-READ/Kconfig

# MEMORY MMAP: VMA VM_SOFTDIRTY
source package/MEMORY-MMAP/BiscuitOS-MEMORY-MMAP-VMA-VM-SOFTDIRTY/Kconfig

# MEMORY MMAP: VMA VM_NORESERVE
source package/MEMORY-MMAP/BiscuitOS-MEMORY-MMAP-VMA-VM-NORESERVE/Kconfig

# MEMORY MMAP: RBTREE UPDATE GAP
source package/MEMORY-MMAP/BiscuitOS-MEMORY-MMAP-RB-UPDATE-GAP/Kconfig

# MEMORY MMAP: AREA
source package/MEMORY-MMAP/BiscuitOS-MEMORY-MMAP-AREA/Kconfig

# MEMORY MMAP: AREA NOREPLACE
source package/MEMORY-MMAP/BiscuitOS-MEMORY-MMAP-AREA-NOREPLACE/Kconfig

# MEMORY MMAP: AREA FIXED
source package/MEMORY-MMAP/BiscuitOS-MEMORY-MMAP-AREA-FIXED/Kconfig

# MEMORY MMAP: VMOPS -> FAULT
source package/MEMORY-MMAP/BiscuitOS-MEMORY-MMAP-VMOPS-FAULT/Kconfig

# MEMORY MMAP: VMOPS -> HUGE FAULT
source package/MEMORY-MMAP/BiscuitOS-MEMORY-MMAP-VMOPS-HUGE-FAULT/Kconfig

# MEMORY MMAP: VMOPS -> OPEN
source package/MEMORY-MMAP/BiscuitOS-MEMORY-MMAP-VMOPS-OPEN/Kconfig

# MEMORY MMAP: VMOPS -> CLOSE
source package/MEMORY-MMAP/BiscuitOS-MEMORY-MMAP-VMOPS-CLOSE/Kconfig

# MEMORY MMAP: SPECIAL MAPPING(LEGACY)
source package/MEMORY-MMAP/BiscuitOS-MEMORY-MMAP-SPECIAL-MAPPING-LEGACY/Kconfig

# MEMORY MMAP: SPECIAL MAPPING
source package/MEMORY-MMAP/BiscuitOS-MEMORY-MMAP-SPECIAL-MAPPING/Kconfig

# MEMORY MMAP: FILE-MAPPING REVERSE TREE
source package/MEMORY-MMAP/BiscuitOS-MEMORY-MMAP-FILE-REVERSE-TREE/Kconfig

# MEMORY GUP: HOW TO GUP
source package/MEMORY-MMAP/BiscuitOS-MEMORY-GUP-HOW/Kconfig

# MEMORY GUP: HOW TO SMAP
source package/MEMORY-MMAP/BiscuitOS-MEMORY-GUP-SMAP/Kconfig

# MEMORY GUP: FAULT IN WRITE
source package/MEMORY-MMAP/BiscuitOS-MEMORY-GUP-FAULT-IN-WRITE/Kconfig

# MEMORY GUP: FAULT IN SAFE WRITE
source package/MEMORY-MMAP/BiscuitOS-MEMORY-GUP-FAULT-IN-SAFE-WRITE/Kconfig

# MEMORY GUP: FIXUP USER FAULT
source package/MEMORY-MMAP/BiscuitOS-MEMORY-GUP-FIXUP-USER-FAULT/Kconfig

# MEMORY GUP: FAULT IN READ
source package/MEMORY-MMAP/BiscuitOS-MEMORY-GUP-FAULT-IN-READ/Kconfig

# MEMORY GUP: GET USER PAGES
source package/MEMORY-MMAP/BiscuitOS-MEMORY-GUP-GET-USER-PAGES/Kconfig

# MEMORY GUP: GET USER PAGES FAST
source package/MEMORY-MMAP/BiscuitOS-MEMORY-GUP-GET-USER-PAGES-FAST/Kconfig

# MEMORY GUP: GET REMOTE USER PAGES
source package/MEMORY-MMAP/BiscuitOS-MEMORY-GUP-GET-USER-PAGES-REMOTE/Kconfig

# MEMORY GUP: PIN USER PAGES
source package/MEMORY-MMAP/BiscuitOS-MEMORY-GUP-PIN-USER-PAGES/Kconfig

# MEMORY GUP: PIN USER PAGES FAST
source package/MEMORY-MMAP/BiscuitOS-MEMORY-GUP-PIN-USER-PAGES-FAST/Kconfig

# MEMORY GUP: UNPIN USER PAGE
source package/MEMORY-MMAP/BiscuitOS-MEMORY-GUP-UNPIN-USER-PAGE/Kconfig

# MEMORY GUP: PIN REMOTE USER PAGES
source package/MEMORY-MMAP/BiscuitOS-MEMORY-GUP-PIN-USER-PAGES-REMOTE/Kconfig

# MEMORY GUP: FOLL_WRITE
source package/MEMORY-MMAP/BiscuitOS-MEMORY-GUP-FOLL-WRITE/Kconfig

# MEMORY GUP: FOLL_TOUCH
source package/MEMORY-MMAP/BiscuitOS-MEMORY-GUP-FOLL-TOUCH/Kconfig

# MEMORY GUP: FOLL_GET
source package/MEMORY-MMAP/BiscuitOS-MEMORY-GUP-FOLL-GET/Kconfig

# MEMORY GUP: LOOGTERM
source package/MEMORY-MMAP/BiscuitOS-MEMORY-GUP-LOOGTERM/Kconfig

# MEMORY GUP: FAST
source package/MEMORY-MMAP/BiscuitOS-MEMORY-GUP-FAST/Kconfig

# MEMORY GUP: FAST-ONLY
source package/MEMORY-MMAP/BiscuitOS-MEMORY-GUP-FAST-ONLY/Kconfig

# MEMORY GUP: MM-POPULATE
source package/MEMORY-MMAP/BiscuitOS-MEMORY-GUP-MM-POPULATE/Kconfig

# MEMORY GUP: API fault_in_subpage_writeable
source package/MEMORY-MMAP/BiscuitOS-MEMORY-GUP-API-FISW/Kconfig

endif # PK_MEMORY_MMAP
```
