## package/MEMORY-MMAP/BiscuitOS-MEMORY-MMAP-MAP-POPULATE/Kconfig
```kconfig
menuconfig PK_MEMORY_MMAP_MAP_POPULATE
	bool "Memory Mapping: FLAGS MAP_POPULATE"

if PK_MEMORY_MMAP_MAP_POPULATE

config PK_MEMORY_MMAP_MAP_POPULATE_VERSION
	default "default"
	string "verstion"

config PK_MEMORY_MMAP_MAP_POPULATE_TAR
	default "tar.gz"
	string "tar type"

config PK_MEMORY_MMAP_MAP_POPULATE_URL
	default "https://gitee.com/BiscuitOS_team/HardStack/raw/Gitee/Memory-Allocator/MMAP-MECH/BiscuitOS-MEMORY-MMAP-MAP-POPULATE"
	string "url"

config PK_MEMORY_MMAP_MAP_POPULATE_GITHUB
	string "GitHub"

config PK_MEMORY_MMAP_MAP_POPULATE_SRCFILE
	default "main.c Makefile RunBiscuitOS.sh"
	string "Source code list"

config PK_MEMORY_MMAP_MAP_POPULATE_CSRCFILE
	string "Compile source code list"

config PK_MEMORY_MMAP_MAP_POPULATE_CONFIG
	string "CONFIG: Project Configure Options"

config PK_MEMORY_MMAP_MAP_POPULATE_LIBPATH
	string "LIBS: Libraries to pass to the linker, e.g. -l<library>"

config PK_MEMORY_MMAP_MAP_POPULATE_CPPFLAGS
	string "CPPFLAGS: C/C++ preprocessor flags, e.g. -I<include dir>"

config PK_MEMORY_MMAP_MAP_POPULATE_DPKCONFIG
	string "PKG_CONFIG_PATH: Directories to add to pkg-config's search path"

config PK_MEMORY_MMAP_MAP_POPULATE_CFLAGS
	string "CFLAGS: C compiler flags"

config PK_MEMORY_MMAP_MAP_POPULATE_LDFLAGS
	string "LDFLAGS: Linker flags"

config PK_MEMORY_MMAP_MAP_POPULATE_CXXFLAGS
	string "CXXFLAGS: C++ compiler flags"

config PK_MEMORY_MMAP_MAP_POPULATE_ASFLAGS
	string "CCASFLAGS: assembler compiler flags (defaults to CFLAGS)"

config PK_MEMORY_MMAP_MAP_POPULATE_BUILDARCH
	string "--host options on configure for Architecture"

endif # PK_MEMORY_MMAP_MAP_POPULATE
```

## package/MEMORY-MMAP/BiscuitOS-MEMORY-MMAP-MAP-PRIVATE-FILE/Kconfig
```kconfig
menuconfig PK_MEMORY_MMAP_MAP_PRIVATE_FILE
	bool "Memory Mapping: FLAGS MAP_PRIVATE on FILE"

if PK_MEMORY_MMAP_MAP_PRIVATE_FILE

config PK_MEMORY_MMAP_MAP_PRIVATE_FILE_VERSION
	default "default"
	string "verstion"

config PK_MEMORY_MMAP_MAP_PRIVATE_FILE_TAR
	default "tar.gz"
	string "tar type"

config PK_MEMORY_MMAP_MAP_PRIVATE_FILE_URL
	default "https://gitee.com/BiscuitOS_team/HardStack/raw/Gitee/Memory-Allocator/MMAP-MECH/BiscuitOS-MEMORY-MMAP-MAP-PRIVATE-FILE"
	string "url"

config PK_MEMORY_MMAP_MAP_PRIVATE_FILE_GITHUB
	string "GitHub"

config PK_MEMORY_MMAP_MAP_PRIVATE_FILE_SRCFILE
	default "main.c Makefile RunBiscuitOS.sh"
	string "Source code list"

config PK_MEMORY_MMAP_MAP_PRIVATE_FILE_CSRCFILE
	string "Compile source code list"

config PK_MEMORY_MMAP_MAP_PRIVATE_FILE_CONFIG
	string "CONFIG: Project Configure Options"

config PK_MEMORY_MMAP_MAP_PRIVATE_FILE_LIBPATH
	string "LIBS: Libraries to pass to the linker, e.g. -l<library>"

config PK_MEMORY_MMAP_MAP_PRIVATE_FILE_CPPFLAGS
	string "CPPFLAGS: C/C++ preprocessor flags, e.g. -I<include dir>"

config PK_MEMORY_MMAP_MAP_PRIVATE_FILE_DPKCONFIG
	string "PKG_CONFIG_PATH: Directories to add to pkg-config's search path"

config PK_MEMORY_MMAP_MAP_PRIVATE_FILE_CFLAGS
	string "CFLAGS: C compiler flags"

config PK_MEMORY_MMAP_MAP_PRIVATE_FILE_LDFLAGS
	string "LDFLAGS: Linker flags"

config PK_MEMORY_MMAP_MAP_PRIVATE_FILE_CXXFLAGS
	string "CXXFLAGS: C++ compiler flags"

config PK_MEMORY_MMAP_MAP_PRIVATE_FILE_ASFLAGS
	string "CCASFLAGS: assembler compiler flags (defaults to CFLAGS)"

config PK_MEMORY_MMAP_MAP_PRIVATE_FILE_BUILDARCH
	string "--host options on configure for Architecture"

endif # PK_MEMORY_MMAP_MAP_PRIVATE_FILE
```

## package/MEMORY-MMAP/BiscuitOS-MEMORY-MMAP-MAP-PRIVATE/Kconfig
```kconfig
menuconfig PK_MEMORY_MMAP_MAP_PRIVATE
	bool "Memory Mapping: FLAGS MAP_PRIVATE"

if PK_MEMORY_MMAP_MAP_PRIVATE

config PK_MEMORY_MMAP_MAP_PRIVATE_VERSION
	default "default"
	string "verstion"

config PK_MEMORY_MMAP_MAP_PRIVATE_TAR
	default "tar.gz"
	string "tar type"

config PK_MEMORY_MMAP_MAP_PRIVATE_URL
	default "https://gitee.com/BiscuitOS_team/HardStack/raw/Gitee/Memory-Allocator/MMAP-MECH/BiscuitOS-MEMORY-MMAP-MAP-PRIVATE"
	string "url"

config PK_MEMORY_MMAP_MAP_PRIVATE_GITHUB
	string "GitHub"

config PK_MEMORY_MMAP_MAP_PRIVATE_SRCFILE
	default "main.c Makefile RunBiscuitOS.sh"
	string "Source code list"

config PK_MEMORY_MMAP_MAP_PRIVATE_CSRCFILE
	string "Compile source code list"

config PK_MEMORY_MMAP_MAP_PRIVATE_CONFIG
	string "CONFIG: Project Configure Options"

config PK_MEMORY_MMAP_MAP_PRIVATE_LIBPATH
	string "LIBS: Libraries to pass to the linker, e.g. -l<library>"

config PK_MEMORY_MMAP_MAP_PRIVATE_CPPFLAGS
	string "CPPFLAGS: C/C++ preprocessor flags, e.g. -I<include dir>"

config PK_MEMORY_MMAP_MAP_PRIVATE_DPKCONFIG
	string "PKG_CONFIG_PATH: Directories to add to pkg-config's search path"

config PK_MEMORY_MMAP_MAP_PRIVATE_CFLAGS
	string "CFLAGS: C compiler flags"

config PK_MEMORY_MMAP_MAP_PRIVATE_LDFLAGS
	string "LDFLAGS: Linker flags"

config PK_MEMORY_MMAP_MAP_PRIVATE_CXXFLAGS
	string "CXXFLAGS: C++ compiler flags"

config PK_MEMORY_MMAP_MAP_PRIVATE_ASFLAGS
	string "CCASFLAGS: assembler compiler flags (defaults to CFLAGS)"

config PK_MEMORY_MMAP_MAP_PRIVATE_BUILDARCH
	string "--host options on configure for Architecture"

endif # PK_MEMORY_MMAP_MAP_PRIVATE
```

## package/MEMORY-MMAP/BiscuitOS-MEMORY-MMAP-MAP-SYNC/Kconfig
```kconfig
menuconfig PK_MEMORY_MMAP_MAP_SYNC
	select PK_E2FSPROGS
	bool "Memory Mapping: FLAGS MAP_SYNC"

if PK_MEMORY_MMAP_MAP_SYNC

config PK_MEMORY_MMAP_MAP_SYNC_VERSION
	default "default"
	string "verstion"

config PK_MEMORY_MMAP_MAP_SYNC_TAR
	default "tar.gz"
	string "tar type"

config PK_MEMORY_MMAP_MAP_SYNC_URL
	default "https://gitee.com/BiscuitOS_team/HardStack/raw/Gitee/Memory-Allocator/MMAP-MECH/BiscuitOS-MEMORY-MMAP-MAP-SYNC"
	string "url"

config PK_MEMORY_MMAP_MAP_SYNC_GITHUB
	string "GitHub"

config PK_MEMORY_MMAP_MAP_SYNC_SRCFILE
	default "main.c Makefile RunBiscuitOS.sh"
	string "Source code list"

config PK_MEMORY_MMAP_MAP_SYNC_CSRCFILE
	string "Compile source code list"

config PK_MEMORY_MMAP_MAP_SYNC_CONFIG
	string "CONFIG: Project Configure Options"

config PK_MEMORY_MMAP_MAP_SYNC_LIBPATH
	string "LIBS: Libraries to pass to the linker, e.g. -l<library>"

config PK_MEMORY_MMAP_MAP_SYNC_CPPFLAGS
	string "CPPFLAGS: C/C++ preprocessor flags, e.g. -I<include dir>"

config PK_MEMORY_MMAP_MAP_SYNC_DPKCONFIG
	string "PKG_CONFIG_PATH: Directories to add to pkg-config's search path"

config PK_MEMORY_MMAP_MAP_SYNC_CFLAGS
	string "CFLAGS: C compiler flags"

config PK_MEMORY_MMAP_MAP_SYNC_LDFLAGS
	string "LDFLAGS: Linker flags"

config PK_MEMORY_MMAP_MAP_SYNC_CXXFLAGS
	string "CXXFLAGS: C++ compiler flags"

config PK_MEMORY_MMAP_MAP_SYNC_ASFLAGS
	string "CCASFLAGS: assembler compiler flags (defaults to CFLAGS)"

config PK_MEMORY_MMAP_MAP_SYNC_BUILDARCH
	string "--host options on configure for Architecture"

endif # PK_MEMORY_MMAP_MAP_SYNC
```

## package/MEMORY-MMAP/BiscuitOS-MEMORY-MMAP-MAP-UNINITIALIZED/Kconfig
```kconfig
menuconfig PK_MEMORY_MMAP_MAP_UNINITIALIZED
	bool "Memory Mapping: FLAGS MAP_UNINITIALIZED"

if PK_MEMORY_MMAP_MAP_UNINITIALIZED

config PK_MEMORY_MMAP_MAP_UNINITIALIZED_VERSION
	default "default"
	string "verstion"

config PK_MEMORY_MMAP_MAP_UNINITIALIZED_TAR
	default "tar.gz"
	string "tar type"

config PK_MEMORY_MMAP_MAP_UNINITIALIZED_URL
	default "https://gitee.com/BiscuitOS_team/HardStack/raw/Gitee/Memory-Allocator/MMAP-MECH/BiscuitOS-MEMORY-MMAP-MAP-UNINITIALIZED"
	string "url"

config PK_MEMORY_MMAP_MAP_UNINITIALIZED_GITHUB
	string "GitHub"

config PK_MEMORY_MMAP_MAP_UNINITIALIZED_SRCFILE
	default "main.c Makefile RunBiscuitOS.sh"
	string "Source code list"

config PK_MEMORY_MMAP_MAP_UNINITIALIZED_CSRCFILE
	string "Compile source code list"

config PK_MEMORY_MMAP_MAP_UNINITIALIZED_CONFIG
	string "CONFIG: Project Configure Options"

config PK_MEMORY_MMAP_MAP_UNINITIALIZED_LIBPATH
	string "LIBS: Libraries to pass to the linker, e.g. -l<library>"

config PK_MEMORY_MMAP_MAP_UNINITIALIZED_CPPFLAGS
	string "CPPFLAGS: C/C++ preprocessor flags, e.g. -I<include dir>"

config PK_MEMORY_MMAP_MAP_UNINITIALIZED_DPKCONFIG
	string "PKG_CONFIG_PATH: Directories to add to pkg-config's search path"

config PK_MEMORY_MMAP_MAP_UNINITIALIZED_CFLAGS
	string "CFLAGS: C compiler flags"

config PK_MEMORY_MMAP_MAP_UNINITIALIZED_LDFLAGS
	string "LDFLAGS: Linker flags"

config PK_MEMORY_MMAP_MAP_UNINITIALIZED_CXXFLAGS
	string "CXXFLAGS: C++ compiler flags"

config PK_MEMORY_MMAP_MAP_UNINITIALIZED_ASFLAGS
	string "CCASFLAGS: assembler compiler flags (defaults to CFLAGS)"

config PK_MEMORY_MMAP_MAP_UNINITIALIZED_BUILDARCH
	string "--host options on configure for Architecture"

endif # PK_MEMORY_MMAP_MAP_UNINITIALIZED
```

## package/MEMORY-MMAP/BiscuitOS-MEMORY-MMAP-RB-UPDATE-GAP/Kconfig
```kconfig
menuconfig PK_MEMORY_MMAP_RB_UPDATE_GAP
	bool "Memory Mapping: UPDATE RB GAP"

if PK_MEMORY_MMAP_RB_UPDATE_GAP

config PK_MEMORY_MMAP_RB_UPDATE_GAP_VERSION
	default "default"
	string "verstion"

config PK_MEMORY_MMAP_RB_UPDATE_GAP_TAR
	default "tar.gz"
	string "tar type"

config PK_MEMORY_MMAP_RB_UPDATE_GAP_URL
	default "https://gitee.com/BiscuitOS_team/HardStack/raw/Gitee/Memory-Allocator/MMAP-MECH/BiscuitOS-MEMORY-MMAP-RB-UPDATE-GAP"
	string "url"

config PK_MEMORY_MMAP_RB_UPDATE_GAP_GITHUB
	string "GitHub"

config PK_MEMORY_MMAP_RB_UPDATE_GAP_SRCFILE
	default "main.c Makefile RunBiscuitOS.sh Makefile.app Kconfig app.c"
	string "Source code list"

config PK_MEMORY_MMAP_RB_UPDATE_GAP_CSRCFILE
	string "Compile source code list"

config PK_MEMORY_MMAP_RB_UPDATE_GAP_CONFIG
	string "CONFIG: Project Configure Options"

config PK_MEMORY_MMAP_RB_UPDATE_GAP_LIBPATH
	string "LIBS: Libraries to pass to the linker, e.g. -l<library>"

config PK_MEMORY_MMAP_RB_UPDATE_GAP_CPPFLAGS
	string "CPPFLAGS: C/C++ preprocessor flags, e.g. -I<include dir>"

config PK_MEMORY_MMAP_RB_UPDATE_GAP_DPKCONFIG
	string "PKG_CONFIG_PATH: Directories to add to pkg-config's search path"

config PK_MEMORY_MMAP_RB_UPDATE_GAP_CFLAGS
	string "CFLAGS: C compiler flags"

config PK_MEMORY_MMAP_RB_UPDATE_GAP_LDFLAGS
	string "LDFLAGS: Linker flags"

config PK_MEMORY_MMAP_RB_UPDATE_GAP_CXXFLAGS
	string "CXXFLAGS: C++ compiler flags"

config PK_MEMORY_MMAP_RB_UPDATE_GAP_ASFLAGS
	string "CCASFLAGS: assembler compiler flags (defaults to CFLAGS)"

config PK_MEMORY_MMAP_RB_UPDATE_GAP_BUILDARCH
	string "--host options on configure for Architecture"

endif # PK_MEMORY_MMAP_RB_UPDATE_GAP
```

## package/MEMORY-MMAP/BiscuitOS-MEMORY-MMAP-SPECIAL-MAPPING-LEGACY/Kconfig
```kconfig
menuconfig PK_MEMORY_MMAP_SPECIAL_MAPPING_LEGACY
	bool "Memory Mapping: SPECIAL MAPPING(LEGACY)"

if PK_MEMORY_MMAP_SPECIAL_MAPPING_LEGACY

config PK_MEMORY_MMAP_SPECIAL_MAPPING_LEGACY_VERSION
	default "default"
	string "verstion"

config PK_MEMORY_MMAP_SPECIAL_MAPPING_LEGACY_TAR
	default "tar.gz"
	string "tar type"

config PK_MEMORY_MMAP_SPECIAL_MAPPING_LEGACY_URL
	default "https://gitee.com/BiscuitOS_team/HardStack/raw/Gitee/Memory-Allocator/MMAP-MECH/BiscuitOS-MEMORY-MMAP-SPECIAL-MAPPING-LEGACY"
	string "url"

config PK_MEMORY_MMAP_SPECIAL_MAPPING_LEGACY_GITHUB
	string "GitHub"

config PK_MEMORY_MMAP_SPECIAL_MAPPING_LEGACY_SRCFILE
	default "app.c  Kconfig  main.c  Makefile  Makefile.app  RunBiscuitOS.sh"
	string "Source code list"

config PK_MEMORY_MMAP_SPECIAL_MAPPING_LEGACY_CSRCFILE
	string "Compile source code list"

config PK_MEMORY_MMAP_SPECIAL_MAPPING_LEGACY_CONFIG
	string "CONFIG: Project Configure Options"

config PK_MEMORY_MMAP_SPECIAL_MAPPING_LEGACY_LIBPATH
	string "LIBS: Libraries to pass to the linker, e.g. -l<library>"

config PK_MEMORY_MMAP_SPECIAL_MAPPING_LEGACY_CPPFLAGS
	string "CPPFLAGS: C/C++ preprocessor flags, e.g. -I<include dir>"

config PK_MEMORY_MMAP_SPECIAL_MAPPING_LEGACY_DPKCONFIG
	string "PKG_CONFIG_PATH: Directories to add to pkg-config's search path"

config PK_MEMORY_MMAP_SPECIAL_MAPPING_LEGACY_CFLAGS
	string "CFLAGS: C compiler flags"

config PK_MEMORY_MMAP_SPECIAL_MAPPING_LEGACY_LDFLAGS
	string "LDFLAGS: Linker flags"

config PK_MEMORY_MMAP_SPECIAL_MAPPING_LEGACY_CXXFLAGS
	string "CXXFLAGS: C++ compiler flags"

config PK_MEMORY_MMAP_SPECIAL_MAPPING_LEGACY_ASFLAGS
	string "CCASFLAGS: assembler compiler flags (defaults to CFLAGS)"

config PK_MEMORY_MMAP_SPECIAL_MAPPING_LEGACY_BUILDARCH
	string "--host options on configure for Architecture"

endif # PK_MEMORY_MMAP_SPECIAL_MAPPING_LEGACY
```
