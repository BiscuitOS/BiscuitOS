## package/MEMORY-MMAP/BiscuitOS-MEMORY-MMAP-AREA-NOREPLACE/Kconfig
```kconfig
menuconfig PK_MEMORY_MMAP_AREA_NOREPLACE
	bool "Memory Mapping: AREA NOREPLACE"

if PK_MEMORY_MMAP_AREA_NOREPLACE

config PK_MEMORY_MMAP_AREA_NOREPLACE_VERSION
	default "default"
	string "verstion"

config PK_MEMORY_MMAP_AREA_NOREPLACE_TAR
	default "tar.gz"
	string "tar type"

config PK_MEMORY_MMAP_AREA_NOREPLACE_URL
	default "https://gitee.com/BiscuitOS_team/HardStack/raw/Gitee/Memory-Allocator/MMAP-MECH/BiscuitOS-MEMORY-MMAP-AREA-NOREPLACE"
	string "url"

config PK_MEMORY_MMAP_AREA_NOREPLACE_GITHUB
	string "GitHub"

config PK_MEMORY_MMAP_AREA_NOREPLACE_SRCFILE
	default "main.c Makefile RunBiscuitOS.sh"
	string "Source code list"

config PK_MEMORY_MMAP_AREA_NOREPLACE_CSRCFILE
	string "Compile source code list"

config PK_MEMORY_MMAP_AREA_NOREPLACE_CONFIG
	string "CONFIG: Project Configure Options"

config PK_MEMORY_MMAP_AREA_NOREPLACE_LIBPATH
	string "LIBS: Libraries to pass to the linker, e.g. -l<library>"

config PK_MEMORY_MMAP_AREA_NOREPLACE_CPPFLAGS
	string "CPPFLAGS: C/C++ preprocessor flags, e.g. -I<include dir>"

config PK_MEMORY_MMAP_AREA_NOREPLACE_DPKCONFIG
	string "PKG_CONFIG_PATH: Directories to add to pkg-config's search path"

config PK_MEMORY_MMAP_AREA_NOREPLACE_CFLAGS
	string "CFLAGS: C compiler flags"

config PK_MEMORY_MMAP_AREA_NOREPLACE_LDFLAGS
	string "LDFLAGS: Linker flags"

config PK_MEMORY_MMAP_AREA_NOREPLACE_CXXFLAGS
	string "CXXFLAGS: C++ compiler flags"

config PK_MEMORY_MMAP_AREA_NOREPLACE_ASFLAGS
	string "CCASFLAGS: assembler compiler flags (defaults to CFLAGS)"

config PK_MEMORY_MMAP_AREA_NOREPLACE_BUILDARCH
	string "--host options on configure for Architecture"

endif # PK_MEMORY_MMAP_AREA_NOREPLACE
```

## package/MEMORY-MMAP/BiscuitOS-MEMORY-MMAP-AREA/Kconfig
```kconfig
menuconfig PK_MEMORY_MMAP_AREA
	bool "Memory Mapping: AREA"

if PK_MEMORY_MMAP_AREA

config PK_MEMORY_MMAP_AREA_VERSION
	default "default"
	string "verstion"

config PK_MEMORY_MMAP_AREA_TAR
	default "tar.gz"
	string "tar type"

config PK_MEMORY_MMAP_AREA_URL
	default "https://gitee.com/BiscuitOS_team/HardStack/raw/Gitee/Memory-Allocator/MMAP-MECH/BiscuitOS-MEMORY-MMAP-AREA"
	string "url"

config PK_MEMORY_MMAP_AREA_GITHUB
	string "GitHub"

config PK_MEMORY_MMAP_AREA_SRCFILE
	default "main.c Makefile RunBiscuitOS.sh"
	string "Source code list"

config PK_MEMORY_MMAP_AREA_CSRCFILE
	string "Compile source code list"

config PK_MEMORY_MMAP_AREA_CONFIG
	string "CONFIG: Project Configure Options"

config PK_MEMORY_MMAP_AREA_LIBPATH
	string "LIBS: Libraries to pass to the linker, e.g. -l<library>"

config PK_MEMORY_MMAP_AREA_CPPFLAGS
	string "CPPFLAGS: C/C++ preprocessor flags, e.g. -I<include dir>"

config PK_MEMORY_MMAP_AREA_DPKCONFIG
	string "PKG_CONFIG_PATH: Directories to add to pkg-config's search path"

config PK_MEMORY_MMAP_AREA_CFLAGS
	string "CFLAGS: C compiler flags"

config PK_MEMORY_MMAP_AREA_LDFLAGS
	string "LDFLAGS: Linker flags"

config PK_MEMORY_MMAP_AREA_CXXFLAGS
	string "CXXFLAGS: C++ compiler flags"

config PK_MEMORY_MMAP_AREA_ASFLAGS
	string "CCASFLAGS: assembler compiler flags (defaults to CFLAGS)"

config PK_MEMORY_MMAP_AREA_BUILDARCH
	string "--host options on configure for Architecture"

endif # PK_MEMORY_MMAP_AREA
```

## package/MEMORY-MMAP/BiscuitOS-MEMORY-MMAP-FILE-REVERSE-TREE/Kconfig
```kconfig
menuconfig PK_MEMORY_MMAP_FILE_REVERSE_TREE
	bool "Memory Mapping: FILE-MAPPING REVERSE TREE"

if PK_MEMORY_MMAP_FILE_REVERSE_TREE

config PK_MEMORY_MMAP_FILE_REVERSE_TREE_VERSION
	default "default"
	string "verstion"

config PK_MEMORY_MMAP_FILE_REVERSE_TREE_TAR
	default "tar.gz"
	string "tar type"

config PK_MEMORY_MMAP_FILE_REVERSE_TREE_URL
	default "https://gitee.com/BiscuitOS_team/HardStack/raw/Gitee/Memory-Allocator/MMAP-MECH/BiscuitOS-MEMORY-MMAP-FILE-REVERSE-TREE"
	string "url"

config PK_MEMORY_MMAP_FILE_REVERSE_TREE_GITHUB
	string "GitHub"

config PK_MEMORY_MMAP_FILE_REVERSE_TREE_SRCFILE
	default "Kconfig  main.c  Makefile  Makefile.host  RunBiscuitOS.sh"
	string "Source code list"

config PK_MEMORY_MMAP_FILE_REVERSE_TREE_CSRCFILE
	string "Compile source code list"

config PK_MEMORY_MMAP_FILE_REVERSE_TREE_CONFIG
	string "CONFIG: Project Configure Options"

config PK_MEMORY_MMAP_FILE_REVERSE_TREE_LIBPATH
	string "LIBS: Libraries to pass to the linker, e.g. -l<library>"

config PK_MEMORY_MMAP_FILE_REVERSE_TREE_CPPFLAGS
	string "CPPFLAGS: C/C++ preprocessor flags, e.g. -I<include dir>"

config PK_MEMORY_MMAP_FILE_REVERSE_TREE_DPKCONFIG
	string "PKG_CONFIG_PATH: Directories to add to pkg-config's search path"

config PK_MEMORY_MMAP_FILE_REVERSE_TREE_CFLAGS
	string "CFLAGS: C compiler flags"

config PK_MEMORY_MMAP_FILE_REVERSE_TREE_LDFLAGS
	string "LDFLAGS: Linker flags"

config PK_MEMORY_MMAP_FILE_REVERSE_TREE_CXXFLAGS
	string "CXXFLAGS: C++ compiler flags"

config PK_MEMORY_MMAP_FILE_REVERSE_TREE_ASFLAGS
	string "CCASFLAGS: assembler compiler flags (defaults to CFLAGS)"

config PK_MEMORY_MMAP_FILE_REVERSE_TREE_BUILDARCH
	string "--host options on configure for Architecture"

endif # PK_MEMORY_MMAP_FILE_REVERSE_TREE
```

## package/MEMORY-MMAP/BiscuitOS-MEMORY-MMAP-MAP-ANONYMOUS/Kconfig
```kconfig
menuconfig PK_MEMORY_MMAP_MAP_ANONYMOUS
	bool "Memory Mapping: FLAGS MAP_ANONYMOUS"

if PK_MEMORY_MMAP_MAP_ANONYMOUS

config PK_MEMORY_MMAP_MAP_ANONYMOUS_VERSION
	default "default"
	string "verstion"

config PK_MEMORY_MMAP_MAP_ANONYMOUS_TAR
	default "tar.gz"
	string "tar type"

config PK_MEMORY_MMAP_MAP_ANONYMOUS_URL
	default "https://gitee.com/BiscuitOS_team/HardStack/raw/Gitee/Memory-Allocator/MMAP-MECH/BiscuitOS-MEMORY-MMAP-MAP-ANONYMOUS"
	string "url"

config PK_MEMORY_MMAP_MAP_ANONYMOUS_GITHUB
	string "GitHub"

config PK_MEMORY_MMAP_MAP_ANONYMOUS_SRCFILE
	default "main.c Makefile RunBiscuitOS.sh"
	string "Source code list"

config PK_MEMORY_MMAP_MAP_ANONYMOUS_CSRCFILE
	string "Compile source code list"

config PK_MEMORY_MMAP_MAP_ANONYMOUS_CONFIG
	string "CONFIG: Project Configure Options"

config PK_MEMORY_MMAP_MAP_ANONYMOUS_LIBPATH
	string "LIBS: Libraries to pass to the linker, e.g. -l<library>"

config PK_MEMORY_MMAP_MAP_ANONYMOUS_CPPFLAGS
	string "CPPFLAGS: C/C++ preprocessor flags, e.g. -I<include dir>"

config PK_MEMORY_MMAP_MAP_ANONYMOUS_DPKCONFIG
	string "PKG_CONFIG_PATH: Directories to add to pkg-config's search path"

config PK_MEMORY_MMAP_MAP_ANONYMOUS_CFLAGS
	string "CFLAGS: C compiler flags"

config PK_MEMORY_MMAP_MAP_ANONYMOUS_LDFLAGS
	string "LDFLAGS: Linker flags"

config PK_MEMORY_MMAP_MAP_ANONYMOUS_CXXFLAGS
	string "CXXFLAGS: C++ compiler flags"

config PK_MEMORY_MMAP_MAP_ANONYMOUS_ASFLAGS
	string "CCASFLAGS: assembler compiler flags (defaults to CFLAGS)"

config PK_MEMORY_MMAP_MAP_ANONYMOUS_BUILDARCH
	string "--host options on configure for Architecture"

endif # PK_MEMORY_MMAP_MAP_ANONYMOUS
```

## package/MEMORY-MMAP/BiscuitOS-MEMORY-MMAP-MAP-FIXED-NOREPLACE/Kconfig
```kconfig
menuconfig PK_MEMORY_MMAP_MAP_FIXED_NOREPLACE
	bool "Memory Mapping: FLAGS MAP_FIXED_NOREPLACE"

if PK_MEMORY_MMAP_MAP_FIXED_NOREPLACE

config PK_MEMORY_MMAP_MAP_FIXED_NOREPLACE_VERSION
	default "default"
	string "verstion"

config PK_MEMORY_MMAP_MAP_FIXED_NOREPLACE_TAR
	default "tar.gz"
	string "tar type"

config PK_MEMORY_MMAP_MAP_FIXED_NOREPLACE_URL
	default "https://gitee.com/BiscuitOS_team/HardStack/raw/Gitee/Memory-Allocator/MMAP-MECH/BiscuitOS-MEMORY-MMAP-MAP-FIXED-NOREPLACE"
	string "url"

config PK_MEMORY_MMAP_MAP_FIXED_NOREPLACE_GITHUB
	string "GitHub"

config PK_MEMORY_MMAP_MAP_FIXED_NOREPLACE_SRCFILE
	default "main.c Makefile RunBiscuitOS.sh"
	string "Source code list"

config PK_MEMORY_MMAP_MAP_FIXED_NOREPLACE_CSRCFILE
	string "Compile source code list"

config PK_MEMORY_MMAP_MAP_FIXED_NOREPLACE_CONFIG
	string "CONFIG: Project Configure Options"

config PK_MEMORY_MMAP_MAP_FIXED_NOREPLACE_LIBPATH
	string "LIBS: Libraries to pass to the linker, e.g. -l<library>"

config PK_MEMORY_MMAP_MAP_FIXED_NOREPLACE_CPPFLAGS
	string "CPPFLAGS: C/C++ preprocessor flags, e.g. -I<include dir>"

config PK_MEMORY_MMAP_MAP_FIXED_NOREPLACE_DPKCONFIG
	string "PKG_CONFIG_PATH: Directories to add to pkg-config's search path"

config PK_MEMORY_MMAP_MAP_FIXED_NOREPLACE_CFLAGS
	string "CFLAGS: C compiler flags"

config PK_MEMORY_MMAP_MAP_FIXED_NOREPLACE_LDFLAGS
	string "LDFLAGS: Linker flags"

config PK_MEMORY_MMAP_MAP_FIXED_NOREPLACE_CXXFLAGS
	string "CXXFLAGS: C++ compiler flags"

config PK_MEMORY_MMAP_MAP_FIXED_NOREPLACE_ASFLAGS
	string "CCASFLAGS: assembler compiler flags (defaults to CFLAGS)"

config PK_MEMORY_MMAP_MAP_FIXED_NOREPLACE_BUILDARCH
	string "--host options on configure for Architecture"

endif # PK_MEMORY_MMAP_MAP_FIXED_NOREPLACE
```

## package/MEMORY-MMAP/BiscuitOS-MEMORY-MMAP-MAP-FIXED/Kconfig
```kconfig
menuconfig PK_MEMORY_MMAP_MAP_FIXED
	bool "Memory Mapping: FLAGS MAP_FIXED"

if PK_MEMORY_MMAP_MAP_FIXED

config PK_MEMORY_MMAP_MAP_FIXED_VERSION
	default "default"
	string "verstion"

config PK_MEMORY_MMAP_MAP_FIXED_TAR
	default "tar.gz"
	string "tar type"

config PK_MEMORY_MMAP_MAP_FIXED_URL
	default "https://gitee.com/BiscuitOS_team/HardStack/raw/Gitee/Memory-Allocator/MMAP-MECH/BiscuitOS-MEMORY-MMAP-MAP-FIXED"
	string "url"

config PK_MEMORY_MMAP_MAP_FIXED_GITHUB
	string "GitHub"

config PK_MEMORY_MMAP_MAP_FIXED_SRCFILE
	default "main.c Makefile RunBiscuitOS.sh"
	string "Source code list"

config PK_MEMORY_MMAP_MAP_FIXED_CSRCFILE
	string "Compile source code list"

config PK_MEMORY_MMAP_MAP_FIXED_CONFIG
	string "CONFIG: Project Configure Options"

config PK_MEMORY_MMAP_MAP_FIXED_LIBPATH
	string "LIBS: Libraries to pass to the linker, e.g. -l<library>"

config PK_MEMORY_MMAP_MAP_FIXED_CPPFLAGS
	string "CPPFLAGS: C/C++ preprocessor flags, e.g. -I<include dir>"

config PK_MEMORY_MMAP_MAP_FIXED_DPKCONFIG
	string "PKG_CONFIG_PATH: Directories to add to pkg-config's search path"

config PK_MEMORY_MMAP_MAP_FIXED_CFLAGS
	string "CFLAGS: C compiler flags"

config PK_MEMORY_MMAP_MAP_FIXED_LDFLAGS
	string "LDFLAGS: Linker flags"

config PK_MEMORY_MMAP_MAP_FIXED_CXXFLAGS
	string "CXXFLAGS: C++ compiler flags"

config PK_MEMORY_MMAP_MAP_FIXED_ASFLAGS
	string "CCASFLAGS: assembler compiler flags (defaults to CFLAGS)"

config PK_MEMORY_MMAP_MAP_FIXED_BUILDARCH
	string "--host options on configure for Architecture"

endif # PK_MEMORY_MMAP_MAP_FIXED
```

## package/MEMORY-MMAP/BiscuitOS-MEMORY-MMAP-MAP-GROWSDOWN/Kconfig
```kconfig
menuconfig PK_MEMORY_MMAP_MAP_GROWSDOWN
	bool "Memory Mapping: FLAGS MAP_GROWSDOWN"

if PK_MEMORY_MMAP_MAP_GROWSDOWN

config PK_MEMORY_MMAP_MAP_GROWSDOWN_VERSION
	default "default"
	string "verstion"

config PK_MEMORY_MMAP_MAP_GROWSDOWN_TAR
	default "tar.gz"
	string "tar type"

config PK_MEMORY_MMAP_MAP_GROWSDOWN_URL
	default "https://gitee.com/BiscuitOS_team/HardStack/raw/Gitee/Memory-Allocator/MMAP-MECH/BiscuitOS-MEMORY-MMAP-MAP-GROWSDOWN"
	string "url"

config PK_MEMORY_MMAP_MAP_GROWSDOWN_GITHUB
	string "GitHub"

config PK_MEMORY_MMAP_MAP_GROWSDOWN_SRCFILE
	default "main.c Makefile RunBiscuitOS.sh"
	string "Source code list"

config PK_MEMORY_MMAP_MAP_GROWSDOWN_CSRCFILE
	string "Compile source code list"

config PK_MEMORY_MMAP_MAP_GROWSDOWN_CONFIG
	string "CONFIG: Project Configure Options"

config PK_MEMORY_MMAP_MAP_GROWSDOWN_LIBPATH
	string "LIBS: Libraries to pass to the linker, e.g. -l<library>"

config PK_MEMORY_MMAP_MAP_GROWSDOWN_CPPFLAGS
	string "CPPFLAGS: C/C++ preprocessor flags, e.g. -I<include dir>"

config PK_MEMORY_MMAP_MAP_GROWSDOWN_DPKCONFIG
	string "PKG_CONFIG_PATH: Directories to add to pkg-config's search path"

config PK_MEMORY_MMAP_MAP_GROWSDOWN_CFLAGS
	string "CFLAGS: C compiler flags"

config PK_MEMORY_MMAP_MAP_GROWSDOWN_LDFLAGS
	string "LDFLAGS: Linker flags"

config PK_MEMORY_MMAP_MAP_GROWSDOWN_CXXFLAGS
	string "CXXFLAGS: C++ compiler flags"

config PK_MEMORY_MMAP_MAP_GROWSDOWN_ASFLAGS
	string "CCASFLAGS: assembler compiler flags (defaults to CFLAGS)"

config PK_MEMORY_MMAP_MAP_GROWSDOWN_BUILDARCH
	string "--host options on configure for Architecture"

endif # PK_MEMORY_MMAP_MAP_GROWSDOWN
```

## package/MEMORY-MMAP/BiscuitOS-MEMORY-MMAP-MAP-NONBLOCK/Kconfig
```kconfig
menuconfig PK_MEMORY_MMAP_MAP_NONBLOCK
	bool "Memory Mapping: FLAGS MAP_NONBLOCK"

if PK_MEMORY_MMAP_MAP_NONBLOCK

config PK_MEMORY_MMAP_MAP_NONBLOCK_VERSION
	default "default"
	string "verstion"

config PK_MEMORY_MMAP_MAP_NONBLOCK_TAR
	default "tar.gz"
	string "tar type"

config PK_MEMORY_MMAP_MAP_NONBLOCK_URL
	default "https://gitee.com/BiscuitOS_team/HardStack/raw/Gitee/Memory-Allocator/MMAP-MECH/BiscuitOS-MEMORY-MMAP-MAP-NONBLOCK"
	string "url"

config PK_MEMORY_MMAP_MAP_NONBLOCK_GITHUB
	string "GitHub"

config PK_MEMORY_MMAP_MAP_NONBLOCK_SRCFILE
	default "main.c Makefile RunBiscuitOS.sh"
	string "Source code list"

config PK_MEMORY_MMAP_MAP_NONBLOCK_CSRCFILE
	string "Compile source code list"

config PK_MEMORY_MMAP_MAP_NONBLOCK_CONFIG
	string "CONFIG: Project Configure Options"

config PK_MEMORY_MMAP_MAP_NONBLOCK_LIBPATH
	string "LIBS: Libraries to pass to the linker, e.g. -l<library>"

config PK_MEMORY_MMAP_MAP_NONBLOCK_CPPFLAGS
	string "CPPFLAGS: C/C++ preprocessor flags, e.g. -I<include dir>"

config PK_MEMORY_MMAP_MAP_NONBLOCK_DPKCONFIG
	string "PKG_CONFIG_PATH: Directories to add to pkg-config's search path"

config PK_MEMORY_MMAP_MAP_NONBLOCK_CFLAGS
	string "CFLAGS: C compiler flags"

config PK_MEMORY_MMAP_MAP_NONBLOCK_LDFLAGS
	string "LDFLAGS: Linker flags"

config PK_MEMORY_MMAP_MAP_NONBLOCK_CXXFLAGS
	string "CXXFLAGS: C++ compiler flags"

config PK_MEMORY_MMAP_MAP_NONBLOCK_ASFLAGS
	string "CCASFLAGS: assembler compiler flags (defaults to CFLAGS)"

config PK_MEMORY_MMAP_MAP_NONBLOCK_BUILDARCH
	string "--host options on configure for Architecture"

endif # PK_MEMORY_MMAP_MAP_NONBLOCK
```

## package/MEMORY-MMAP/BiscuitOS-MEMORY-MMAP-MAP-NORESERVE/Kconfig
```kconfig
menuconfig PK_MEMORY_MMAP_MAP_NORESERVE
	bool "Memory Mapping: FLAGS MAP_NORESERVE"

if PK_MEMORY_MMAP_MAP_NORESERVE

config PK_MEMORY_MMAP_MAP_NORESERVE_VERSION
	default "default"
	string "verstion"

config PK_MEMORY_MMAP_MAP_NORESERVE_TAR
	default "tar.gz"
	string "tar type"

config PK_MEMORY_MMAP_MAP_NORESERVE_URL
	default "https://gitee.com/BiscuitOS_team/HardStack/raw/Gitee/Memory-Allocator/MMAP-MECH/BiscuitOS-MEMORY-MMAP-MAP-NORESERVE"
	string "url"

config PK_MEMORY_MMAP_MAP_NORESERVE_GITHUB
	string "GitHub"

config PK_MEMORY_MMAP_MAP_NORESERVE_SRCFILE
	default "main.c Makefile RunBiscuitOS.sh"
	string "Source code list"

config PK_MEMORY_MMAP_MAP_NORESERVE_CSRCFILE
	string "Compile source code list"

config PK_MEMORY_MMAP_MAP_NORESERVE_CONFIG
	string "CONFIG: Project Configure Options"

config PK_MEMORY_MMAP_MAP_NORESERVE_LIBPATH
	string "LIBS: Libraries to pass to the linker, e.g. -l<library>"

config PK_MEMORY_MMAP_MAP_NORESERVE_CPPFLAGS
	string "CPPFLAGS: C/C++ preprocessor flags, e.g. -I<include dir>"

config PK_MEMORY_MMAP_MAP_NORESERVE_DPKCONFIG
	string "PKG_CONFIG_PATH: Directories to add to pkg-config's search path"

config PK_MEMORY_MMAP_MAP_NORESERVE_CFLAGS
	string "CFLAGS: C compiler flags"

config PK_MEMORY_MMAP_MAP_NORESERVE_LDFLAGS
	string "LDFLAGS: Linker flags"

config PK_MEMORY_MMAP_MAP_NORESERVE_CXXFLAGS
	string "CXXFLAGS: C++ compiler flags"

config PK_MEMORY_MMAP_MAP_NORESERVE_ASFLAGS
	string "CCASFLAGS: assembler compiler flags (defaults to CFLAGS)"

config PK_MEMORY_MMAP_MAP_NORESERVE_BUILDARCH
	string "--host options on configure for Architecture"

endif # PK_MEMORY_MMAP_MAP_NORESERVE
```
