## package/MEMORY-MMAP/BiscuitOS-MEMORY-GUP-FOLL-TOUCH/Kconfig
```kconfig
menuconfig PK_MEMORY_GUP_FOLL_TOUCH
	bool "GUP: FOLL_TOUCH"

if PK_MEMORY_GUP_FOLL_TOUCH

config PK_MEMORY_GUP_FOLL_TOUCH_VERSION
	default "default"
	string "verstion"

config PK_MEMORY_GUP_FOLL_TOUCH_TAR
	default "tar.gz"
	string "tar type"

config PK_MEMORY_GUP_FOLL_TOUCH_URL
	default "https://gitee.com/BiscuitOS_team/HardStack/raw/Gitee/Memory-Allocator/MMAP-MECH/BiscuitOS-MEMORY-GUP-FOLL-TOUCH"
	string "url"

config PK_MEMORY_GUP_FOLL_TOUCH_GITHUB
	string "GitHub"

config PK_MEMORY_GUP_FOLL_TOUCH_SRCFILE
	default "app.c  Kconfig  main.c  Makefile  Makefile.host  RunBiscuitOS.sh"
	string "Source code list"

config PK_MEMORY_GUP_FOLL_TOUCH_CSRCFILE
	string "Compile source code list"

config PK_MEMORY_GUP_FOLL_TOUCH_CONFIG
	string "CONFIG: Project Configure Options"

config PK_MEMORY_GUP_FOLL_TOUCH_LIBPATH
	string "LIBS: Libraries to pass to the linker, e.g. -l<library>"

config PK_MEMORY_GUP_FOLL_TOUCH_CPPFLAGS
	string "CPPFLAGS: C/C++ preprocessor flags, e.g. -I<include dir>"

config PK_MEMORY_GUP_FOLL_TOUCH_DPKCONFIG
	string "PKG_CONFIG_PATH: Directories to add to pkg-config's search path"

config PK_MEMORY_GUP_FOLL_TOUCH_CFLAGS
	string "CFLAGS: C compiler flags"

config PK_MEMORY_GUP_FOLL_TOUCH_LDFLAGS
	string "LDFLAGS: Linker flags"

config PK_MEMORY_GUP_FOLL_TOUCH_CXXFLAGS
	string "CXXFLAGS: C++ compiler flags"

config PK_MEMORY_GUP_FOLL_TOUCH_ASFLAGS
	string "CCASFLAGS: assembler compiler flags (defaults to CFLAGS)"

config PK_MEMORY_GUP_FOLL_TOUCH_BUILDARCH
	string "--host options on configure for Architecture"

endif # PK_MEMORY_GUP_FOLL_TOUCH
```

## package/MEMORY-MMAP/BiscuitOS-MEMORY-GUP-FOLL-WRITE/Kconfig
```kconfig
menuconfig PK_MEMORY_GUP_FOLL_WRITE
	bool "GUP: FOLL_WRITE"

if PK_MEMORY_GUP_FOLL_WRITE

config PK_MEMORY_GUP_FOLL_WRITE_VERSION
	default "default"
	string "verstion"

config PK_MEMORY_GUP_FOLL_WRITE_TAR
	default "tar.gz"
	string "tar type"

config PK_MEMORY_GUP_FOLL_WRITE_URL
	default "https://gitee.com/BiscuitOS_team/HardStack/raw/Gitee/Memory-Allocator/MMAP-MECH/BiscuitOS-MEMORY-GUP-FOLL-WRITE"
	string "url"

config PK_MEMORY_GUP_FOLL_WRITE_GITHUB
	string "GitHub"

config PK_MEMORY_GUP_FOLL_WRITE_SRCFILE
	default "app.c  Kconfig  main.c  Makefile  Makefile.host  RunBiscuitOS.sh"
	string "Source code list"

config PK_MEMORY_GUP_FOLL_WRITE_CSRCFILE
	string "Compile source code list"

config PK_MEMORY_GUP_FOLL_WRITE_CONFIG
	string "CONFIG: Project Configure Options"

config PK_MEMORY_GUP_FOLL_WRITE_LIBPATH
	string "LIBS: Libraries to pass to the linker, e.g. -l<library>"

config PK_MEMORY_GUP_FOLL_WRITE_CPPFLAGS
	string "CPPFLAGS: C/C++ preprocessor flags, e.g. -I<include dir>"

config PK_MEMORY_GUP_FOLL_WRITE_DPKCONFIG
	string "PKG_CONFIG_PATH: Directories to add to pkg-config's search path"

config PK_MEMORY_GUP_FOLL_WRITE_CFLAGS
	string "CFLAGS: C compiler flags"

config PK_MEMORY_GUP_FOLL_WRITE_LDFLAGS
	string "LDFLAGS: Linker flags"

config PK_MEMORY_GUP_FOLL_WRITE_CXXFLAGS
	string "CXXFLAGS: C++ compiler flags"

config PK_MEMORY_GUP_FOLL_WRITE_ASFLAGS
	string "CCASFLAGS: assembler compiler flags (defaults to CFLAGS)"

config PK_MEMORY_GUP_FOLL_WRITE_BUILDARCH
	string "--host options on configure for Architecture"

endif # PK_MEMORY_GUP_FOLL_WRITE
```

## package/MEMORY-MMAP/BiscuitOS-MEMORY-GUP-HOW/Kconfig
```kconfig
menuconfig PK_MEMORY_GUP_HOW
	bool "GUP: FIRST DEMO"

if PK_MEMORY_GUP_HOW

config PK_MEMORY_GUP_HOW_VERSION
	default "default"
	string "verstion"

config PK_MEMORY_GUP_HOW_TAR
	default "tar.gz"
	string "tar type"

config PK_MEMORY_GUP_HOW_URL
	default "https://gitee.com/BiscuitOS_team/HardStack/raw/Gitee/Memory-Allocator/MMAP-MECH/BiscuitOS-MEMORY-GUP-HOW"
	string "url"

config PK_MEMORY_GUP_HOW_GITHUB
	string "GitHub"

config PK_MEMORY_GUP_HOW_SRCFILE
	default "app.c  Kconfig  main.c  Makefile  Makefile.host  RunBiscuitOS.sh"
	string "Source code list"

config PK_MEMORY_GUP_HOW_CSRCFILE
	string "Compile source code list"

config PK_MEMORY_GUP_HOW_CONFIG
	string "CONFIG: Project Configure Options"

config PK_MEMORY_GUP_HOW_LIBPATH
	string "LIBS: Libraries to pass to the linker, e.g. -l<library>"

config PK_MEMORY_GUP_HOW_CPPFLAGS
	string "CPPFLAGS: C/C++ preprocessor flags, e.g. -I<include dir>"

config PK_MEMORY_GUP_HOW_DPKCONFIG
	string "PKG_CONFIG_PATH: Directories to add to pkg-config's search path"

config PK_MEMORY_GUP_HOW_CFLAGS
	string "CFLAGS: C compiler flags"

config PK_MEMORY_GUP_HOW_LDFLAGS
	string "LDFLAGS: Linker flags"

config PK_MEMORY_GUP_HOW_CXXFLAGS
	string "CXXFLAGS: C++ compiler flags"

config PK_MEMORY_GUP_HOW_ASFLAGS
	string "CCASFLAGS: assembler compiler flags (defaults to CFLAGS)"

config PK_MEMORY_GUP_HOW_BUILDARCH
	string "--host options on configure for Architecture"

endif # PK_MEMORY_GUP_HOW
```

## package/MEMORY-MMAP/BiscuitOS-MEMORY-GUP-LOOGTERM/Kconfig
```kconfig
menuconfig PK_MEMORY_GUP_LOOGTERM
	bool "GUP: LOOGTERM"

if PK_MEMORY_GUP_LOOGTERM

config PK_MEMORY_GUP_LOOGTERM_VERSION
	default "default"
	string "verstion"

config PK_MEMORY_GUP_LOOGTERM_TAR
	default "tar.gz"
	string "tar type"

config PK_MEMORY_GUP_LOOGTERM_URL
	default "https://gitee.com/BiscuitOS_team/HardStack/raw/Gitee/Memory-Allocator/MMAP-MECH/BiscuitOS-MEMORY-GUP-LOOGTERM"
	string "url"

config PK_MEMORY_GUP_LOOGTERM_GITHUB
	string "GitHub"

config PK_MEMORY_GUP_LOOGTERM_SRCFILE
	default "app.c  Kconfig  main.c  Makefile  Makefile.host  RunBiscuitOS.sh"
	string "Source code list"

config PK_MEMORY_GUP_LOOGTERM_CSRCFILE
	string "Compile source code list"

config PK_MEMORY_GUP_LOOGTERM_CONFIG
	string "CONFIG: Project Configure Options"

config PK_MEMORY_GUP_LOOGTERM_LIBPATH
	string "LIBS: Libraries to pass to the linker, e.g. -l<library>"

config PK_MEMORY_GUP_LOOGTERM_CPPFLAGS
	string "CPPFLAGS: C/C++ preprocessor flags, e.g. -I<include dir>"

config PK_MEMORY_GUP_LOOGTERM_DPKCONFIG
	string "PKG_CONFIG_PATH: Directories to add to pkg-config's search path"

config PK_MEMORY_GUP_LOOGTERM_CFLAGS
	string "CFLAGS: C compiler flags"

config PK_MEMORY_GUP_LOOGTERM_LDFLAGS
	string "LDFLAGS: Linker flags"

config PK_MEMORY_GUP_LOOGTERM_CXXFLAGS
	string "CXXFLAGS: C++ compiler flags"

config PK_MEMORY_GUP_LOOGTERM_ASFLAGS
	string "CCASFLAGS: assembler compiler flags (defaults to CFLAGS)"

config PK_MEMORY_GUP_LOOGTERM_BUILDARCH
	string "--host options on configure for Architecture"

endif # PK_MEMORY_GUP_LOOGTERM
```

## package/MEMORY-MMAP/BiscuitOS-MEMORY-GUP-PIN-USER-PAGES-FAST/Kconfig
```kconfig
menuconfig PK_MEMORY_GUP_PIN_USER_PAGES_FAST
	bool "GUP: PIN USER PAGES FAST"

if PK_MEMORY_GUP_PIN_USER_PAGES_FAST

config PK_MEMORY_GUP_PIN_USER_PAGES_FAST_VERSION
	default "default"
	string "verstion"

config PK_MEMORY_GUP_PIN_USER_PAGES_FAST_TAR
	default "tar.gz"
	string "tar type"

config PK_MEMORY_GUP_PIN_USER_PAGES_FAST_URL
	default "https://gitee.com/BiscuitOS_team/HardStack/raw/Gitee/Memory-Allocator/MMAP-MECH/BiscuitOS-MEMORY-GUP-PIN-USER-PAGES-FAST"
	string "url"

config PK_MEMORY_GUP_PIN_USER_PAGES_FAST_GITHUB
	string "GitHub"

config PK_MEMORY_GUP_PIN_USER_PAGES_FAST_SRCFILE
	default "app.c  Kconfig  main.c  Makefile  Makefile.host  RunBiscuitOS.sh"
	string "Source code list"

config PK_MEMORY_GUP_PIN_USER_PAGES_FAST_CSRCFILE
	string "Compile source code list"

config PK_MEMORY_GUP_PIN_USER_PAGES_FAST_CONFIG
	string "CONFIG: Project Configure Options"

config PK_MEMORY_GUP_PIN_USER_PAGES_FAST_LIBPATH
	string "LIBS: Libraries to pass to the linker, e.g. -l<library>"

config PK_MEMORY_GUP_PIN_USER_PAGES_FAST_CPPFLAGS
	string "CPPFLAGS: C/C++ preprocessor flags, e.g. -I<include dir>"

config PK_MEMORY_GUP_PIN_USER_PAGES_FAST_DPKCONFIG
	string "PKG_CONFIG_PATH: Directories to add to pkg-config's search path"

config PK_MEMORY_GUP_PIN_USER_PAGES_FAST_CFLAGS
	string "CFLAGS: C compiler flags"

config PK_MEMORY_GUP_PIN_USER_PAGES_FAST_LDFLAGS
	string "LDFLAGS: Linker flags"

config PK_MEMORY_GUP_PIN_USER_PAGES_FAST_CXXFLAGS
	string "CXXFLAGS: C++ compiler flags"

config PK_MEMORY_GUP_PIN_USER_PAGES_FAST_ASFLAGS
	string "CCASFLAGS: assembler compiler flags (defaults to CFLAGS)"

config PK_MEMORY_GUP_PIN_USER_PAGES_FAST_BUILDARCH
	string "--host options on configure for Architecture"

endif # PK_MEMORY_GUP_PIN_USER_PAGES_FAST
```

## package/MEMORY-MMAP/BiscuitOS-MEMORY-GUP-PIN-USER-PAGES-REMOTE/Kconfig
```kconfig
menuconfig PK_MEMORY_GUP_PIN_USER_PAGES_REMOTE
	bool "GUP: PIN REMOTE USER PAGES"

if PK_MEMORY_GUP_PIN_USER_PAGES_REMOTE

config PK_MEMORY_GUP_PIN_USER_PAGES_REMOTE_VERSION
	default "default"
	string "verstion"

config PK_MEMORY_GUP_PIN_USER_PAGES_REMOTE_TAR
	default "tar.gz"
	string "tar type"

config PK_MEMORY_GUP_PIN_USER_PAGES_REMOTE_URL
	default "https://gitee.com/BiscuitOS_team/HardStack/raw/Gitee/Memory-Allocator/MMAP-MECH/BiscuitOS-MEMORY-GUP-PIN-USER-PAGES-REMOTE"
	string "url"

config PK_MEMORY_GUP_PIN_USER_PAGES_REMOTE_GITHUB
	string "GitHub"

config PK_MEMORY_GUP_PIN_USER_PAGES_REMOTE_SRCFILE
	default "app.c  Kconfig  main.c  Makefile  Makefile.host  RunBiscuitOS.sh"
	string "Source code list"

config PK_MEMORY_GUP_PIN_USER_PAGES_REMOTE_CSRCFILE
	string "Compile source code list"

config PK_MEMORY_GUP_PIN_USER_PAGES_REMOTE_CONFIG
	string "CONFIG: Project Configure Options"

config PK_MEMORY_GUP_PIN_USER_PAGES_REMOTE_LIBPATH
	string "LIBS: Libraries to pass to the linker, e.g. -l<library>"

config PK_MEMORY_GUP_PIN_USER_PAGES_REMOTE_CPPFLAGS
	string "CPPFLAGS: C/C++ preprocessor flags, e.g. -I<include dir>"

config PK_MEMORY_GUP_PIN_USER_PAGES_REMOTE_DPKCONFIG
	string "PKG_CONFIG_PATH: Directories to add to pkg-config's search path"

config PK_MEMORY_GUP_PIN_USER_PAGES_REMOTE_CFLAGS
	string "CFLAGS: C compiler flags"

config PK_MEMORY_GUP_PIN_USER_PAGES_REMOTE_LDFLAGS
	string "LDFLAGS: Linker flags"

config PK_MEMORY_GUP_PIN_USER_PAGES_REMOTE_CXXFLAGS
	string "CXXFLAGS: C++ compiler flags"

config PK_MEMORY_GUP_PIN_USER_PAGES_REMOTE_ASFLAGS
	string "CCASFLAGS: assembler compiler flags (defaults to CFLAGS)"

config PK_MEMORY_GUP_PIN_USER_PAGES_REMOTE_BUILDARCH
	string "--host options on configure for Architecture"

endif # PK_MEMORY_GUP_PIN_USER_PAGES_REMOTE
```

## package/MEMORY-MMAP/BiscuitOS-MEMORY-GUP-PIN-USER-PAGES/Kconfig
```kconfig
menuconfig PK_MEMORY_GUP_PIN_USER_PAGES
	bool "GUP: PIN USER PAGES"

if PK_MEMORY_GUP_PIN_USER_PAGES

config PK_MEMORY_GUP_PIN_USER_PAGES_VERSION
	default "default"
	string "verstion"

config PK_MEMORY_GUP_PIN_USER_PAGES_TAR
	default "tar.gz"
	string "tar type"

config PK_MEMORY_GUP_PIN_USER_PAGES_URL
	default "https://gitee.com/BiscuitOS_team/HardStack/raw/Gitee/Memory-Allocator/MMAP-MECH/BiscuitOS-MEMORY-GUP-PIN-USER-PAGES"
	string "url"

config PK_MEMORY_GUP_PIN_USER_PAGES_GITHUB
	string "GitHub"

config PK_MEMORY_GUP_PIN_USER_PAGES_SRCFILE
	default "app.c  Kconfig  main.c  Makefile  Makefile.host  RunBiscuitOS.sh"
	string "Source code list"

config PK_MEMORY_GUP_PIN_USER_PAGES_CSRCFILE
	string "Compile source code list"

config PK_MEMORY_GUP_PIN_USER_PAGES_CONFIG
	string "CONFIG: Project Configure Options"

config PK_MEMORY_GUP_PIN_USER_PAGES_LIBPATH
	string "LIBS: Libraries to pass to the linker, e.g. -l<library>"

config PK_MEMORY_GUP_PIN_USER_PAGES_CPPFLAGS
	string "CPPFLAGS: C/C++ preprocessor flags, e.g. -I<include dir>"

config PK_MEMORY_GUP_PIN_USER_PAGES_DPKCONFIG
	string "PKG_CONFIG_PATH: Directories to add to pkg-config's search path"

config PK_MEMORY_GUP_PIN_USER_PAGES_CFLAGS
	string "CFLAGS: C compiler flags"

config PK_MEMORY_GUP_PIN_USER_PAGES_LDFLAGS
	string "LDFLAGS: Linker flags"

config PK_MEMORY_GUP_PIN_USER_PAGES_CXXFLAGS
	string "CXXFLAGS: C++ compiler flags"

config PK_MEMORY_GUP_PIN_USER_PAGES_ASFLAGS
	string "CCASFLAGS: assembler compiler flags (defaults to CFLAGS)"

config PK_MEMORY_GUP_PIN_USER_PAGES_BUILDARCH
	string "--host options on configure for Architecture"

endif # PK_MEMORY_GUP_PIN_USER_PAGES
```

## package/MEMORY-MMAP/BiscuitOS-MEMORY-GUP-SMAP/Kconfig
```kconfig
menuconfig PK_MEMORY_GUP_SMAP
	bool "GUP: 2ND DEMO"

if PK_MEMORY_GUP_SMAP

config PK_MEMORY_GUP_SMAP_VERSION
	default "default"
	string "verstion"

config PK_MEMORY_GUP_SMAP_TAR
	default "tar.gz"
	string "tar type"

config PK_MEMORY_GUP_SMAP_URL
	default "https://gitee.com/BiscuitOS_team/HardStack/raw/Gitee/Memory-Allocator/MMAP-MECH/BiscuitOS-MEMORY-GUP-SMAP"
	string "url"

config PK_MEMORY_GUP_SMAP_GITHUB
	string "GitHub"

config PK_MEMORY_GUP_SMAP_SRCFILE
	default "app.c  Kconfig  main.c  Makefile  Makefile.host  RunBiscuitOS.sh"
	string "Source code list"

config PK_MEMORY_GUP_SMAP_CSRCFILE
	string "Compile source code list"

config PK_MEMORY_GUP_SMAP_CONFIG
	string "CONFIG: Project Configure Options"

config PK_MEMORY_GUP_SMAP_LIBPATH
	string "LIBS: Libraries to pass to the linker, e.g. -l<library>"

config PK_MEMORY_GUP_SMAP_CPPFLAGS
	string "CPPFLAGS: C/C++ preprocessor flags, e.g. -I<include dir>"

config PK_MEMORY_GUP_SMAP_DPKCONFIG
	string "PKG_CONFIG_PATH: Directories to add to pkg-config's search path"

config PK_MEMORY_GUP_SMAP_CFLAGS
	string "CFLAGS: C compiler flags"

config PK_MEMORY_GUP_SMAP_LDFLAGS
	string "LDFLAGS: Linker flags"

config PK_MEMORY_GUP_SMAP_CXXFLAGS
	string "CXXFLAGS: C++ compiler flags"

config PK_MEMORY_GUP_SMAP_ASFLAGS
	string "CCASFLAGS: assembler compiler flags (defaults to CFLAGS)"

config PK_MEMORY_GUP_SMAP_BUILDARCH
	string "--host options on configure for Architecture"

endif # PK_MEMORY_GUP_SMAP
```

## package/MEMORY-MMAP/BiscuitOS-MEMORY-MMAP-AREA-FIXED/Kconfig
```kconfig
menuconfig PK_MEMORY_MMAP_AREA_FIXED
	bool "Memory Mapping: AREA FIXED"

if PK_MEMORY_MMAP_AREA_FIXED

config PK_MEMORY_MMAP_AREA_FIXED_VERSION
	default "default"
	string "verstion"

config PK_MEMORY_MMAP_AREA_FIXED_TAR
	default "tar.gz"
	string "tar type"

config PK_MEMORY_MMAP_AREA_FIXED_URL
	default "https://gitee.com/BiscuitOS_team/HardStack/raw/Gitee/Memory-Allocator/MMAP-MECH/BiscuitOS-MEMORY-MMAP-AREA-FIXED"
	string "url"

config PK_MEMORY_MMAP_AREA_FIXED_GITHUB
	string "GitHub"

config PK_MEMORY_MMAP_AREA_FIXED_SRCFILE
	default "main.c Makefile RunBiscuitOS.sh"
	string "Source code list"

config PK_MEMORY_MMAP_AREA_FIXED_CSRCFILE
	string "Compile source code list"

config PK_MEMORY_MMAP_AREA_FIXED_CONFIG
	string "CONFIG: Project Configure Options"

config PK_MEMORY_MMAP_AREA_FIXED_LIBPATH
	string "LIBS: Libraries to pass to the linker, e.g. -l<library>"

config PK_MEMORY_MMAP_AREA_FIXED_CPPFLAGS
	string "CPPFLAGS: C/C++ preprocessor flags, e.g. -I<include dir>"

config PK_MEMORY_MMAP_AREA_FIXED_DPKCONFIG
	string "PKG_CONFIG_PATH: Directories to add to pkg-config's search path"

config PK_MEMORY_MMAP_AREA_FIXED_CFLAGS
	string "CFLAGS: C compiler flags"

config PK_MEMORY_MMAP_AREA_FIXED_LDFLAGS
	string "LDFLAGS: Linker flags"

config PK_MEMORY_MMAP_AREA_FIXED_CXXFLAGS
	string "CXXFLAGS: C++ compiler flags"

config PK_MEMORY_MMAP_AREA_FIXED_ASFLAGS
	string "CCASFLAGS: assembler compiler flags (defaults to CFLAGS)"

config PK_MEMORY_MMAP_AREA_FIXED_BUILDARCH
	string "--host options on configure for Architecture"

endif # PK_MEMORY_MMAP_AREA_FIXED
```
