## package/SCHEDULE/BiscuitOS-SCHED-KTHREAD/Kconfig
```kconfig
menuconfig PK_SCHED_KTHREAD
	bool "SCHEDULE OBJECT: Kernel Thread"

if PK_SCHED_KTHREAD

config PK_SCHED_KTHREAD_VERSION
	default "default"
	string "verstion"

config PK_SCHED_KTHREAD_TAR
	default "tar.gz"
	string "tar type"

config PK_SCHED_KTHREAD_URL
	default "https://gitee.com/BiscuitOS_team/HardStack/raw/Gitee/SCHEDULE-SUBSYSTEM/BiscuitOS-SCHED-KTHREAD"
	string "url"

config PK_SCHED_KTHREAD_GITHUB
	string "GitHub"

config PK_SCHED_KTHREAD_SRCFILE
	default "Kconfig  Makefile  Makefile.host  RunBiscuitOS.sh  main.c"
	string "Source code list"

config PK_SCHED_KTHREAD_CSRCFILE
	string "Compile source code list"

config PK_SCHED_KTHREAD_CONFIG
	string "CONFIG: Project Configure Options"

config PK_SCHED_KTHREAD_LIBPATH
	string "LIBS: Libraries to pass to the linker, e.g. -l<library>"

config PK_SCHED_KTHREAD_CPPFLAGS
	string "CPPFLAGS: C/C++ preprocessor flags, e.g. -I<include dir>"

config PK_SCHED_KTHREAD_DPKCONFIG
	string "PKG_CONFIG_PATH: Directories to add to pkg-config's search path"

config PK_SCHED_KTHREAD_CFLAGS
	string "CFLAGS: C compiler flags"

config PK_SCHED_KTHREAD_LDFLAGS
	string "LDFLAGS: Linker flags"

config PK_SCHED_KTHREAD_CXXFLAGS
	string "CXXFLAGS: C++ compiler flags"

config PK_SCHED_KTHREAD_ASFLAGS
	string "CCASFLAGS: assembler compiler flags (defaults to CFLAGS)"

config PK_SCHED_KTHREAD_BUILDARCH
	string "--host options on configure for Architecture"

endif # PK_SCHED_KTHREAD
```

## package/SCHEDULE/BiscuitOS-SCHED-SOFTIRQ/Kconfig
```kconfig
menuconfig PK_SCHED_SOFTIRQ
	bool "SCHEDULE OBJECT: SOFTIRQ"

if PK_SCHED_SOFTIRQ

config PK_SCHED_SOFTIRQ_VERSION
	default "default"
	string "verstion"

config PK_SCHED_SOFTIRQ_TAR
	default "tar.gz"
	string "tar type"

config PK_SCHED_SOFTIRQ_URL
	default "https://gitee.com/BiscuitOS_team/HardStack/raw/Gitee/SCHEDULE-SUBSYSTEM/BiscuitOS-SCHED-SOFTIRQ"
	string "url"

config PK_SCHED_SOFTIRQ_GITHUB
	string "GitHub"

config PK_SCHED_SOFTIRQ_SRCFILE
	default "Kconfig  Makefile main.c"
	string "Source code list"

config PK_SCHED_SOFTIRQ_CSRCFILE
	string "Compile source code list"

config PK_SCHED_SOFTIRQ_CONFIG
	string "CONFIG: Project Configure Options"

config PK_SCHED_SOFTIRQ_LIBPATH
	string "LIBS: Libraries to pass to the linker, e.g. -l<library>"

config PK_SCHED_SOFTIRQ_CPPFLAGS
	string "CPPFLAGS: C/C++ preprocessor flags, e.g. -I<include dir>"

config PK_SCHED_SOFTIRQ_DPKCONFIG
	string "PKG_CONFIG_PATH: Directories to add to pkg-config's search path"

config PK_SCHED_SOFTIRQ_CFLAGS
	string "CFLAGS: C compiler flags"

config PK_SCHED_SOFTIRQ_LDFLAGS
	string "LDFLAGS: Linker flags"

config PK_SCHED_SOFTIRQ_CXXFLAGS
	string "CXXFLAGS: C++ compiler flags"

config PK_SCHED_SOFTIRQ_ASFLAGS
	string "CCASFLAGS: assembler compiler flags (defaults to CFLAGS)"

config PK_SCHED_SOFTIRQ_BUILDARCH
	string "--host options on configure for Architecture"

endif # PK_SCHED_SOFTIRQ
```

## package/SCHEDULE/BiscuitOS-SCHED-TASKLET/Kconfig
```kconfig
menuconfig PK_SCHED_TASKLET
	bool "SCHEDULE OBJECT: TASKLET"

if PK_SCHED_TASKLET

config PK_SCHED_TASKLET_VERSION
	default "default"
	string "verstion"

config PK_SCHED_TASKLET_TAR
	default "tar.gz"
	string "tar type"

config PK_SCHED_TASKLET_URL
	default "https://gitee.com/BiscuitOS_team/HardStack/raw/Gitee/SCHEDULE-SUBSYSTEM/BiscuitOS-SCHED-TASKLET"
	string "url"

config PK_SCHED_TASKLET_GITHUB
	string "GitHub"

config PK_SCHED_TASKLET_SRCFILE
	default "Kconfig  Makefile  Makefile.host  RunBiscuitOS.sh  main.c"
	string "Source code list"

config PK_SCHED_TASKLET_CSRCFILE
	string "Compile source code list"

config PK_SCHED_TASKLET_CONFIG
	string "CONFIG: Project Configure Options"

config PK_SCHED_TASKLET_LIBPATH
	string "LIBS: Libraries to pass to the linker, e.g. -l<library>"

config PK_SCHED_TASKLET_CPPFLAGS
	string "CPPFLAGS: C/C++ preprocessor flags, e.g. -I<include dir>"

config PK_SCHED_TASKLET_DPKCONFIG
	string "PKG_CONFIG_PATH: Directories to add to pkg-config's search path"

config PK_SCHED_TASKLET_CFLAGS
	string "CFLAGS: C compiler flags"

config PK_SCHED_TASKLET_LDFLAGS
	string "LDFLAGS: Linker flags"

config PK_SCHED_TASKLET_CXXFLAGS
	string "CXXFLAGS: C++ compiler flags"

config PK_SCHED_TASKLET_ASFLAGS
	string "CCASFLAGS: assembler compiler flags (defaults to CFLAGS)"

config PK_SCHED_TASKLET_BUILDARCH
	string "--host options on configure for Architecture"

endif # PK_SCHED_TASKLET
```

## package/SCHEDULE/BiscuitOS-SCHED-WAITQUEUE/Kconfig
```kconfig
menuconfig PK_SCHED_WAITQUEUE
	bool "SCHEDULE OBJECT: WAITQUEUE"

if PK_SCHED_WAITQUEUE

config PK_SCHED_WAITQUEUE_VERSION
	default "default"
	string "verstion"

config PK_SCHED_WAITQUEUE_TAR
	default "tar.gz"
	string "tar type"

config PK_SCHED_WAITQUEUE_URL
	default "https://gitee.com/BiscuitOS_team/HardStack/raw/Gitee/SCHEDULE-SUBSYSTEM/BiscuitOS-SCHED-WAITQUEUE"
	string "url"

config PK_SCHED_WAITQUEUE_GITHUB
	string "GitHub"

config PK_SCHED_WAITQUEUE_SRCFILE
	default "Kconfig  Makefile  Makefile.host  RunBiscuitOS.sh  main.c"
	string "Source code list"

config PK_SCHED_WAITQUEUE_CSRCFILE
	string "Compile source code list"

config PK_SCHED_WAITQUEUE_CONFIG
	string "CONFIG: Project Configure Options"

config PK_SCHED_WAITQUEUE_LIBPATH
	string "LIBS: Libraries to pass to the linker, e.g. -l<library>"

config PK_SCHED_WAITQUEUE_CPPFLAGS
	string "CPPFLAGS: C/C++ preprocessor flags, e.g. -I<include dir>"

config PK_SCHED_WAITQUEUE_DPKCONFIG
	string "PKG_CONFIG_PATH: Directories to add to pkg-config's search path"

config PK_SCHED_WAITQUEUE_CFLAGS
	string "CFLAGS: C compiler flags"

config PK_SCHED_WAITQUEUE_LDFLAGS
	string "LDFLAGS: Linker flags"

config PK_SCHED_WAITQUEUE_CXXFLAGS
	string "CXXFLAGS: C++ compiler flags"

config PK_SCHED_WAITQUEUE_ASFLAGS
	string "CCASFLAGS: assembler compiler flags (defaults to CFLAGS)"

config PK_SCHED_WAITQUEUE_BUILDARCH
	string "--host options on configure for Architecture"

endif # PK_SCHED_WAITQUEUE
```

## package/SCHEDULE/BiscuitOS-SCHED-WORKQUEUE/Kconfig
```kconfig
menuconfig PK_SCHED_WORKQUEUE
	bool "SCHEDULE OBJECT: WORKQUEUE"

if PK_SCHED_WORKQUEUE

config PK_SCHED_WORKQUEUE_VERSION
	default "default"
	string "verstion"

config PK_SCHED_WORKQUEUE_TAR
	default "tar.gz"
	string "tar type"

config PK_SCHED_WORKQUEUE_URL
	default "https://gitee.com/BiscuitOS_team/HardStack/raw/Gitee/SCHEDULE-SUBSYSTEM/BiscuitOS-SCHED-WORKQUEUE"
	string "url"

config PK_SCHED_WORKQUEUE_GITHUB
	string "GitHub"

config PK_SCHED_WORKQUEUE_SRCFILE
	default "Kconfig  Makefile  Makefile.host  RunBiscuitOS.sh  main.c"
	string "Source code list"

config PK_SCHED_WORKQUEUE_CSRCFILE
	string "Compile source code list"

config PK_SCHED_WORKQUEUE_CONFIG
	string "CONFIG: Project Configure Options"

config PK_SCHED_WORKQUEUE_LIBPATH
	string "LIBS: Libraries to pass to the linker, e.g. -l<library>"

config PK_SCHED_WORKQUEUE_CPPFLAGS
	string "CPPFLAGS: C/C++ preprocessor flags, e.g. -I<include dir>"

config PK_SCHED_WORKQUEUE_DPKCONFIG
	string "PKG_CONFIG_PATH: Directories to add to pkg-config's search path"

config PK_SCHED_WORKQUEUE_CFLAGS
	string "CFLAGS: C compiler flags"

config PK_SCHED_WORKQUEUE_LDFLAGS
	string "LDFLAGS: Linker flags"

config PK_SCHED_WORKQUEUE_CXXFLAGS
	string "CXXFLAGS: C++ compiler flags"

config PK_SCHED_WORKQUEUE_ASFLAGS
	string "CCASFLAGS: assembler compiler flags (defaults to CFLAGS)"

config PK_SCHED_WORKQUEUE_BUILDARCH
	string "--host options on configure for Architecture"

endif # PK_SCHED_WORKQUEUE
```

## package/SCHEDULE/Kconfig
```kconfig
menuconfig PK_SCHEDULE
	bool "SCHEDULE"

if PK_SCHEDULE

# APP USER MODE
source package/SCHEDULE/BiscuitOS-SCHED-APP-USER-MODE/Kconfig

# APP KERNEL MODE
source package/SCHEDULE/BiscuitOS-SCHED-APP-KERNEL-MODE/Kconfig

# KERNEL THREAD
source package/SCHEDULE/BiscuitOS-SCHED-KTHREAD/Kconfig

# SOFTIRQ
source package/SCHEDULE/BiscuitOS-SCHED-SOFTIRQ/Kconfig

# INTERRUPT
source package/SCHEDULE/BiscuitOS-SCHED-INTERRUPT/Kconfig

# WAITQUEUE
source package/SCHEDULE/BiscuitOS-SCHED-WAITQUEUE/Kconfig

# WORKQUEUE
source package/SCHEDULE/BiscuitOS-SCHED-WORKQUEUE/Kconfig

# TASKLET
source package/SCHEDULE/BiscuitOS-SCHED-TASKLET/Kconfig

# COMPLETE
source package/SCHEDULE/BiscuitOS-SCHED-COMPLETE/Kconfig

endif # PK_SCHEDULE
```

## package/SHMEM/BiscuitOS-SHMEM-client/Kconfig
```kconfig
menuconfig PK_SHMEM_CLIENT
	bool "SHMEM: Client Application"

if PK_SHMEM_CLIENT

config PK_SHMEM_CLIENT_VERSION
	default "default"
	string "verstion"

config PK_SHMEM_CLIENT_TAR
	default "tar.gz"
	string "tar type"

config PK_SHMEM_CLIENT_URL
	default "https://gitee.com/BiscuitOS_team/HardStack/raw/Gitee/Memory-Allocator/SHMEM/BiscuitOS-SHMEM-client"
	string "url"

config PK_SHMEM_CLIENT_GITHUB
	string "GitHub"

config PK_SHMEM_CLIENT_SRCFILE
	default "main.c Makefile"
	string "Source code list"

config PK_SHMEM_CLIENT_CSRCFILE
	string "Compile source code list"

config PK_SHMEM_CLIENT_CONFIG
	string "CONFIG: Project Configure Options"

config PK_SHMEM_CLIENT_LIBPATH
	string "LIBS: Libraries to pass to the linker, e.g. -l<library>"

config PK_SHMEM_CLIENT_CPPFLAGS
	string "CPPFLAGS: C/C++ preprocessor flags, e.g. -I<include dir>"

config PK_SHMEM_CLIENT_DPKCONFIG
	string "PKG_CONFIG_PATH: Directories to add to pkg-config's search path"

config PK_SHMEM_CLIENT_CFLAGS
	string "CFLAGS: C compiler flags"

config PK_SHMEM_CLIENT_LDFLAGS
	string "LDFLAGS: Linker flags"

config PK_SHMEM_CLIENT_CXXFLAGS
	string "CXXFLAGS: C++ compiler flags"

config PK_SHMEM_CLIENT_ASFLAGS
	string "CCASFLAGS: assembler compiler flags (defaults to CFLAGS)"

config PK_SHMEM_CLIENT_BUILDARCH
	string "--host options on configure for Architecture"

endif # PK_SHMEM_CLIENT
```

## package/SHMEM/Kconfig
```kconfig
menuconfig PK_SHMEM
	bool "SHMEM: IPC Share Memory Mechanism"

if PK_SHMEM

# SHMEM server
source package/SHMEM/BiscuitOS-SHMEM-server/Kconfig

# SHMEM Client
source package/SHMEM/BiscuitOS-SHMEM-client/Kconfig

endif # PK_SHMEM
```

## package/SMBIOS/Kconfig
```kconfig
menuconfig PK_SMBIOS
	bool "SMBIOS: System Management BIOS"

if PK_SMBIOS

# SMBIOS
source package/SMBIOS/dmidecode/Kconfig

endif # PK_SMBIOS
```

## package/SMBIOS/dmidecode/Kconfig
```kconfig
menuconfig PK_DMIDECODE_TOOLS
	bool "DMI: Desktop Management interface"

if PK_DMIDECODE_TOOLS

config PK_DMIDECODE_TOOLS_VERSION
	default "3.3"
	string "verstion"

config PK_DMIDECODE_TOOLS_TAR
	default "tar.xz"
	string "tar type"

config PK_DMIDECODE_TOOLS_URL
	default "http://ftp.igh.cnrs.fr/pub/nongnu/dmidecode/"
	string "url"

config PK_DMIDECODE_TOOLS_GITHUB
	default ""
	string "GitHub"

config PK_DMIDECODE_TOOLS_SRCFILE
	string "Source code list"

config PK_DMIDECODE_TOOLS_CONFIG
	default "--enable-silent-rules"
	string "CONFIG: Project Configure Options"

config PK_DMIDECODE_TOOLS_LIBPATH
	string "LIBS: Libraries to pass to the linker, e.g. -l<library>"

config PK_DMIDECODE_TOOLS_CPPFLAGS
	string "CPPFLAGS: C/C++ preprocessor flags, e.g. -I<include dir>"

config PK_DMIDECODE_TOOLS_DPKCONFIG
	string "PKG_CONFIG_PATH: Directories to add to pkg-config's search path"

config PK_DMIDECODE_TOOLS_CFLAGS
	string "CFLAGS: C compiler flags"

config PK_DMIDECODE_TOOLS_LDFLAGS
	string "LDFLAGS: Linker flags"

config PK_DMIDECODE_TOOLS_CXXFLAGS
	string "CXXFLAGS: C++ compiler flags"

config PK_DMIDECODE_TOOLS_ASFLAGS
	string "CCASFLAGS: assembler compiler flags (defaults to CFLAGS)"

config PK_DMIDECODE_TOOLS_BUILDARCH
	default "x86_64-unknown-linux-gnu"
	string "--host options on configure for Architecture"

endif # PK_DMIDECODE_TOOLS
```

## package/SMP/Kconfig
```kconfig
menuconfig PK_SMP
	bool "SMP"

if PK_SMP

# on_each_cpu
source package/SMP/on_each_cpu/Kconfig

# smp_call_function_single
source package/SMP/smp_call_function_single/Kconfig

endif # PK_SMP
```

## package/SMP/on_each_cpu/Kconfig
```kconfig
menuconfig PK_ON_EACH_CPU
	bool "on_each_cpu"

if PK_ON_EACH_CPU

config PK_ON_EACH_CPU_VERSION
	default "0.0.1"
	string "verstion"

config PK_ON_EACH_CPU_TAR
	default "tar.gz"
	string "tar type"

config PK_ON_EACH_CPU_URL
	default "https://gitee.com/BiscuitOS_team/HardStack/raw/Gitee/SubSystem/smp/on_each_cpu"
	string "url"

config PK_ON_EACH_CPU_GITHUB
	string "GitHub"

config PK_ON_EACH_CPU_SRCFILE
	default "Kconfig main.c Makefile"
	string "Source code list"

config PK_ON_EACH_CPU_CSRCFILE
	string "Compile source code list"

config PK_ON_EACH_CPU_CONFIG
	string "CONFIG: Project Configure Options"

config PK_ON_EACH_CPU_LIBPATH
	string "LIBS: Libraries to pass to the linker, e.g. -l<library>"

config PK_ON_EACH_CPU_CPPFLAGS
	string "CPPFLAGS: C/C++ preprocessor flags, e.g. -I<include dir>"

config PK_ON_EACH_CPU_DPKCONFIG
	string "PKG_CONFIG_PATH: Directories to add to pkg-config's search path"

config PK_ON_EACH_CPU_CFLAGS
	string "CFLAGS: C compiler flags"

config PK_ON_EACH_CPU_LDFLAGS
	string "LDFLAGS: Linker flags"

config PK_ON_EACH_CPU_CXXFLAGS
	string "CXXFLAGS: C++ compiler flags"

config PK_ON_EACH_CPU_ASFLAGS
	string "CCASFLAGS: assembler compiler flags (defaults to CFLAGS)"

config PK_ON_EACH_CPU_BUILDARCH
	string "--host options on configure for Architecture"

endif # PK_ON_EACH_CPU
```

## package/SMP/smp_call_function_single/Kconfig
```kconfig
menuconfig PK_SMP_CALL_FUNCTION_SINGLE
	bool "smp_call_function_single"

if PK_SMP_CALL_FUNCTION_SINGLE

config PK_SMP_CALL_FUNCTION_SINGLE_VERSION
	default "0.0.1"
	string "verstion"

config PK_SMP_CALL_FUNCTION_SINGLE_TAR
	default "tar.gz"
	string "tar type"

config PK_SMP_CALL_FUNCTION_SINGLE_URL
	default "https://gitee.com/BiscuitOS_team/HardStack/raw/Gitee/SubSystem/smp/smp_call_function_single"
	string "url"

config PK_SMP_CALL_FUNCTION_SINGLE_GITHUB
	string "GitHub"

config PK_SMP_CALL_FUNCTION_SINGLE_SRCFILE
	default "Kconfig main.c Makefile"
	string "Source code list"

config PK_SMP_CALL_FUNCTION_SINGLE_CSRCFILE
	string "Compile source code list"

config PK_SMP_CALL_FUNCTION_SINGLE_CONFIG
	string "CONFIG: Project Configure Options"

config PK_SMP_CALL_FUNCTION_SINGLE_LIBPATH
	string "LIBS: Libraries to pass to the linker, e.g. -l<library>"

config PK_SMP_CALL_FUNCTION_SINGLE_CPPFLAGS
	string "CPPFLAGS: C/C++ preprocessor flags, e.g. -I<include dir>"

config PK_SMP_CALL_FUNCTION_SINGLE_DPKCONFIG
	string "PKG_CONFIG_PATH: Directories to add to pkg-config's search path"

config PK_SMP_CALL_FUNCTION_SINGLE_CFLAGS
	string "CFLAGS: C compiler flags"

config PK_SMP_CALL_FUNCTION_SINGLE_LDFLAGS
	string "LDFLAGS: Linker flags"

config PK_SMP_CALL_FUNCTION_SINGLE_CXXFLAGS
	string "CXXFLAGS: C++ compiler flags"

config PK_SMP_CALL_FUNCTION_SINGLE_ASFLAGS
	string "CCASFLAGS: assembler compiler flags (defaults to CFLAGS)"

config PK_SMP_CALL_FUNCTION_SINGLE_BUILDARCH
	string "--host options on configure for Architecture"

endif # PK_SMP_CALL_FUNCTION_SINGLE
```
