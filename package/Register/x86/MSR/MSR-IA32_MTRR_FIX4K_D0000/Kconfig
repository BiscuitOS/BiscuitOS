## package/Register/x86/MSR/MSR-IA32_MTRR_FIX4K_D0000/Kconfig
```kconfig
menuconfig PK_MSR_IA32_MTRR_FIX4K_D0000
	bool "MSR IA32_MTRR_FIX4K_D0000"

if PK_MSR_IA32_MTRR_FIX4K_D0000

config PK_MSR_IA32_MTRR_FIX4K_D0000_VERSION
	default "default"
	string "verstion"

config PK_MSR_IA32_MTRR_FIX4K_D0000_TAR
	default "tar.gz"
	string "tar type"

config PK_MSR_IA32_MTRR_FIX4K_D0000_URL
	default "https://gitee.com/BiscuitOS_team/HardStack/raw/Gitee/Architecture/Intel/Register/MSR-IA32_MTRR_FIX4K_D0000"
	string "url"

config PK_MSR_IA32_MTRR_FIX4K_D0000_GITHUB
	string "GitHub"

config PK_MSR_IA32_MTRR_FIX4K_D0000_SRCFILE
	default "main.c Kconfig Makefile"
	string "Source code list"

config PK_MSR_IA32_MTRR_FIX4K_D0000_CSRCFILE
	string "Compile source code list"

config PK_MSR_IA32_MTRR_FIX4K_D0000_CONFIG
	string "CONFIG: Project Configure Options"

config PK_MSR_IA32_MTRR_FIX4K_D0000_LIBPATH
	string "LIBS: Libraries to pass to the linker, e.g. -l<library>"

config PK_MSR_IA32_MTRR_FIX4K_D0000_CPPFLAGS
	string "CPPFLAGS: C/C++ preprocessor flags, e.g. -I<include dir>"

config PK_MSR_IA32_MTRR_FIX4K_D0000_DPKCONFIG
	string "PKG_CONFIG_PATH: Directories to add to pkg-config's search path"

config PK_MSR_IA32_MTRR_FIX4K_D0000_CFLAGS
	string "CFLAGS: C compiler flags"

config PK_MSR_IA32_MTRR_FIX4K_D0000_LDFLAGS
	string "LDFLAGS: Linker flags"

config PK_MSR_IA32_MTRR_FIX4K_D0000_CXXFLAGS
	string "CXXFLAGS: C++ compiler flags"

config PK_MSR_IA32_MTRR_FIX4K_D0000_ASFLAGS
	string "CCASFLAGS: assembler compiler flags (defaults to CFLAGS)"

config PK_MSR_IA32_MTRR_FIX4K_D0000_BUILDARCH
	string "--host options on configure for Architecture"

endif # PK_MSR_IA32_MTRR_FIX4K_D0000
```

## package/Register/x86/MSR/MSR-IA32_MTRR_FIX64K_00000/Kconfig
```kconfig
menuconfig PK_MSR_IA32_MTRR_FIX64K_00000
	bool "MSR IA32_MTRR_FIX64K_00000"

if PK_MSR_IA32_MTRR_FIX64K_00000

config PK_MSR_IA32_MTRR_FIX64K_00000_VERSION
	default "default"
	string "verstion"

config PK_MSR_IA32_MTRR_FIX64K_00000_TAR
	default "tar.gz"
	string "tar type"

config PK_MSR_IA32_MTRR_FIX64K_00000_URL
	default "https://gitee.com/BiscuitOS_team/HardStack/raw/Gitee/Architecture/Intel/Register/MSR-IA32_MTRR_FIX64K_00000"
	string "url"

config PK_MSR_IA32_MTRR_FIX64K_00000_GITHUB
	string "GitHub"

config PK_MSR_IA32_MTRR_FIX64K_00000_SRCFILE
	default "main.c Kconfig Makefile"
	string "Source code list"

config PK_MSR_IA32_MTRR_FIX64K_00000_CSRCFILE
	string "Compile source code list"

config PK_MSR_IA32_MTRR_FIX64K_00000_CONFIG
	string "CONFIG: Project Configure Options"

config PK_MSR_IA32_MTRR_FIX64K_00000_LIBPATH
	string "LIBS: Libraries to pass to the linker, e.g. -l<library>"

config PK_MSR_IA32_MTRR_FIX64K_00000_CPPFLAGS
	string "CPPFLAGS: C/C++ preprocessor flags, e.g. -I<include dir>"

config PK_MSR_IA32_MTRR_FIX64K_00000_DPKCONFIG
	string "PKG_CONFIG_PATH: Directories to add to pkg-config's search path"

config PK_MSR_IA32_MTRR_FIX64K_00000_CFLAGS
	string "CFLAGS: C compiler flags"

config PK_MSR_IA32_MTRR_FIX64K_00000_LDFLAGS
	string "LDFLAGS: Linker flags"

config PK_MSR_IA32_MTRR_FIX64K_00000_CXXFLAGS
	string "CXXFLAGS: C++ compiler flags"

config PK_MSR_IA32_MTRR_FIX64K_00000_ASFLAGS
	string "CCASFLAGS: assembler compiler flags (defaults to CFLAGS)"

config PK_MSR_IA32_MTRR_FIX64K_00000_BUILDARCH
	string "--host options on configure for Architecture"

endif # PK_MSR_IA32_MTRR_FIX64K_00000
```

## package/Register/x86/MSR/MSR-IA32_MTRR_PHYSBASEn/Kconfig
```kconfig
menuconfig PK_MSR_IA32_MTRR_PHYSBASEn
	bool "MSR IA32_MTRR_PHYSBASEn"

if PK_MSR_IA32_MTRR_PHYSBASEn

config PK_MSR_IA32_MTRR_PHYSBASEn_VERSION
	default "default"
	string "verstion"

config PK_MSR_IA32_MTRR_PHYSBASEn_TAR
	default "tar.gz"
	string "tar type"

config PK_MSR_IA32_MTRR_PHYSBASEn_URL
	default "https://gitee.com/BiscuitOS_team/HardStack/raw/Gitee/Architecture/Intel/Register/MSR-IA32_MTRR_PHYSBASEn"
	string "url"

config PK_MSR_IA32_MTRR_PHYSBASEn_GITHUB
	string "GitHub"

config PK_MSR_IA32_MTRR_PHYSBASEn_SRCFILE
	default "main.c Kconfig Makefile"
	string "Source code list"

config PK_MSR_IA32_MTRR_PHYSBASEn_CSRCFILE
	string "Compile source code list"

config PK_MSR_IA32_MTRR_PHYSBASEn_CONFIG
	string "CONFIG: Project Configure Options"

config PK_MSR_IA32_MTRR_PHYSBASEn_LIBPATH
	string "LIBS: Libraries to pass to the linker, e.g. -l<library>"

config PK_MSR_IA32_MTRR_PHYSBASEn_CPPFLAGS
	string "CPPFLAGS: C/C++ preprocessor flags, e.g. -I<include dir>"

config PK_MSR_IA32_MTRR_PHYSBASEn_DPKCONFIG
	string "PKG_CONFIG_PATH: Directories to add to pkg-config's search path"

config PK_MSR_IA32_MTRR_PHYSBASEn_CFLAGS
	string "CFLAGS: C compiler flags"

config PK_MSR_IA32_MTRR_PHYSBASEn_LDFLAGS
	string "LDFLAGS: Linker flags"

config PK_MSR_IA32_MTRR_PHYSBASEn_CXXFLAGS
	string "CXXFLAGS: C++ compiler flags"

config PK_MSR_IA32_MTRR_PHYSBASEn_ASFLAGS
	string "CCASFLAGS: assembler compiler flags (defaults to CFLAGS)"

config PK_MSR_IA32_MTRR_PHYSBASEn_BUILDARCH
	string "--host options on configure for Architecture"

endif # PK_MSR_IA32_MTRR_PHYSBASEn
```

## package/Register/x86/MSR/MSR-IA32_MTRR_PHYSMASKn/Kconfig
```kconfig
menuconfig PK_MSR_IA32_MTRR_PHYSMASKn
	bool "MSR IA32_MTRR_PHYSMASKn"

if PK_MSR_IA32_MTRR_PHYSMASKn

config PK_MSR_IA32_MTRR_PHYSMASKn_VERSION
	default "default"
	string "verstion"

config PK_MSR_IA32_MTRR_PHYSMASKn_TAR
	default "tar.gz"
	string "tar type"

config PK_MSR_IA32_MTRR_PHYSMASKn_URL
	default "https://gitee.com/BiscuitOS_team/HardStack/raw/Gitee/Architecture/Intel/Register/MSR-IA32_MTRR_PHYSMASKn"
	string "url"

config PK_MSR_IA32_MTRR_PHYSMASKn_GITHUB
	string "GitHub"

config PK_MSR_IA32_MTRR_PHYSMASKn_SRCFILE
	default "main.c Kconfig Makefile"
	string "Source code list"

config PK_MSR_IA32_MTRR_PHYSMASKn_CSRCFILE
	string "Compile source code list"

config PK_MSR_IA32_MTRR_PHYSMASKn_CONFIG
	string "CONFIG: Project Configure Options"

config PK_MSR_IA32_MTRR_PHYSMASKn_LIBPATH
	string "LIBS: Libraries to pass to the linker, e.g. -l<library>"

config PK_MSR_IA32_MTRR_PHYSMASKn_CPPFLAGS
	string "CPPFLAGS: C/C++ preprocessor flags, e.g. -I<include dir>"

config PK_MSR_IA32_MTRR_PHYSMASKn_DPKCONFIG
	string "PKG_CONFIG_PATH: Directories to add to pkg-config's search path"

config PK_MSR_IA32_MTRR_PHYSMASKn_CFLAGS
	string "CFLAGS: C compiler flags"

config PK_MSR_IA32_MTRR_PHYSMASKn_LDFLAGS
	string "LDFLAGS: Linker flags"

config PK_MSR_IA32_MTRR_PHYSMASKn_CXXFLAGS
	string "CXXFLAGS: C++ compiler flags"

config PK_MSR_IA32_MTRR_PHYSMASKn_ASFLAGS
	string "CCASFLAGS: assembler compiler flags (defaults to CFLAGS)"

config PK_MSR_IA32_MTRR_PHYSMASKn_BUILDARCH
	string "--host options on configure for Architecture"

endif # PK_MSR_IA32_MTRR_PHYSMASKn
```

## package/Register/x86/MSR_IA32_VMX_PINBASED_CTLS/Kconfig
```kconfig
menuconfig PK_X86_MSR_IA32_VMX_PINBASED_CTLS
	bool "MSR_IA32_VMX_PINBASED_CTLS"

if PK_X86_MSR_IA32_VMX_PINBASED_CTLS

config PK_X86_MSR_IA32_VMX_PINBASED_CTLS_VERSION
	default "0.0.1"
	string "verstion"

config PK_X86_MSR_IA32_VMX_PINBASED_CTLS_TAR
	default "tar.gz"
	string "tar type"

config PK_X86_MSR_IA32_VMX_PINBASED_CTLS_URL
	default "https://gitee.com/BiscuitOS_team/HardStack/raw/Gitee/Architecture/Intel/Register/MSR_IA32_VMX_PINBASED_CTLS"
	string "url"

config PK_X86_MSR_IA32_VMX_PINBASED_CTLS_GITHUB
	string "GitHub"

config PK_X86_MSR_IA32_VMX_PINBASED_CTLS_SRCFILE
	default "main.c Kconfig Makefile"
	string "Source code list"

config PK_X86_MSR_IA32_VMX_PINBASED_CTLS_CSRCFILE
	string "Compile source code list"

config PK_X86_MSR_IA32_VMX_PINBASED_CTLS_CONFIG
	string "CONFIG: Project Configure Options"

config PK_X86_MSR_IA32_VMX_PINBASED_CTLS_LIBPATH
	string "LIBS: Libraries to pass to the linker, e.g. -l<library>"

config PK_X86_MSR_IA32_VMX_PINBASED_CTLS_CPPFLAGS
	string "CPPFLAGS: C/C++ preprocessor flags, e.g. -I<include dir>"

config PK_X86_MSR_IA32_VMX_PINBASED_CTLS_DPKCONFIG
	string "PKG_CONFIG_PATH: Directories to add to pkg-config's search path"

config PK_X86_MSR_IA32_VMX_PINBASED_CTLS_CFLAGS
	string "CFLAGS: C compiler flags"

config PK_X86_MSR_IA32_VMX_PINBASED_CTLS_LDFLAGS
	string "LDFLAGS: Linker flags"

config PK_X86_MSR_IA32_VMX_PINBASED_CTLS_CXXFLAGS
	string "CXXFLAGS: C++ compiler flags"

config PK_X86_MSR_IA32_VMX_PINBASED_CTLS_ASFLAGS
	string "CCASFLAGS: assembler compiler flags (defaults to CFLAGS)"

config PK_X86_MSR_IA32_VMX_PINBASED_CTLS_BUILDARCH
	string "--host options on configure for Architecture"

endif # PK_X86_MSR_IA32_VMX_PINBASED_CTLS
```

## package/SCHEDULE/BiscuitOS-SCHED-APP-KERNEL-MODE/Kconfig
```kconfig
menuconfig PK_SCHED_APP_KERNEL
	bool "SCHEDULE OBJECT: APPLICATION KERNEL MODE "

if PK_SCHED_APP_KERNEL

config PK_SCHED_APP_KERNEL_VERSION
	default "default"
	string "verstion"

config PK_SCHED_APP_KERNEL_TAR
	default "tar.gz"
	string "tar type"

config PK_SCHED_APP_KERNEL_URL
	default "https://gitee.com/BiscuitOS_team/HardStack/raw/Gitee/SCHEDULE-SUBSYSTEM/BiscuitOS-SCHED-APP-KERNEL-MODE"
	string "url"

config PK_SCHED_APP_KERNEL_GITHUB
	string "GitHub"

config PK_SCHED_APP_KERNEL_SRCFILE
	default "main.c Makefile RunBiscuitOS.sh Kconfig app.c Makefile.host "
	string "Source code list"

config PK_SCHED_APP_KERNEL_CSRCFILE
	string "Compile source code list"

config PK_SCHED_APP_KERNEL_CONFIG
	string "CONFIG: Project Configure Options"

config PK_SCHED_APP_KERNEL_LIBPATH
	string "LIBS: Libraries to pass to the linker, e.g. -l<library>"

config PK_SCHED_APP_KERNEL_CPPFLAGS
	string "CPPFLAGS: C/C++ preprocessor flags, e.g. -I<include dir>"

config PK_SCHED_APP_KERNEL_DPKCONFIG
	string "PKG_CONFIG_PATH: Directories to add to pkg-config's search path"

config PK_SCHED_APP_KERNEL_CFLAGS
	string "CFLAGS: C compiler flags"

config PK_SCHED_APP_KERNEL_LDFLAGS
	string "LDFLAGS: Linker flags"

config PK_SCHED_APP_KERNEL_CXXFLAGS
	string "CXXFLAGS: C++ compiler flags"

config PK_SCHED_APP_KERNEL_ASFLAGS
	string "CCASFLAGS: assembler compiler flags (defaults to CFLAGS)"

config PK_SCHED_APP_KERNEL_BUILDARCH
	string "--host options on configure for Architecture"

endif # PK_SCHED_APP_KERNEL
```

## package/SCHEDULE/BiscuitOS-SCHED-APP-USER-MODE/Kconfig
```kconfig
menuconfig PK_SCHED_APP_USER
	bool "SCHEDULE OBJECT: APPLICATION USER MODE "

if PK_SCHED_APP_USER

config PK_SCHED_APP_USER_VERSION
	default "default"
	string "verstion"

config PK_SCHED_APP_USER_TAR
	default "tar.gz"
	string "tar type"

config PK_SCHED_APP_USER_URL
	default "https://gitee.com/BiscuitOS_team/HardStack/raw/Gitee/SCHEDULE-SUBSYSTEM/BiscuitOS-SCHED-APP-USER-MODE"
	string "url"

config PK_SCHED_APP_USER_GITHUB
	string "GitHub"

config PK_SCHED_APP_USER_SRCFILE
	default "main.c Makefile RunBiscuitOS.sh"
	string "Source code list"

config PK_SCHED_APP_USER_CSRCFILE
	string "Compile source code list"

config PK_SCHED_APP_USER_CONFIG
	string "CONFIG: Project Configure Options"

config PK_SCHED_APP_USER_LIBPATH
	string "LIBS: Libraries to pass to the linker, e.g. -l<library>"

config PK_SCHED_APP_USER_CPPFLAGS
	string "CPPFLAGS: C/C++ preprocessor flags, e.g. -I<include dir>"

config PK_SCHED_APP_USER_DPKCONFIG
	string "PKG_CONFIG_PATH: Directories to add to pkg-config's search path"

config PK_SCHED_APP_USER_CFLAGS
	string "CFLAGS: C compiler flags"

config PK_SCHED_APP_USER_LDFLAGS
	string "LDFLAGS: Linker flags"

config PK_SCHED_APP_USER_CXXFLAGS
	string "CXXFLAGS: C++ compiler flags"

config PK_SCHED_APP_USER_ASFLAGS
	string "CCASFLAGS: assembler compiler flags (defaults to CFLAGS)"

config PK_SCHED_APP_USER_BUILDARCH
	string "--host options on configure for Architecture"

endif # PK_SCHED_APP_USER
```

## package/SCHEDULE/BiscuitOS-SCHED-COMPLETE/Kconfig
```kconfig
menuconfig PK_SCHED_COMPLETE
	bool "SCHEDULE OBJECT: COMPLETE"

if PK_SCHED_COMPLETE

config PK_SCHED_COMPLETE_VERSION
	default "default"
	string "verstion"

config PK_SCHED_COMPLETE_TAR
	default "tar.gz"
	string "tar type"

config PK_SCHED_COMPLETE_URL
	default "https://gitee.com/BiscuitOS_team/HardStack/raw/Gitee/SCHEDULE-SUBSYSTEM/BiscuitOS-SCHED-COMPLETE"
	string "url"

config PK_SCHED_COMPLETE_GITHUB
	string "GitHub"

config PK_SCHED_COMPLETE_SRCFILE
	default "Kconfig  Makefile  Makefile.host  RunBiscuitOS.sh  main.c"
	string "Source code list"

config PK_SCHED_COMPLETE_CSRCFILE
	string "Compile source code list"

config PK_SCHED_COMPLETE_CONFIG
	string "CONFIG: Project Configure Options"

config PK_SCHED_COMPLETE_LIBPATH
	string "LIBS: Libraries to pass to the linker, e.g. -l<library>"

config PK_SCHED_COMPLETE_CPPFLAGS
	string "CPPFLAGS: C/C++ preprocessor flags, e.g. -I<include dir>"

config PK_SCHED_COMPLETE_DPKCONFIG
	string "PKG_CONFIG_PATH: Directories to add to pkg-config's search path"

config PK_SCHED_COMPLETE_CFLAGS
	string "CFLAGS: C compiler flags"

config PK_SCHED_COMPLETE_LDFLAGS
	string "LDFLAGS: Linker flags"

config PK_SCHED_COMPLETE_CXXFLAGS
	string "CXXFLAGS: C++ compiler flags"

config PK_SCHED_COMPLETE_ASFLAGS
	string "CCASFLAGS: assembler compiler flags (defaults to CFLAGS)"

config PK_SCHED_COMPLETE_BUILDARCH
	string "--host options on configure for Architecture"

endif # PK_SCHED_COMPLETE
```

## package/SCHEDULE/BiscuitOS-SCHED-INTERRUPT/Kconfig
```kconfig
menuconfig PK_SCHED_INTERRUPT
	bool "SCHEDULE OBJECT: INTERRUPT"

if PK_SCHED_INTERRUPT

config PK_SCHED_INTERRUPT_VERSION
	default "default"
	string "verstion"

config PK_SCHED_INTERRUPT_TAR
	default "tar.gz"
	string "tar type"

config PK_SCHED_INTERRUPT_URL
	default "https://gitee.com/BiscuitOS_team/HardStack/raw/Gitee/SCHEDULE-SUBSYSTEM/BiscuitOS-SCHED-INTERRUPT"
	string "url"

config PK_SCHED_INTERRUPT_GITHUB
	string "GitHub"

config PK_SCHED_INTERRUPT_SRCFILE
	default "Kconfig  Makefile  Makefile.host  RunBiscuitOS.sh  main.c"
	string "Source code list"

config PK_SCHED_INTERRUPT_CSRCFILE
	string "Compile source code list"

config PK_SCHED_INTERRUPT_CONFIG
	string "CONFIG: Project Configure Options"

config PK_SCHED_INTERRUPT_LIBPATH
	string "LIBS: Libraries to pass to the linker, e.g. -l<library>"

config PK_SCHED_INTERRUPT_CPPFLAGS
	string "CPPFLAGS: C/C++ preprocessor flags, e.g. -I<include dir>"

config PK_SCHED_INTERRUPT_DPKCONFIG
	string "PKG_CONFIG_PATH: Directories to add to pkg-config's search path"

config PK_SCHED_INTERRUPT_CFLAGS
	string "CFLAGS: C compiler flags"

config PK_SCHED_INTERRUPT_LDFLAGS
	string "LDFLAGS: Linker flags"

config PK_SCHED_INTERRUPT_CXXFLAGS
	string "CXXFLAGS: C++ compiler flags"

config PK_SCHED_INTERRUPT_ASFLAGS
	string "CCASFLAGS: assembler compiler flags (defaults to CFLAGS)"

config PK_SCHED_INTERRUPT_BUILDARCH
	string "--host options on configure for Architecture"

endif # PK_SCHED_INTERRUPT
```
