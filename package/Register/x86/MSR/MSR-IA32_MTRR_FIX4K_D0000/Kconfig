## package/SWAP/BiscuitOS-mkswap-swapon/Kconfig
```kconfig
menuconfig PK_SWAP_MKSWAP_SWAPON
	bool "mkswap and swapon tools on BiscuitOS"

if PK_SWAP_MKSWAP_SWAPON

config PK_SWAP_MKSWAP_SWAPON_VERSION
	default "default"
	string "verstion"

config PK_SWAP_MKSWAP_SWAPON_TAR
	default "tar.gz"
	string "tar type"

config PK_SWAP_MKSWAP_SWAPON_URL
	default "https://gitee.com/BiscuitOS_team/HardStack/raw/Gitee/Memory-Allocator/SWAP/BiscuitOS-mkswap-swapon"
	string "url"

config PK_SWAP_MKSWAP_SWAPON_GITHUB
	string "GitHub"

config PK_SWAP_MKSWAP_SWAPON_SRCFILE
	default "main.c Makefile RunBiscuitOS.sh"
	string "Source code list"

config PK_SWAP_MKSWAP_SWAPON_CSRCFILE
	string "Compile source code list"

config PK_SWAP_MKSWAP_SWAPON_CONFIG
	string "CONFIG: Project Configure Options"

config PK_SWAP_MKSWAP_SWAPON_LIBPATH
	string "LIBS: Libraries to pass to the linker, e.g. -l<library>"

config PK_SWAP_MKSWAP_SWAPON_CPPFLAGS
	string "CPPFLAGS: C/C++ preprocessor flags, e.g. -I<include dir>"

config PK_SWAP_MKSWAP_SWAPON_DPKCONFIG
	string "PKG_CONFIG_PATH: Directories to add to pkg-config's search path"

config PK_SWAP_MKSWAP_SWAPON_CFLAGS
	string "CFLAGS: C compiler flags"

config PK_SWAP_MKSWAP_SWAPON_LDFLAGS
	string "LDFLAGS: Linker flags"

config PK_SWAP_MKSWAP_SWAPON_CXXFLAGS
	string "CXXFLAGS: C++ compiler flags"

config PK_SWAP_MKSWAP_SWAPON_ASFLAGS
	string "CCASFLAGS: assembler compiler flags (defaults to CFLAGS)"

config PK_SWAP_MKSWAP_SWAPON_BUILDARCH
	string "--host options on configure for Architecture"

endif # PK_SWAP_MKSWAP_SWAPON
```

## package/SWAP/Kconfig
```kconfig
menuconfig PK_SWAP
	bool "SWAP Mechanism"

if PK_SWAP

# mkswap and swapon on Userspace
source package/SWAP/BiscuitOS-mkswap-swapon/Kconfig

endif # PK_SWAP
```

## package/THP/BiscuitOS-THP-AnonHugepage-madvise/Kconfig
```kconfig
menuconfig PK_THP_ANONHUGE_MADVISE
	bool "THP: Madvise Page to AnonHugepage"

if PK_THP_ANONHUGE_MADVISE

config PK_THP_ANONHUGE_MADVISE_VERSION
	default "default"
	string "verstion"

config PK_THP_ANONHUGE_MADVISE_TAR
	default "tar.gz"
	string "tar type"

config PK_THP_ANONHUGE_MADVISE_URL
	default "https://gitee.com/BiscuitOS_team/HardStack/raw/Gitee/Memory-Allocator/THP/BiscuitOS-THP-AnonHugepage-madvise"
	string "url"

config PK_THP_ANONHUGE_MADVISE_GITHUB
	string "GitHub"

config PK_THP_ANONHUGE_MADVISE_SRCFILE
	default "main.c Makefile RunBiscuitOS.sh README.md"
	string "Source code list"

config PK_THP_ANONHUGE_MADVISE_CSRCFILE
	string "Compile source code list"

config PK_THP_ANONHUGE_MADVISE_CONFIG
	string "CONFIG: Project Configure Options"

config PK_THP_ANONHUGE_MADVISE_LIBPATH
	string "LIBS: Libraries to pass to the linker, e.g. -l<library>"

config PK_THP_ANONHUGE_MADVISE_CPPFLAGS
	string "CPPFLAGS: C/C++ preprocessor flags, e.g. -I<include dir>"

config PK_THP_ANONHUGE_MADVISE_DPKCONFIG
	string "PKG_CONFIG_PATH: Directories to add to pkg-config's search path"

config PK_THP_ANONHUGE_MADVISE_CFLAGS
	string "CFLAGS: C compiler flags"

config PK_THP_ANONHUGE_MADVISE_LDFLAGS
	string "LDFLAGS: Linker flags"

config PK_THP_ANONHUGE_MADVISE_CXXFLAGS
	string "CXXFLAGS: C++ compiler flags"

config PK_THP_ANONHUGE_MADVISE_ASFLAGS
	string "CCASFLAGS: assembler compiler flags (defaults to CFLAGS)"

config PK_THP_ANONHUGE_MADVISE_BUILDARCH
	string "--host options on configure for Architecture"

endif # PK_THP_ANONHUGE_MADVISE
```
