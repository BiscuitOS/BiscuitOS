## package/MEMORY-MMAP/BiscuitOS-MEMORY-GUP-API-FISW/Kconfig
```kconfig
menuconfig PK_MEMORY_GUP_API_FISW
	bool "GUP-API: fault_in_subpage_writeable"

if PK_MEMORY_GUP_API_FISW

config PK_MEMORY_GUP_API_FISW_VERSION
	default "default"
	string "verstion"

config PK_MEMORY_GUP_API_FISW_TAR
	default "tar.gz"
	string "tar type"

config PK_MEMORY_GUP_API_FISW_URL
	default "https://gitee.com/BiscuitOS_team/HardStack/raw/Gitee/Memory-Allocator/MMAP-MECH/BiscuitOS-MEMORY-GUP-API-FISW"
	string "url"

config PK_MEMORY_GUP_API_FISW_GITHUB
	string "GitHub"

config PK_MEMORY_GUP_API_FISW_SRCFILE
	default "app.c  Kconfig  main.c  Makefile  Makefile.host  RunBiscuitOS.sh"
	string "Source code list"

config PK_MEMORY_GUP_API_FISW_CSRCFILE
	string "Compile source code list"

config PK_MEMORY_GUP_API_FISW_CONFIG
	string "CONFIG: Project Configure Options"

config PK_MEMORY_GUP_API_FISW_LIBPATH
	string "LIBS: Libraries to pass to the linker, e.g. -l<library>"

config PK_MEMORY_GUP_API_FISW_CPPFLAGS
	string "CPPFLAGS: C/C++ preprocessor flags, e.g. -I<include dir>"

config PK_MEMORY_GUP_API_FISW_DPKCONFIG
	string "PKG_CONFIG_PATH: Directories to add to pkg-config's search path"

config PK_MEMORY_GUP_API_FISW_CFLAGS
	string "CFLAGS: C compiler flags"

config PK_MEMORY_GUP_API_FISW_LDFLAGS
	string "LDFLAGS: Linker flags"

config PK_MEMORY_GUP_API_FISW_CXXFLAGS
	string "CXXFLAGS: C++ compiler flags"

config PK_MEMORY_GUP_API_FISW_ASFLAGS
	string "CCASFLAGS: assembler compiler flags (defaults to CFLAGS)"

config PK_MEMORY_GUP_API_FISW_BUILDARCH
	string "--host options on configure for Architecture"

endif # PK_MEMORY_GUP_API_FISW
```

## package/MEMORY-MMAP/BiscuitOS-MEMORY-GUP-FAST-ONLY/Kconfig
```kconfig
menuconfig PK_MEMORY_GUP_FAST_ONLY
	bool "GUP: FAST-ONLY"

if PK_MEMORY_GUP_FAST_ONLY

config PK_MEMORY_GUP_FAST_ONLY_VERSION
	default "default"
	string "verstion"

config PK_MEMORY_GUP_FAST_ONLY_TAR
	default "tar.gz"
	string "tar type"

config PK_MEMORY_GUP_FAST_ONLY_URL
	default "https://gitee.com/BiscuitOS_team/HardStack/raw/Gitee/Memory-Allocator/MMAP-MECH/BiscuitOS-MEMORY-GUP-FAST-ONLY"
	string "url"

config PK_MEMORY_GUP_FAST_ONLY_GITHUB
	string "GitHub"

config PK_MEMORY_GUP_FAST_ONLY_SRCFILE
	default "app.c  Kconfig  main.c  Makefile  Makefile.host  RunBiscuitOS.sh"
	string "Source code list"

config PK_MEMORY_GUP_FAST_ONLY_CSRCFILE
	string "Compile source code list"

config PK_MEMORY_GUP_FAST_ONLY_CONFIG
	string "CONFIG: Project Configure Options"

config PK_MEMORY_GUP_FAST_ONLY_LIBPATH
	string "LIBS: Libraries to pass to the linker, e.g. -l<library>"

config PK_MEMORY_GUP_FAST_ONLY_CPPFLAGS
	string "CPPFLAGS: C/C++ preprocessor flags, e.g. -I<include dir>"

config PK_MEMORY_GUP_FAST_ONLY_DPKCONFIG
	string "PKG_CONFIG_PATH: Directories to add to pkg-config's search path"

config PK_MEMORY_GUP_FAST_ONLY_CFLAGS
	string "CFLAGS: C compiler flags"

config PK_MEMORY_GUP_FAST_ONLY_LDFLAGS
	string "LDFLAGS: Linker flags"

config PK_MEMORY_GUP_FAST_ONLY_CXXFLAGS
	string "CXXFLAGS: C++ compiler flags"

config PK_MEMORY_GUP_FAST_ONLY_ASFLAGS
	string "CCASFLAGS: assembler compiler flags (defaults to CFLAGS)"

config PK_MEMORY_GUP_FAST_ONLY_BUILDARCH
	string "--host options on configure for Architecture"

endif # PK_MEMORY_GUP_FAST_ONLY
```

## package/MEMORY-MMAP/BiscuitOS-MEMORY-GUP-FAST/Kconfig
```kconfig
menuconfig PK_MEMORY_GUP_FAST
	bool "GUP: FAST"

if PK_MEMORY_GUP_FAST

config PK_MEMORY_GUP_FAST_VERSION
	default "default"
	string "verstion"

config PK_MEMORY_GUP_FAST_TAR
	default "tar.gz"
	string "tar type"

config PK_MEMORY_GUP_FAST_URL
	default "https://gitee.com/BiscuitOS_team/HardStack/raw/Gitee/Memory-Allocator/MMAP-MECH/BiscuitOS-MEMORY-GUP-FAST"
	string "url"

config PK_MEMORY_GUP_FAST_GITHUB
	string "GitHub"

config PK_MEMORY_GUP_FAST_SRCFILE
	default "app.c  Kconfig  main.c  Makefile  Makefile.host  RunBiscuitOS.sh"
	string "Source code list"

config PK_MEMORY_GUP_FAST_CSRCFILE
	string "Compile source code list"

config PK_MEMORY_GUP_FAST_CONFIG
	string "CONFIG: Project Configure Options"

config PK_MEMORY_GUP_FAST_LIBPATH
	string "LIBS: Libraries to pass to the linker, e.g. -l<library>"

config PK_MEMORY_GUP_FAST_CPPFLAGS
	string "CPPFLAGS: C/C++ preprocessor flags, e.g. -I<include dir>"

config PK_MEMORY_GUP_FAST_DPKCONFIG
	string "PKG_CONFIG_PATH: Directories to add to pkg-config's search path"

config PK_MEMORY_GUP_FAST_CFLAGS
	string "CFLAGS: C compiler flags"

config PK_MEMORY_GUP_FAST_LDFLAGS
	string "LDFLAGS: Linker flags"

config PK_MEMORY_GUP_FAST_CXXFLAGS
	string "CXXFLAGS: C++ compiler flags"

config PK_MEMORY_GUP_FAST_ASFLAGS
	string "CCASFLAGS: assembler compiler flags (defaults to CFLAGS)"

config PK_MEMORY_GUP_FAST_BUILDARCH
	string "--host options on configure for Architecture"

endif # PK_MEMORY_GUP_FAST
```

## package/MEMORY-MMAP/BiscuitOS-MEMORY-GUP-FAULT-IN-READ/Kconfig
```kconfig
menuconfig PK_MEMORY_GUP_FAULT_IN_READ
	bool "GUP: FAULT IN READ"

if PK_MEMORY_GUP_FAULT_IN_READ

config PK_MEMORY_GUP_FAULT_IN_READ_VERSION
	default "default"
	string "verstion"

config PK_MEMORY_GUP_FAULT_IN_READ_TAR
	default "tar.gz"
	string "tar type"

config PK_MEMORY_GUP_FAULT_IN_READ_URL
	default "https://gitee.com/BiscuitOS_team/HardStack/raw/Gitee/Memory-Allocator/MMAP-MECH/BiscuitOS-MEMORY-GUP-FAULT-IN-READ"
	string "url"

config PK_MEMORY_GUP_FAULT_IN_READ_GITHUB
	string "GitHub"

config PK_MEMORY_GUP_FAULT_IN_READ_SRCFILE
	default "app.c  Kconfig  main.c  Makefile  Makefile.host  RunBiscuitOS.sh"
	string "Source code list"

config PK_MEMORY_GUP_FAULT_IN_READ_CSRCFILE
	string "Compile source code list"

config PK_MEMORY_GUP_FAULT_IN_READ_CONFIG
	string "CONFIG: Project Configure Options"

config PK_MEMORY_GUP_FAULT_IN_READ_LIBPATH
	string "LIBS: Libraries to pass to the linker, e.g. -l<library>"

config PK_MEMORY_GUP_FAULT_IN_READ_CPPFLAGS
	string "CPPFLAGS: C/C++ preprocessor flags, e.g. -I<include dir>"

config PK_MEMORY_GUP_FAULT_IN_READ_DPKCONFIG
	string "PKG_CONFIG_PATH: Directories to add to pkg-config's search path"

config PK_MEMORY_GUP_FAULT_IN_READ_CFLAGS
	string "CFLAGS: C compiler flags"

config PK_MEMORY_GUP_FAULT_IN_READ_LDFLAGS
	string "LDFLAGS: Linker flags"

config PK_MEMORY_GUP_FAULT_IN_READ_CXXFLAGS
	string "CXXFLAGS: C++ compiler flags"

config PK_MEMORY_GUP_FAULT_IN_READ_ASFLAGS
	string "CCASFLAGS: assembler compiler flags (defaults to CFLAGS)"

config PK_MEMORY_GUP_FAULT_IN_READ_BUILDARCH
	string "--host options on configure for Architecture"

endif # PK_MEMORY_GUP_FAULT_IN_READ
```

## package/MEMORY-MMAP/BiscuitOS-MEMORY-GUP-FOLL-GET/Kconfig
```kconfig
menuconfig PK_MEMORY_GUP_FOLL_GET
	bool "GUP: FOLL_GET"

if PK_MEMORY_GUP_FOLL_GET

config PK_MEMORY_GUP_FOLL_GET_VERSION
	default "default"
	string "verstion"

config PK_MEMORY_GUP_FOLL_GET_TAR
	default "tar.gz"
	string "tar type"

config PK_MEMORY_GUP_FOLL_GET_URL
	default "https://gitee.com/BiscuitOS_team/HardStack/raw/Gitee/Memory-Allocator/MMAP-MECH/BiscuitOS-MEMORY-GUP-FOLL-GET"
	string "url"

config PK_MEMORY_GUP_FOLL_GET_GITHUB
	string "GitHub"

config PK_MEMORY_GUP_FOLL_GET_SRCFILE
	default "app.c  Kconfig  main.c  Makefile  Makefile.host  RunBiscuitOS.sh"
	string "Source code list"

config PK_MEMORY_GUP_FOLL_GET_CSRCFILE
	string "Compile source code list"

config PK_MEMORY_GUP_FOLL_GET_CONFIG
	string "CONFIG: Project Configure Options"

config PK_MEMORY_GUP_FOLL_GET_LIBPATH
	string "LIBS: Libraries to pass to the linker, e.g. -l<library>"

config PK_MEMORY_GUP_FOLL_GET_CPPFLAGS
	string "CPPFLAGS: C/C++ preprocessor flags, e.g. -I<include dir>"

config PK_MEMORY_GUP_FOLL_GET_DPKCONFIG
	string "PKG_CONFIG_PATH: Directories to add to pkg-config's search path"

config PK_MEMORY_GUP_FOLL_GET_CFLAGS
	string "CFLAGS: C compiler flags"

config PK_MEMORY_GUP_FOLL_GET_LDFLAGS
	string "LDFLAGS: Linker flags"

config PK_MEMORY_GUP_FOLL_GET_CXXFLAGS
	string "CXXFLAGS: C++ compiler flags"

config PK_MEMORY_GUP_FOLL_GET_ASFLAGS
	string "CCASFLAGS: assembler compiler flags (defaults to CFLAGS)"

config PK_MEMORY_GUP_FOLL_GET_BUILDARCH
	string "--host options on configure for Architecture"

endif # PK_MEMORY_GUP_FOLL_GET
```
