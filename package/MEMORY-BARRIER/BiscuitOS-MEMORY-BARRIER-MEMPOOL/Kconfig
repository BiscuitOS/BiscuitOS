## package/MEMORY-LOCKING/BiscuitOS-MEMORY-LOCKING-SEMAPHORE/Kconfig
```kconfig
menuconfig PK_MEMLOCK_SEMAPHORE
	bool "Semaphore"

if PK_MEMLOCK_SEMAPHORE

config PK_MEMLOCK_SEMAPHORE_VERSION
	default "default"
	string "verstion"

config PK_MEMLOCK_SEMAPHORE_TAR
	default "tar.gz"
	string "tar type"

config PK_MEMLOCK_SEMAPHORE_URL
	default "https://gitee.com/BiscuitOS_team/HardStack/raw/Gitee/Memory-Allocator/MEMORY-LOCKING/BiscuitOS-MEMORY-LOCKING-SEMAPHORE"
	string "url"

config PK_MEMLOCK_SEMAPHORE_GITHUB
	string "GitHub"

config PK_MEMLOCK_SEMAPHORE_SRCFILE
	default "main.c Makefile RunBiscuitOS.sh Makefile.host Kconfig"
	string "Source code list"

config PK_MEMLOCK_SEMAPHORE_CSRCFILE
	string "Compile source code list"

config PK_MEMLOCK_SEMAPHORE_CONFIG
	string "CONFIG: Project Configure Options"

config PK_MEMLOCK_SEMAPHORE_LIBPATH
	string "LIBS: Libraries to pass to the linker, e.g. -l<library>"

config PK_MEMLOCK_SEMAPHORE_CPPFLAGS
	string "CPPFLAGS: C/C++ preprocessor flags, e.g. -I<include dir>"

config PK_MEMLOCK_SEMAPHORE_DPKCONFIG
	string "PKG_CONFIG_PATH: Directories to add to pkg-config's search path"

config PK_MEMLOCK_SEMAPHORE_CFLAGS
	string "CFLAGS: C compiler flags"

config PK_MEMLOCK_SEMAPHORE_LDFLAGS
	string "LDFLAGS: Linker flags"

config PK_MEMLOCK_SEMAPHORE_CXXFLAGS
	string "CXXFLAGS: C++ compiler flags"

config PK_MEMLOCK_SEMAPHORE_ASFLAGS
	string "CCASFLAGS: assembler compiler flags (defaults to CFLAGS)"

config PK_MEMLOCK_SEMAPHORE_BUILDARCH
	string "--host options on configure for Architecture"

endif # PK_MEMLOCK_SEMAPHORE
```

## package/MEMORY-LOCKING/BiscuitOS-MEMORY-LOCKING-SEQLOCK/Kconfig
```kconfig
menuconfig PK_MEMLOCK_SEQLOCK
	bool "SeqLock"

if PK_MEMLOCK_SEQLOCK

config PK_MEMLOCK_SEQLOCK_VERSION
	default "default"
	string "verstion"

config PK_MEMLOCK_SEQLOCK_TAR
	default "tar.gz"
	string "tar type"

config PK_MEMLOCK_SEQLOCK_URL
	default "https://gitee.com/BiscuitOS_team/HardStack/raw/Gitee/Memory-Allocator/MEMORY-LOCKING/BiscuitOS-MEMORY-LOCKING-SEQLOCK"
	string "url"

config PK_MEMLOCK_SEQLOCK_GITHUB
	string "GitHub"

config PK_MEMLOCK_SEQLOCK_SRCFILE
	default "main.c Makefile RunBiscuitOS.sh Makefile.host Kconfig"
	string "Source code list"

config PK_MEMLOCK_SEQLOCK_CSRCFILE
	string "Compile source code list"

config PK_MEMLOCK_SEQLOCK_CONFIG
	string "CONFIG: Project Configure Options"

config PK_MEMLOCK_SEQLOCK_LIBPATH
	string "LIBS: Libraries to pass to the linker, e.g. -l<library>"

config PK_MEMLOCK_SEQLOCK_CPPFLAGS
	string "CPPFLAGS: C/C++ preprocessor flags, e.g. -I<include dir>"

config PK_MEMLOCK_SEQLOCK_DPKCONFIG
	string "PKG_CONFIG_PATH: Directories to add to pkg-config's search path"

config PK_MEMLOCK_SEQLOCK_CFLAGS
	string "CFLAGS: C compiler flags"

config PK_MEMLOCK_SEQLOCK_LDFLAGS
	string "LDFLAGS: Linker flags"

config PK_MEMLOCK_SEQLOCK_CXXFLAGS
	string "CXXFLAGS: C++ compiler flags"

config PK_MEMLOCK_SEQLOCK_ASFLAGS
	string "CCASFLAGS: assembler compiler flags (defaults to CFLAGS)"

config PK_MEMLOCK_SEQLOCK_BUILDARCH
	string "--host options on configure for Architecture"

endif # PK_MEMLOCK_SEQLOCK
```

## package/MEMORY-LOCKING/BiscuitOS-MEMORY-LOCKING-SPINLOCK/Kconfig
```kconfig
menuconfig PK_MEMLOCK_SPINLOCK
	bool "SpinLock"

if PK_MEMLOCK_SPINLOCK

config PK_MEMLOCK_SPINLOCK_VERSION
	default "default"
	string "verstion"

config PK_MEMLOCK_SPINLOCK_TAR
	default "tar.gz"
	string "tar type"

config PK_MEMLOCK_SPINLOCK_URL
	default "https://gitee.com/BiscuitOS_team/HardStack/raw/Gitee/Memory-Allocator/MEMORY-LOCKING/BiscuitOS-MEMORY-LOCKING-SPINLOCK"
	string "url"

config PK_MEMLOCK_SPINLOCK_GITHUB
	string "GitHub"

config PK_MEMLOCK_SPINLOCK_SRCFILE
	default "main.c Makefile RunBiscuitOS.sh Makefile.host Kconfig"
	string "Source code list"

config PK_MEMLOCK_SPINLOCK_CSRCFILE
	string "Compile source code list"

config PK_MEMLOCK_SPINLOCK_CONFIG
	string "CONFIG: Project Configure Options"

config PK_MEMLOCK_SPINLOCK_LIBPATH
	string "LIBS: Libraries to pass to the linker, e.g. -l<library>"

config PK_MEMLOCK_SPINLOCK_CPPFLAGS
	string "CPPFLAGS: C/C++ preprocessor flags, e.g. -I<include dir>"

config PK_MEMLOCK_SPINLOCK_DPKCONFIG
	string "PKG_CONFIG_PATH: Directories to add to pkg-config's search path"

config PK_MEMLOCK_SPINLOCK_CFLAGS
	string "CFLAGS: C compiler flags"

config PK_MEMLOCK_SPINLOCK_LDFLAGS
	string "LDFLAGS: Linker flags"

config PK_MEMLOCK_SPINLOCK_CXXFLAGS
	string "CXXFLAGS: C++ compiler flags"

config PK_MEMLOCK_SPINLOCK_ASFLAGS
	string "CCASFLAGS: assembler compiler flags (defaults to CFLAGS)"

config PK_MEMLOCK_SPINLOCK_BUILDARCH
	string "--host options on configure for Architecture"

endif # PK_MEMLOCK_SPINLOCK
```

## package/MEMORY-LOCKING/Kconfig
```kconfig
menuconfig PK_MEMORY_LOCKING
	bool "Memory Locking Mechanism"

if PK_MEMORY_LOCKING

# Spinlock
source package/MEMORY-LOCKING/BiscuitOS-MEMORY-LOCKING-SPINLOCK/Kconfig

# Semaphore
source package/MEMORY-LOCKING/BiscuitOS-MEMORY-LOCKING-SEMAPHORE/Kconfig

# MUTEX
source package/MEMORY-LOCKING/BiscuitOS-MEMORY-LOCKING-MUTEX/Kconfig

# RW-Semaphore
source package/MEMORY-LOCKING/BiscuitOS-MEMORY-LOCKING-RW_SEMAPHORE/Kconfig

# RWLOCK
source package/MEMORY-LOCKING/BiscuitOS-MEMORY-LOCKING-RWLOCK/Kconfig

# RCU
source package/MEMORY-LOCKING/BiscuitOS-MEMORY-LOCKING-RCU/Kconfig

# SEQLOCK
source package/MEMORY-LOCKING/BiscuitOS-MEMORY-LOCKING-SEQLOCK/Kconfig

endif # PK_MEMORY_LOCKING
```

## package/MEMORY-MMAP/BiscuitOS-MEMMAP-ALLOC-ALIGN-MEMORY/Kconfig
```kconfig
menuconfig PK_MEMMAP_ALLOC_ALIGN_MEM
	bool "Alloc Specify Alignment Virtual Memory"

if PK_MEMMAP_ALLOC_ALIGN_MEM

config PK_MEMMAP_ALLOC_ALIGN_MEM_VERSION
	default "default"
	string "verstion"

config PK_MEMMAP_ALLOC_ALIGN_MEM_TAR
	default "tar.gz"
	string "tar type"

config PK_MEMMAP_ALLOC_ALIGN_MEM_URL
	default "https://gitee.com/BiscuitOS_team/HardStack/raw/Gitee/Memory-Allocator/MEMORY-MAPPING/BiscuitOS-MEMMAP-ALLOC-ALIGN-MEMORY"
	string "url"

config PK_MEMMAP_ALLOC_ALIGN_MEM_GITHUB
	string "GitHub"

config PK_MEMMAP_ALLOC_ALIGN_MEM_SRCFILE
	default "main.c Makefile"
	string "Source code list"

config PK_MEMMAP_ALLOC_ALIGN_MEM_CSRCFILE
	string "Compile source code list"

config PK_MEMMAP_ALLOC_ALIGN_MEM_CONFIG
	string "CONFIG: Project Configure Options"

config PK_MEMMAP_ALLOC_ALIGN_MEM_LIBPATH
	string "LIBS: Libraries to pass to the linker, e.g. -l<library>"

config PK_MEMMAP_ALLOC_ALIGN_MEM_CPPFLAGS
	string "CPPFLAGS: C/C++ preprocessor flags, e.g. -I<include dir>"

config PK_MEMMAP_ALLOC_ALIGN_MEM_DPKCONFIG
	string "PKG_CONFIG_PATH: Directories to add to pkg-config's search path"

config PK_MEMMAP_ALLOC_ALIGN_MEM_CFLAGS
	string "CFLAGS: C compiler flags"

config PK_MEMMAP_ALLOC_ALIGN_MEM_LDFLAGS
	string "LDFLAGS: Linker flags"

config PK_MEMMAP_ALLOC_ALIGN_MEM_CXXFLAGS
	string "CXXFLAGS: C++ compiler flags"

config PK_MEMMAP_ALLOC_ALIGN_MEM_ASFLAGS
	string "CCASFLAGS: assembler compiler flags (defaults to CFLAGS)"

config PK_MEMMAP_ALLOC_ALIGN_MEM_BUILDARCH
	string "--host options on configure for Architecture"

endif # PK_MEMMAP_ALLOC_ALIGN_MEM
```

## package/MEMORY-MMAP/BiscuitOS-MEMMAP-DETECT-PHYSMEM/Kconfig
```kconfig
menuconfig PK_MEMMAP_DETECT_PHYSMEM
	bool "Detect Physical Memory for Userspace Virtual Memory"

if PK_MEMMAP_DETECT_PHYSMEM

config PK_MEMMAP_DETECT_PHYSMEM_VERSION
	default "default"
	string "verstion"

config PK_MEMMAP_DETECT_PHYSMEM_TAR
	default "tar.gz"
	string "tar type"

config PK_MEMMAP_DETECT_PHYSMEM_URL
	default "https://gitee.com/BiscuitOS_team/HardStack/raw/Gitee/Memory-Allocator/MEMORY-MAPPING/BiscuitOS-MEMMAP-DETECT-PHYSMEM"
	string "url"

config PK_MEMMAP_DETECT_PHYSMEM_GITHUB
	string "GitHub"

config PK_MEMMAP_DETECT_PHYSMEM_SRCFILE
	default "main.c Makefile"
	string "Source code list"

config PK_MEMMAP_DETECT_PHYSMEM_CSRCFILE
	string "Compile source code list"

config PK_MEMMAP_DETECT_PHYSMEM_CONFIG
	string "CONFIG: Project Configure Options"

config PK_MEMMAP_DETECT_PHYSMEM_LIBPATH
	string "LIBS: Libraries to pass to the linker, e.g. -l<library>"

config PK_MEMMAP_DETECT_PHYSMEM_CPPFLAGS
	string "CPPFLAGS: C/C++ preprocessor flags, e.g. -I<include dir>"

config PK_MEMMAP_DETECT_PHYSMEM_DPKCONFIG
	string "PKG_CONFIG_PATH: Directories to add to pkg-config's search path"

config PK_MEMMAP_DETECT_PHYSMEM_CFLAGS
	string "CFLAGS: C compiler flags"

config PK_MEMMAP_DETECT_PHYSMEM_LDFLAGS
	string "LDFLAGS: Linker flags"

config PK_MEMMAP_DETECT_PHYSMEM_CXXFLAGS
	string "CXXFLAGS: C++ compiler flags"

config PK_MEMMAP_DETECT_PHYSMEM_ASFLAGS
	string "CCASFLAGS: assembler compiler flags (defaults to CFLAGS)"

config PK_MEMMAP_DETECT_PHYSMEM_BUILDARCH
	string "--host options on configure for Architecture"

endif # PK_MEMMAP_DETECT_PHYSMEM
```

## package/MEMORY-MMAP/BiscuitOS-MEMMAP-INFO-NUMA-NODE/Kconfig
```kconfig
menuconfig PK_MEMMAP_INFO_NUMA_NODE
	bool "Information: NUMA NODE"

if PK_MEMMAP_INFO_NUMA_NODE

config PK_MEMMAP_INFO_NUMA_NODE_VERSION
	default "default"
	string "verstion"

config PK_MEMMAP_INFO_NUMA_NODE_TAR
	default "tar.gz"
	string "tar type"

config PK_MEMMAP_INFO_NUMA_NODE_URL
	default "https://gitee.com/BiscuitOS_team/HardStack/raw/Gitee/Memory-Allocator/MEMORY-MAPPING/BiscuitOS-MEMMAP-INFO-NUMA-NODE"
	string "url"

config PK_MEMMAP_INFO_NUMA_NODE_GITHUB
	string "GitHub"

config PK_MEMMAP_INFO_NUMA_NODE_SRCFILE
	default "main.c Makefile RunBiscuitOS.sh"
	string "Source code list"

config PK_MEMMAP_INFO_NUMA_NODE_CSRCFILE
	string "Compile source code list"

config PK_MEMMAP_INFO_NUMA_NODE_CONFIG
	string "CONFIG: Project Configure Options"

config PK_MEMMAP_INFO_NUMA_NODE_LIBPATH
	string "LIBS: Libraries to pass to the linker, e.g. -l<library>"

config PK_MEMMAP_INFO_NUMA_NODE_CPPFLAGS
	string "CPPFLAGS: C/C++ preprocessor flags, e.g. -I<include dir>"

config PK_MEMMAP_INFO_NUMA_NODE_DPKCONFIG
	string "PKG_CONFIG_PATH: Directories to add to pkg-config's search path"

config PK_MEMMAP_INFO_NUMA_NODE_CFLAGS
	string "CFLAGS: C compiler flags"

config PK_MEMMAP_INFO_NUMA_NODE_LDFLAGS
	string "LDFLAGS: Linker flags"

config PK_MEMMAP_INFO_NUMA_NODE_CXXFLAGS
	string "CXXFLAGS: C++ compiler flags"

config PK_MEMMAP_INFO_NUMA_NODE_ASFLAGS
	string "CCASFLAGS: assembler compiler flags (defaults to CFLAGS)"

config PK_MEMMAP_INFO_NUMA_NODE_BUILDARCH
	string "--host options on configure for Architecture"

endif # PK_MEMMAP_INFO_NUMA_NODE
```

## package/MEMORY-MMAP/BiscuitOS-MEMMAP-INFO-PHYSMEM/Kconfig
```kconfig
menuconfig PK_MEMMAP_INFO_PHYSMEM
	bool "Information: Physical Memory"

if PK_MEMMAP_INFO_PHYSMEM

config PK_MEMMAP_INFO_PHYSMEM_VERSION
	default "default"
	string "verstion"

config PK_MEMMAP_INFO_PHYSMEM_TAR
	default "tar.gz"
	string "tar type"

config PK_MEMMAP_INFO_PHYSMEM_URL
	default "https://gitee.com/BiscuitOS_team/HardStack/raw/Gitee/Memory-Allocator/MEMORY-MAPPING/BiscuitOS-MEMMAP-INFO-PHYSMEM"
	string "url"

config PK_MEMMAP_INFO_PHYSMEM_GITHUB
	string "GitHub"

config PK_MEMMAP_INFO_PHYSMEM_SRCFILE
	default "main.c Makefile RunBiscuitOS.sh"
	string "Source code list"

config PK_MEMMAP_INFO_PHYSMEM_CSRCFILE
	string "Compile source code list"

config PK_MEMMAP_INFO_PHYSMEM_CONFIG
	string "CONFIG: Project Configure Options"

config PK_MEMMAP_INFO_PHYSMEM_LIBPATH
	string "LIBS: Libraries to pass to the linker, e.g. -l<library>"

config PK_MEMMAP_INFO_PHYSMEM_CPPFLAGS
	string "CPPFLAGS: C/C++ preprocessor flags, e.g. -I<include dir>"

config PK_MEMMAP_INFO_PHYSMEM_DPKCONFIG
	string "PKG_CONFIG_PATH: Directories to add to pkg-config's search path"

config PK_MEMMAP_INFO_PHYSMEM_CFLAGS
	string "CFLAGS: C compiler flags"

config PK_MEMMAP_INFO_PHYSMEM_LDFLAGS
	string "LDFLAGS: Linker flags"

config PK_MEMMAP_INFO_PHYSMEM_CXXFLAGS
	string "CXXFLAGS: C++ compiler flags"

config PK_MEMMAP_INFO_PHYSMEM_ASFLAGS
	string "CCASFLAGS: assembler compiler flags (defaults to CFLAGS)"

config PK_MEMMAP_INFO_PHYSMEM_BUILDARCH
	string "--host options on configure for Architecture"

endif # PK_MEMMAP_INFO_PHYSMEM
```

## package/MEMORY-MMAP/BiscuitOS-MEMMAP-MIGRATE-PAGE-NUMA/Kconfig
```kconfig
menuconfig PK_MEMMAP_MIGRATE_PAGE_NUMA
	select SUPPORT_DIY
	select DIY_NUMA
	bool "Migrate Page on NUMA"

if PK_MEMMAP_MIGRATE_PAGE_NUMA

config PK_MEMMAP_MIGRATE_PAGE_NUMA_VERSION
	default "default"
	string "verstion"

config PK_MEMMAP_MIGRATE_PAGE_NUMA_TAR
	default "tar.gz"
	string "tar type"

config PK_MEMMAP_MIGRATE_PAGE_NUMA_URL
	default "https://gitee.com/BiscuitOS_team/HardStack/raw/Gitee/Memory-Allocator/MEMORY-MAPPING/BiscuitOS-MEMMAP-MIGRATE-PAGE-NUMA"
	string "url"

config PK_MEMMAP_MIGRATE_PAGE_NUMA_GITHUB
	string "GitHub"

config PK_MEMMAP_MIGRATE_PAGE_NUMA_SRCFILE
	default "main.c Makefile RunBiscuitOS.sh"
	string "Source code list"

config PK_MEMMAP_MIGRATE_PAGE_NUMA_CSRCFILE
	string "Compile source code list"

config PK_MEMMAP_MIGRATE_PAGE_NUMA_CONFIG
	string "CONFIG: Project Configure Options"

config PK_MEMMAP_MIGRATE_PAGE_NUMA_LIBPATH
	string "LIBS: Libraries to pass to the linker, e.g. -l<library>"

config PK_MEMMAP_MIGRATE_PAGE_NUMA_CPPFLAGS
	string "CPPFLAGS: C/C++ preprocessor flags, e.g. -I<include dir>"

config PK_MEMMAP_MIGRATE_PAGE_NUMA_DPKCONFIG
	string "PKG_CONFIG_PATH: Directories to add to pkg-config's search path"

config PK_MEMMAP_MIGRATE_PAGE_NUMA_CFLAGS
	string "CFLAGS: C compiler flags"

config PK_MEMMAP_MIGRATE_PAGE_NUMA_LDFLAGS
	string "LDFLAGS: Linker flags"

config PK_MEMMAP_MIGRATE_PAGE_NUMA_CXXFLAGS
	string "CXXFLAGS: C++ compiler flags"

config PK_MEMMAP_MIGRATE_PAGE_NUMA_ASFLAGS
	string "CCASFLAGS: assembler compiler flags (defaults to CFLAGS)"

config PK_MEMMAP_MIGRATE_PAGE_NUMA_BUILDARCH
	string "--host options on configure for Architecture"

endif # PK_MEMMAP_MIGRATE_PAGE_NUMA
```

## package/MEMORY-MMAP/BiscuitOS-MEMMAP-TRIGGER-OOM/Kconfig
```kconfig
menuconfig PK_MEMMAP_TRIGGER_OOM
	bool "Trigger OOM"

if PK_MEMMAP_TRIGGER_OOM

config PK_MEMMAP_TRIGGER_OOM_VERSION
	default "default"
	string "verstion"

config PK_MEMMAP_TRIGGER_OOM_TAR
	default "tar.gz"
	string "tar type"

config PK_MEMMAP_TRIGGER_OOM_URL
	default "https://gitee.com/BiscuitOS_team/HardStack/raw/Gitee/Memory-Allocator/MEMORY-MAPPING/BiscuitOS-MEMMAP-TRIGGER-OOM"
	string "url"

config PK_MEMMAP_TRIGGER_OOM_GITHUB
	string "GitHub"

config PK_MEMMAP_TRIGGER_OOM_SRCFILE
	default "main.c Makefile RunBiscuitOS.sh"
	string "Source code list"

config PK_MEMMAP_TRIGGER_OOM_CSRCFILE
	string "Compile source code list"

config PK_MEMMAP_TRIGGER_OOM_CONFIG
	string "CONFIG: Project Configure Options"

config PK_MEMMAP_TRIGGER_OOM_LIBPATH
	string "LIBS: Libraries to pass to the linker, e.g. -l<library>"

config PK_MEMMAP_TRIGGER_OOM_CPPFLAGS
	string "CPPFLAGS: C/C++ preprocessor flags, e.g. -I<include dir>"

config PK_MEMMAP_TRIGGER_OOM_DPKCONFIG
	string "PKG_CONFIG_PATH: Directories to add to pkg-config's search path"

config PK_MEMMAP_TRIGGER_OOM_CFLAGS
	string "CFLAGS: C compiler flags"

config PK_MEMMAP_TRIGGER_OOM_LDFLAGS
	string "LDFLAGS: Linker flags"

config PK_MEMMAP_TRIGGER_OOM_CXXFLAGS
	string "CXXFLAGS: C++ compiler flags"

config PK_MEMMAP_TRIGGER_OOM_ASFLAGS
	string "CCASFLAGS: assembler compiler flags (defaults to CFLAGS)"

config PK_MEMMAP_TRIGGER_OOM_BUILDARCH
	string "--host options on configure for Architecture"

endif # PK_MEMMAP_TRIGGER_OOM
```
