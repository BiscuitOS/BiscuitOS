## package/MEMORY-BARRIER/BiscuitOS-MEMORY-BARRIER-MEMPOOL/Kconfig
```kconfig
menuconfig PK_MEMBARRIER_MEMPOOL
	bool "MEMORY Barrier Scene: Memory Pool"

if PK_MEMBARRIER_MEMPOOL

config PK_MEMBARRIER_MEMPOOL_VERSION
	default "default"
	string "verstion"

config PK_MEMBARRIER_MEMPOOL_TAR
	default "tar.gz"
	string "tar type"

config PK_MEMBARRIER_MEMPOOL_URL
	default "https://gitee.com/BiscuitOS_team/HardStack/raw/Gitee/Memory-Allocator/MEMORY-BARRIER/BiscuitOS-MEMORY-BARRIER-MEMPOOL"
	string "url"

config PK_MEMBARRIER_MEMPOOL_GITHUB
	string "GitHub"

config PK_MEMBARRIER_MEMPOOL_SRCFILE
	default "main.c Makefile RunBiscuitOS.sh Makefile.host Kconfig"
	string "Source code list"

config PK_MEMBARRIER_MEMPOOL_CSRCFILE
	string "Compile source code list"

config PK_MEMBARRIER_MEMPOOL_CONFIG
	string "CONFIG: Project Configure Options"

config PK_MEMBARRIER_MEMPOOL_LIBPATH
	string "LIBS: Libraries to pass to the linker, e.g. -l<library>"

config PK_MEMBARRIER_MEMPOOL_CPPFLAGS
	string "CPPFLAGS: C/C++ preprocessor flags, e.g. -I<include dir>"

config PK_MEMBARRIER_MEMPOOL_DPKCONFIG
	string "PKG_CONFIG_PATH: Directories to add to pkg-config's search path"

config PK_MEMBARRIER_MEMPOOL_CFLAGS
	string "CFLAGS: C compiler flags"

config PK_MEMBARRIER_MEMPOOL_LDFLAGS
	string "LDFLAGS: Linker flags"

config PK_MEMBARRIER_MEMPOOL_CXXFLAGS
	string "CXXFLAGS: C++ compiler flags"

config PK_MEMBARRIER_MEMPOOL_ASFLAGS
	string "CCASFLAGS: assembler compiler flags (defaults to CFLAGS)"

config PK_MEMBARRIER_MEMPOOL_BUILDARCH
	string "--host options on configure for Architecture"

endif # PK_MEMBARRIER_MEMPOOL
```

## package/MEMORY-BARRIER/BiscuitOS-MEMORY-BARRIER-NOLOCKING-SYNC-COUNTER/Kconfig
```kconfig
menuconfig PK_MEMBARRIER_NOLOCK_SYNC_CNT
	bool "NO-LOCKING Synchronization with Counter"

if PK_MEMBARRIER_NOLOCK_SYNC_CNT

config PK_MEMBARRIER_NOLOCK_SYNC_CNT_VERSION
	default "default"
	string "verstion"

config PK_MEMBARRIER_NOLOCK_SYNC_CNT_TAR
	default "tar.gz"
	string "tar type"

config PK_MEMBARRIER_NOLOCK_SYNC_CNT_URL
	default "https://gitee.com/BiscuitOS_team/HardStack/raw/Gitee/Memory-Allocator/MEMORY-BARRIER/BiscuitOS-MEMORY-BARRIER-NOLOCKING-SYNC-COUNTER"
	string "url"

config PK_MEMBARRIER_NOLOCK_SYNC_CNT_GITHUB
	string "GitHub"

config PK_MEMBARRIER_NOLOCK_SYNC_CNT_SRCFILE
	default "main.c Makefile RunBiscuitOS.sh Makefile.host Kconfig"
	string "Source code list"

config PK_MEMBARRIER_NOLOCK_SYNC_CNT_CSRCFILE
	string "Compile source code list"

config PK_MEMBARRIER_NOLOCK_SYNC_CNT_CONFIG
	string "CONFIG: Project Configure Options"

config PK_MEMBARRIER_NOLOCK_SYNC_CNT_LIBPATH
	string "LIBS: Libraries to pass to the linker, e.g. -l<library>"

config PK_MEMBARRIER_NOLOCK_SYNC_CNT_CPPFLAGS
	string "CPPFLAGS: C/C++ preprocessor flags, e.g. -I<include dir>"

config PK_MEMBARRIER_NOLOCK_SYNC_CNT_DPKCONFIG
	string "PKG_CONFIG_PATH: Directories to add to pkg-config's search path"

config PK_MEMBARRIER_NOLOCK_SYNC_CNT_CFLAGS
	string "CFLAGS: C compiler flags"

config PK_MEMBARRIER_NOLOCK_SYNC_CNT_LDFLAGS
	string "LDFLAGS: Linker flags"

config PK_MEMBARRIER_NOLOCK_SYNC_CNT_CXXFLAGS
	string "CXXFLAGS: C++ compiler flags"

config PK_MEMBARRIER_NOLOCK_SYNC_CNT_ASFLAGS
	string "CCASFLAGS: assembler compiler flags (defaults to CFLAGS)"

config PK_MEMBARRIER_NOLOCK_SYNC_CNT_BUILDARCH
	string "--host options on configure for Architecture"

endif # PK_MEMBARRIER_NOLOCK_SYNC_CNT
```

## package/MEMORY-BARRIER/BiscuitOS-MEMORY-BARRIER-NOLOCKING-SYNC-WMB/Kconfig
```kconfig
menuconfig PK_MEMBARRIER_NOLOCK_SYNC_WMB
	bool "NO-LOCKING Synchronization with smp_wmb"

if PK_MEMBARRIER_NOLOCK_SYNC_WMB

config PK_MEMBARRIER_NOLOCK_SYNC_WMB_VERSION
	default "default"
	string "verstion"

config PK_MEMBARRIER_NOLOCK_SYNC_WMB_TAR
	default "tar.gz"
	string "tar type"

config PK_MEMBARRIER_NOLOCK_SYNC_WMB_URL
	default "https://gitee.com/BiscuitOS_team/HardStack/raw/Gitee/Memory-Allocator/MEMORY-BARRIER/BiscuitOS-MEMORY-BARRIER-NOLOCKING-SYNC-WMB"
	string "url"

config PK_MEMBARRIER_NOLOCK_SYNC_WMB_GITHUB
	string "GitHub"

config PK_MEMBARRIER_NOLOCK_SYNC_WMB_SRCFILE
	default "main.c Makefile RunBiscuitOS.sh Makefile.host Kconfig"
	string "Source code list"

config PK_MEMBARRIER_NOLOCK_SYNC_WMB_CSRCFILE
	string "Compile source code list"

config PK_MEMBARRIER_NOLOCK_SYNC_WMB_CONFIG
	string "CONFIG: Project Configure Options"

config PK_MEMBARRIER_NOLOCK_SYNC_WMB_LIBPATH
	string "LIBS: Libraries to pass to the linker, e.g. -l<library>"

config PK_MEMBARRIER_NOLOCK_SYNC_WMB_CPPFLAGS
	string "CPPFLAGS: C/C++ preprocessor flags, e.g. -I<include dir>"

config PK_MEMBARRIER_NOLOCK_SYNC_WMB_DPKCONFIG
	string "PKG_CONFIG_PATH: Directories to add to pkg-config's search path"

config PK_MEMBARRIER_NOLOCK_SYNC_WMB_CFLAGS
	string "CFLAGS: C compiler flags"

config PK_MEMBARRIER_NOLOCK_SYNC_WMB_LDFLAGS
	string "LDFLAGS: Linker flags"

config PK_MEMBARRIER_NOLOCK_SYNC_WMB_CXXFLAGS
	string "CXXFLAGS: C++ compiler flags"

config PK_MEMBARRIER_NOLOCK_SYNC_WMB_ASFLAGS
	string "CCASFLAGS: assembler compiler flags (defaults to CFLAGS)"

config PK_MEMBARRIER_NOLOCK_SYNC_WMB_BUILDARCH
	string "--host options on configure for Architecture"

endif # PK_MEMBARRIER_NOLOCK_SYNC_WMB
```

## package/MEMORY-BARRIER/BiscuitOS-MEMORY-BARRIER-NOLOCKING-SYNC/Kconfig
```kconfig
menuconfig PK_MEMBARRIER_NOLOCK_SYNC
	bool "NO-LOCKING Synchronization"

if PK_MEMBARRIER_NOLOCK_SYNC

config PK_MEMBARRIER_NOLOCK_SYNC_VERSION
	default "default"
	string "verstion"

config PK_MEMBARRIER_NOLOCK_SYNC_TAR
	default "tar.gz"
	string "tar type"

config PK_MEMBARRIER_NOLOCK_SYNC_URL
	default "https://gitee.com/BiscuitOS_team/HardStack/raw/Gitee/Memory-Allocator/MEMORY-BARRIER/BiscuitOS-MEMORY-BARRIER-NOLOCKING-SYNC"
	string "url"

config PK_MEMBARRIER_NOLOCK_SYNC_GITHUB
	string "GitHub"

config PK_MEMBARRIER_NOLOCK_SYNC_SRCFILE
	default "main.c Makefile RunBiscuitOS.sh Makefile.host Kconfig"
	string "Source code list"

config PK_MEMBARRIER_NOLOCK_SYNC_CSRCFILE
	string "Compile source code list"

config PK_MEMBARRIER_NOLOCK_SYNC_CONFIG
	string "CONFIG: Project Configure Options"

config PK_MEMBARRIER_NOLOCK_SYNC_LIBPATH
	string "LIBS: Libraries to pass to the linker, e.g. -l<library>"

config PK_MEMBARRIER_NOLOCK_SYNC_CPPFLAGS
	string "CPPFLAGS: C/C++ preprocessor flags, e.g. -I<include dir>"

config PK_MEMBARRIER_NOLOCK_SYNC_DPKCONFIG
	string "PKG_CONFIG_PATH: Directories to add to pkg-config's search path"

config PK_MEMBARRIER_NOLOCK_SYNC_CFLAGS
	string "CFLAGS: C compiler flags"

config PK_MEMBARRIER_NOLOCK_SYNC_LDFLAGS
	string "LDFLAGS: Linker flags"

config PK_MEMBARRIER_NOLOCK_SYNC_CXXFLAGS
	string "CXXFLAGS: C++ compiler flags"

config PK_MEMBARRIER_NOLOCK_SYNC_ASFLAGS
	string "CCASFLAGS: assembler compiler flags (defaults to CFLAGS)"

config PK_MEMBARRIER_NOLOCK_SYNC_BUILDARCH
	string "--host options on configure for Architecture"

endif # PK_MEMBARRIER_NOLOCK_SYNC
```

## package/MEMORY-BARRIER/BiscuitOS-MEMORY-BARRIER-OUT-COMPILER/Kconfig
```kconfig
menuconfig PK_MEMBARRIER_OUT_COMPILER
	bool "Out-of-Order Execution at Compile Time"

if PK_MEMBARRIER_OUT_COMPILER

config PK_MEMBARRIER_OUT_COMPILER_VERSION
	default "default"
	string "verstion"

config PK_MEMBARRIER_OUT_COMPILER_TAR
	default "tar.gz"
	string "tar type"

config PK_MEMBARRIER_OUT_COMPILER_URL
	default "https://gitee.com/BiscuitOS_team/HardStack/raw/Gitee/Memory-Allocator/MEMORY-BARRIER/BiscuitOS-MEMORY-BARRIER-OUT-COMPILER"
	string "url"

config PK_MEMBARRIER_OUT_COMPILER_GITHUB
	string "GitHub"

config PK_MEMBARRIER_OUT_COMPILER_SRCFILE
	default "main.c Makefile main-atomic.c main-barrier.c"
	string "Source code list"

config PK_MEMBARRIER_OUT_COMPILER_CSRCFILE
	string "Compile source code list"

config PK_MEMBARRIER_OUT_COMPILER_CONFIG
	string "CONFIG: Project Configure Options"

config PK_MEMBARRIER_OUT_COMPILER_LIBPATH
	string "LIBS: Libraries to pass to the linker, e.g. -l<library>"

config PK_MEMBARRIER_OUT_COMPILER_CPPFLAGS
	string "CPPFLAGS: C/C++ preprocessor flags, e.g. -I<include dir>"

config PK_MEMBARRIER_OUT_COMPILER_DPKCONFIG
	string "PKG_CONFIG_PATH: Directories to add to pkg-config's search path"

config PK_MEMBARRIER_OUT_COMPILER_CFLAGS
	string "CFLAGS: C compiler flags"

config PK_MEMBARRIER_OUT_COMPILER_LDFLAGS
	string "LDFLAGS: Linker flags"

config PK_MEMBARRIER_OUT_COMPILER_CXXFLAGS
	string "CXXFLAGS: C++ compiler flags"

config PK_MEMBARRIER_OUT_COMPILER_ASFLAGS
	string "CCASFLAGS: assembler compiler flags (defaults to CFLAGS)"

config PK_MEMBARRIER_OUT_COMPILER_BUILDARCH
	string "--host options on configure for Architecture"

endif # PK_MEMBARRIER_OUT_COMPILER
```

## package/MEMORY-BARRIER/BiscuitOS-MEMORY-BARRIER-SMP-RWMB/Kconfig
```kconfig
menuconfig PK_MEMBARRIER_SMP_RWMB
	bool "SMP Read/Write Barrier"

if PK_MEMBARRIER_SMP_RWMB

config PK_MEMBARRIER_SMP_RWMB_VERSION
	default "default"
	string "verstion"

config PK_MEMBARRIER_SMP_RWMB_TAR
	default "tar.gz"
	string "tar type"

config PK_MEMBARRIER_SMP_RWMB_URL
	default "https://gitee.com/BiscuitOS_team/HardStack/raw/Gitee/Memory-Allocator/MEMORY-BARRIER/BiscuitOS-MEMORY-BARRIER-SMP-RWMB"
	string "url"

config PK_MEMBARRIER_SMP_RWMB_GITHUB
	string "GitHub"

config PK_MEMBARRIER_SMP_RWMB_SRCFILE
	default "main.c Makefile RunBiscuitOS.sh Makefile.host Kconfig"
	string "Source code list"

config PK_MEMBARRIER_SMP_RWMB_CSRCFILE
	string "Compile source code list"

config PK_MEMBARRIER_SMP_RWMB_CONFIG
	string "CONFIG: Project Configure Options"

config PK_MEMBARRIER_SMP_RWMB_LIBPATH
	string "LIBS: Libraries to pass to the linker, e.g. -l<library>"

config PK_MEMBARRIER_SMP_RWMB_CPPFLAGS
	string "CPPFLAGS: C/C++ preprocessor flags, e.g. -I<include dir>"

config PK_MEMBARRIER_SMP_RWMB_DPKCONFIG
	string "PKG_CONFIG_PATH: Directories to add to pkg-config's search path"

config PK_MEMBARRIER_SMP_RWMB_CFLAGS
	string "CFLAGS: C compiler flags"

config PK_MEMBARRIER_SMP_RWMB_LDFLAGS
	string "LDFLAGS: Linker flags"

config PK_MEMBARRIER_SMP_RWMB_CXXFLAGS
	string "CXXFLAGS: C++ compiler flags"

config PK_MEMBARRIER_SMP_RWMB_ASFLAGS
	string "CCASFLAGS: assembler compiler flags (defaults to CFLAGS)"

config PK_MEMBARRIER_SMP_RWMB_BUILDARCH
	string "--host options on configure for Architecture"

endif # PK_MEMBARRIER_SMP_RWMB
```

## package/MEMORY-BARRIER/Kconfig
```kconfig
menuconfig PK_MEMORY_BARRIER
	bool "Memory Barriers Mechanism"

if PK_MEMORY_BARRIER

# SMP R/WMB
source package/MEMORY-BARRIER/BiscuitOS-MEMORY-BARRIER-SMP-RWMB/Kconfig

# NOLOCKING SYNC
source package/MEMORY-BARRIER/BiscuitOS-MEMORY-BARRIER-NOLOCKING-SYNC/Kconfig

# NOLOCKING SYNC with smp_wmb
source package/MEMORY-BARRIER/BiscuitOS-MEMORY-BARRIER-NOLOCKING-SYNC-WMB/Kconfig

# NOLOCKING SYNC with Counter
source package/MEMORY-BARRIER/BiscuitOS-MEMORY-BARRIER-NOLOCKING-SYNC-COUNTER/Kconfig

endif # PK_MEMORY_BARRIER
```

## package/MEMORY-LOCKING/BiscuitOS-MEMORY-LOCKING-MUTEX/Kconfig
```kconfig
menuconfig PK_MEMLOCK_MUTEX
	bool "Mutex Lock"

if PK_MEMLOCK_MUTEX

config PK_MEMLOCK_MUTEX_VERSION
	default "default"
	string "verstion"

config PK_MEMLOCK_MUTEX_TAR
	default "tar.gz"
	string "tar type"

config PK_MEMLOCK_MUTEX_URL
	default "https://gitee.com/BiscuitOS_team/HardStack/raw/Gitee/Memory-Allocator/MEMORY-LOCKING/BiscuitOS-MEMORY-LOCKING-MUTEX"
	string "url"

config PK_MEMLOCK_MUTEX_GITHUB
	string "GitHub"

config PK_MEMLOCK_MUTEX_SRCFILE
	default "main.c Makefile RunBiscuitOS.sh Makefile.host Kconfig"
	string "Source code list"

config PK_MEMLOCK_MUTEX_CSRCFILE
	string "Compile source code list"

config PK_MEMLOCK_MUTEX_CONFIG
	string "CONFIG: Project Configure Options"

config PK_MEMLOCK_MUTEX_LIBPATH
	string "LIBS: Libraries to pass to the linker, e.g. -l<library>"

config PK_MEMLOCK_MUTEX_CPPFLAGS
	string "CPPFLAGS: C/C++ preprocessor flags, e.g. -I<include dir>"

config PK_MEMLOCK_MUTEX_DPKCONFIG
	string "PKG_CONFIG_PATH: Directories to add to pkg-config's search path"

config PK_MEMLOCK_MUTEX_CFLAGS
	string "CFLAGS: C compiler flags"

config PK_MEMLOCK_MUTEX_LDFLAGS
	string "LDFLAGS: Linker flags"

config PK_MEMLOCK_MUTEX_CXXFLAGS
	string "CXXFLAGS: C++ compiler flags"

config PK_MEMLOCK_MUTEX_ASFLAGS
	string "CCASFLAGS: assembler compiler flags (defaults to CFLAGS)"

config PK_MEMLOCK_MUTEX_BUILDARCH
	string "--host options on configure for Architecture"

endif # PK_MEMLOCK_MUTEX
```

## package/MEMORY-LOCKING/BiscuitOS-MEMORY-LOCKING-RCU/Kconfig
```kconfig
menuconfig PK_MEMLOCK_RCU
	bool "RCU(Read-Copy-Update) Lock"

if PK_MEMLOCK_RCU

config PK_MEMLOCK_RCU_VERSION
	default "default"
	string "verstion"

config PK_MEMLOCK_RCU_TAR
	default "tar.gz"
	string "tar type"

config PK_MEMLOCK_RCU_URL
	default "https://gitee.com/BiscuitOS_team/HardStack/raw/Gitee/Memory-Allocator/MEMORY-LOCKING/BiscuitOS-MEMORY-LOCKING-RCU"
	string "url"

config PK_MEMLOCK_RCU_GITHUB
	string "GitHub"

config PK_MEMLOCK_RCU_SRCFILE
	default "main.c Makefile RunBiscuitOS.sh Makefile.host Kconfig"
	string "Source code list"

config PK_MEMLOCK_RCU_CSRCFILE
	string "Compile source code list"

config PK_MEMLOCK_RCU_CONFIG
	string "CONFIG: Project Configure Options"

config PK_MEMLOCK_RCU_LIBPATH
	string "LIBS: Libraries to pass to the linker, e.g. -l<library>"

config PK_MEMLOCK_RCU_CPPFLAGS
	string "CPPFLAGS: C/C++ preprocessor flags, e.g. -I<include dir>"

config PK_MEMLOCK_RCU_DPKCONFIG
	string "PKG_CONFIG_PATH: Directories to add to pkg-config's search path"

config PK_MEMLOCK_RCU_CFLAGS
	string "CFLAGS: C compiler flags"

config PK_MEMLOCK_RCU_LDFLAGS
	string "LDFLAGS: Linker flags"

config PK_MEMLOCK_RCU_CXXFLAGS
	string "CXXFLAGS: C++ compiler flags"

config PK_MEMLOCK_RCU_ASFLAGS
	string "CCASFLAGS: assembler compiler flags (defaults to CFLAGS)"

config PK_MEMLOCK_RCU_BUILDARCH
	string "--host options on configure for Architecture"

endif # PK_MEMLOCK_RCU
```

## package/MEMORY-LOCKING/BiscuitOS-MEMORY-LOCKING-RWLOCK/Kconfig
```kconfig
menuconfig PK_MEMLOCK_RWLOCK
	bool "Read/Write Lock"

if PK_MEMLOCK_RWLOCK

config PK_MEMLOCK_RWLOCK_VERSION
	default "default"
	string "verstion"

config PK_MEMLOCK_RWLOCK_TAR
	default "tar.gz"
	string "tar type"

config PK_MEMLOCK_RWLOCK_URL
	default "https://gitee.com/BiscuitOS_team/HardStack/raw/Gitee/Memory-Allocator/MEMORY-LOCKING/BiscuitOS-MEMORY-LOCKING-RWLOCK"
	string "url"

config PK_MEMLOCK_RWLOCK_GITHUB
	string "GitHub"

config PK_MEMLOCK_RWLOCK_SRCFILE
	default "main.c Makefile RunBiscuitOS.sh Makefile.host Kconfig"
	string "Source code list"

config PK_MEMLOCK_RWLOCK_CSRCFILE
	string "Compile source code list"

config PK_MEMLOCK_RWLOCK_CONFIG
	string "CONFIG: Project Configure Options"

config PK_MEMLOCK_RWLOCK_LIBPATH
	string "LIBS: Libraries to pass to the linker, e.g. -l<library>"

config PK_MEMLOCK_RWLOCK_CPPFLAGS
	string "CPPFLAGS: C/C++ preprocessor flags, e.g. -I<include dir>"

config PK_MEMLOCK_RWLOCK_DPKCONFIG
	string "PKG_CONFIG_PATH: Directories to add to pkg-config's search path"

config PK_MEMLOCK_RWLOCK_CFLAGS
	string "CFLAGS: C compiler flags"

config PK_MEMLOCK_RWLOCK_LDFLAGS
	string "LDFLAGS: Linker flags"

config PK_MEMLOCK_RWLOCK_CXXFLAGS
	string "CXXFLAGS: C++ compiler flags"

config PK_MEMLOCK_RWLOCK_ASFLAGS
	string "CCASFLAGS: assembler compiler flags (defaults to CFLAGS)"

config PK_MEMLOCK_RWLOCK_BUILDARCH
	string "--host options on configure for Architecture"

endif # PK_MEMLOCK_RWLOCK
```
