## package/hugetlb/BiscuitOS-hugetlb-history-v2.6.6/Kconfig
```kconfig
menuconfig PK_HUGETLB_HISTORY_V2_6_6
	bool "Hugetlb History: Linux 2.6.6"

if PK_HUGETLB_HISTORY_V2_6_6

config PK_HUGETLB_HISTORY_V2_6_6_VERSION
	default "2.6.6"
	string "verstion"

config PK_HUGETLB_HISTORY_V2_6_6_TAR
	default "tar.gz"
	string "tar type"

config PK_HUGETLB_HISTORY_V2_6_6_URL
	default "https://gitee.com/BiscuitOS_team/HardStack/raw/Gitee/Memory-Allocator/Hugetlb/BiscuitOS-hugetlb-fork-on-anonymous-private-mapping"
	string "url"

config PK_HUGETLB_HISTORY_V2_6_6_GITHUB
	string "GitHub"
	default "https://gitee.com/BiscuitOS_team/hugetlb-history.git"

config PK_HUGETLB_HISTORY_V2_6_6_SRCFILE
	default "README.md"
	string "Source code list"

config PK_HUGETLB_HISTORY_V2_6_6_CSRCFILE
	string "Compile source code list"

config PK_HUGETLB_HISTORY_V2_6_6_CONFIG
	string "CONFIG: Project Configure Options"

config PK_HUGETLB_HISTORY_V2_6_6_LIBPATH
	string "LIBS: Libraries to pass to the linker, e.g. -l<library>"

config PK_HUGETLB_HISTORY_V2_6_6_CPPFLAGS
	string "CPPFLAGS: C/C++ preprocessor flags, e.g. -I<include dir>"

config PK_HUGETLB_HISTORY_V2_6_6_DPKCONFIG
	string "PKG_CONFIG_PATH: Directories to add to pkg-config's search path"

config PK_HUGETLB_HISTORY_V2_6_6_CFLAGS
	string "CFLAGS: C compiler flags"

config PK_HUGETLB_HISTORY_V2_6_6_LDFLAGS
	string "LDFLAGS: Linker flags"

config PK_HUGETLB_HISTORY_V2_6_6_CXXFLAGS
	string "CXXFLAGS: C++ compiler flags"

config PK_HUGETLB_HISTORY_V2_6_6_ASFLAGS
	string "CCASFLAGS: assembler compiler flags (defaults to CFLAGS)"

config PK_HUGETLB_HISTORY_V2_6_6_BUILDARCH
	string "--host options on configure for Architecture"

endif # PK_HUGETLB_HISTORY_V2_6_6
```

## package/hugetlb/BiscuitOS-libhugetlbfs-usage/Kconfig
```kconfig
menuconfig PK_LIBHUGETLBFS_USAGE
	select PK_LIBHUGETLBFS
	bool "libhugetlbfs: The Application for libhugetlbfs"

if PK_LIBHUGETLBFS_USAGE

config PK_LIBHUGETLBFS_USAGE_VERSION
	default "default"
	string "verstion"

config PK_LIBHUGETLBFS_USAGE_TAR
	default "tar.gz"
	string "tar type"

config PK_LIBHUGETLBFS_USAGE_URL
	default "https://gitee.com/BiscuitOS_team/HardStack/raw/Gitee/Memory-Allocator/Hugetlb/BiscuitOS-libhugetlbfs-usage-default"
	string "url"

config PK_LIBHUGETLBFS_USAGE_GITHUB
	string "GitHub"

config PK_LIBHUGETLBFS_USAGE_SRCFILE
	default "main.c Makefile RunBiscuitOS.sh"
	string "Source code list"

config PK_LIBHUGETLBFS_USAGE_CSRCFILE
	string "Compile source code list"

config PK_LIBHUGETLBFS_USAGE_CONFIG
	string "CONFIG: Project Configure Options"

config PK_LIBHUGETLBFS_USAGE_LIBPATH
	string "LIBS: Libraries to pass to the linker, e.g. -l<library>"

config PK_LIBHUGETLBFS_USAGE_CPPFLAGS
	string "CPPFLAGS: C/C++ preprocessor flags, e.g. -I<include dir>"

config PK_LIBHUGETLBFS_USAGE_DPKCONFIG
	string "PKG_CONFIG_PATH: Directories to add to pkg-config's search path"

config PK_LIBHUGETLBFS_USAGE_CFLAGS
	string "CFLAGS: C compiler flags"

config PK_LIBHUGETLBFS_USAGE_LDFLAGS
	string "LDFLAGS: Linker flags"

config PK_LIBHUGETLBFS_USAGE_CXXFLAGS
	string "CXXFLAGS: C++ compiler flags"

config PK_LIBHUGETLBFS_USAGE_ASFLAGS
	string "CCASFLAGS: assembler compiler flags (defaults to CFLAGS)"

config PK_LIBHUGETLBFS_USAGE_BUILDARCH
	string "--host options on configure for Architecture"

endif # PK_LIBHUGETLBFS_USAGE
```

## package/hugetlb/Kconfig
```kconfig
menuconfig PK_HUGETLB
	bool "Hugetlb and Hugetlbfs Mechanism"

if PK_HUGETLB

# libhugetlbfs
source package/hugetlb/libhugetlbfs/Kconfig

# Usage for libhugetlbfs
source package/hugetlb/BiscuitOS-libhugetlbfs-usage/Kconfig

# Hugetlb Anonymous Share-mapping for default hugepage
source package/hugetlb/BiscuitOS-hugetlb-anonymous-share-mapping/Kconfig

# Hugetlb Anonymous Share-mapping for SYS V SHMEM
source package/hugetlb/BiscuitOS-hugetlb-anonymous-share-mapping-sysv/Kconfig

# Hugetlb Anonymous Share-mapping for memfd SHMEM
source package/hugetlb/BiscuitOS-hugetlb-anonymous-share-mapping-memfd/Kconfig

# Hugetlb Anonymous Share-mapping on libhugetlbfs
source package/hugetlb/BiscuitOS-hugetlb-anonymous-share-mapping-libhugetlbfs/Kconfig

# Hugetlb Anonymous Share-mapping for Migration
source package/hugetlb/BiscuitOS-hugetlb-anonymous-share-mapping-migration/Kconfig

# Hugetlb Anonymous Share-mapping for NO-RESERVE
source package/hugetlb/BiscuitOS-hugetlb-anonymous-share-mapping-noreserve/Kconfig

# Hugetlb Anonymous Share-mapping for Populate
source package/hugetlb/BiscuitOS-hugetlb-anonymous-share-mapping-populate/Kconfig

# Hugetlb Anonymous Share-mapping for 64KiB
source package/hugetlb/BiscuitOS-hugetlb-anonymous-share-mapping-64KiB/Kconfig

# Hugetlb Anonymous Share-mapping for SYS V SHMEM (64KiB)
source package/hugetlb/BiscuitOS-hugetlb-anonymous-share-mapping-sysv-64KiB/Kconfig

# Hugetlb Anonymous Share-mapping for memfd SHMEM (64KiB)
source package/hugetlb/BiscuitOS-hugetlb-anonymous-share-mapping-memfd-64KiB/Kconfig

# Hugetlb Anonymous Share-mapping on libhugetlbfs (64KiB)
source package/hugetlb/BiscuitOS-hugetlb-anonymous-share-mapping-libhugetlbfs-64KiB/Kconfig

# Hugetlb Anonymous Share-mapping for Migration (64KiB)
source package/hugetlb/BiscuitOS-hugetlb-anonymous-share-mapping-migration-64KiB/Kconfig

# Hugetlb Anonymous Share-mapping for NO-RESERVE (64KiB)
source package/hugetlb/BiscuitOS-hugetlb-anonymous-share-mapping-noreserve-64KiB/Kconfig

# Hugetlb Anonymous Share-mapping for Populate (64KiB)
source package/hugetlb/BiscuitOS-hugetlb-anonymous-share-mapping-populate-64KiB/Kconfig

# Hugetlb Anonymous Share-mapping for 2MiB
source package/hugetlb/BiscuitOS-hugetlb-anonymous-share-mapping-2MiB/Kconfig

# Hugetlb Anonymous Share-mapping for SYS V SHMEM (2MiB)
source package/hugetlb/BiscuitOS-hugetlb-anonymous-share-mapping-sysv-2MiB/Kconfig

# Hugetlb Anonymous Share-mapping for memfd SHMEM (2MiB)
source package/hugetlb/BiscuitOS-hugetlb-anonymous-share-mapping-memfd-2MiB/Kconfig

# Hugetlb Anonymous Share-mapping on libhugetlbfs (2MiB)
source package/hugetlb/BiscuitOS-hugetlb-anonymous-share-mapping-libhugetlbfs-2MiB/Kconfig

# Hugetlb Anonymous Share-mapping for Migration (2MiB)
source package/hugetlb/BiscuitOS-hugetlb-anonymous-share-mapping-migration-2MiB/Kconfig

# Hugetlb Anonymous Share-mapping for NO-RESERVE (2MiB)
source package/hugetlb/BiscuitOS-hugetlb-anonymous-share-mapping-noreserve-2MiB/Kconfig

# Hugetlb Anonymous Share-mapping for Populate (2MiB)
source package/hugetlb/BiscuitOS-hugetlb-anonymous-share-mapping-populate-2MiB/Kconfig

# Hugetlb Anonymous Share-mapping for 4MiB
source package/hugetlb/BiscuitOS-hugetlb-anonymous-share-mapping-4MiB/Kconfig

# Hugetlb Anonymous Share-mapping for SYS V SHMEM (4MiB)
source package/hugetlb/BiscuitOS-hugetlb-anonymous-share-mapping-sysv-4MiB/Kconfig

# Hugetlb Anonymous Share-mapping for memfd SHMEM (4MiB)
source package/hugetlb/BiscuitOS-hugetlb-anonymous-share-mapping-memfd-4MiB/Kconfig

# Hugetlb Anonymous Share-mapping on libhugetlbfs (4MiB)
source package/hugetlb/BiscuitOS-hugetlb-anonymous-share-mapping-libhugetlbfs-4MiB/Kconfig

# Hugetlb Anonymous Share-mapping for NO-RESERVE (4MiB)
source package/hugetlb/BiscuitOS-hugetlb-anonymous-share-mapping-noreserve-4MiB/Kconfig

# Hugetlb Anonymous Share-mapping for Populate (4MiB)
source package/hugetlb/BiscuitOS-hugetlb-anonymous-share-mapping-populate-4MiB/Kconfig

# Hugetlb Anonymous Share-mapping for 32MiB
source package/hugetlb/BiscuitOS-hugetlb-anonymous-share-mapping-32MiB/Kconfig

# Hugetlb Anonymous Share-mapping for SYS V SHMEM (32MiB)
source package/hugetlb/BiscuitOS-hugetlb-anonymous-share-mapping-sysv-32MiB/Kconfig

# Hugetlb Anonymous Share-mapping for memfd SHMEM (32MiB)
source package/hugetlb/BiscuitOS-hugetlb-anonymous-share-mapping-memfd-32MiB/Kconfig

# Hugetlb Anonymous Share-mapping on libhugetlbfs (32MiB)
source package/hugetlb/BiscuitOS-hugetlb-anonymous-share-mapping-libhugetlbfs-32MiB/Kconfig

# Hugetlb Anonymous Share-mapping for Migration (32MiB)
source package/hugetlb/BiscuitOS-hugetlb-anonymous-share-mapping-migration-32MiB/Kconfig

# Hugetlb Anonymous Share-mapping for NO-RESERVE (32MiB)
source package/hugetlb/BiscuitOS-hugetlb-anonymous-share-mapping-noreserve-32MiB/Kconfig

# Hugetlb Anonymous Share-mapping for Populate (32MiB)
source package/hugetlb/BiscuitOS-hugetlb-anonymous-share-mapping-populate-32MiB/Kconfig

# Hugetlb Anonymous Share-mapping for 1Gig
source package/hugetlb/BiscuitOS-hugetlb-anonymous-share-mapping-1Gig/Kconfig

# Hugetlb Anonymous Share-mapping for SYS V SHMEM (1Gig)
source package/hugetlb/BiscuitOS-hugetlb-anonymous-share-mapping-sysv-1Gig/Kconfig

# Hugetlb Anonymous Share-mapping for memfd SHMEM (1Gig)
source package/hugetlb/BiscuitOS-hugetlb-anonymous-share-mapping-memfd-1Gig/Kconfig

# Hugetlb Anonymous Share-mapping on libhugetlbfs (1Gig)
source package/hugetlb/BiscuitOS-hugetlb-anonymous-share-mapping-libhugetlbfs-1Gig/Kconfig

# Hugetlb fork on Anonymous Privated-mapping
source package/hugetlb/BiscuitOS-hugetlb-fork-on-anonymous-private-mapping/Kconfig

# Hugetlb fork on File Privated-mapping
source package/hugetlb/BiscuitOS-hugetlb-fork-on-file-private-mapping/Kconfig

# Hugetlb history on linux 2.6.6
source package/hugetlb/BiscuitOS-hugetlb-history-v2.6.6/Kconfig

endif # PK_HUGETLB
```

## package/hugetlb/libhugetlbfs/Kconfig
```kconfig
menuconfig PK_LIBHUGETLBFS
	bool "libhugetlbfs: Dynamic hugetlbfs library"

if PK_LIBHUGETLBFS

config PK_LIBHUGETLBFS_VERSION
	default "default"
	string "verstion"

config PK_LIBHUGETLBFS_TAR
	default "tar.xz"
	string "tar type"

config PK_LIBHUGETLBFS_URL
	default "http://ftp.igh.cnrs.fr/pub/nongnu/dmidecode/"
	string "url"

config PK_LIBHUGETLBFS_GITHUB
	default "git@gitee.com:mirrors/libhugetlbfs.git"
	string "GitHub"

config PK_LIBHUGETLBFS_SRCFILE
	string "Source code list"

config PK_LIBHUGETLBFS_CONFIG
	default "--enable-silent-rules"
	string "CONFIG: Project Configure Options"

config PK_LIBHUGETLBFS_LIBPATH
	string "LIBS: Libraries to pass to the linker, e.g. -l<library>"

config PK_LIBHUGETLBFS_CPPFLAGS
	string "CPPFLAGS: C/C++ preprocessor flags, e.g. -I<include dir>"

config PK_LIBHUGETLBFS_DPKCONFIG
	string "PKG_CONFIG_PATH: Directories to add to pkg-config's search path"

config PK_LIBHUGETLBFS_CFLAGS
	string "CFLAGS: C compiler flags"

config PK_LIBHUGETLBFS_LDFLAGS
	string "LDFLAGS: Linker flags"

config PK_LIBHUGETLBFS_CXXFLAGS
	string "CXXFLAGS: C++ compiler flags"

config PK_LIBHUGETLBFS_ASFLAGS
	string "CCASFLAGS: assembler compiler flags (defaults to CFLAGS)"

config PK_LIBHUGETLBFS_BUILDARCH
	default "x86_64-unknown-linux-gnu"
	string "--host options on configure for Architecture"

endif # PK_LIBHUGETLBFS
```

## package/hugetlbfs/Kconfig
```kconfig
menuconfig PK_HUGETLBFS
	bool "Hugetlbfs: Hugepage and Transparent Hugepage"

if PK_HUGETLBFS

# libhugetlbfs
source package/hugetlbfs/libhugetlbfs/Kconfig

# libhugetlbfs-usage
source package/hugetlbfs/BiscuitOS-libhugetlbfs-usage/Kconfig

# Hugetlbfs 2M share mmap on userspace
source package/hugetlbfs/BiscuitOS-hugetlbfs-2M-share-mmap-userspace/Kconfig

# Hugetlbfs 2M private mmap on userspace
source package/hugetlbfs/BiscuitOS-hugetlbfs-2M-private-mmap-userspace/Kconfig

# Hugetlbfs 2M anonymous share mmap on userspace
source package/hugetlbfs/BiscuitOS-hugetlbfs-2M-anonymous-share-mmap-userspace/Kconfig

# Hugetlbfs 2M anonymous private mmap on userspace
source package/hugetlbfs/BiscuitOS-hugetlbfs-2M-anonymous-private-mmap-userspace/Kconfig

# Hugetlbfs 1G share mmap on userspace
source package/hugetlbfs/BiscuitOS-hugetlbfs-1G-share-mmap-userspace/Kconfig

# Hugetlbfs 1G private mmap on userspace
source package/hugetlbfs/BiscuitOS-hugetlbfs-1G-private-mmap-userspace/Kconfig

# Hugetlbfs 1G anonymous share mmap on userspace
source package/hugetlbfs/BiscuitOS-hugetlbfs-1G-anonymous-share-mmap-userspace/Kconfig

# Hugetlbfs 1G anonymous private mmap on userspace
source package/hugetlbfs/BiscuitOS-hugetlbfs-1G-anonymous-private-mmap-userspace/Kconfig

endif # PK_HUGETLBFS
```

## package/i2c/Kconfig
```kconfig
menuconfig PK_I2C
	bool "I2C: Inter-Integrated Circuit"

if PK_I2C

# AT24C08 application
source package/i2c/at24c08_app/Kconfig

# AT24C08 chest
source package/i2c/at24c08_chest/Kconfig

# AT24C08 Module
source package/i2c/at24c08_module/Kconfig

# I2C Bus Device Driver
source package/i2c/i2c_bus/Kconfig

# LM75A Application
source "package/i2c/lm75a_app/Kconfig"

# LM75A Device Driver
source "package/i2c/lm75a_module/Kconfig"

# LM75A input Application
source "package/i2c/lm75a_input_app/Kconfig"

# LM75A input Device Driver
source "package/i2c/lm75a_input_module/Kconfig"

# LM75A thermal Watchdog
source "package/i2c/lm75a_thermal_watchdog/Kconfig"

# PCF8574 application
source package/i2c/pcf8574_app/Kconfig

# PCF8574 module
source package/i2c/pcf8574_module/Kconfig

# PCF8574 Interrupt module
source package/i2c/pcf8574_intr_module/Kconfig

# PCF8574 Interrupt error
source package/i2c/pcf8574_err0/Kconfig

# PCF8574 Traffic Light
source package/i2c/pcf8574_traffic/Kconfig

endif # PK_I2C
```

## package/i2c/at24c08_app/Kconfig
```kconfig
menuconfig PK_AT24C08_APP
	bool "AT24C08 Application"

if PK_AT24C08_APP

config PK_AT24C08_APP_VERSION
	default "0.0.1"
	string "verstion"

config PK_AT24C08_APP_TAR
	default "tar.gz"
	string "tar type"

config PK_AT24C08_APP_URL
	default "https://gitee.com/BiscuitOS_team/HardStack/raw/Gitee/Device-Driver/i2c/Device/AT24C08/userland"
	string "url"

config PK_AT24C08_APP_GITHUB
	string "GitHub"

config PK_AT24C08_APP_SRCFILE
	default "at24c08.c at24c08.sh Makefile"
	string "Source code list"

config PK_AT24C08_APP_CSRCFILE
	string "Compile source code list"

config PK_AT24C08_APP_CONFIG
	string "CONFIG: Project Configure Options"

config PK_AT24C08_APP_LIBPATH
	string "LIBS: Libraries to pass to the linker, e.g. -l<library>"

config PK_AT24C08_APP_CPPFLAGS
	string "CPPFLAGS: C/C++ preprocessor flags, e.g. -I<include dir>"

config PK_AT24C08_APP_DPKCONFIG
	string "PKG_CONFIG_PATH: Directories to add to pkg-config's search path"

config PK_AT24C08_APP_CFLAGS
	string "CFLAGS: C compiler flags"

config PK_AT24C08_APP_LDFLAGS
	string "LDFLAGS: Linker flags"

config PK_AT24C08_APP_CXXFLAGS
	string "CXXFLAGS: C++ compiler flags"

config PK_AT24C08_APP_ASFLAGS
	string "CCASFLAGS: assembler compiler flags (defaults to CFLAGS)"

config PK_AT24C08_APP_BUILDARCH
	string "--host options on configure for Architecture"

endif # PK_AT24C08_APP
```

## package/i2c/at24c08_chest/Kconfig
```kconfig
menuconfig PK_AT24C08_CHEST
	bool "AT24C08 Chest"

if PK_AT24C08_CHEST

config PK_AT24C08_CHEST_VERSION
	default "0.0.1"
	string "verstion"

config PK_AT24C08_CHEST_TAR
	default "tar.gz"
	string "tar type"

config PK_AT24C08_CHEST_URL
	default "https://gitee.com/BiscuitOS_team/HardStack/raw/Gitee/Device-Driver/i2c/Device/AT24C08/Chest"
	string "url"

config PK_AT24C08_CHEST_GITHUB
	string "GitHub"

config PK_AT24C08_CHEST_SRCFILE
	default "Makefile src/at24c08_lib.c src/chest.c src/main.c src/user_command.c include/at24c08_lib.h include/chest.h include/command.h"
	string "Source code list"

config PK_AT24C08_CHEST_CSRCFILE
	string "Compile source code list"

config PK_AT24C08_CHEST_CONFIG
	string "CONFIG: Project Configure Options"

config PK_AT24C08_CHEST_LIBPATH
	string "LIBS: Libraries to pass to the linker, e.g. -l<library>"

config PK_AT24C08_CHEST_CPPFLAGS
	string "CPPFLAGS: C/C++ preprocessor flags, e.g. -I<include dir>"

config PK_AT24C08_CHEST_DPKCONFIG
	string "PKG_CONFIG_PATH: Directories to add to pkg-config's search path"

config PK_AT24C08_CHEST_CFLAGS
	string "CFLAGS: C compiler flags"

config PK_AT24C08_CHEST_LDFLAGS
	string "LDFLAGS: Linker flags"

config PK_AT24C08_CHEST_CXXFLAGS
	string "CXXFLAGS: C++ compiler flags"

config PK_AT24C08_CHEST_ASFLAGS
	string "CCASFLAGS: assembler compiler flags (defaults to CFLAGS)"

config PK_AT24C08_CHEST_BUILDARCH
	string "--host options on configure for Architecture"

endif # PK_AT24C08_CHEST
```
