## package/hugetlb/BiscuitOS-hugetlb-anonymous-share-mapping-noreserve/Kconfig
```kconfig
menuconfig PK_BISCUITOS_HUGETLB_ANON_SHARE_NORSVD
	bool "hugetlb: Anon-Shared on NO-RESERVE (Default-Size Hugepages+)"

if PK_BISCUITOS_HUGETLB_ANON_SHARE_NORSVD

config PK_BISCUITOS_HUGETLB_ANON_SHARE_NORSVD_VERSION
	default "default"
	string "verstion"

config PK_BISCUITOS_HUGETLB_ANON_SHARE_NORSVD_TAR
	default "tar.gz"
	string "tar type"

config PK_BISCUITOS_HUGETLB_ANON_SHARE_NORSVD_URL
	default "https://gitee.com/BiscuitOS_team/HardStack/raw/Gitee/Memory-Allocator/Hugetlb/BiscuitOS-hugetlb-anonymous-share-mapping-noreserve"
	string "url"

config PK_BISCUITOS_HUGETLB_ANON_SHARE_NORSVD_GITHUB
	string "GitHub"

config PK_BISCUITOS_HUGETLB_ANON_SHARE_NORSVD_SRCFILE
	default "main.c Makefile RunBiscuitOS.sh"
	string "Source code list"

config PK_BISCUITOS_HUGETLB_ANON_SHARE_NORSVD_CSRCFILE
	string "Compile source code list"

config PK_BISCUITOS_HUGETLB_ANON_SHARE_NORSVD_CONFIG
	string "CONFIG: Project Configure Options"

config PK_BISCUITOS_HUGETLB_ANON_SHARE_NORSVD_LIBPATH
	string "LIBS: Libraries to pass to the linker, e.g. -l<library>"

config PK_BISCUITOS_HUGETLB_ANON_SHARE_NORSVD_CPPFLAGS
	string "CPPFLAGS: C/C++ preprocessor flags, e.g. -I<include dir>"

config PK_BISCUITOS_HUGETLB_ANON_SHARE_NORSVD_DPKCONFIG
	string "PKG_CONFIG_PATH: Directories to add to pkg-config's search path"

config PK_BISCUITOS_HUGETLB_ANON_SHARE_NORSVD_CFLAGS
	string "CFLAGS: C compiler flags"

config PK_BISCUITOS_HUGETLB_ANON_SHARE_NORSVD_LDFLAGS
	string "LDFLAGS: Linker flags"

config PK_BISCUITOS_HUGETLB_ANON_SHARE_NORSVD_CXXFLAGS
	string "CXXFLAGS: C++ compiler flags"

config PK_BISCUITOS_HUGETLB_ANON_SHARE_NORSVD_ASFLAGS
	string "CCASFLAGS: assembler compiler flags (defaults to CFLAGS)"

config PK_BISCUITOS_HUGETLB_ANON_SHARE_NORSVD_BUILDARCH
	string "--host options on configure for Architecture"

endif # PK_BISCUITOS_HUGETLB_ANON_SHARE_NORSVD
```

## package/hugetlb/BiscuitOS-hugetlb-anonymous-share-mapping-populate/Kconfig
```kconfig
menuconfig PK_BISCUITOS_HUGETLB_ANON_SHARE_POPULATE
	bool "hugetlb: Anon-Shared on Populate (Default-Size Hugepages+)"

if PK_BISCUITOS_HUGETLB_ANON_SHARE_POPULATE

config PK_BISCUITOS_HUGETLB_ANON_SHARE_POPULATE_VERSION
	default "default"
	string "verstion"

config PK_BISCUITOS_HUGETLB_ANON_SHARE_POPULATE_TAR
	default "tar.gz"
	string "tar type"

config PK_BISCUITOS_HUGETLB_ANON_SHARE_POPULATE_URL
	default "https://gitee.com/BiscuitOS_team/HardStack/raw/Gitee/Memory-Allocator/Hugetlb/BiscuitOS-hugetlb-anonymous-share-mapping-populate"
	string "url"

config PK_BISCUITOS_HUGETLB_ANON_SHARE_POPULATE_GITHUB
	string "GitHub"

config PK_BISCUITOS_HUGETLB_ANON_SHARE_POPULATE_SRCFILE
	default "main.c Makefile RunBiscuitOS.sh"
	string "Source code list"

config PK_BISCUITOS_HUGETLB_ANON_SHARE_POPULATE_CSRCFILE
	string "Compile source code list"

config PK_BISCUITOS_HUGETLB_ANON_SHARE_POPULATE_CONFIG
	string "CONFIG: Project Configure Options"

config PK_BISCUITOS_HUGETLB_ANON_SHARE_POPULATE_LIBPATH
	string "LIBS: Libraries to pass to the linker, e.g. -l<library>"

config PK_BISCUITOS_HUGETLB_ANON_SHARE_POPULATE_CPPFLAGS
	string "CPPFLAGS: C/C++ preprocessor flags, e.g. -I<include dir>"

config PK_BISCUITOS_HUGETLB_ANON_SHARE_POPULATE_DPKCONFIG
	string "PKG_CONFIG_PATH: Directories to add to pkg-config's search path"

config PK_BISCUITOS_HUGETLB_ANON_SHARE_POPULATE_CFLAGS
	string "CFLAGS: C compiler flags"

config PK_BISCUITOS_HUGETLB_ANON_SHARE_POPULATE_LDFLAGS
	string "LDFLAGS: Linker flags"

config PK_BISCUITOS_HUGETLB_ANON_SHARE_POPULATE_CXXFLAGS
	string "CXXFLAGS: C++ compiler flags"

config PK_BISCUITOS_HUGETLB_ANON_SHARE_POPULATE_ASFLAGS
	string "CCASFLAGS: assembler compiler flags (defaults to CFLAGS)"

config PK_BISCUITOS_HUGETLB_ANON_SHARE_POPULATE_BUILDARCH
	string "--host options on configure for Architecture"

endif # PK_BISCUITOS_HUGETLB_ANON_SHARE_POPULATE
```

## package/hugetlb/BiscuitOS-hugetlb-anonymous-share-mapping-sysv/Kconfig
```kconfig
menuconfig PK_BISCUITOS_HUGETLB_ANON_SHARE_SYSV
	bool "hugetlb: Anon-Shared on SYS V SHMEM (Default-Size Hugepages+)"

if PK_BISCUITOS_HUGETLB_ANON_SHARE_SYSV

config PK_BISCUITOS_HUGETLB_ANON_SHARE_SYSV_VERSION
	default "default"
	string "verstion"

config PK_BISCUITOS_HUGETLB_ANON_SHARE_SYSV_TAR
	default "tar.gz"
	string "tar type"

config PK_BISCUITOS_HUGETLB_ANON_SHARE_SYSV_URL
	default "https://gitee.com/BiscuitOS_team/HardStack/raw/Gitee/Memory-Allocator/Hugetlb/BiscuitOS-hugetlb-anonymous-share-mapping-sysv"
	string "url"

config PK_BISCUITOS_HUGETLB_ANON_SHARE_SYSV_GITHUB
	string "GitHub"

config PK_BISCUITOS_HUGETLB_ANON_SHARE_SYSV_SRCFILE
	default "server.c client.c Makefile RunBiscuitOS.sh"
	string "Source code list"

config PK_BISCUITOS_HUGETLB_ANON_SHARE_SYSV_CSRCFILE
	string "Compile source code list"

config PK_BISCUITOS_HUGETLB_ANON_SHARE_SYSV_CONFIG
	string "CONFIG: Project Configure Options"

config PK_BISCUITOS_HUGETLB_ANON_SHARE_SYSV_LIBPATH
	string "LIBS: Libraries to pass to the linker, e.g. -l<library>"

config PK_BISCUITOS_HUGETLB_ANON_SHARE_SYSV_CPPFLAGS
	string "CPPFLAGS: C/C++ preprocessor flags, e.g. -I<include dir>"

config PK_BISCUITOS_HUGETLB_ANON_SHARE_SYSV_DPKCONFIG
	string "PKG_CONFIG_PATH: Directories to add to pkg-config's search path"

config PK_BISCUITOS_HUGETLB_ANON_SHARE_SYSV_CFLAGS
	string "CFLAGS: C compiler flags"

config PK_BISCUITOS_HUGETLB_ANON_SHARE_SYSV_LDFLAGS
	string "LDFLAGS: Linker flags"

config PK_BISCUITOS_HUGETLB_ANON_SHARE_SYSV_CXXFLAGS
	string "CXXFLAGS: C++ compiler flags"

config PK_BISCUITOS_HUGETLB_ANON_SHARE_SYSV_ASFLAGS
	string "CCASFLAGS: assembler compiler flags (defaults to CFLAGS)"

config PK_BISCUITOS_HUGETLB_ANON_SHARE_SYSV_BUILDARCH
	string "--host options on configure for Architecture"

endif # PK_BISCUITOS_HUGETLB_ANON_SHARE_SYSV
```

## package/hugetlb/BiscuitOS-hugetlb-file-share-mapping-migration/Kconfig
```kconfig
menuconfig PK_BISCUITOS_HUGETLB_FILE_SHARE_MIGRATE
	bool "hugetlb: File-Shared on Migration (Default-Size Hugepages+)"

if PK_BISCUITOS_HUGETLB_FILE_SHARE_MIGRATE

config PK_BISCUITOS_HUGETLB_FILE_SHARE_MIGRATE_VERSION
	default "default"
	string "verstion"

config PK_BISCUITOS_HUGETLB_FILE_SHARE_MIGRATE_TAR
	default "tar.gz"
	string "tar type"

config PK_BISCUITOS_HUGETLB_FILE_SHARE_MIGRATE_URL
	default "https://gitee.com/BiscuitOS_team/HardStack/raw/Gitee/Memory-Allocator/Hugetlb/BiscuitOS-hugetlb-file-share-mapping-migration"
	string "url"

config PK_BISCUITOS_HUGETLB_FILE_SHARE_MIGRATE_GITHUB
	string "GitHub"

config PK_BISCUITOS_HUGETLB_FILE_SHARE_MIGRATE_SRCFILE
	default "main.c Makefile RunBiscuitOS.sh"
	string "Source code list"

config PK_BISCUITOS_HUGETLB_FILE_SHARE_MIGRATE_CSRCFILE
	string "Compile source code list"

config PK_BISCUITOS_HUGETLB_FILE_SHARE_MIGRATE_CONFIG
	string "CONFIG: Project Configure Options"

config PK_BISCUITOS_HUGETLB_FILE_SHARE_MIGRATE_LIBPATH
	string "LIBS: Libraries to pass to the linker, e.g. -l<library>"

config PK_BISCUITOS_HUGETLB_FILE_SHARE_MIGRATE_CPPFLAGS
	string "CPPFLAGS: C/C++ preprocessor flags, e.g. -I<include dir>"

config PK_BISCUITOS_HUGETLB_FILE_SHARE_MIGRATE_DPKCONFIG
	string "PKG_CONFIG_PATH: Directories to add to pkg-config's search path"

config PK_BISCUITOS_HUGETLB_FILE_SHARE_MIGRATE_CFLAGS
	string "CFLAGS: C compiler flags"

config PK_BISCUITOS_HUGETLB_FILE_SHARE_MIGRATE_LDFLAGS
	string "LDFLAGS: Linker flags"

config PK_BISCUITOS_HUGETLB_FILE_SHARE_MIGRATE_CXXFLAGS
	string "CXXFLAGS: C++ compiler flags"

config PK_BISCUITOS_HUGETLB_FILE_SHARE_MIGRATE_ASFLAGS
	string "CCASFLAGS: assembler compiler flags (defaults to CFLAGS)"

config PK_BISCUITOS_HUGETLB_FILE_SHARE_MIGRATE_BUILDARCH
	string "--host options on configure for Architecture"

endif # PK_BISCUITOS_HUGETLB_FILE_SHARE_MIGRATE
```

## package/hugetlb/BiscuitOS-hugetlb-file-share-mapping-posix/Kconfig
```kconfig
menuconfig PK_BISCUITOS_HUGETLB_FILE_SHARE_POSIX
	bool "hugetlb: File-Shared on POSIX SHMEM (Default-Size Hugepages+)"

if PK_BISCUITOS_HUGETLB_FILE_SHARE_POSIX

config PK_BISCUITOS_HUGETLB_FILE_SHARE_POSIX_VERSION
	default "default"
	string "verstion"

config PK_BISCUITOS_HUGETLB_FILE_SHARE_POSIX_TAR
	default "tar.gz"
	string "tar type"

config PK_BISCUITOS_HUGETLB_FILE_SHARE_POSIX_URL
	default "https://gitee.com/BiscuitOS_team/HardStack/raw/Gitee/Memory-Allocator/Hugetlb/BiscuitOS-hugetlb-file-share-mapping-posix"
	string "url"

config PK_BISCUITOS_HUGETLB_FILE_SHARE_POSIX_GITHUB
	string "GitHub"

config PK_BISCUITOS_HUGETLB_FILE_SHARE_POSIX_SRCFILE
	default "server.c client.c Makefile RunBiscuitOS.sh"
	string "Source code list"

config PK_BISCUITOS_HUGETLB_FILE_SHARE_POSIX_CSRCFILE
	string "Compile source code list"

config PK_BISCUITOS_HUGETLB_FILE_SHARE_POSIX_CONFIG
	string "CONFIG: Project Configure Options"

config PK_BISCUITOS_HUGETLB_FILE_SHARE_POSIX_LIBPATH
	string "LIBS: Libraries to pass to the linker, e.g. -l<library>"

config PK_BISCUITOS_HUGETLB_FILE_SHARE_POSIX_CPPFLAGS
	string "CPPFLAGS: C/C++ preprocessor flags, e.g. -I<include dir>"

config PK_BISCUITOS_HUGETLB_FILE_SHARE_POSIX_DPKCONFIG
	string "PKG_CONFIG_PATH: Directories to add to pkg-config's search path"

config PK_BISCUITOS_HUGETLB_FILE_SHARE_POSIX_CFLAGS
	string "CFLAGS: C compiler flags"

config PK_BISCUITOS_HUGETLB_FILE_SHARE_POSIX_LDFLAGS
	string "LDFLAGS: Linker flags"

config PK_BISCUITOS_HUGETLB_FILE_SHARE_POSIX_CXXFLAGS
	string "CXXFLAGS: C++ compiler flags"

config PK_BISCUITOS_HUGETLB_FILE_SHARE_POSIX_ASFLAGS
	string "CCASFLAGS: assembler compiler flags (defaults to CFLAGS)"

config PK_BISCUITOS_HUGETLB_FILE_SHARE_POSIX_BUILDARCH
	string "--host options on configure for Architecture"

endif # PK_BISCUITOS_HUGETLB_FILE_SHARE_POSIX
```

## package/hugetlb/BiscuitOS-hugetlb-file-share-mapping-usock/Kconfig
```kconfig
menuconfig PK_BISCUITOS_HUGETLB_FILE_SHARE_USOCK
	bool "hugetlb: File-Shared on Unix-Sock SHMEM (Default-Size Hugepages+)"

if PK_BISCUITOS_HUGETLB_FILE_SHARE_USOCK

config PK_BISCUITOS_HUGETLB_FILE_SHARE_USOCK_VERSION
	default "default"
	string "verstion"

config PK_BISCUITOS_HUGETLB_FILE_SHARE_USOCK_TAR
	default "tar.gz"
	string "tar type"

config PK_BISCUITOS_HUGETLB_FILE_SHARE_USOCK_URL
	default "https://gitee.com/BiscuitOS_team/HardStack/raw/Gitee/Memory-Allocator/Hugetlb/BiscuitOS-hugetlb-file-share-mapping-usock"
	string "url"

config PK_BISCUITOS_HUGETLB_FILE_SHARE_USOCK_GITHUB
	string "GitHub"

config PK_BISCUITOS_HUGETLB_FILE_SHARE_USOCK_SRCFILE
	default "server.c client.c Makefile RunBiscuitOS.sh"
	string "Source code list"

config PK_BISCUITOS_HUGETLB_FILE_SHARE_USOCK_CSRCFILE
	string "Compile source code list"

config PK_BISCUITOS_HUGETLB_FILE_SHARE_USOCK_CONFIG
	string "CONFIG: Project Configure Options"

config PK_BISCUITOS_HUGETLB_FILE_SHARE_USOCK_LIBPATH
	string "LIBS: Libraries to pass to the linker, e.g. -l<library>"

config PK_BISCUITOS_HUGETLB_FILE_SHARE_USOCK_CPPFLAGS
	string "CPPFLAGS: C/C++ preprocessor flags, e.g. -I<include dir>"

config PK_BISCUITOS_HUGETLB_FILE_SHARE_USOCK_DPKCONFIG
	string "PKG_CONFIG_PATH: Directories to add to pkg-config's search path"

config PK_BISCUITOS_HUGETLB_FILE_SHARE_USOCK_CFLAGS
	string "CFLAGS: C compiler flags"

config PK_BISCUITOS_HUGETLB_FILE_SHARE_USOCK_LDFLAGS
	string "LDFLAGS: Linker flags"

config PK_BISCUITOS_HUGETLB_FILE_SHARE_USOCK_CXXFLAGS
	string "CXXFLAGS: C++ compiler flags"

config PK_BISCUITOS_HUGETLB_FILE_SHARE_USOCK_ASFLAGS
	string "CCASFLAGS: assembler compiler flags (defaults to CFLAGS)"

config PK_BISCUITOS_HUGETLB_FILE_SHARE_USOCK_BUILDARCH
	string "--host options on configure for Architecture"

endif # PK_BISCUITOS_HUGETLB_FILE_SHARE_USOCK
```

## package/hugetlb/BiscuitOS-hugetlb-file-share-mapping/Kconfig
```kconfig
menuconfig PK_BISCUITOS_HUGETLB_FILE_SHARE
	bool "hugetlb: File-Shared (Default-Size Hugepages+)"

if PK_BISCUITOS_HUGETLB_FILE_SHARE

config PK_BISCUITOS_HUGETLB_FILE_SHARE_VERSION
	default "default"
	string "verstion"

config PK_BISCUITOS_HUGETLB_FILE_SHARE_TAR
	default "tar.gz"
	string "tar type"

config PK_BISCUITOS_HUGETLB_FILE_SHARE_URL
	default "https://gitee.com/BiscuitOS_team/HardStack/raw/Gitee/Memory-Allocator/Hugetlb/BiscuitOS-hugetlb-file-share-mapping"
	string "url"

config PK_BISCUITOS_HUGETLB_FILE_SHARE_GITHUB
	string "GitHub"

config PK_BISCUITOS_HUGETLB_FILE_SHARE_SRCFILE
	default "main.c Makefile RunBiscuitOS.sh"
	string "Source code list"

config PK_BISCUITOS_HUGETLB_FILE_SHARE_CSRCFILE
	string "Compile source code list"

config PK_BISCUITOS_HUGETLB_FILE_SHARE_CONFIG
	string "CONFIG: Project Configure Options"

config PK_BISCUITOS_HUGETLB_FILE_SHARE_LIBPATH
	string "LIBS: Libraries to pass to the linker, e.g. -l<library>"

config PK_BISCUITOS_HUGETLB_FILE_SHARE_CPPFLAGS
	string "CPPFLAGS: C/C++ preprocessor flags, e.g. -I<include dir>"

config PK_BISCUITOS_HUGETLB_FILE_SHARE_DPKCONFIG
	string "PKG_CONFIG_PATH: Directories to add to pkg-config's search path"

config PK_BISCUITOS_HUGETLB_FILE_SHARE_CFLAGS
	string "CFLAGS: C compiler flags"

config PK_BISCUITOS_HUGETLB_FILE_SHARE_LDFLAGS
	string "LDFLAGS: Linker flags"

config PK_BISCUITOS_HUGETLB_FILE_SHARE_CXXFLAGS
	string "CXXFLAGS: C++ compiler flags"

config PK_BISCUITOS_HUGETLB_FILE_SHARE_ASFLAGS
	string "CCASFLAGS: assembler compiler flags (defaults to CFLAGS)"

config PK_BISCUITOS_HUGETLB_FILE_SHARE_BUILDARCH
	string "--host options on configure for Architecture"

endif # PK_BISCUITOS_HUGETLB_FILE_SHARE
```

## package/hugetlb/BiscuitOS-hugetlb-fork-on-anonymous-private-mapping/Kconfig
```kconfig
menuconfig PK_BISCUITOS_HUGETLB_FORK_ANON_PRIVATE
	bool "Hugetlb: Fork on Anonymous Privated-mapping"

if PK_BISCUITOS_HUGETLB_FORK_ANON_PRIVATE

config PK_BISCUITOS_HUGETLB_FORK_ANON_PRIVATE_VERSION
	default "default"
	string "verstion"

config PK_BISCUITOS_HUGETLB_FORK_ANON_PRIVATE_TAR
	default "tar.gz"
	string "tar type"

config PK_BISCUITOS_HUGETLB_FORK_ANON_PRIVATE_URL
	default "https://gitee.com/BiscuitOS_team/HardStack/raw/Gitee/Memory-Allocator/Hugetlb/BiscuitOS-hugetlb-fork-on-anonymous-private-mapping"
	string "url"

config PK_BISCUITOS_HUGETLB_FORK_ANON_PRIVATE_GITHUB
	string "GitHub"

config PK_BISCUITOS_HUGETLB_FORK_ANON_PRIVATE_SRCFILE
	default "main.c Makefile RunBiscuitOS.sh"
	string "Source code list"

config PK_BISCUITOS_HUGETLB_FORK_ANON_PRIVATE_CSRCFILE
	string "Compile source code list"

config PK_BISCUITOS_HUGETLB_FORK_ANON_PRIVATE_CONFIG
	string "CONFIG: Project Configure Options"

config PK_BISCUITOS_HUGETLB_FORK_ANON_PRIVATE_LIBPATH
	string "LIBS: Libraries to pass to the linker, e.g. -l<library>"

config PK_BISCUITOS_HUGETLB_FORK_ANON_PRIVATE_CPPFLAGS
	string "CPPFLAGS: C/C++ preprocessor flags, e.g. -I<include dir>"

config PK_BISCUITOS_HUGETLB_FORK_ANON_PRIVATE_DPKCONFIG
	string "PKG_CONFIG_PATH: Directories to add to pkg-config's search path"

config PK_BISCUITOS_HUGETLB_FORK_ANON_PRIVATE_CFLAGS
	string "CFLAGS: C compiler flags"

config PK_BISCUITOS_HUGETLB_FORK_ANON_PRIVATE_LDFLAGS
	string "LDFLAGS: Linker flags"

config PK_BISCUITOS_HUGETLB_FORK_ANON_PRIVATE_CXXFLAGS
	string "CXXFLAGS: C++ compiler flags"

config PK_BISCUITOS_HUGETLB_FORK_ANON_PRIVATE_ASFLAGS
	string "CCASFLAGS: assembler compiler flags (defaults to CFLAGS)"

config PK_BISCUITOS_HUGETLB_FORK_ANON_PRIVATE_BUILDARCH
	string "--host options on configure for Architecture"

endif # PK_BISCUITOS_HUGETLB_FORK_ANON_PRIVATE
```
