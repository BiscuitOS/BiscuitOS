## package/i2c/i2c_bus/Kconfig
```kconfig
menuconfig PK_I2C_BUS
	bool "I2C Bus Device Driver"

if PK_I2C_BUS

config PK_I2C_BUS_VERSION
	default "0.0.1"
	string "verstion"

config PK_I2C_BUS_TAR
	default "tar.gz"
	string "tar type"

config PK_I2C_BUS_URL
	default "https://gitee.com/BiscuitOS_team/HardStack/raw/Gitee/Device-Driver/i2c/Bus/kernel"
	string "url"

config PK_I2C_BUS_GITHUB
	string "GitHub"

config PK_I2C_BUS_SRCFILE
	default "i2c_bus.c Kconfig Makefile"
	string "Source code list"

config PK_I2C_BUS_CSRCFILE
	string "Compile source code list"

config PK_I2C_BUS_CONFIG
	string "CONFIG: Project Configure Options"

config PK_I2C_BUS_LIBPATH
	string "LIBS: Libraries to pass to the linker, e.g. -l<library>"

config PK_I2C_BUS_CPPFLAGS
	string "CPPFLAGS: C/C++ preprocessor flags, e.g. -I<include dir>"

config PK_I2C_BUS_DPKCONFIG
	string "PKG_CONFIG_PATH: Directories to add to pkg-config's search path"

config PK_I2C_BUS_CFLAGS
	string "CFLAGS: C compiler flags"

config PK_I2C_BUS_LDFLAGS
	string "LDFLAGS: Linker flags"

config PK_I2C_BUS_CXXFLAGS
	string "CXXFLAGS: C++ compiler flags"

config PK_I2C_BUS_ASFLAGS
	string "CCASFLAGS: assembler compiler flags (defaults to CFLAGS)"

config PK_I2C_BUS_BUILDARCH
	string "--host options on configure for Architecture"

endif # PK_I2C_BUS
```

## package/i2c/lm75a_app/Kconfig
```kconfig
menuconfig PK_LM75A_APP
	bool "LM75A: Application"

if PK_LM75A_APP

config PK_LM75A_APP_VERSION
	default "0.0.1"
	string "verstion"

config PK_LM75A_APP_TAR
	default "tar.gz"
	string "tar type"

config PK_LM75A_APP_URL
	default "https://gitee.com/BiscuitOS_team/HardStack/raw/Gitee/Device-Driver/i2c/Device/LM75A/Base/userland"
	string "url"

config PK_LM75A_APP_GITHUB
	string "GitHub"

config PK_LM75A_APP_SRCFILE
	default "lm75a.c lm75a.sh Makefile"
	string "Source code list"

config PK_LM75A_APP_CSRCFILE
	string "Compile source code list"

config PK_LM75A_APP_CONFIG
	string "CONFIG: Project Configure Options"

config PK_LM75A_APP_LIBPATH
	string "LIBS: Libraries to pass to the linker, e.g. -l<library>"

config PK_LM75A_APP_CPPFLAGS
	string "CPPFLAGS: C/C++ preprocessor flags, e.g. -I<include dir>"

config PK_LM75A_APP_DPKCONFIG
	string "PKG_CONFIG_PATH: Directories to add to pkg-config's search path"

config PK_LM75A_APP_CFLAGS
	string "CFLAGS: C compiler flags"

config PK_LM75A_APP_LDFLAGS
	string "LDFLAGS: Linker flags"

config PK_LM75A_APP_CXXFLAGS
	string "CXXFLAGS: C++ compiler flags"

config PK_LM75A_APP_ASFLAGS
	string "CCASFLAGS: assembler compiler flags (defaults to CFLAGS)"

config PK_LM75A_APP_BUILDARCH
	string "--host options on configure for Architecture"

endif # PK_LM75A_APP
```

## package/i2c/lm75a_module/Kconfig
```kconfig
menuconfig PK_LM75A_MOD
	bool "LM75A: Device Driver Module"

if PK_LM75A_MOD

config PK_LM75A_MOD_VERSION
	default "0.0.1"
	string "verstion"

config PK_LM75A_MOD_TAR
	default "tar.gz"
	string "tar type"

config PK_LM75A_MOD_URL
	default "https://gitee.com/BiscuitOS_team/HardStack/raw/Gitee/Device-Driver/i2c/Device/LM75A/Base/kernel"
	string "url"

config PK_LM75A_MOD_GITHUB
	string "GitHub"

config PK_LM75A_MOD_SRCFILE
	default "lm75a.c default.dts Kconfig Makefile"
	string "Source code list"

config PK_LM75A_MOD_CSRCFILE
	string "Compile source code list"

config PK_LM75A_MOD_CONFIG
	string "CONFIG: Project Configure Options"

config PK_LM75A_MOD_LIBPATH
	string "LIBS: Libraries to pass to the linker, e.g. -l<library>"

config PK_LM75A_MOD_CPPFLAGS
	string "CPPFLAGS: C/C++ preprocessor flags, e.g. -I<include dir>"

config PK_LM75A_MOD_DPKCONFIG
	string "PKG_CONFIG_PATH: Directories to add to pkg-config's search path"

config PK_LM75A_MOD_CFLAGS
	string "CFLAGS: C compiler flags"

config PK_LM75A_MOD_LDFLAGS
	string "LDFLAGS: Linker flags"

config PK_LM75A_MOD_CXXFLAGS
	string "CXXFLAGS: C++ compiler flags"

config PK_LM75A_MOD_ASFLAGS
	string "CCASFLAGS: assembler compiler flags (defaults to CFLAGS)"

config PK_LM75A_MOD_BUILDARCH
	string "--host options on configure for Architecture"

endif # PK_LM75A_MOD
```

## package/i2c/lm75a_thermal_watchdog/Kconfig
```kconfig
menuconfig PK_LM75A_WDOG
	bool "LM75A: Theraml Watchdog"

if PK_LM75A_WDOG

config PK_LM75A_WDOG_VERSION
	default "0.0.1"
	string "verstion"

config PK_LM75A_WDOG_TAR
	default "tar.gz"
	string "tar type"

config PK_LM75A_WDOG_URL
	default "https://gitee.com/BiscuitOS_team/HardStack/raw/Gitee/Device-Driver/i2c/Device/LM75A/Thermal_Watchdog/userland"
	string "url"

config PK_LM75A_WDOG_GITHUB
	string "GitHub"

config PK_LM75A_WDOG_SRCFILE
	default "lm75a.c lm75a.sh Makefile"
	string "Source code list"

config PK_LM75A_WDOG_CSRCFILE
	string "Compile source code list"

config PK_LM75A_WDOG_CONFIG
	string "CONFIG: Project Configure Options"

config PK_LM75A_WDOG_LIBPATH
	string "LIBS: Libraries to pass to the linker, e.g. -l<library>"

config PK_LM75A_WDOG_CPPFLAGS
	string "CPPFLAGS: C/C++ preprocessor flags, e.g. -I<include dir>"

config PK_LM75A_WDOG_DPKCONFIG
	string "PKG_CONFIG_PATH: Directories to add to pkg-config's search path"

config PK_LM75A_WDOG_CFLAGS
	string "CFLAGS: C compiler flags"

config PK_LM75A_WDOG_LDFLAGS
	string "LDFLAGS: Linker flags"

config PK_LM75A_WDOG_CXXFLAGS
	string "CXXFLAGS: C++ compiler flags"

config PK_LM75A_WDOG_ASFLAGS
	string "CCASFLAGS: assembler compiler flags (defaults to CFLAGS)"

config PK_LM75A_WDOG_BUILDARCH
	string "--host options on configure for Architecture"

endif # PK_LM75A_WDOG
```

## package/i2c/pcf8574_app/Kconfig
```kconfig
menuconfig PK_PCF8574_APP
	bool "PCF8574 IO Expander Application"

if PK_PCF8574_APP

config PK_PCF8574_APP_VERSION
	default "0.0.1"
	string "verstion"

config PK_PCF8574_APP_TAR
	default "tar.gz"
	string "tar type"

config PK_PCF8574_APP_URL
	default "https://gitee.com/BiscuitOS_team/HardStack/raw/Gitee/Device-Driver/i2c/Device/PCF8574/Base/userland"
	string "url"

config PK_PCF8574_APP_GITHUB
	string "GitHub"

config PK_PCF8574_APP_SRCFILE
	default "pcf8574.c pcf8574.sh Makefile"
	string "Source code list"

config PK_PCF8574_APP_CSRCFILE
	string "Compile source code list"

config PK_PCF8574_APP_CONFIG
	string "CONFIG: Project Configure Options"

config PK_PCF8574_APP_LIBPATH
	string "LIBS: Libraries to pass to the linker, e.g. -l<library>"

config PK_PCF8574_APP_CPPFLAGS
	string "CPPFLAGS: C/C++ preprocessor flags, e.g. -I<include dir>"

config PK_PCF8574_APP_DPKCONFIG
	string "PKG_CONFIG_PATH: Directories to add to pkg-config's search path"

config PK_PCF8574_APP_CFLAGS
	string "CFLAGS: C compiler flags"

config PK_PCF8574_APP_LDFLAGS
	string "LDFLAGS: Linker flags"

config PK_PCF8574_APP_CXXFLAGS
	string "CXXFLAGS: C++ compiler flags"

config PK_PCF8574_APP_ASFLAGS
	string "CCASFLAGS: assembler compiler flags (defaults to CFLAGS)"

config PK_PCF8574_APP_BUILDARCH
	string "--host options on configure for Architecture"

endif # PK_PCF8574_APP
```

## package/i2c/pcf8574_err0/Kconfig
```kconfig
menuconfig PK_PCF8574_ERR0
	bool "PCF8574 Interrupt Error"

if PK_PCF8574_ERR0

config PK_PCF8574_ERR0_VERSION
	default "0.0.1"
	string "verstion"

config PK_PCF8574_ERR0_TAR
	default "tar.gz"
	string "tar type"

config PK_PCF8574_ERR0_URL
	default "https://gitee.com/BiscuitOS_team/HardStack/raw/Gitee/Device-Driver/i2c/Device/PCF8574/Error/intr_handler"
	string "url"

config PK_PCF8574_ERR0_GITHUB
	string "GitHub"

config PK_PCF8574_ERR0_SRCFILE
	default "pcf8574.c default.dts Kconfig Makefile Error_log.txt"
	string "Source code list"

config PK_PCF8574_ERR0_CSRCFILE
	string "Compile source code list"

config PK_PCF8574_ERR0_CONFIG
	string "CONFIG: Project Configure Options"

config PK_PCF8574_ERR0_LIBPATH
	string "LIBS: Libraries to pass to the linker, e.g. -l<library>"

config PK_PCF8574_ERR0_CPPFLAGS
	string "CPPFLAGS: C/C++ preprocessor flags, e.g. -I<include dir>"

config PK_PCF8574_ERR0_DPKCONFIG
	string "PKG_CONFIG_PATH: Directories to add to pkg-config's search path"

config PK_PCF8574_ERR0_CFLAGS
	string "CFLAGS: C compiler flags"

config PK_PCF8574_ERR0_LDFLAGS
	string "LDFLAGS: Linker flags"

config PK_PCF8574_ERR0_CXXFLAGS
	string "CXXFLAGS: C++ compiler flags"

config PK_PCF8574_ERR0_ASFLAGS
	string "CCASFLAGS: assembler compiler flags (defaults to CFLAGS)"

config PK_PCF8574_ERR0_BUILDARCH
	string "--host options on configure for Architecture"

endif # PK_PCF8574_ERR0
```

## package/i2c/pcf8574_intr_module/Kconfig
```kconfig
menuconfig PK_PCF8574_INTR_MOD
	bool "PCF8574 Interrupt Device Driver"

if PK_PCF8574_INTR_MOD

config PK_PCF8574_INTR_MOD_VERSION
	default "0.0.1"
	string "verstion"

config PK_PCF8574_INTR_MOD_TAR
	default "tar.gz"
	string "tar type"

config PK_PCF8574_INTR_MOD_URL
	default "https://gitee.com/BiscuitOS_team/HardStack/raw/Gitee/Device-Driver/i2c/Device/PCF8574/Interrupt/kernel"
	string "url"

config PK_PCF8574_INTR_MOD_GITHUB
	string "GitHub"

config PK_PCF8574_INTR_MOD_SRCFILE
	default "pcf8574.c default.dts Kconfig Makefile"
	string "Source code list"

config PK_PCF8574_INTR_MOD_CSRCFILE
	string "Compile source code list"

config PK_PCF8574_INTR_MOD_CONFIG
	string "CONFIG: Project Configure Options"

config PK_PCF8574_INTR_MOD_LIBPATH
	string "LIBS: Libraries to pass to the linker, e.g. -l<library>"

config PK_PCF8574_INTR_MOD_CPPFLAGS
	string "CPPFLAGS: C/C++ preprocessor flags, e.g. -I<include dir>"

config PK_PCF8574_INTR_MOD_DPKCONFIG
	string "PKG_CONFIG_PATH: Directories to add to pkg-config's search path"

config PK_PCF8574_INTR_MOD_CFLAGS
	string "CFLAGS: C compiler flags"

config PK_PCF8574_INTR_MOD_LDFLAGS
	string "LDFLAGS: Linker flags"

config PK_PCF8574_INTR_MOD_CXXFLAGS
	string "CXXFLAGS: C++ compiler flags"

config PK_PCF8574_INTR_MOD_ASFLAGS
	string "CCASFLAGS: assembler compiler flags (defaults to CFLAGS)"

config PK_PCF8574_INTR_MOD_BUILDARCH
	string "--host options on configure for Architecture"

endif # PK_PCF8574_INTR_MOD
```

## package/i2c/pcf8574_traffic/Kconfig
```kconfig
menuconfig PK_PCF8574_TRAFFIC
	bool "PCF8574 Traffic Light Application"

if PK_PCF8574_TRAFFIC

config PK_PCF8574_TRAFFIC_VERSION
	default "0.0.1"
	string "verstion"

config PK_PCF8574_TRAFFIC_TAR
	default "tar.gz"
	string "tar type"

config PK_PCF8574_TRAFFIC_URL
	default "https://gitee.com/BiscuitOS_team/HardStack/raw/Gitee/Device-Driver/i2c/Device/PCF8574/Traffic"
	string "url"

config PK_PCF8574_TRAFFIC_GITHUB
	string "GitHub"

config PK_PCF8574_TRAFFIC_SRCFILE
	default "traffic.c Makefile"
	string "Source code list"

config PK_PCF8574_TRAFFIC_CSRCFILE
	string "Compile source code list"

config PK_PCF8574_TRAFFIC_CONFIG
	string "CONFIG: Project Configure Options"

config PK_PCF8574_TRAFFIC_LIBPATH
	string "LIBS: Libraries to pass to the linker, e.g. -l<library>"

config PK_PCF8574_TRAFFIC_CPPFLAGS
	string "CPPFLAGS: C/C++ preprocessor flags, e.g. -I<include dir>"

config PK_PCF8574_TRAFFIC_DPKCONFIG
	string "PKG_CONFIG_PATH: Directories to add to pkg-config's search path"

config PK_PCF8574_TRAFFIC_CFLAGS
	string "CFLAGS: C compiler flags"

config PK_PCF8574_TRAFFIC_LDFLAGS
	string "LDFLAGS: Linker flags"

config PK_PCF8574_TRAFFIC_CXXFLAGS
	string "CXXFLAGS: C++ compiler flags"

config PK_PCF8574_TRAFFIC_ASFLAGS
	string "CCASFLAGS: assembler compiler flags (defaults to CFLAGS)"

config PK_PCF8574_TRAFFIC_BUILDARCH
	string "--host options on configure for Architecture"

endif # PK_PCF8574_TRAFFIC
```

## package/idr/DEFINE_IDR/Kconfig
```kconfig
menuconfig PK_DEFINE_IDR
	bool "DEFINE_IDR()"

if PK_DEFINE_IDR

config PK_DEFINE_IDR_VERSION
	default "0.0.1"
	string "verstion"

config PK_DEFINE_IDR_TAR
	default "tar.gz"
	string "tar type"

config PK_DEFINE_IDR_URL
	default "https://gitee.com/BiscuitOS_team/HardStack/raw/Gitee/Algorithem/IDR/API/DEFINE_IDR"
	string "url"

config PK_DEFINE_IDR_GITHUB
	string "GitHub"

config PK_DEFINE_IDR_SRCFILE
	default "idr.c Makefile README.md"
	string "Source code list"

config PK_DEFINE_IDR_CSRCFILE
	string "Compile source code list"

config PK_DEFINE_IDR_CONFIG
	string "CONFIG: Project Configure Options"

config PK_DEFINE_IDR_LIBPATH
	string "LIBS: Libraries to pass to the linker, e.g. -l<library>"

config PK_DEFINE_IDR_CPPFLAGS
	string "CPPFLAGS: C/C++ preprocessor flags, e.g. -I<include dir>"

config PK_DEFINE_IDR_DPKCONFIG
	string "PKG_CONFIG_PATH: Directories to add to pkg-config's search path"

config PK_DEFINE_IDR_CFLAGS
	string "CFLAGS: C compiler flags"

config PK_DEFINE_IDR_LDFLAGS
	string "LDFLAGS: Linker flags"

config PK_DEFINE_IDR_CXXFLAGS
	string "CXXFLAGS: C++ compiler flags"

config PK_DEFINE_IDR_ASFLAGS
	string "CCASFLAGS: assembler compiler flags (defaults to CFLAGS)"

config PK_DEFINE_IDR_BUILDARCH
	string "--host options on configure for Architecture"

endif # PK_DEFINE_IDR
```
