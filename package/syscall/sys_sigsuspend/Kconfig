## package/syscall/sys_sigsuspend/Kconfig
```kconfig
menuconfig PK_SYS_SIGSUSPEND
	bool "sys_sigsuspend"

if PK_SYS_SIGSUSPEND

# C sigsuspend
source "package/syscall/sys_sigsuspend/sigsuspend_common/Kconfig"

endif # PK_SYS_SIGSUSPEND
```

## package/syscall/sys_stat64/Kconfig
```kconfig
menuconfig PK_SYS_STAT64
	bool "sys_stat64"

if PK_SYS_STAT64

# C stat64
source "package/syscall/sys_stat64/stat64_common/Kconfig"

endif # PK_SYS_STAT64
```

## package/syscall/sys_statfs/Kconfig
```kconfig
menuconfig PK_SYS_STATFS
	bool "sys_statfs"

if PK_SYS_STATFS

# C statfs
source "package/syscall/sys_statfs/statfs_common/Kconfig"

endif # PK_SYS_STATFS
```

## package/syscall/sys_symlink/Kconfig
```kconfig
menuconfig PK_SYS_SYMLINK
	bool "sys_symlink"

if PK_SYS_SYMLINK

# C symlink
source "package/syscall/sys_symlink/symlink_common/Kconfig"

endif # PK_SYS_SYMLINK
```

## package/syscall/sys_sync/Kconfig
```kconfig
menuconfig PK_SYS_SYNC
	bool "sys_sync"

if PK_SYS_SYNC

# C sync
source "package/syscall/sys_sync/sync_common/Kconfig"

endif # PK_SYS_SYNC
```

## package/syscall/sys_sysinfo/Kconfig
```kconfig
menuconfig PK_SYS_SYSINFO
	bool "sys_sysinfo"

if PK_SYS_SYSINFO

# C sysinfo
source "package/syscall/sys_sysinfo/sysinfo_common/Kconfig"

endif # PK_SYS_SYSINFO
```

## package/syscall/sys_syslog/Kconfig
```kconfig
menuconfig PK_SYS_SYSLOG
	bool "sys_syslog"

if PK_SYS_SYSLOG

# C syslog
source "package/syscall/sys_syslog/syslog_common/Kconfig"

endif # PK_SYS_SYSLOG
```

## package/syscall/sys_times/Kconfig
```kconfig
menuconfig PK_SYS_TIMES
	bool "sys_times"

if PK_SYS_TIMES

# C times
source "package/syscall/sys_times/times_common/Kconfig"

endif # PK_SYS_TIMES
```

## package/syscall/sys_truncate/Kconfig
```kconfig
menuconfig PK_SYS_TRUNCATE
	bool "sys_truncate"

if PK_SYS_TRUNCATE

# C truncate
source "package/syscall/sys_truncate/truncate_common/Kconfig"

endif # PK_SYS_TRUNCATE
```

## package/syscall/sys_truncate64/Kconfig
```kconfig
menuconfig PK_SYS_TRUNCATE64
	bool "sys_truncate64"

if PK_SYS_TRUNCATE64

# C truncate64
source "package/syscall/sys_truncate64/truncate64_common/Kconfig"

endif # PK_SYS_TRUNCATE64
```

## package/syscall/sys_umask/Kconfig
```kconfig
menuconfig PK_SYS_UMASK
	bool "sys_umask"

if PK_SYS_UMASK

# C umask
source "package/syscall/sys_umask/umask_common/Kconfig"

endif # PK_SYS_UMASK
```

## package/syscall/sys_unlink/Kconfig
```kconfig
menuconfig PK_SYS_UNLINK
	bool "sys_unlink"

if PK_SYS_UNLINK

# C unlink
source "package/syscall/sys_unlink/unlink_common/Kconfig"

endif # PK_SYS_UNLINK
```

## package/syscall/sys_uselib/Kconfig
```kconfig
menuconfig PK_SYS_USELIB
	bool "sys_uselib"

if PK_SYS_USELIB

# C uselib
source "package/syscall/sys_uselib/uselib_common/Kconfig"

endif # PK_SYS_USELIB
```

## package/syscall/sys_ustat/Kconfig
```kconfig
menuconfig PK_SYS_USTAT
	bool "sys_ustat"

if PK_SYS_USTAT

# C ustat
source "package/syscall/sys_ustat/ustat_common/Kconfig"

endif # PK_SYS_USTAT
```

## package/syscall/sys_vfork/Kconfig
```kconfig
menuconfig PK_SYS_VFORK
	bool "sys_vfork"

if PK_SYS_VFORK

# C vfork
source "package/syscall/sys_vfork/vfork_common/Kconfig"

endif # PK_SYS_VFORK
```

## package/syscall/sys_vhangup/Kconfig
```kconfig
menuconfig PK_SYS_VHANGUP
	bool "sys_vhangup"

if PK_SYS_VHANGUP

# C vhangup
source "package/syscall/sys_vhangup/vhangup_common/Kconfig"

endif # PK_SYS_VHANGUP
```

## package/syscall/sys_write/Kconfig
```kconfig
menuconfig PK_SYS_WRITE
	bool "sys_write"

if PK_SYS_WRITE

# C write
source "package/syscall/sys_write/write_common/Kconfig"

endif # PK_SYS_WRITE
```

## package/syscall/sys_writev/Kconfig
```kconfig
menuconfig PK_SYS_WRITEV
	bool "sys_writev"

if PK_SYS_WRITEV

# C writev
source "package/syscall/sys_writev/writev_common/Kconfig"

endif # PK_SYS_WRITEV
```

## package/tcmalloc/BiscuitOS-TCMALLOC-APP/Kconfig
```kconfig
menuconfig PK_TCMALLOC_APP
	select PK_TCMALLOC_TOOLS
	bool "TCMALLOC ON APPLICATION"

if PK_TCMALLOC_APP

config PK_TCMALLOC_APP_VERSION
	default "default"
	string "verstion"

config PK_TCMALLOC_APP_TAR
	default "tar.gz"
	string "tar type"

config PK_TCMALLOC_APP_URL
	default "https://gitee.com/BiscuitOS_team/HardStack/raw/Gitee/Memory-Allocator/TCMALLOC-ALLOCATOR/BiscuitOS-TCMALLOC-APP"
	string "url"

config PK_TCMALLOC_APP_GITHUB
	string "GitHub"

config PK_TCMALLOC_APP_SRCFILE
	default "main.c Makefile RunBiscuitOS.sh"
	string "Source code list"

config PK_TCMALLOC_APP_CSRCFILE
	string "Compile source code list"

config PK_TCMALLOC_APP_CONFIG
	string "CONFIG: Project Configure Options"

config PK_TCMALLOC_APP_LIBPATH
	string "LIBS: Libraries to pass to the linker, e.g. -l<library>"

config PK_TCMALLOC_APP_CPPFLAGS
	string "CPPFLAGS: C/C++ preprocessor flags, e.g. -I<include dir>"

config PK_TCMALLOC_APP_DPKCONFIG
	string "PKG_CONFIG_PATH: Directories to add to pkg-config's search path"

config PK_TCMALLOC_APP_CFLAGS
	string "CFLAGS: C compiler flags"

config PK_TCMALLOC_APP_LDFLAGS
	string "LDFLAGS: Linker flags"

config PK_TCMALLOC_APP_CXXFLAGS
	string "CXXFLAGS: C++ compiler flags"

config PK_TCMALLOC_APP_ASFLAGS
	string "CCASFLAGS: assembler compiler flags (defaults to CFLAGS)"

config PK_TCMALLOC_APP_BUILDARCH
	string "--host options on configure for Architecture"

endif # PK_TCMALLOC_APP
```

## package/tcmalloc/Kconfig
```kconfig
menuconfig PK_TCMALLOC
	bool "tcmalloc: Thread-Caching Malloc"

if PK_TCMALLOC

# tcmalloc
source package/tcmalloc/tcmalloc/Kconfig

# TCMALLOC APP DEMO
source package/tcmalloc/BiscuitOS-TCMALLOC-APP/Kconfig

endif # PK_TCMALLOC
```

## package/tcmalloc/tcmalloc/Kconfig
```kconfig
menuconfig PK_TCMALLOC_TOOLS
	bool "tcmalloc tools"

if PK_TCMALLOC_TOOLS

config PK_TCMALLOC_TOOLS_VERSION
	default "default"
	string "verstion"

config PK_TCMALLOC_TOOLS_TAR
	default "tar.xz"
	string "tar type"

config PK_TCMALLOC_TOOLS_URL
	default ""
	string "url"

config PK_TCMALLOC_TOOLS_GITHUB
	default "https://gitee.com/mirrors/tcmalloc.git"
	string "GitHub"

config PK_TCMALLOC_TOOLS_SRCFILE
	string "Source code list"

config PK_TCMALLOC_TOOLS_CONFIG
	default "--enable-silent-rules"
	string "CONFIG: Project Configure Options"

config PK_TCMALLOC_TOOLS_LIBPATH
	string "LIBS: Libraries to pass to the linker, e.g. -l<library>"

config PK_TCMALLOC_TOOLS_CPPFLAGS
	string "CPPFLAGS: C/C++ preprocessor flags, e.g. -I<include dir>"

config PK_TCMALLOC_TOOLS_DPKCONFIG
	string "PKG_CONFIG_PATH: Directories to add to pkg-config's search path"

config PK_TCMALLOC_TOOLS_CFLAGS
	string "CFLAGS: C compiler flags"

config PK_TCMALLOC_TOOLS_LDFLAGS
	string "LDFLAGS: Linker flags"

config PK_TCMALLOC_TOOLS_CXXFLAGS
	string "CXXFLAGS: C++ compiler flags"

config PK_TCMALLOC_TOOLS_ASFLAGS
	string "CCASFLAGS: assembler compiler flags (defaults to CFLAGS)"

config PK_TCMALLOC_TOOLS_BUILDARCH
	default "x86_64-unknown-linux-gnu"
	string "--host options on configure for Architecture"

endif # PK_TCMALLOC_TOOLS
```

## package/tetris/Kconfig
```kconfig
menuconfig PK_TETRIS
	select PK_NCURSES
	bool "Game: tetris"

if PK_TETRIS

config PK_TETRIS_VERSION
	default "0.0.1"
	string "verstion"

config PK_TETRIS_TAR
	default "tar.gz"
	string "tar type"

config PK_TETRIS_URL
	default "https://gitee.com/BiscuitOS_team/HardStack/raw/Gitee/GAME/tetris"
	string "url"

config PK_TETRIS_GITHUB
	string "GitHub"

config PK_TETRIS_SRCFILE
	default "keys.h Makefile README.md settings.h tetris.c"
	string "Source code list"

config PK_TETRIS_CSRCFILE
	string "Compile source code list"

config PK_TETRIS_CONFIG
	string "CONFIG: Project Configure Options"

config PK_TETRIS_LIBPATH
	string "LIBS: Libraries to pass to the linker, e.g. -l<library>"

config PK_TETRIS_CPPFLAGS
	string "CPPFLAGS: C/C++ preprocessor flags, e.g. -I<include dir>"

config PK_TETRIS_DPKCONFIG
	string "PKG_CONFIG_PATH: Directories to add to pkg-config's search path"

config PK_TETRIS_CFLAGS
	string "CFLAGS: C compiler flags"

config PK_TETRIS_LDFLAGS
	string "LDFLAGS: Linker flags"

config PK_TETRIS_CXXFLAGS
	string "CXXFLAGS: C++ compiler flags"

config PK_TETRIS_ASFLAGS
	string "CCASFLAGS: assembler compiler flags (defaults to CFLAGS)"

config PK_TETRIS_BUILDARCH
	string "--host options on configure for Architecture"

endif # PK_TETRIS
```

## package/util-linux/Kconfig
```kconfig
menuconfig PK_UTIL_LINUX
	bool "util-linux"

if PK_UTIL_LINUX

config PK_UTIL_LINUX_VERSION
	default "2.30"
	string "verstion"

config PK_UTIL_LINUX_TAR
	default "tar.gz"
	string "tar type"

config PK_UTIL_LINUX_URL
	default "http://ftp.ntu.edu.tw/pub/linux/utils/util-linux/v2.30/"
	string "url"

config PK_UTIL_LINUX_GITHUB
	string "GitHub"

config PK_UTIL_LINUX_SRCFILE
	string "Source code list"

config PK_UTIL_LINUX_CONFIG
	default "--disable-all-programs --enable-shared --disable-static --enable-libmount --enable-libblkid --enable-silent-rules"
	string "CONFIG: Project Configure Options"

config PK_UTIL_LINUX_LIBPATH
	string "LIBS: Libraries to pass to the linker, e.g. -l<library>"

config PK_UTIL_LINUX_CPPFLAGS
	string "CPPFLAGS: C/C++ preprocessor flags, e.g. -I<include dir>"

config PK_UTIL_LINUX_DPKCONFIG
	string "PKG_CONFIG_PATH: Directories to add to pkg-config's search path"

config PK_UTIL_LINUX_CFLAGS
	string "CFLAGS: C compiler flags"

config PK_UTIL_LINUX_LDFLAGS
	string "LDFLAGS: Linker flags"

config PK_UTIL_LINUX_CXXFLAGS
	string "CXXFLAGS: C++ compiler flags"

config PK_UTIL_LINUX_ASFLAGS
	string "CCASFLAGS: assembler compiler flags (defaults to CFLAGS)"

config PK_UTIL_LINUX_BUILDARCH
	default "x86_64-unknown-linux-gnu"
	string "--host options on configure for Architecture"

endif # PK_UTIL_LINUX
```

## package/utils-linux/Kconfig
```kconfig
#
# kconfig for utils-linux
#
config PACKAGE_UTILS_LINUX
	bool "Utils for linux"
	help
	  util-linux is a standard package distributed by the 
	  Linux Kernel Organization for use as part of the Linux 
	  operating system. A fork, util-linux-ng—with ng meaning 
	  "next generation"—was created when development stalled, 
	  but as of January 2011 has been renamed back to util-linux, 
	  and is the official version of the package.
```

## package/videoproto/Kconfig
```kconfig
menuconfig PK_VIDEOPROTO
	bool "videoproto"

if PK_VIDEOPROTO

config PK_VIDEOPROTO_VERSION
	default "2.3.3"
	string "verstion"

config PK_VIDEOPROTO_TAR
	default "tar.gz"
	string "tar type"

config PK_VIDEOPROTO_URL
	default "https://www.x.org/releases/individual/proto/"
	string "url"

config PK_VIDEOPROTO_GITHUB
	string "GitHub"

config PK_VIDEOPROTO_SRCFILE
	string "Source code list"

config PK_VIDEOPROTO_CONFIG
	default "--disable-static"
	string "CONFIG: Project Configure Options"

config PK_VIDEOPROTO_LIBPATH
	string "LIBS: Libraries to pass to the linker, e.g. -l<library>"

config PK_VIDEOPROTO_CPPFLAGS
	string "CPPFLAGS: C/C++ preprocessor flags, e.g. -I<include dir>"

config PK_VIDEOPROTO_DPKCONFIG
	string "PKG_CONFIG_PATH: Directories to add to pkg-config's search path"

config PK_VIDEOPROTO_CFLAGS
	string "CFLAGS: C compiler flags"

config PK_VIDEOPROTO_LDFLAGS
	string "LDFLAGS: Linker flags"

config PK_VIDEOPROTO_CXXFLAGS
	string "CXXFLAGS: C++ compiler flags"

config PK_VIDEOPROTO_ASFLAGS
	string "CCASFLAGS: assembler compiler flags (defaults to CFLAGS)"

config PK_VIDEOPROTO_BUILDARCH
	default "x86_64-unknown-linux-gnu"
	string "--host options on configure for Architecture"

endif # PK_VIDEOPROTO
```
