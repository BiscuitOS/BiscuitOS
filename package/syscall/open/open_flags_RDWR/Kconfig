## package/syscall/open/open_flags_RDWR/Kconfig
```kconfig
menuconfig PK_OPEN_FLAGS_RDWR
	select PK_OPEN_KAPI
	bool "open flags: O_RDWR"

if PK_OPEN_FLAGS_RDWR

config PK_OPEN_FLAGS_RDWR_VERSION
	default "0.0.1"
	string "verstion"

config PK_OPEN_FLAGS_RDWR_TAR
	default "tar.gz"
	string "tar type"

config PK_OPEN_FLAGS_RDWR_URL
	default "https://gitee.com/BiscuitOS_team/HardStack/raw/Gitee/SystemCall/arm/open/flags/O_RDWR"
	string "url"

config PK_OPEN_FLAGS_RDWR_GITHUB
	string "GitHub"

config PK_OPEN_FLAGS_RDWR_SRCFILE
	default "open.c Makefile"
	string "Source code list"

config PK_OPEN_FLAGS_RDWR_CSRCFILE
	string "Compile source code list"

config PK_OPEN_FLAGS_RDWR_CONFIG
	string "CONFIG: Project Configure Options"

config PK_OPEN_FLAGS_RDWR_LIBPATH
	string "LIBS: Libraries to pass to the linker, e.g. -l<library>"

config PK_OPEN_FLAGS_RDWR_CPPFLAGS
	string "CPPFLAGS: C/C++ preprocessor flags, e.g. -I<include dir>"

config PK_OPEN_FLAGS_RDWR_DPKCONFIG
	string "PKG_CONFIG_PATH: Directories to add to pkg-config's search path"

config PK_OPEN_FLAGS_RDWR_CFLAGS
	string "CFLAGS: C compiler flags"

config PK_OPEN_FLAGS_RDWR_LDFLAGS
	string "LDFLAGS: Linker flags"

config PK_OPEN_FLAGS_RDWR_CXXFLAGS
	string "CXXFLAGS: C++ compiler flags"

config PK_OPEN_FLAGS_RDWR_ASFLAGS
	string "CCASFLAGS: assembler compiler flags (defaults to CFLAGS)"

config PK_OPEN_FLAGS_RDWR_BUILDARCH
	string "--host options on configure for Architecture"

endif # PK_OPEN_FLAGS_RDWR
```

## package/syscall/open/open_flags_TMPFILE/Kconfig
```kconfig
menuconfig PK_OPEN_FLAGS_TMPFILE
	select PK_OPEN_KAPI
	bool "open flags: O_TMPFILE/__O_TMPFILE"

if PK_OPEN_FLAGS_TMPFILE

config PK_OPEN_FLAGS_TMPFILE_VERSION
	default "0.0.1"
	string "verstion"

config PK_OPEN_FLAGS_TMPFILE_TAR
	default "tar.gz"
	string "tar type"

config PK_OPEN_FLAGS_TMPFILE_URL
	default "https://gitee.com/BiscuitOS_team/HardStack/raw/Gitee/SystemCall/arm/open/flags/O_TMPFILE"
	string "url"

config PK_OPEN_FLAGS_TMPFILE_GITHUB
	string "GitHub"

config PK_OPEN_FLAGS_TMPFILE_SRCFILE
	default "open.c open-bs.c Makefile"
	string "Source code list"

config PK_OPEN_FLAGS_TMPFILE_CSRCFILE
	string "Compile source code list"

config PK_OPEN_FLAGS_TMPFILE_CONFIG
	string "CONFIG: Project Configure Options"

config PK_OPEN_FLAGS_TMPFILE_LIBPATH
	string "LIBS: Libraries to pass to the linker, e.g. -l<library>"

config PK_OPEN_FLAGS_TMPFILE_CPPFLAGS
	string "CPPFLAGS: C/C++ preprocessor flags, e.g. -I<include dir>"

config PK_OPEN_FLAGS_TMPFILE_DPKCONFIG
	string "PKG_CONFIG_PATH: Directories to add to pkg-config's search path"

config PK_OPEN_FLAGS_TMPFILE_CFLAGS
	string "CFLAGS: C compiler flags"

config PK_OPEN_FLAGS_TMPFILE_LDFLAGS
	string "LDFLAGS: Linker flags"

config PK_OPEN_FLAGS_TMPFILE_CXXFLAGS
	string "CXXFLAGS: C++ compiler flags"

config PK_OPEN_FLAGS_TMPFILE_ASFLAGS
	string "CCASFLAGS: assembler compiler flags (defaults to CFLAGS)"

config PK_OPEN_FLAGS_TMPFILE_BUILDARCH
	string "--host options on configure for Architecture"

endif # PK_OPEN_FLAGS_TMPFILE
```

## package/syscall/open/open_flags_WRONLY/Kconfig
```kconfig
menuconfig PK_OPEN_FLAGS_WRONLY
	select PK_OPEN_KAPI
	bool "open flags: O_WRONLY"

if PK_OPEN_FLAGS_WRONLY

config PK_OPEN_FLAGS_WRONLY_VERSION
	default "0.0.1"
	string "verstion"

config PK_OPEN_FLAGS_WRONLY_TAR
	default "tar.gz"
	string "tar type"

config PK_OPEN_FLAGS_WRONLY_URL
	default "https://gitee.com/BiscuitOS_team/HardStack/raw/Gitee/SystemCall/arm/open/flags/O_WRONLY"
	string "url"

config PK_OPEN_FLAGS_WRONLY_GITHUB
	string "GitHub"

config PK_OPEN_FLAGS_WRONLY_SRCFILE
	default "open.c Makefile"
	string "Source code list"

config PK_OPEN_FLAGS_WRONLY_CSRCFILE
	string "Compile source code list"

config PK_OPEN_FLAGS_WRONLY_CONFIG
	string "CONFIG: Project Configure Options"

config PK_OPEN_FLAGS_WRONLY_LIBPATH
	string "LIBS: Libraries to pass to the linker, e.g. -l<library>"

config PK_OPEN_FLAGS_WRONLY_CPPFLAGS
	string "CPPFLAGS: C/C++ preprocessor flags, e.g. -I<include dir>"

config PK_OPEN_FLAGS_WRONLY_DPKCONFIG
	string "PKG_CONFIG_PATH: Directories to add to pkg-config's search path"

config PK_OPEN_FLAGS_WRONLY_CFLAGS
	string "CFLAGS: C compiler flags"

config PK_OPEN_FLAGS_WRONLY_LDFLAGS
	string "LDFLAGS: Linker flags"

config PK_OPEN_FLAGS_WRONLY_CXXFLAGS
	string "CXXFLAGS: C++ compiler flags"

config PK_OPEN_FLAGS_WRONLY_ASFLAGS
	string "CCASFLAGS: assembler compiler flags (defaults to CFLAGS)"

config PK_OPEN_FLAGS_WRONLY_BUILDARCH
	string "--host options on configure for Architecture"

endif # PK_OPEN_FLAGS_WRONLY
```

## package/syscall/open/open_pathlen/Kconfig
```kconfig
menuconfig PK_OPEN_PATHLEN
	select PK_OPEN_KAPI
	bool "open: path length"

if PK_OPEN_PATHLEN

config PK_OPEN_PATHLEN_VERSION
	default "0.0.1"
	string "verstion"

config PK_OPEN_PATHLEN_TAR
	default "tar.gz"
	string "tar type"

config PK_OPEN_PATHLEN_URL
	default "https://gitee.com/BiscuitOS_team/HardStack/raw/Gitee/SystemCall/arm/open/pathlen"
	string "url"

config PK_OPEN_PATHLEN_GITHUB
	string "GitHub"

config PK_OPEN_PATHLEN_SRCFILE
	default "open.c Makefile"
	string "Source code list"

config PK_OPEN_PATHLEN_CSRCFILE
	string "Compile source code list"

config PK_OPEN_PATHLEN_CONFIG
	string "CONFIG: Project Configure Options"

config PK_OPEN_PATHLEN_LIBPATH
	string "LIBS: Libraries to pass to the linker, e.g. -l<library>"

config PK_OPEN_PATHLEN_CPPFLAGS
	string "CPPFLAGS: C/C++ preprocessor flags, e.g. -I<include dir>"

config PK_OPEN_PATHLEN_DPKCONFIG
	string "PKG_CONFIG_PATH: Directories to add to pkg-config's search path"

config PK_OPEN_PATHLEN_CFLAGS
	string "CFLAGS: C compiler flags"

config PK_OPEN_PATHLEN_LDFLAGS
	string "LDFLAGS: Linker flags"

config PK_OPEN_PATHLEN_CXXFLAGS
	string "CXXFLAGS: C++ compiler flags"

config PK_OPEN_PATHLEN_ASFLAGS
	string "CCASFLAGS: assembler compiler flags (defaults to CFLAGS)"

config PK_OPEN_PATHLEN_BUILDARCH
	string "--host options on configure for Architecture"

endif # PK_OPEN_PATHLEN
```

## package/syscall/open_kapi/Kconfig
```kconfig
menuconfig PK_OPEN_KAPI
	bool "open: kernel"

if PK_OPEN_KAPI

config PK_OPEN_KAPI_VERSION
	default "0.0.1"
	string "verstion"

config PK_OPEN_KAPI_TAR
	default "tar.gz"
	string "tar type"

config PK_OPEN_KAPI_URL
	default "https://gitee.com/BiscuitOS_team/HardStack/raw/Gitee/SystemCall/arm/open/kernel"
	string "url"

config PK_OPEN_KAPI_GITHUB
	string "GitHub"

config PK_OPEN_KAPI_SRCFILE
	default "open.c Kconfig Makefile 0000-syscall-add-open.patch"
	string "Source code list"

config PK_OPEN_KAPI_CSRCFILE
	string "Compile source code list"

config PK_OPEN_KAPI_CONFIG
	string "CONFIG: Project Configure Options"

config PK_OPEN_KAPI_LIBPATH
	string "LIBS: Libraries to pass to the linker, e.g. -l<library>"

config PK_OPEN_KAPI_CPPFLAGS
	string "CPPFLAGS: C/C++ preprocessor flags, e.g. -I<include dir>"

config PK_OPEN_KAPI_DPKCONFIG
	string "PKG_CONFIG_PATH: Directories to add to pkg-config's search path"

config PK_OPEN_KAPI_CFLAGS
	string "CFLAGS: C compiler flags"

config PK_OPEN_KAPI_LDFLAGS
	string "LDFLAGS: Linker flags"

config PK_OPEN_KAPI_CXXFLAGS
	string "CXXFLAGS: C++ compiler flags"

config PK_OPEN_KAPI_ASFLAGS
	string "CCASFLAGS: assembler compiler flags (defaults to CFLAGS)"

config PK_OPEN_KAPI_BUILDARCH
	string "--host options on configure for Architecture"

endif # PK_OPEN_KAPI
```

## package/syscall/open_uapi/Kconfig
```kconfig
menuconfig PK_OPEN_UAPI
	select PK_OPEN_KAPI
	bool "open: userspace"

if PK_OPEN_UAPI

config PK_OPEN_UAPI_VERSION
	default "0.0.1"
	string "verstion"

config PK_OPEN_UAPI_TAR
	default "tar.gz"
	string "tar type"

config PK_OPEN_UAPI_URL
	default "https://gitee.com/BiscuitOS_team/HardStack/raw/Gitee/SystemCall/arm/open/userland"
	string "url"

config PK_OPEN_UAPI_GITHUB
	string "GitHub"

config PK_OPEN_UAPI_SRCFILE
	default "open.c Makefile"
	string "Source code list"

config PK_OPEN_UAPI_CSRCFILE
	string "Compile source code list"

config PK_OPEN_UAPI_CONFIG
	string "CONFIG: Project Configure Options"

config PK_OPEN_UAPI_LIBPATH
	string "LIBS: Libraries to pass to the linker, e.g. -l<library>"

config PK_OPEN_UAPI_CPPFLAGS
	string "CPPFLAGS: C/C++ preprocessor flags, e.g. -I<include dir>"

config PK_OPEN_UAPI_DPKCONFIG
	string "PKG_CONFIG_PATH: Directories to add to pkg-config's search path"

config PK_OPEN_UAPI_CFLAGS
	string "CFLAGS: C compiler flags"

config PK_OPEN_UAPI_LDFLAGS
	string "LDFLAGS: Linker flags"

config PK_OPEN_UAPI_CXXFLAGS
	string "CXXFLAGS: C++ compiler flags"

config PK_OPEN_UAPI_ASFLAGS
	string "CCASFLAGS: assembler compiler flags (defaults to CFLAGS)"

config PK_OPEN_UAPI_BUILDARCH
	string "--host options on configure for Architecture"

endif # PK_OPEN_UAPI
```

## package/syscall/sys_access/Kconfig
```kconfig
menuconfig PK_SYS_ACCESS
	bool "sys_access"

if PK_SYS_ACCESS

# C access
source "package/syscall/sys_access/access_common/Kconfig"

endif # PK_SYS_ACCESS
```

## package/syscall/sys_acct/Kconfig
```kconfig
menuconfig PK_SYS_ACCT
	bool "sys_acct"

if PK_SYS_ACCT

# C acct
source "package/syscall/sys_acct/acct_common/Kconfig"

endif # PK_SYS_ACCT
```

## package/syscall/sys_brk/Kconfig
```kconfig
menuconfig PK_SYS_BRK
	bool "sys_brk"

if PK_SYS_BRK

# C brk
source "package/syscall/sys_brk/brk_common/Kconfig"

endif # PK_SYS_BRK
```

## package/syscall/sys_chdir/Kconfig
```kconfig
menuconfig PK_SYS_CHDIR
	bool "sys_chdir"

if PK_SYS_CHDIR

# C chdir
source "package/syscall/sys_chdir/chdir_common/Kconfig"

endif # PK_SYS_CHDIR
```

## package/syscall/sys_chmod/Kconfig
```kconfig
menuconfig PK_SYS_CHMOD
	bool "sys_chmod"

if PK_SYS_CHMOD

# C chmod
source "package/syscall/sys_chmod/chmod_common/Kconfig"

endif # PK_SYS_CHMOD
```

## package/syscall/sys_chown16/Kconfig
```kconfig
menuconfig PK_SYS_CHOWN16
	bool "sys_chown16"

if PK_SYS_CHOWN16

# C chown16
source "package/syscall/sys_chown16/chown16_common/Kconfig"

endif # PK_SYS_CHOWN16
```

## package/syscall/sys_chroot/Kconfig
```kconfig
menuconfig PK_SYS_CHROOT
	bool "sys_chroot"

if PK_SYS_CHROOT

# C chroot
source "package/syscall/sys_chroot/chroot_common/Kconfig"

endif # PK_SYS_CHROOT
```

## package/syscall/sys_close/Kconfig
```kconfig
menuconfig PK_SYS_CLOSE
	bool "sys_close"

if PK_SYS_CLOSE

# C close
source "package/syscall/sys_close/close_common/Kconfig"

endif # PK_SYS_CLOSE
```

## package/syscall/sys_creat/Kconfig
```kconfig
menuconfig PK_SYS_CREAT
	bool "sys_creat"

if PK_SYS_CREAT

# C creat
source "package/syscall/sys_creat/creat_common/Kconfig"

endif # PK_SYS_CREAT
```

## package/syscall/sys_dup/Kconfig
```kconfig
menuconfig PK_SYS_DUP
	bool "sys_dup"

if PK_SYS_DUP

# C dup
source "package/syscall/sys_dup/dup_common/Kconfig"

endif # PK_SYS_DUP
```

## package/syscall/sys_dup2/Kconfig
```kconfig
menuconfig PK_SYS_DUP2
	bool "sys_dup2"

if PK_SYS_DUP2

# C dup2
source "package/syscall/sys_dup2/dup2_common/Kconfig"

endif # PK_SYS_DUP2
```

## package/syscall/sys_execve/Kconfig
```kconfig
menuconfig PK_SYS_EXECVE
	bool "sys_execve"

if PK_SYS_EXECVE

# C execve
source "package/syscall/sys_execve/execve_common/Kconfig"

endif # PK_SYS_EXECVE
```

## package/syscall/sys_exit/Kconfig
```kconfig
menuconfig PK_SYS_EXIT
	bool "sys_exit"

if PK_SYS_EXIT

# C exit
source "package/syscall/sys_exit/exit_common/Kconfig"

endif # PK_SYS_EXIT
```

## package/syscall/sys_fchdir/Kconfig
```kconfig
menuconfig PK_SYS_FCHDIR
	bool "sys_fchdir"

if PK_SYS_FCHDIR

# C fchdir
source "package/syscall/sys_fchdir/fchdir_common/Kconfig"

endif # PK_SYS_FCHDIR
```

## package/syscall/sys_fchmod/Kconfig
```kconfig
menuconfig PK_SYS_FCHMOD
	bool "sys_fchmod"

if PK_SYS_FCHMOD

# C fchmod
source "package/syscall/sys_fchmod/fchmod_common/Kconfig"

endif # PK_SYS_FCHMOD
```

## package/syscall/sys_fchown16/Kconfig
```kconfig
menuconfig PK_SYS_FCHOWN16
	bool "sys_fchown16"

if PK_SYS_FCHOWN16

# C fchown16
source "package/syscall/sys_fchown16/fchown16_common/Kconfig"

endif # PK_SYS_FCHOWN16
```

## package/syscall/sys_fcntl/Kconfig
```kconfig
menuconfig PK_SYS_FCNTL
	bool "sys_fcntl"

if PK_SYS_FCNTL

# C fcntl
source "package/syscall/sys_fcntl/fcntl_common/Kconfig"

endif # PK_SYS_FCNTL
```

## package/syscall/sys_fdatasync/Kconfig
```kconfig
menuconfig PK_SYS_FDATASYNC
	bool "sys_fdatasync"

if PK_SYS_FDATASYNC

# C fdatasync
source "package/syscall/sys_fdatasync/fdatasync_common/Kconfig"

endif # PK_SYS_FDATASYNC
```

## package/syscall/sys_flock/Kconfig
```kconfig
menuconfig PK_SYS_FLOCK
	bool "sys_flock"

if PK_SYS_FLOCK

# C flock
source "package/syscall/sys_flock/flock_common/Kconfig"

endif # PK_SYS_FLOCK
```
