## package/syscall/sys_setdomainname/Kconfig
```kconfig
menuconfig PK_SYS_SETDOMAINNAME
	bool "sys_setdomainname"

if PK_SYS_SETDOMAINNAME

# C setdomainname
source "package/syscall/sys_setdomainname/setdomainname_common/Kconfig"

endif # PK_SYS_SETDOMAINNAME
```

## package/syscall/sys_setfsgid16/Kconfig
```kconfig
menuconfig PK_SYS_SETFSGID16
	bool "sys_setfsgid16"

if PK_SYS_SETFSGID16

# C setfsgid16
source "package/syscall/sys_setfsgid16/setfsgid16_common/Kconfig"

endif # PK_SYS_SETFSGID16
```

## package/syscall/sys_setfsuid16/Kconfig
```kconfig
menuconfig PK_SYS_SETFSUID16
	bool "sys_setfsuid16"

if PK_SYS_SETFSUID16

# C setfsuid16
source "package/syscall/sys_setfsuid16/setfsuid16_common/Kconfig"

endif # PK_SYS_SETFSUID16
```

## package/syscall/sys_setgid/Kconfig
```kconfig
menuconfig PK_SYS_SETGID
	bool "sys_setgid"

if PK_SYS_SETGID

# C setgid
source "package/syscall/sys_setgid/setgid_common/Kconfig"

endif # PK_SYS_SETGID
```

## package/syscall/sys_setgid16/Kconfig
```kconfig
menuconfig PK_SYS_SETGID16
	bool "sys_setgid16"

if PK_SYS_SETGID16

# C setgid16
source "package/syscall/sys_setgid16/setgid16_common/Kconfig"

endif # PK_SYS_SETGID16
```

## package/syscall/sys_setgroups/Kconfig
```kconfig
menuconfig PK_SYS_SETGROUPS
	bool "sys_setgroups"

if PK_SYS_SETGROUPS

# C setgroups
source "package/syscall/sys_setgroups/setgroups_common/Kconfig"

endif # PK_SYS_SETGROUPS
```

## package/syscall/sys_setgroups16/Kconfig
```kconfig
menuconfig PK_SYS_SETGROUPS16
	bool "sys_setgroups16"

if PK_SYS_SETGROUPS16

# C setgroups16
source "package/syscall/sys_setgroups16/setgroups16_common/Kconfig"

endif # PK_SYS_SETGROUPS16
```

## package/syscall/sys_sethostname/Kconfig
```kconfig
menuconfig PK_SYS_SETHOSTNAME
	bool "sys_sethostname"

if PK_SYS_SETHOSTNAME

# C sethostname
source "package/syscall/sys_sethostname/sethostname_common/Kconfig"

endif # PK_SYS_SETHOSTNAME
```

## package/syscall/sys_setitimer/Kconfig
```kconfig
menuconfig PK_SYS_SETITIMER
	bool "sys_setitimer"

if PK_SYS_SETITIMER

# C setitimer
source "package/syscall/sys_setitimer/setitimer_common/Kconfig"

endif # PK_SYS_SETITIMER
```

## package/syscall/sys_setpgid/Kconfig
```kconfig
menuconfig PK_SYS_SETPGID
	bool "sys_setpgid"

if PK_SYS_SETPGID

# C setpgid
source "package/syscall/sys_setpgid/setpgid_common/Kconfig"

endif # PK_SYS_SETPGID
```

## package/syscall/sys_setpriority/Kconfig
```kconfig
menuconfig PK_SYS_SETPRIORITY
	bool "sys_setpriority"

if PK_SYS_SETPRIORITY

# C setpriority
source "package/syscall/sys_setpriority/setpriority_common/Kconfig"

endif # PK_SYS_SETPRIORITY
```

## package/syscall/sys_setregid/Kconfig
```kconfig
menuconfig PK_SYS_SETREGID
	bool "sys_setregid"

if PK_SYS_SETREGID

# C setregid
source "package/syscall/sys_setregid/setregid_common/Kconfig"

endif # PK_SYS_SETREGID
```

## package/syscall/sys_setregid16/Kconfig
```kconfig
menuconfig PK_SYS_SETREGID16
	bool "sys_setregid16"

if PK_SYS_SETREGID16

# C setregid16
source "package/syscall/sys_setregid16/setregid16_common/Kconfig"

endif # PK_SYS_SETREGID16
```

## package/syscall/sys_setresgid16/Kconfig
```kconfig
menuconfig PK_SYS_SETRESGID16
	bool "sys_setresgid16"

if PK_SYS_SETRESGID16

# C setresgid16
source "package/syscall/sys_setresgid16/setresgid16_common/Kconfig"

endif # PK_SYS_SETRESGID16
```

## package/syscall/sys_setresuid16/Kconfig
```kconfig
menuconfig PK_SYS_SETRESUID16
	bool "sys_setresuid16"

if PK_SYS_SETRESUID16

# C setresuid16
source "package/syscall/sys_setresuid16/setresuid16_common/Kconfig"

endif # PK_SYS_SETRESUID16
```

## package/syscall/sys_setreuid/Kconfig
```kconfig
menuconfig PK_SYS_SETREUID
	bool "sys_setreuid"

if PK_SYS_SETREUID

# C setreuid
source "package/syscall/sys_setreuid/setreuid_common/Kconfig"

endif # PK_SYS_SETREUID
```

## package/syscall/sys_setreuid16/Kconfig
```kconfig
menuconfig PK_SYS_SETREUID16
	bool "sys_setreuid16"

if PK_SYS_SETREUID16

# C setreuid16
source "package/syscall/sys_setreuid16/setreuid16_common/Kconfig"

endif # PK_SYS_SETREUID16
```

## package/syscall/sys_setrlimit/Kconfig
```kconfig
menuconfig PK_SYS_SETRLIMIT
	bool "sys_setrlimit"

if PK_SYS_SETRLIMIT

# C setrlimit
source "package/syscall/sys_setrlimit/setrlimit_common/Kconfig"

endif # PK_SYS_SETRLIMIT
```

## package/syscall/sys_setsid/Kconfig
```kconfig
menuconfig PK_SYS_SETSID
	bool "sys_setsid"

if PK_SYS_SETSID

# C setsid
source "package/syscall/sys_setsid/setsid_common/Kconfig"

endif # PK_SYS_SETSID
```

## package/syscall/sys_settimeofday/Kconfig
```kconfig
menuconfig PK_SYS_SETTIMEOFDAY
	bool "sys_settimeofday"

if PK_SYS_SETTIMEOFDAY

# C settimeofday
source "package/syscall/sys_settimeofday/settimeofday_common/Kconfig"

endif # PK_SYS_SETTIMEOFDAY
```

## package/syscall/sys_setuid/Kconfig
```kconfig
menuconfig PK_SYS_SETUID
	bool "sys_setuid"

if PK_SYS_SETUID

# C setuid
source "package/syscall/sys_setuid/setuid_common/Kconfig"

endif # PK_SYS_SETUID
```

## package/syscall/sys_setuid16/Kconfig
```kconfig
menuconfig PK_SYS_SETUID16
	bool "sys_setuid16"

if PK_SYS_SETUID16

# C setuid16
source "package/syscall/sys_setuid16/setuid16_common/Kconfig"

endif # PK_SYS_SETUID16
```

## package/syscall/sys_sigaction/Kconfig
```kconfig
menuconfig PK_SYS_SIGACTION
	bool "sys_sigaction"

if PK_SYS_SIGACTION

# C sigaction
source "package/syscall/sys_sigaction/sigaction_common/Kconfig"

endif # PK_SYS_SIGACTION
```

## package/syscall/sys_sigpending/Kconfig
```kconfig
menuconfig PK_SYS_SIGPENDING
	bool "sys_sigpending"

if PK_SYS_SIGPENDING

# C sigpending
source "package/syscall/sys_sigpending/sigpending_common/Kconfig"

endif # PK_SYS_SIGPENDING
```

## package/syscall/sys_sigprocmask/Kconfig
```kconfig
menuconfig PK_SYS_SIGPROCMASK
	bool "sys_sigprocmask"

if PK_SYS_SIGPROCMASK

# C sigprocmask
source "package/syscall/sys_sigprocmask/sigprocmask_common/Kconfig"

endif # PK_SYS_SIGPROCMASK
```
