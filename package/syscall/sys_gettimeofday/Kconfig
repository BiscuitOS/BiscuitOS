## package/syscall/sys_hello_BiscuitOS/SYSCALL_Pointer_common/Kconfig
```kconfig
menuconfig PK_SYS_SYSCALL_POINTER
	bool "Syscall paramenter: Pointer"
	select PK_STRACE

if PK_SYS_SYSCALL_POINTER

config PK_SYS_SYSCALL_POINTER_VERSION
	default "0.0.1"
	string "verstion"

config PK_SYS_SYSCALL_POINTER_TAR
	default "tar.gz"
	string "tar type"

config PK_SYS_SYSCALL_POINTER_URL
	default "https://gitee.com/BiscuitOS_team/HardStack/raw/Gitee/SystemCall/sys_hello_BiscuitOS/SYSCALL_Pointer_common"
	string "url"

config PK_SYS_SYSCALL_POINTER_GITHUB
	string "GitHub"

config PK_SYS_SYSCALL_POINTER_SRCFILE
	default "main.c Makefile BiscuitOS_syscall.c"
	string "Source code list"

config PK_SYS_SYSCALL_POINTER_CSRCFILE
	string "Compile source code list"

config PK_SYS_SYSCALL_POINTER_CONFIG
	string "CONFIG: Project Configure Options"

config PK_SYS_SYSCALL_POINTER_LIBPATH
	string "LIBS: Libraries to pass to the linker, e.g. -l<library>"

config PK_SYS_SYSCALL_POINTER_CPPFLAGS
	string "CPPFLAGS: C/C++ preprocessor flags, e.g. -I<include dir>"

config PK_SYS_SYSCALL_POINTER_DPKCONFIG
	string "PKG_CONFIG_PATH: Directories to add to pkg-config's search path"

config PK_SYS_SYSCALL_POINTER_CFLAGS
	string "CFLAGS: C compiler flags"

config PK_SYS_SYSCALL_POINTER_LDFLAGS
	string "LDFLAGS: Linker flags"

config PK_SYS_SYSCALL_POINTER_CXXFLAGS
	string "CXXFLAGS: C++ compiler flags"

config PK_SYS_SYSCALL_POINTER_ASFLAGS
	string "CCASFLAGS: assembler compiler flags (defaults to CFLAGS)"

config PK_SYS_SYSCALL_POINTER_BUILDARCH
	string "--host options on configure for Architecture"

endif # PK_SYS_SYSCALL_POINTER
```

## package/syscall/sys_hello_BiscuitOS/SYSCALL_Strings_common/Kconfig
```kconfig
menuconfig PK_SYS_SYSCALL_STRINGS
	bool "Syscall paramenter: Strings"

if PK_SYS_SYSCALL_STRINGS

config PK_SYS_SYSCALL_STRINGS_VERSION
	default "0.0.1"
	string "verstion"

config PK_SYS_SYSCALL_STRINGS_TAR
	default "tar.gz"
	string "tar type"

config PK_SYS_SYSCALL_STRINGS_URL
	default "https://gitee.com/BiscuitOS_team/HardStack/raw/Gitee/SystemCall/sys_hello_BiscuitOS/SYSCALL_Strings_common"
	string "url"

config PK_SYS_SYSCALL_STRINGS_GITHUB
	string "GitHub"

config PK_SYS_SYSCALL_STRINGS_SRCFILE
	default "main.c Makefile BiscuitOS_syscall.c"
	string "Source code list"

config PK_SYS_SYSCALL_STRINGS_CSRCFILE
	string "Compile source code list"

config PK_SYS_SYSCALL_STRINGS_CONFIG
	string "CONFIG: Project Configure Options"

config PK_SYS_SYSCALL_STRINGS_LIBPATH
	string "LIBS: Libraries to pass to the linker, e.g. -l<library>"

config PK_SYS_SYSCALL_STRINGS_CPPFLAGS
	string "CPPFLAGS: C/C++ preprocessor flags, e.g. -I<include dir>"

config PK_SYS_SYSCALL_STRINGS_DPKCONFIG
	string "PKG_CONFIG_PATH: Directories to add to pkg-config's search path"

config PK_SYS_SYSCALL_STRINGS_CFLAGS
	string "CFLAGS: C compiler flags"

config PK_SYS_SYSCALL_STRINGS_LDFLAGS
	string "LDFLAGS: Linker flags"

config PK_SYS_SYSCALL_STRINGS_CXXFLAGS
	string "CXXFLAGS: C++ compiler flags"

config PK_SYS_SYSCALL_STRINGS_ASFLAGS
	string "CCASFLAGS: assembler compiler flags (defaults to CFLAGS)"

config PK_SYS_SYSCALL_STRINGS_BUILDARCH
	string "--host options on configure for Architecture"

endif # PK_SYS_SYSCALL_STRINGS
```

## package/syscall/sys_ioctl/Kconfig
```kconfig
menuconfig PK_SYS_IOCTL
	bool "sys_ioctl"

if PK_SYS_IOCTL

# C ioctl
source "package/syscall/sys_ioctl/ioctl_common/Kconfig"

endif # PK_SYS_IOCTL
```

## package/syscall/sys_kill/Kconfig
```kconfig
menuconfig PK_SYS_KILL
	bool "sys_kill"

if PK_SYS_KILL

# C kill
source "package/syscall/sys_kill/kill_common/Kconfig"

endif # PK_SYS_KILL
```

## package/syscall/sys_lchown/Kconfig
```kconfig
menuconfig PK_SYS_LCHOWN
	bool "sys_lchown"

if PK_SYS_LCHOWN

# C lchown
source "package/syscall/sys_lchown/lchown_common/Kconfig"

endif # PK_SYS_LCHOWN
```

## package/syscall/sys_link/Kconfig
```kconfig
menuconfig PK_SYS_LINK
	bool "sys_link"

if PK_SYS_LINK

# C link
source "package/syscall/sys_link/link_common/Kconfig"

endif # PK_SYS_LINK
```

## package/syscall/sys_llseek/Kconfig
```kconfig
menuconfig PK_SYS_LLSEEK
	bool "sys_llseek"

if PK_SYS_LLSEEK

# C llseek
source "package/syscall/sys_llseek/llseek_common/Kconfig"

endif # PK_SYS_LLSEEK
```

## package/syscall/sys_lseek/Kconfig
```kconfig
menuconfig PK_SYS_LSEEK
	bool "sys_lseek"

if PK_SYS_LSEEK

# C lseek
source "package/syscall/sys_lseek/lseek_common/Kconfig"

endif # PK_SYS_LSEEK
```

## package/syscall/sys_lstat64/Kconfig
```kconfig
menuconfig PK_SYS_LSTAT64
	bool "sys_lstat64"

if PK_SYS_LSTAT64

# C lstat64
source "package/syscall/sys_lstat64/lstat64_common/Kconfig"

endif # PK_SYS_LSTAT64
```

## package/syscall/sys_mkdir/Kconfig
```kconfig
menuconfig PK_SYS_MKDIR
	bool "sys_mkdir"

if PK_SYS_MKDIR

# C mkdir
source "package/syscall/sys_mkdir/mkdir_common/Kconfig"

endif # PK_SYS_MKDIR
```

## package/syscall/sys_mknod/Kconfig
```kconfig
menuconfig PK_SYS_MKNOD
	bool "sys_mknod"

if PK_SYS_MKNOD

# C mknod
source "package/syscall/sys_mknod/mknod_common/Kconfig"

endif # PK_SYS_MKNOD
```

## package/syscall/sys_mlock/Kconfig
```kconfig
menuconfig PK_SYS_MLOCK
	bool "sys_mlock"

if PK_SYS_MLOCK

# C mlock
source "package/syscall/sys_mlock/mlock_common/Kconfig"

endif # PK_SYS_MLOCK
```

## package/syscall/sys_mlockall/Kconfig
```kconfig
menuconfig PK_SYS_MLOCKALL
	bool "sys_mlockall"

if PK_SYS_MLOCKALL

# C mlockall
source "package/syscall/sys_mlockall/mlockall_common/Kconfig"

endif # PK_SYS_MLOCKALL
```
