## package/syscall/sys_gettimeofday/Kconfig
```kconfig
menuconfig PK_SYS_GETTIMEOFDAY
	bool "sys_gettimeofday"

if PK_SYS_GETTIMEOFDAY

# C gettimeofday
source "package/syscall/sys_gettimeofday/gettimeofday_common/Kconfig"

endif # PK_SYS_GETTIMEOFDAY
```

## package/syscall/sys_getuid/Kconfig
```kconfig
menuconfig PK_SYS_GETUID
	bool "sys_getuid"

if PK_SYS_GETUID

# C getuid
source "package/syscall/sys_getuid/getuid_common/Kconfig"

endif # PK_SYS_GETUID
```

## package/syscall/sys_getuid16/Kconfig
```kconfig
menuconfig PK_SYS_GETUID16
	bool "sys_getuid16"

if PK_SYS_GETUID16

# C getuid16
source "package/syscall/sys_getuid16/getuid16_common/Kconfig"

endif # PK_SYS_GETUID16
```

## package/syscall/sys_hello_BiscuitOS/Kconfig
```kconfig
menuconfig PK_SYS_HELLO_BISCUITOS
	bool "sys_hello_BiscuitOS"
	select PK_STRACE

if PK_SYS_HELLO_BISCUITOS

# C debug_BiscuitOS
source "package/syscall/sys_hello_BiscuitOS/debug_BiscuitOS_common/Kconfig"

# C hello_BiscuitOS
source "package/syscall/sys_hello_BiscuitOS/hello_BiscuitOS_common/Kconfig"

# SYSCALL_DEFINE0
source "package/syscall/sys_hello_BiscuitOS/SYSCALL_DEFINE0_common/Kconfig"

# SYSCALL_DEFINE1
source "package/syscall/sys_hello_BiscuitOS/SYSCALL_DEFINE1_common/Kconfig"

# SYSCALL_DEFINE2
source "package/syscall/sys_hello_BiscuitOS/SYSCALL_DEFINE2_common/Kconfig"

# SYSCALL_DEFINE3
source "package/syscall/sys_hello_BiscuitOS/SYSCALL_DEFINE3_common/Kconfig"

# SYSCALL_DEFINE4
source "package/syscall/sys_hello_BiscuitOS/SYSCALL_DEFINE4_common/Kconfig"

# SYSCALL_DEFINE5
source "package/syscall/sys_hello_BiscuitOS/SYSCALL_DEFINE5_common/Kconfig"

# SYSCALL_DEFINE6
source "package/syscall/sys_hello_BiscuitOS/SYSCALL_DEFINE6_common/Kconfig"

# Paramenter: Array
source "package/syscall/sys_hello_BiscuitOS/SYSCALL_Array_common/Kconfig"

# Paramenter: Integer
source "package/syscall/sys_hello_BiscuitOS/SYSCALL_Integer_common/Kconfig"

# Paramenter: Pointer
source "package/syscall/sys_hello_BiscuitOS/SYSCALL_Pointer_common/Kconfig"

# Paramenter: Strings
source "package/syscall/sys_hello_BiscuitOS/SYSCALL_Strings_common/Kconfig"

endif # PK_SYS_HELLO_BISCUITOS
```

## package/syscall/sys_hello_BiscuitOS/SYSCALL_Array_common/Kconfig
```kconfig
menuconfig PK_SYS_SYSCALL_ARRAY
	bool "Syscall paramenter: Array"
	select PK_STRACE

if PK_SYS_SYSCALL_ARRAY

config PK_SYS_SYSCALL_ARRAY_VERSION
	default "0.0.1"
	string "verstion"

config PK_SYS_SYSCALL_ARRAY_TAR
	default "tar.gz"
	string "tar type"

config PK_SYS_SYSCALL_ARRAY_URL
	default "https://gitee.com/BiscuitOS_team/HardStack/raw/Gitee/SystemCall/sys_hello_BiscuitOS/SYSCALL_Array_common"
	string "url"

config PK_SYS_SYSCALL_ARRAY_GITHUB
	string "GitHub"

config PK_SYS_SYSCALL_ARRAY_SRCFILE
	default "main.c Makefile BiscuitOS_syscall.c"
	string "Source code list"

config PK_SYS_SYSCALL_ARRAY_CSRCFILE
	string "Compile source code list"

config PK_SYS_SYSCALL_ARRAY_CONFIG
	string "CONFIG: Project Configure Options"

config PK_SYS_SYSCALL_ARRAY_LIBPATH
	string "LIBS: Libraries to pass to the linker, e.g. -l<library>"

config PK_SYS_SYSCALL_ARRAY_CPPFLAGS
	string "CPPFLAGS: C/C++ preprocessor flags, e.g. -I<include dir>"

config PK_SYS_SYSCALL_ARRAY_DPKCONFIG
	string "PKG_CONFIG_PATH: Directories to add to pkg-config's search path"

config PK_SYS_SYSCALL_ARRAY_CFLAGS
	string "CFLAGS: C compiler flags"

config PK_SYS_SYSCALL_ARRAY_LDFLAGS
	string "LDFLAGS: Linker flags"

config PK_SYS_SYSCALL_ARRAY_CXXFLAGS
	string "CXXFLAGS: C++ compiler flags"

config PK_SYS_SYSCALL_ARRAY_ASFLAGS
	string "CCASFLAGS: assembler compiler flags (defaults to CFLAGS)"

config PK_SYS_SYSCALL_ARRAY_BUILDARCH
	string "--host options on configure for Architecture"

endif # PK_SYS_SYSCALL_ARRAY
```

## package/syscall/sys_hello_BiscuitOS/SYSCALL_DEFINE0_common/Kconfig
```kconfig
menuconfig PK_SYS_SYSCALL_DEFINE0
	bool "SYSCALL_DEFINE0(): Zero Paramenter"
	select PK_STRACE

if PK_SYS_SYSCALL_DEFINE0

config PK_SYS_SYSCALL_DEFINE0_VERSION
	default "0.0.1"
	string "verstion"

config PK_SYS_SYSCALL_DEFINE0_TAR
	default "tar.gz"
	string "tar type"

config PK_SYS_SYSCALL_DEFINE0_URL
	default "https://gitee.com/BiscuitOS_team/HardStack/raw/Gitee/SystemCall/sys_hello_BiscuitOS/SYSCALL_DEFINE0_common"
	string "url"

config PK_SYS_SYSCALL_DEFINE0_GITHUB
	string "GitHub"

config PK_SYS_SYSCALL_DEFINE0_SRCFILE
	default "main.c Makefile BiscuitOS_syscall.c"
	string "Source code list"

config PK_SYS_SYSCALL_DEFINE0_CSRCFILE
	string "Compile source code list"

config PK_SYS_SYSCALL_DEFINE0_CONFIG
	string "CONFIG: Project Configure Options"

config PK_SYS_SYSCALL_DEFINE0_LIBPATH
	string "LIBS: Libraries to pass to the linker, e.g. -l<library>"

config PK_SYS_SYSCALL_DEFINE0_CPPFLAGS
	string "CPPFLAGS: C/C++ preprocessor flags, e.g. -I<include dir>"

config PK_SYS_SYSCALL_DEFINE0_DPKCONFIG
	string "PKG_CONFIG_PATH: Directories to add to pkg-config's search path"

config PK_SYS_SYSCALL_DEFINE0_CFLAGS
	string "CFLAGS: C compiler flags"

config PK_SYS_SYSCALL_DEFINE0_LDFLAGS
	string "LDFLAGS: Linker flags"

config PK_SYS_SYSCALL_DEFINE0_CXXFLAGS
	string "CXXFLAGS: C++ compiler flags"

config PK_SYS_SYSCALL_DEFINE0_ASFLAGS
	string "CCASFLAGS: assembler compiler flags (defaults to CFLAGS)"

config PK_SYS_SYSCALL_DEFINE0_BUILDARCH
	string "--host options on configure for Architecture"

endif # PK_SYS_SYSCALL_DEFINE0
```

## package/syscall/sys_hello_BiscuitOS/SYSCALL_DEFINE1_common/Kconfig
```kconfig
menuconfig PK_SYS_SYSCALL_DEFINE1
	bool "SYSCALL_DEFINE1(): One Paramenter"
	select PK_STRACE

if PK_SYS_SYSCALL_DEFINE1

config PK_SYS_SYSCALL_DEFINE1_VERSION
	default "0.0.1"
	string "verstion"

config PK_SYS_SYSCALL_DEFINE1_TAR
	default "tar.gz"
	string "tar type"

config PK_SYS_SYSCALL_DEFINE1_URL
	default "https://gitee.com/BiscuitOS_team/HardStack/raw/Gitee/SystemCall/sys_hello_BiscuitOS/SYSCALL_DEFINE1_common"
	string "url"

config PK_SYS_SYSCALL_DEFINE1_GITHUB
	string "GitHub"

config PK_SYS_SYSCALL_DEFINE1_SRCFILE
	default "main.c Makefile BiscuitOS_syscall.c"
	string "Source code list"

config PK_SYS_SYSCALL_DEFINE1_CSRCFILE
	string "Compile source code list"

config PK_SYS_SYSCALL_DEFINE1_CONFIG
	string "CONFIG: Project Configure Options"

config PK_SYS_SYSCALL_DEFINE1_LIBPATH
	string "LIBS: Libraries to pass to the linker, e.g. -l<library>"

config PK_SYS_SYSCALL_DEFINE1_CPPFLAGS
	string "CPPFLAGS: C/C++ preprocessor flags, e.g. -I<include dir>"

config PK_SYS_SYSCALL_DEFINE1_DPKCONFIG
	string "PKG_CONFIG_PATH: Directories to add to pkg-config's search path"

config PK_SYS_SYSCALL_DEFINE1_CFLAGS
	string "CFLAGS: C compiler flags"

config PK_SYS_SYSCALL_DEFINE1_LDFLAGS
	string "LDFLAGS: Linker flags"

config PK_SYS_SYSCALL_DEFINE1_CXXFLAGS
	string "CXXFLAGS: C++ compiler flags"

config PK_SYS_SYSCALL_DEFINE1_ASFLAGS
	string "CCASFLAGS: assembler compiler flags (defaults to CFLAGS)"

config PK_SYS_SYSCALL_DEFINE1_BUILDARCH
	string "--host options on configure for Architecture"

endif # PK_SYS_SYSCALL_DEFINE1
```

## package/syscall/sys_hello_BiscuitOS/SYSCALL_DEFINE2_common/Kconfig
```kconfig
menuconfig PK_SYS_SYSCALL_DEFINE2
	bool "SYSCALL_DEFINE2(): Two Paramenter"
	select PK_STRACE

if PK_SYS_SYSCALL_DEFINE2

config PK_SYS_SYSCALL_DEFINE2_VERSION
	default "0.0.1"
	string "verstion"

config PK_SYS_SYSCALL_DEFINE2_TAR
	default "tar.gz"
	string "tar type"

config PK_SYS_SYSCALL_DEFINE2_URL
	default "https://gitee.com/BiscuitOS_team/HardStack/raw/Gitee/SystemCall/sys_hello_BiscuitOS/SYSCALL_DEFINE2_common"
	string "url"

config PK_SYS_SYSCALL_DEFINE2_GITHUB
	string "GitHub"

config PK_SYS_SYSCALL_DEFINE2_SRCFILE
	default "main.c Makefile BiscuitOS_syscall.c"
	string "Source code list"

config PK_SYS_SYSCALL_DEFINE2_CSRCFILE
	string "Compile source code list"

config PK_SYS_SYSCALL_DEFINE2_CONFIG
	string "CONFIG: Project Configure Options"

config PK_SYS_SYSCALL_DEFINE2_LIBPATH
	string "LIBS: Libraries to pass to the linker, e.g. -l<library>"

config PK_SYS_SYSCALL_DEFINE2_CPPFLAGS
	string "CPPFLAGS: C/C++ preprocessor flags, e.g. -I<include dir>"

config PK_SYS_SYSCALL_DEFINE2_DPKCONFIG
	string "PKG_CONFIG_PATH: Directories to add to pkg-config's search path"

config PK_SYS_SYSCALL_DEFINE2_CFLAGS
	string "CFLAGS: C compiler flags"

config PK_SYS_SYSCALL_DEFINE2_LDFLAGS
	string "LDFLAGS: Linker flags"

config PK_SYS_SYSCALL_DEFINE2_CXXFLAGS
	string "CXXFLAGS: C++ compiler flags"

config PK_SYS_SYSCALL_DEFINE2_ASFLAGS
	string "CCASFLAGS: assembler compiler flags (defaults to CFLAGS)"

config PK_SYS_SYSCALL_DEFINE2_BUILDARCH
	string "--host options on configure for Architecture"

endif # PK_SYS_SYSCALL_DEFINE2
```

## package/syscall/sys_hello_BiscuitOS/SYSCALL_DEFINE3_common/Kconfig
```kconfig
menuconfig PK_SYS_SYSCALL_DEFINE3
	bool "SYSCALL_DEFINE3(): Three Paramenter"

if PK_SYS_SYSCALL_DEFINE3

config PK_SYS_SYSCALL_DEFINE3_VERSION
	default "0.0.1"
	string "verstion"

config PK_SYS_SYSCALL_DEFINE3_TAR
	default "tar.gz"
	string "tar type"

config PK_SYS_SYSCALL_DEFINE3_URL
	default "https://gitee.com/BiscuitOS_team/HardStack/raw/Gitee/SystemCall/sys_hello_BiscuitOS/SYSCALL_DEFINE3_common"
	string "url"

config PK_SYS_SYSCALL_DEFINE3_GITHUB
	string "GitHub"

config PK_SYS_SYSCALL_DEFINE3_SRCFILE
	default "main.c Makefile BiscuitOS_syscall.c"
	string "Source code list"

config PK_SYS_SYSCALL_DEFINE3_CSRCFILE
	string "Compile source code list"

config PK_SYS_SYSCALL_DEFINE3_CONFIG
	string "CONFIG: Project Configure Options"

config PK_SYS_SYSCALL_DEFINE3_LIBPATH
	string "LIBS: Libraries to pass to the linker, e.g. -l<library>"

config PK_SYS_SYSCALL_DEFINE3_CPPFLAGS
	string "CPPFLAGS: C/C++ preprocessor flags, e.g. -I<include dir>"

config PK_SYS_SYSCALL_DEFINE3_DPKCONFIG
	string "PKG_CONFIG_PATH: Directories to add to pkg-config's search path"

config PK_SYS_SYSCALL_DEFINE3_CFLAGS
	string "CFLAGS: C compiler flags"

config PK_SYS_SYSCALL_DEFINE3_LDFLAGS
	string "LDFLAGS: Linker flags"

config PK_SYS_SYSCALL_DEFINE3_CXXFLAGS
	string "CXXFLAGS: C++ compiler flags"

config PK_SYS_SYSCALL_DEFINE3_ASFLAGS
	string "CCASFLAGS: assembler compiler flags (defaults to CFLAGS)"

config PK_SYS_SYSCALL_DEFINE3_BUILDARCH
	string "--host options on configure for Architecture"

endif # PK_SYS_SYSCALL_DEFINE3
```

## package/syscall/sys_hello_BiscuitOS/SYSCALL_DEFINE4_common/Kconfig
```kconfig
menuconfig PK_SYS_SYSCALL_DEFINE4
	bool "SYSCALL_DEFINE4(): Four Paramenter"

if PK_SYS_SYSCALL_DEFINE4

config PK_SYS_SYSCALL_DEFINE4_VERSION
	default "0.0.1"
	string "verstion"

config PK_SYS_SYSCALL_DEFINE4_TAR
	default "tar.gz"
	string "tar type"

config PK_SYS_SYSCALL_DEFINE4_URL
	default "https://gitee.com/BiscuitOS_team/HardStack/raw/Gitee/SystemCall/sys_hello_BiscuitOS/SYSCALL_DEFINE4_common"
	string "url"

config PK_SYS_SYSCALL_DEFINE4_GITHUB
	string "GitHub"

config PK_SYS_SYSCALL_DEFINE4_SRCFILE
	default "main.c Makefile BiscuitOS_syscall.c"
	string "Source code list"

config PK_SYS_SYSCALL_DEFINE4_CSRCFILE
	string "Compile source code list"

config PK_SYS_SYSCALL_DEFINE4_CONFIG
	string "CONFIG: Project Configure Options"

config PK_SYS_SYSCALL_DEFINE4_LIBPATH
	string "LIBS: Libraries to pass to the linker, e.g. -l<library>"

config PK_SYS_SYSCALL_DEFINE4_CPPFLAGS
	string "CPPFLAGS: C/C++ preprocessor flags, e.g. -I<include dir>"

config PK_SYS_SYSCALL_DEFINE4_DPKCONFIG
	string "PKG_CONFIG_PATH: Directories to add to pkg-config's search path"

config PK_SYS_SYSCALL_DEFINE4_CFLAGS
	string "CFLAGS: C compiler flags"

config PK_SYS_SYSCALL_DEFINE4_LDFLAGS
	string "LDFLAGS: Linker flags"

config PK_SYS_SYSCALL_DEFINE4_CXXFLAGS
	string "CXXFLAGS: C++ compiler flags"

config PK_SYS_SYSCALL_DEFINE4_ASFLAGS
	string "CCASFLAGS: assembler compiler flags (defaults to CFLAGS)"

config PK_SYS_SYSCALL_DEFINE4_BUILDARCH
	string "--host options on configure for Architecture"

endif # PK_SYS_SYSCALL_DEFINE4
```

## package/syscall/sys_hello_BiscuitOS/SYSCALL_DEFINE5_common/Kconfig
```kconfig
menuconfig PK_SYS_SYSCALL_DEFINE5
	bool "SYSCALL_DEFINE5(): Five Paramenter"
	select PK_STRACE

if PK_SYS_SYSCALL_DEFINE5

config PK_SYS_SYSCALL_DEFINE5_VERSION
	default "0.0.1"
	string "verstion"

config PK_SYS_SYSCALL_DEFINE5_TAR
	default "tar.gz"
	string "tar type"

config PK_SYS_SYSCALL_DEFINE5_URL
	default "https://gitee.com/BiscuitOS_team/HardStack/raw/Gitee/SystemCall/sys_hello_BiscuitOS/SYSCALL_DEFINE5_common"
	string "url"

config PK_SYS_SYSCALL_DEFINE5_GITHUB
	string "GitHub"

config PK_SYS_SYSCALL_DEFINE5_SRCFILE
	default "main.c Makefile BiscuitOS_syscall.c"
	string "Source code list"

config PK_SYS_SYSCALL_DEFINE5_CSRCFILE
	string "Compile source code list"

config PK_SYS_SYSCALL_DEFINE5_CONFIG
	string "CONFIG: Project Configure Options"

config PK_SYS_SYSCALL_DEFINE5_LIBPATH
	string "LIBS: Libraries to pass to the linker, e.g. -l<library>"

config PK_SYS_SYSCALL_DEFINE5_CPPFLAGS
	string "CPPFLAGS: C/C++ preprocessor flags, e.g. -I<include dir>"

config PK_SYS_SYSCALL_DEFINE5_DPKCONFIG
	string "PKG_CONFIG_PATH: Directories to add to pkg-config's search path"

config PK_SYS_SYSCALL_DEFINE5_CFLAGS
	string "CFLAGS: C compiler flags"

config PK_SYS_SYSCALL_DEFINE5_LDFLAGS
	string "LDFLAGS: Linker flags"

config PK_SYS_SYSCALL_DEFINE5_CXXFLAGS
	string "CXXFLAGS: C++ compiler flags"

config PK_SYS_SYSCALL_DEFINE5_ASFLAGS
	string "CCASFLAGS: assembler compiler flags (defaults to CFLAGS)"

config PK_SYS_SYSCALL_DEFINE5_BUILDARCH
	string "--host options on configure for Architecture"

endif # PK_SYS_SYSCALL_DEFINE5
```

## package/syscall/sys_hello_BiscuitOS/SYSCALL_Integer_common/Kconfig
```kconfig
menuconfig PK_SYS_SYSCALL_INTEGER
	bool "Syscall paramenter: Ineger"

if PK_SYS_SYSCALL_INTEGER

config PK_SYS_SYSCALL_INTEGER_VERSION
	default "0.0.1"
	string "verstion"

config PK_SYS_SYSCALL_INTEGER_TAR
	default "tar.gz"
	string "tar type"

config PK_SYS_SYSCALL_INTEGER_URL
	default "https://gitee.com/BiscuitOS_team/HardStack/raw/Gitee/SystemCall/sys_hello_BiscuitOS/SYSCALL_Integer_common"
	string "url"

config PK_SYS_SYSCALL_INTEGER_GITHUB
	string "GitHub"

config PK_SYS_SYSCALL_INTEGER_SRCFILE
	default "main.c Makefile BiscuitOS_syscall.c"
	string "Source code list"

config PK_SYS_SYSCALL_INTEGER_CSRCFILE
	string "Compile source code list"

config PK_SYS_SYSCALL_INTEGER_CONFIG
	string "CONFIG: Project Configure Options"

config PK_SYS_SYSCALL_INTEGER_LIBPATH
	string "LIBS: Libraries to pass to the linker, e.g. -l<library>"

config PK_SYS_SYSCALL_INTEGER_CPPFLAGS
	string "CPPFLAGS: C/C++ preprocessor flags, e.g. -I<include dir>"

config PK_SYS_SYSCALL_INTEGER_DPKCONFIG
	string "PKG_CONFIG_PATH: Directories to add to pkg-config's search path"

config PK_SYS_SYSCALL_INTEGER_CFLAGS
	string "CFLAGS: C compiler flags"

config PK_SYS_SYSCALL_INTEGER_LDFLAGS
	string "LDFLAGS: Linker flags"

config PK_SYS_SYSCALL_INTEGER_CXXFLAGS
	string "CXXFLAGS: C++ compiler flags"

config PK_SYS_SYSCALL_INTEGER_ASFLAGS
	string "CCASFLAGS: assembler compiler flags (defaults to CFLAGS)"

config PK_SYS_SYSCALL_INTEGER_BUILDARCH
	string "--host options on configure for Architecture"

endif # PK_SYS_SYSCALL_INTEGER
```
