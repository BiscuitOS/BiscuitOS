## package/syscall/sys_fork/Kconfig
```kconfig
menuconfig PK_SYS_FORK
	bool "sys_fork"

if PK_SYS_FORK

# C fork
source "package/syscall/sys_fork/fork_common/Kconfig"

endif # PK_SYS_FORK
```

## package/syscall/sys_fstat64/Kconfig
```kconfig
menuconfig PK_SYS_FSTAT64
	bool "sys_fstat64"

if PK_SYS_FSTAT64

# C fstat64
source "package/syscall/sys_fstat64/fstat64_common/Kconfig"

endif # PK_SYS_FSTAT64
```

## package/syscall/sys_fstatfs/Kconfig
```kconfig
menuconfig PK_SYS_FSTATFS
	bool "sys_fstatfs"

if PK_SYS_FSTATFS

# C fstatfs
source "package/syscall/sys_fstatfs/fstatfs_common/Kconfig"

endif # PK_SYS_FSTATFS
```

## package/syscall/sys_fsync/Kconfig
```kconfig
menuconfig PK_SYS_FSYNC
	bool "sys_fsync"

if PK_SYS_FSYNC

# C fsync
source "package/syscall/sys_fsync/fsync_common/Kconfig"

endif # PK_SYS_FSYNC
```

## package/syscall/sys_ftruncate/Kconfig
```kconfig
menuconfig PK_SYS_FTRUNCATE
	bool "sys_ftruncate"

if PK_SYS_FTRUNCATE

# C ftruncate
source "package/syscall/sys_ftruncate/ftruncate_common/Kconfig"

endif # PK_SYS_FTRUNCATE
```

## package/syscall/sys_ftruncate64/Kconfig
```kconfig
menuconfig PK_SYS_FTRUNCATE64
	bool "sys_ftruncate64"

if PK_SYS_FTRUNCATE64

# C ftruncate64
source "package/syscall/sys_ftruncate64/ftruncate64_common/Kconfig"

endif # PK_SYS_FTRUNCATE64
```

## package/syscall/sys_getcwd/Kconfig
```kconfig
menuconfig PK_SYS_GETCWD
	bool "sys_getcwd"

if PK_SYS_GETCWD

# C getcwd
source "package/syscall/sys_getcwd/getcwd_common/Kconfig"

endif # PK_SYS_GETCWD
```

## package/syscall/sys_getdents/Kconfig
```kconfig
menuconfig PK_SYS_GETDENTS
	bool "sys_getdents"

if PK_SYS_GETDENTS

# C getdents
source "package/syscall/sys_getdents/getdents_common/Kconfig"

endif # PK_SYS_GETDENTS
```

## package/syscall/sys_getegid/Kconfig
```kconfig
menuconfig PK_SYS_GETEGID
	bool "sys_getegid"

if PK_SYS_GETEGID

# C getegid
source "package/syscall/sys_getegid/getegid_common/Kconfig"

endif # PK_SYS_GETEGID
```

## package/syscall/sys_geteuid/Kconfig
```kconfig
menuconfig PK_SYS_GETEUID
	bool "sys_geteuid"

if PK_SYS_GETEUID

# C geteuid
source "package/syscall/sys_geteuid/geteuid_common/Kconfig"

endif # PK_SYS_GETEUID
```

## package/syscall/sys_getgid/Kconfig
```kconfig
menuconfig PK_SYS_GETGID
	bool "sys_getgid"

if PK_SYS_GETGID

# C getgid
source "package/syscall/sys_getgid/getgid_common/Kconfig"

endif # PK_SYS_GETGID
```

## package/syscall/sys_getgid16/Kconfig
```kconfig
menuconfig PK_SYS_GETGID16
	bool "sys_getgid16"

if PK_SYS_GETGID16

# C getgid16
source "package/syscall/sys_getgid16/getgid16_common/Kconfig"

endif # PK_SYS_GETGID16
```

## package/syscall/sys_getgroups/Kconfig
```kconfig
menuconfig PK_SYS_GETGROUPS
	bool "sys_getgroups"

if PK_SYS_GETGROUPS

# C getgroups
source "package/syscall/sys_getgroups/getgroups_common/Kconfig"

endif # PK_SYS_GETGROUPS
```

## package/syscall/sys_getgroups16/Kconfig
```kconfig
menuconfig PK_SYS_GETGROUPS16
	bool "sys_getgroups16"

if PK_SYS_GETGROUPS16

# C getgroups16
source "package/syscall/sys_getgroups16/getgroups16_common/Kconfig"

endif # PK_SYS_GETGROUPS16
```

## package/syscall/sys_getitimer/Kconfig
```kconfig
menuconfig PK_SYS_GETITIMER
	bool "sys_getitimer"

if PK_SYS_GETITIMER

# C getitimer
source "package/syscall/sys_getitimer/getitimer_common/Kconfig"

endif # PK_SYS_GETITIMER
```

## package/syscall/sys_getpgid/Kconfig
```kconfig
menuconfig PK_SYS_GETPGID
	bool "sys_getpgid"

if PK_SYS_GETPGID

# C getpgid
source "package/syscall/sys_getpgid/getpgid_common/Kconfig"

endif # PK_SYS_GETPGID
```

## package/syscall/sys_getpgrp/Kconfig
```kconfig
menuconfig PK_SYS_GETPGRP
	bool "sys_getpgrp"

if PK_SYS_GETPGRP

# C getpgrp
source "package/syscall/sys_getpgrp/getpgrp_common/Kconfig"

endif # PK_SYS_GETPGRP
```

## package/syscall/sys_getpid/Kconfig
```kconfig
menuconfig PK_SYS_GETPID
	bool "sys_getpid"

if PK_SYS_GETPID

# C getpid
source "package/syscall/sys_getpid/getpid_common/Kconfig"

endif # PK_SYS_GETPID
```

## package/syscall/sys_getppid/Kconfig
```kconfig
menuconfig PK_SYS_GETPPID
	bool "sys_getppid"

if PK_SYS_GETPPID

# C getppid
source "package/syscall/sys_getppid/getppid_common/Kconfig"

endif # PK_SYS_GETPPID
```

## package/syscall/sys_getpriority/Kconfig
```kconfig
menuconfig PK_SYS_GETPRIORITY
	bool "sys_getpriority"

if PK_SYS_GETPRIORITY

# C getpriority
source "package/syscall/sys_getpriority/getpriority_common/Kconfig"

endif # PK_SYS_GETPRIORITY
```

## package/syscall/sys_getresgid16/Kconfig
```kconfig
menuconfig PK_SYS_GETRESGID16
	bool "sys_getresgid16"

if PK_SYS_GETRESGID16

# C getresgid16
source "package/syscall/sys_getresgid16/getresgid16_common/Kconfig"

endif # PK_SYS_GETRESGID16
```

## package/syscall/sys_getresuid16/Kconfig
```kconfig
menuconfig PK_SYS_GETRESUID16
	bool "sys_getresuid16"

if PK_SYS_GETRESUID16

# C getresuid16
source "package/syscall/sys_getresuid16/getresuid16_common/Kconfig"

endif # PK_SYS_GETRESUID16
```

## package/syscall/sys_getrlimit/Kconfig
```kconfig
menuconfig PK_SYS_GETRLIMIT
	bool "sys_getrlimit"

if PK_SYS_GETRLIMIT

# C getrlimit
source "package/syscall/sys_getrlimit/getrlimit_common/Kconfig"

endif # PK_SYS_GETRLIMIT
```

## package/syscall/sys_getrusage/Kconfig
```kconfig
menuconfig PK_SYS_GETRUSAGE
	bool "sys_getrusage"

if PK_SYS_GETRUSAGE

# C getrusage
source "package/syscall/sys_getrusage/getrusage_common/Kconfig"

endif # PK_SYS_GETRUSAGE
```

## package/syscall/sys_getsid/Kconfig
```kconfig
menuconfig PK_SYS_GETSID
	bool "sys_getsid"

if PK_SYS_GETSID

# C getsid
source "package/syscall/sys_getsid/getsid_common/Kconfig"

endif # PK_SYS_GETSID
```
