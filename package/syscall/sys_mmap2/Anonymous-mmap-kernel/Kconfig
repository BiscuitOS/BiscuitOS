## package/syscall/sys_mmap2/Anonymous-mmap-kernel/Kconfig
```kconfig
menuconfig PK_SYS_MMAP_ANON_KERNEL
	bool "Anonymous mmap on Kernel"

if PK_SYS_MMAP_ANON_KERNEL

config PK_SYS_MMAP_ANON_KERNEL_VERSION
	default "0.0.1"
	string "verstion"

config PK_SYS_MMAP_ANON_KERNEL_TAR
	default "tar.gz"
	string "tar type"

config PK_SYS_MMAP_ANON_KERNEL_URL
	default "https://gitee.com/BiscuitOS_team/HardStack/raw/Gitee/SystemCall/sys_mmap2/anonymous_mmap_kernel"
	string "url"

config PK_SYS_MMAP_ANON_KERNEL_GITHUB
	string "GitHub"

config PK_SYS_MMAP_ANON_KERNEL_SRCFILE
	default "main.c Kconfig Makefile"
	string "Source code list"

config PK_SYS_MMAP_ANON_KERNEL_CSRCFILE
	string "Compile source code list"

config PK_SYS_MMAP_ANON_KERNEL_CONFIG
	string "CONFIG: Project Configure Options"

config PK_SYS_MMAP_ANON_KERNEL_LIBPATH
	string "LIBS: Libraries to pass to the linker, e.g. -l<library>"

config PK_SYS_MMAP_ANON_KERNEL_CPPFLAGS
	string "CPPFLAGS: C/C++ preprocessor flags, e.g. -I<include dir>"

config PK_SYS_MMAP_ANON_KERNEL_DPKCONFIG
	string "PKG_CONFIG_PATH: Directories to add to pkg-config's search path"

config PK_SYS_MMAP_ANON_KERNEL_CFLAGS
	string "CFLAGS: C compiler flags"

config PK_SYS_MMAP_ANON_KERNEL_LDFLAGS
	string "LDFLAGS: Linker flags"

config PK_SYS_MMAP_ANON_KERNEL_CXXFLAGS
	string "CXXFLAGS: C++ compiler flags"

config PK_SYS_MMAP_ANON_KERNEL_ASFLAGS
	string "CCASFLAGS: assembler compiler flags (defaults to CFLAGS)"

config PK_SYS_MMAP_ANON_KERNEL_BUILDARCH
	string "--host options on configure for Architecture"

endif # PK_SYS_MMAP_ANON_KERNEL
```

## package/syscall/sys_mmap2/Anonymous-mmap-userspace/Kconfig
```kconfig
menuconfig PK_SYS_MMAP_ANON_USER
	bool "Anonymous mmap on Userspace"

if PK_SYS_MMAP_ANON_USER

config PK_SYS_MMAP_ANON_USER_VERSION
	default "0.0.1"
	string "verstion"

config PK_SYS_MMAP_ANON_USER_TAR
	default "tar.gz"
	string "tar type"

config PK_SYS_MMAP_ANON_USER_URL
	default "https://gitee.com/BiscuitOS_team/HardStack/raw/Gitee/SystemCall/sys_mmap2/anonymous_mmap_userspace"
	string "url"

config PK_SYS_MMAP_ANON_USER_GITHUB
	string "GitHub"

config PK_SYS_MMAP_ANON_USER_SRCFILE
	default "main.c Makefile"
	string "Source code list"

config PK_SYS_MMAP_ANON_USER_CSRCFILE
	string "Compile source code list"

config PK_SYS_MMAP_ANON_USER_CONFIG
	string "CONFIG: Project Configure Options"

config PK_SYS_MMAP_ANON_USER_LIBPATH
	string "LIBS: Libraries to pass to the linker, e.g. -l<library>"

config PK_SYS_MMAP_ANON_USER_CPPFLAGS
	string "CPPFLAGS: C/C++ preprocessor flags, e.g. -I<include dir>"

config PK_SYS_MMAP_ANON_USER_DPKCONFIG
	string "PKG_CONFIG_PATH: Directories to add to pkg-config's search path"

config PK_SYS_MMAP_ANON_USER_CFLAGS
	string "CFLAGS: C compiler flags"

config PK_SYS_MMAP_ANON_USER_LDFLAGS
	string "LDFLAGS: Linker flags"

config PK_SYS_MMAP_ANON_USER_CXXFLAGS
	string "CXXFLAGS: C++ compiler flags"

config PK_SYS_MMAP_ANON_USER_ASFLAGS
	string "CCASFLAGS: assembler compiler flags (defaults to CFLAGS)"

config PK_SYS_MMAP_ANON_USER_BUILDARCH
	string "--host options on configure for Architecture"

endif # PK_SYS_MMAP_ANON_USER
```

## package/syscall/sys_mmap2/Kconfig
```kconfig
menuconfig PK_SYS_MMAP2
	bool "sys_mmap2"

if PK_SYS_MMAP2

# C mmap2
source "package/syscall/sys_mmap2/mmap2_common/Kconfig"

# Anonymous mmap on Userspace
source "package/syscall/sys_mmap2/Anonymous-mmap-userspace/Kconfig"

# Anonymous mmap on Kernel
source "package/syscall/sys_mmap2/Anonymous-mmap-kernel/Kconfig"

endif # PK_SYS_MMAP2
```

## package/syscall/sys_mount/Kconfig
```kconfig
menuconfig PK_SYS_MOUNT
	bool "sys_mount"

if PK_SYS_MOUNT

# C mount
source "package/syscall/sys_mount/mount_common/Kconfig"

endif # PK_SYS_MOUNT
```

## package/syscall/sys_mprotect/Kconfig
```kconfig
menuconfig PK_SYS_MPROTECT
	bool "sys_mprotect"

if PK_SYS_MPROTECT

# C mprotect
source "package/syscall/sys_mprotect/mprotect_common/Kconfig"

endif # PK_SYS_MPROTECT
```

## package/syscall/sys_munlock/Kconfig
```kconfig
menuconfig PK_SYS_MUNLOCK
	bool "sys_munlock"

if PK_SYS_MUNLOCK

# C munlock
source "package/syscall/sys_munlock/munlock_common/Kconfig"

endif # PK_SYS_MUNLOCK
```

## package/syscall/sys_munlockall/Kconfig
```kconfig
menuconfig PK_SYS_MUNLOCKALL
	bool "sys_munlockall"

if PK_SYS_MUNLOCKALL

# C munlockall
source "package/syscall/sys_munlockall/munlockall_common/Kconfig"

endif # PK_SYS_MUNLOCKALL
```

## package/syscall/sys_munmap/Kconfig
```kconfig
menuconfig PK_SYS_MUNMAP
	bool "sys_munmap"

if PK_SYS_MUNMAP

# C munmap
source "package/syscall/sys_munmap/munmap_common/Kconfig"

endif # PK_SYS_MUNMAP
```

## package/syscall/sys_newfstat/Kconfig
```kconfig
menuconfig PK_SYS_NEWFSTAT
	bool "sys_newfstat"

if PK_SYS_NEWFSTAT

# C newfstat
source "package/syscall/sys_newfstat/newfstat_common/Kconfig"

endif # PK_SYS_NEWFSTAT
```

## package/syscall/sys_newlstat/Kconfig
```kconfig
menuconfig PK_SYS_NEWLSTAT
	bool "sys_newlstat"

if PK_SYS_NEWLSTAT

# C newlstat
source "package/syscall/sys_newlstat/newlstat_common/Kconfig"

endif # PK_SYS_NEWLSTAT
```

## package/syscall/sys_newlstat/newlstat_common/Kconfig
```kconfig
menuconfig PK_SYS_NEWLSTAT_C
	bool "newlstat() in C"

if PK_SYS_NEWLSTAT_C

config PK_SYS_NEWLSTAT_C_VERSION
	default "0.0.1"
	string "verstion"

config PK_SYS_NEWLSTAT_C_TAR
	default "tar.gz"
	string "tar type"

config PK_SYS_NEWLSTAT_C_URL
	default "https://gitee.com/BiscuitOS_team/HardStack/raw/Gitee/SystemCall/sys_newlstat/newlstat_common"
	string "url"

config PK_SYS_NEWLSTAT_C_GITHUB
	string "GitHub"

config PK_SYS_NEWLSTAT_C_SRCFILE
	default "main.c Makefile"
	string "Source code list"

config PK_SYS_NEWLSTAT_C_CSRCFILE
	string "Compile source code list"

config PK_SYS_NEWLSTAT_C_CONFIG
	string "CONFIG: Project Configure Options"

config PK_SYS_NEWLSTAT_C_LIBPATH
	string "LIBS: Libraries to pass to the linker, e.g. -l<library>"

config PK_SYS_NEWLSTAT_C_CPPFLAGS
	string "CPPFLAGS: C/C++ preprocessor flags, e.g. -I<include dir>"

config PK_SYS_NEWLSTAT_C_DPKCONFIG
	string "PKG_CONFIG_PATH: Directories to add to pkg-config's search path"

config PK_SYS_NEWLSTAT_C_CFLAGS
	string "CFLAGS: C compiler flags"

config PK_SYS_NEWLSTAT_C_LDFLAGS
	string "LDFLAGS: Linker flags"

config PK_SYS_NEWLSTAT_C_CXXFLAGS
	string "CXXFLAGS: C++ compiler flags"

config PK_SYS_NEWLSTAT_C_ASFLAGS
	string "CCASFLAGS: assembler compiler flags (defaults to CFLAGS)"

config PK_SYS_NEWLSTAT_C_BUILDARCH
	string "--host options on configure for Architecture"

endif # PK_SYS_NEWLSTAT_C
```

## package/syscall/sys_newstat/Kconfig
```kconfig
menuconfig PK_SYS_NEWSTAT
	bool "sys_newstat"

if PK_SYS_NEWSTAT

# C newstat
source "package/syscall/sys_newstat/newstat_common/Kconfig"

endif # PK_SYS_NEWSTAT
```

## package/syscall/sys_newuname/Kconfig
```kconfig
menuconfig PK_SYS_NEWUNAME
	bool "sys_newuname"

if PK_SYS_NEWUNAME

# C newuname
source "package/syscall/sys_newuname/newuname_common/Kconfig"

endif # PK_SYS_NEWUNAME
```

## package/syscall/sys_nice/Kconfig
```kconfig
menuconfig PK_SYS_NICE
	bool "sys_nice"

if PK_SYS_NICE

# C nice
source "package/syscall/sys_nice/nice_common/Kconfig"

endif # PK_SYS_NICE
```

## package/syscall/sys_open/Kconfig
```kconfig
menuconfig PK_SYS_OPEN
	bool "sys_open"

if PK_SYS_OPEN

# C open
source "package/syscall/sys_open/open_common/Kconfig"

# getname
source "package/syscall/sys_open/getname_common/Kconfig"

# number
source "package/syscall/sys_open/number_open_common/Kconfig"

endif # PK_SYS_OPEN
```

## package/syscall/sys_open/getname_common/Kconfig
```kconfig
menuconfig PK_SYS_OPEN_GETNAME
	bool "getname(): Max open file name"
	select PK_STRACE

if PK_SYS_OPEN_GETNAME

config PK_SYS_OPEN_GETNAME_VERSION
	default "0.0.1"
	string "verstion"

config PK_SYS_OPEN_GETNAME_TAR
	default "tar.gz"
	string "tar type"

config PK_SYS_OPEN_GETNAME_URL
	default "https://gitee.com/BiscuitOS_team/HardStack/raw/Gitee/SystemCall/sys_open/getname_common"
	string "url"

config PK_SYS_OPEN_GETNAME_GITHUB
	string "GitHub"

config PK_SYS_OPEN_GETNAME_SRCFILE
	default "main.c Makefile"
	string "Source code list"

config PK_SYS_OPEN_GETNAME_CSRCFILE
	string "Compile source code list"

config PK_SYS_OPEN_GETNAME_CONFIG
	string "CONFIG: Project Configure Options"

config PK_SYS_OPEN_GETNAME_LIBPATH
	string "LIBS: Libraries to pass to the linker, e.g. -l<library>"

config PK_SYS_OPEN_GETNAME_CPPFLAGS
	string "CPPFLAGS: C/C++ preprocessor flags, e.g. -I<include dir>"

config PK_SYS_OPEN_GETNAME_DPKCONFIG
	string "PKG_CONFIG_PATH: Directories to add to pkg-config's search path"

config PK_SYS_OPEN_GETNAME_CFLAGS
	string "CFLAGS: C compiler flags"

config PK_SYS_OPEN_GETNAME_LDFLAGS
	string "LDFLAGS: Linker flags"

config PK_SYS_OPEN_GETNAME_CXXFLAGS
	string "CXXFLAGS: C++ compiler flags"

config PK_SYS_OPEN_GETNAME_ASFLAGS
	string "CCASFLAGS: assembler compiler flags (defaults to CFLAGS)"

config PK_SYS_OPEN_GETNAME_BUILDARCH
	string "--host options on configure for Architecture"

endif # PK_SYS_OPEN_GETNAME
```

## package/syscall/sys_open/number_open_common/Kconfig
```kconfig
menuconfig PK_SYS_OPEN_NUMBER
	bool "open number files"
	select PK_STRACE

if PK_SYS_OPEN_NUMBER

config PK_SYS_OPEN_NUMBER_VERSION
	default "0.0.1"
	string "verstion"

config PK_SYS_OPEN_NUMBER_TAR
	default "tar.gz"
	string "tar type"

config PK_SYS_OPEN_NUMBER_URL
	default "https://gitee.com/BiscuitOS_team/HardStack/raw/Gitee/SystemCall/sys_open/number_open_common"
	string "url"

config PK_SYS_OPEN_NUMBER_GITHUB
	string "GitHub"

config PK_SYS_OPEN_NUMBER_SRCFILE
	default "main.c Makefile"
	string "Source code list"

config PK_SYS_OPEN_NUMBER_CSRCFILE
	string "Compile source code list"

config PK_SYS_OPEN_NUMBER_CONFIG
	string "CONFIG: Project Configure Options"

config PK_SYS_OPEN_NUMBER_LIBPATH
	string "LIBS: Libraries to pass to the linker, e.g. -l<library>"

config PK_SYS_OPEN_NUMBER_CPPFLAGS
	string "CPPFLAGS: C/C++ preprocessor flags, e.g. -I<include dir>"

config PK_SYS_OPEN_NUMBER_DPKCONFIG
	string "PKG_CONFIG_PATH: Directories to add to pkg-config's search path"

config PK_SYS_OPEN_NUMBER_CFLAGS
	string "CFLAGS: C compiler flags"

config PK_SYS_OPEN_NUMBER_LDFLAGS
	string "LDFLAGS: Linker flags"

config PK_SYS_OPEN_NUMBER_CXXFLAGS
	string "CXXFLAGS: C++ compiler flags"

config PK_SYS_OPEN_NUMBER_ASFLAGS
	string "CCASFLAGS: assembler compiler flags (defaults to CFLAGS)"

config PK_SYS_OPEN_NUMBER_BUILDARCH
	string "--host options on configure for Architecture"

endif # PK_SYS_OPEN_NUMBER
```

## package/syscall/sys_pause/Kconfig
```kconfig
menuconfig PK_SYS_PAUSE
	bool "sys_pause"

if PK_SYS_PAUSE

# C pause
source "package/syscall/sys_pause/pause_common/Kconfig"

endif # PK_SYS_PAUSE
```

## package/syscall/sys_pipe/Kconfig
```kconfig
menuconfig PK_SYS_PIPE
	bool "sys_pipe"

if PK_SYS_PIPE

# C pipe
source "package/syscall/sys_pipe/pipe_common/Kconfig"

endif # PK_SYS_PIPE
```

## package/syscall/sys_read/Kconfig
```kconfig
menuconfig PK_SYS_READ
	bool "sys_read"

if PK_SYS_READ

# C read
source "package/syscall/sys_read/read_common/Kconfig"

endif # PK_SYS_READ
```

## package/syscall/sys_readlink/Kconfig
```kconfig
menuconfig PK_SYS_READLINK
	bool "sys_readlink"

if PK_SYS_READLINK

# C readlink
source "package/syscall/sys_readlink/readlink_common/Kconfig"

endif # PK_SYS_READLINK
```

## package/syscall/sys_readv/Kconfig
```kconfig
menuconfig PK_SYS_READV
	bool "sys_readv"

if PK_SYS_READV

# C readv
source "package/syscall/sys_readv/readv_common/Kconfig"

endif # PK_SYS_READV
```

## package/syscall/sys_reboot/Kconfig
```kconfig
menuconfig PK_SYS_REBOOT
	bool "sys_reboot"

if PK_SYS_REBOOT

# C reboot
source "package/syscall/sys_reboot/reboot_common/Kconfig"

endif # PK_SYS_REBOOT
```

## package/syscall/sys_rename/Kconfig
```kconfig
menuconfig PK_SYS_RENAME
	bool "sys_rename"

if PK_SYS_RENAME

# C rename
source "package/syscall/sys_rename/rename_common/Kconfig"

endif # PK_SYS_RENAME
```

## package/syscall/sys_rmdir/Kconfig
```kconfig
menuconfig PK_SYS_RMDIR
	bool "sys_rmdir"

if PK_SYS_RMDIR

# C rmdir
source "package/syscall/sys_rmdir/rmdir_common/Kconfig"

endif # PK_SYS_RMDIR
```
