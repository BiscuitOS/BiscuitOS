## package/kbproto/Kconfig
```kconfig
menuconfig PK_KBPROTO
	bool "kbproto"

if PK_KBPROTO

config PK_KBPROTO_VERSION
	default "1.0.7"
	string "verstion"

config PK_KBPROTO_TAR
	default "tar.gz"
	string "tar type"

config PK_KBPROTO_URL
	default "https://www.x.org/releases/individual/proto/"
	string "url"

config PK_KBPROTO_GITHUB
	string "GitHub"

config PK_KBPROTO_SRCFILE
	string "Source code list"

config PK_KBPROTO_CONFIG
	default "--enable-silent-rules --disable-static"
	string "CONFIG: Project Configure Options"

config PK_KBPROTO_LIBPATH
	string "LIBS: Libraries to pass to the linker, e.g. -l<library>"

config PK_KBPROTO_CPPFLAGS
	string "CPPFLAGS: C/C++ preprocessor flags, e.g. -I<include dir>"

config PK_KBPROTO_DPKCONFIG
	string "PKG_CONFIG_PATH: Directories to add to pkg-config's search path"

config PK_KBPROTO_CFLAGS
	string "CFLAGS: C compiler flags"

config PK_KBPROTO_LDFLAGS
	string "LDFLAGS: Linker flags"

config PK_KBPROTO_CXXFLAGS
	string "CXXFLAGS: C++ compiler flags"

config PK_KBPROTO_ASFLAGS
	string "CCASFLAGS: assembler compiler flags (defaults to CFLAGS)"

config PK_KBPROTO_BUILDARCH
	default "x86_64-unknown-linux-gnu"
	string "--host options on configure for Architecture"

endif # PK_KBPROTO
```

## package/kernel_hacking/Kconfig
```kconfig
menuconfig PK_KH
	bool "kernel hacking"

if PK_KH

# offsetof
source package/kernel_hacking/offsetof/Kconfig

endif # PK_KH
```

## package/kernel_hacking/offsetof/Kconfig
```kconfig
menuconfig PK_KH_OFFSETOF
	bool "offsetof"

if PK_KH_OFFSETOF

config PK_KH_OFFSETOF_VERSION
	default "0.0.1"
	string "verstion"

config PK_KH_OFFSETOF_TAR
	default "tar.gz"
	string "tar type"

config PK_KH_OFFSETOF_URL
	default "https://gitee.com/BiscuitOS_team/HardStack/raw/Gitee/Kernel_hacking/API/offsetof"
	string "url"

config PK_KH_OFFSETOF_GITHUB
	string "GitHub"

config PK_KH_OFFSETOF_SRCFILE
	default "core.c Kconfig Makefile"
	string "Source code list"

config PK_KH_OFFSETOF_CSRCFILE
	string "Compile source code list"

config PK_KH_OFFSETOF_CONFIG
	string "CONFIG: Project Configure Options"

config PK_KH_OFFSETOF_LIBPATH
	string "LIBS: Libraries to pass to the linker, e.g. -l<library>"

config PK_KH_OFFSETOF_CPPFLAGS
	string "CPPFLAGS: C/C++ preprocessor flags, e.g. -I<include dir>"

config PK_KH_OFFSETOF_DPKCONFIG
	string "PKG_CONFIG_PATH: Directories to add to pkg-config's search path"

config PK_KH_OFFSETOF_CFLAGS
	string "CFLAGS: C compiler flags"

config PK_KH_OFFSETOF_LDFLAGS
	string "LDFLAGS: Linker flags"

config PK_KH_OFFSETOF_CXXFLAGS
	string "CXXFLAGS: C++ compiler flags"

config PK_KH_OFFSETOF_ASFLAGS
	string "CCASFLAGS: assembler compiler flags (defaults to CFLAGS)"

config PK_KH_OFFSETOF_BUILDARCH
	string "--host options on configure for Architecture"

endif # PK_KH_OFFSETOF
```

## package/kexec-tools/Kconfig
```kconfig
menuconfig PK_KEXEC
	bool "kexec-tools"

if PK_KEXEC

config PK_KEXEC_VERSION
	default "2.0.22"
	string "verstion"

config PK_KEXEC_TAR
	default "tar.gz"
	string "tar type"

config PK_KEXEC_URL
	default "http://ftp.sjtu.edu.cn/sites/ftp.kernel.org/pub/linux/utils/kernel/kexec/"
	string "url"

config PK_KEXEC_GITHUB
	string "GitHub"

config PK_KEXEC_SRCFILE
	string "Source code list"

config PK_KEXEC_CONFIG
	default "--enable-silent-rules --disable-static"
	string "CONFIG: Project Configure Options"

config PK_KEXEC_LIBPATH
	string "LIBS: Libraries to pass to the linker, e.g. -l<library>"

config PK_KEXEC_CPPFLAGS
	string "CPPFLAGS: C/C++ preprocessor flags, e.g. -I<include dir>"

config PK_KEXEC_DPKCONFIG
	string "PKG_CONFIG_PATH: Directories to add to pkg-config's search path"

config PK_KEXEC_CFLAGS
	string "CFLAGS: C compiler flags"

config PK_KEXEC_LDFLAGS
	string "LDFLAGS: Linker flags"

config PK_KEXEC_CXXFLAGS
	string "CXXFLAGS: C++ compiler flags"

config PK_KEXEC_ASFLAGS
	string "CCASFLAGS: assembler compiler flags (defaults to CFLAGS)"

config PK_KEXEC_BUILDARCH
	default "x86_64-unknown-linux-gnu"
	string "--host options on configure for Architecture"

endif # PK_KEXEC
```

## package/kmap/Kconfig
```kconfig
menuconfig PK_KMAP
	bool "Kmap Memory Allocator"

if PK_KMAP

# fixmap on userspace
source package/kmap/fixmap_userspace/Kconfig

# kmap
source package/kmap/kmap/Kconfig

# kmap_atomic
source package/kmap/kmap_atomic/Kconfig

# kmap_atomic_pfn
source package/kmap/kmap_atomic_pfn/Kconfig

# kmap_to_page
source package/kmap/kmap_to_page/Kconfig

# kmap on userspace
source package/kmap/kmap_userspace/Kconfig

# kunmap
source package/kmap/kunmap/Kconfig

# kunmap_atomic
source package/kmap/kunmap_atomic/Kconfig

endif # PK_KMAP
```

## package/kmap/fixmap_userspace/Kconfig
```kconfig
menuconfig PK_FIXMAP_USERSPACE
	bool "Fixmap Memory Allocator on Userspace"

if PK_FIXMAP_USERSPACE

config PK_FIXMAP_USERSPACE_VERSION
	default "0.0.1"
	string "verstion"

config PK_FIXMAP_USERSPACE_TAR
	default "tar.gz"
	string "tar type"

config PK_FIXMAP_USERSPACE_URL
	default "https://gitee.com/BiscuitOS_team/HardStack/raw/Gitee/Memory-Allocator/Kmap/fixmap_userspace"
	string "url"

config PK_FIXMAP_USERSPACE_GITHUB
	string "GitHub"

config PK_FIXMAP_USERSPACE_SRCFILE
	default "main.c Makefile README.md include/linux/biscuitos.h include/linux/bitmap.h include/linux/buddy.h include/linux/getorder.h include/linux/gfp.h include/linux/highmem.h include/linux/list.h include/linux/pgtable.h include/linux/slub.h mm/buddy.c mm/highmem.c mm/kasprintf.c mm/pgtable.c mm/slub.c"
	string "Source code list"

config PK_FIXMAP_USERSPACE_CSRCFILE
	string "Compile source code list"

config PK_FIXMAP_USERSPACE_CONFIG
	string "CONFIG: Project Configure Options"

config PK_FIXMAP_USERSPACE_LIBPATH
	string "LIBS: Libraries to pass to the linker, e.g. -l<library>"

config PK_FIXMAP_USERSPACE_CPPFLAGS
	string "CPPFLAGS: C/C++ preprocessor flags, e.g. -I<include dir>"

config PK_FIXMAP_USERSPACE_DPKCONFIG
	string "PKG_CONFIG_PATH: Directories to add to pkg-config's search path"

config PK_FIXMAP_USERSPACE_CFLAGS
	string "CFLAGS: C compiler flags"

config PK_FIXMAP_USERSPACE_LDFLAGS
	string "LDFLAGS: Linker flags"

config PK_FIXMAP_USERSPACE_CXXFLAGS
	string "CXXFLAGS: C++ compiler flags"

config PK_FIXMAP_USERSPACE_ASFLAGS
	string "CCASFLAGS: assembler compiler flags (defaults to CFLAGS)"

config PK_FIXMAP_USERSPACE_BUILDARCH
	string "--host options on configure for Architecture"

endif # PK_FIXMAP_USERSPACE
```

## package/kmap/kmap/Kconfig
```kconfig
menuconfig PK_KMAP_F
	bool "kmap()"

if PK_KMAP_F

config PK_KMAP_F_VERSION
	default "0.0.1"
	string "verstion"

config PK_KMAP_F_TAR
	default "tar.gz"
	string "tar type"

config PK_KMAP_F_URL
	default "https://gitee.com/BiscuitOS_team/HardStack/raw/Gitee/Memory-Allocator/Kmap/kmap"
	string "url"

config PK_KMAP_F_GITHUB
	string "GitHub"

config PK_KMAP_F_SRCFILE
	default "core.c Makefile Kconfig"
	string "Source code list"

config PK_KMAP_F_CSRCFILE
	string "Compile source code list"

config PK_KMAP_F_CONFIG
	string "CONFIG: Project Configure Options"

config PK_KMAP_F_LIBPATH
	string "LIBS: Libraries to pass to the linker, e.g. -l<library>"

config PK_KMAP_F_CPPFLAGS
	string "CPPFLAGS: C/C++ preprocessor flags, e.g. -I<include dir>"

config PK_KMAP_F_DPKCONFIG
	string "PKG_CONFIG_PATH: Directories to add to pkg-config's search path"

config PK_KMAP_F_CFLAGS
	string "CFLAGS: C compiler flags"

config PK_KMAP_F_LDFLAGS
	string "LDFLAGS: Linker flags"

config PK_KMAP_F_CXXFLAGS
	string "CXXFLAGS: C++ compiler flags"

config PK_KMAP_F_ASFLAGS
	string "CCASFLAGS: assembler compiler flags (defaults to CFLAGS)"

config PK_KMAP_F_BUILDARCH
	string "--host options on configure for Architecture"

endif # PK_KMAP_F
```

## package/kmap/kmap_atomic/Kconfig
```kconfig
menuconfig PK_KMAP_ATOMIC
	bool "kmap_atomic()"

if PK_KMAP_ATOMIC

config PK_KMAP_ATOMIC_VERSION
	default "0.0.1"
	string "verstion"

config PK_KMAP_ATOMIC_TAR
	default "tar.gz"
	string "tar type"

config PK_KMAP_ATOMIC_URL
	default "https://gitee.com/BiscuitOS_team/HardStack/raw/Gitee/Memory-Allocator/Kmap/kmap_atomic"
	string "url"

config PK_KMAP_ATOMIC_GITHUB
	string "GitHub"

config PK_KMAP_ATOMIC_SRCFILE
	default "core.c Makefile Kconfig"
	string "Source code list"

config PK_KMAP_ATOMIC_CSRCFILE
	string "Compile source code list"

config PK_KMAP_ATOMIC_CONFIG
	string "CONFIG: Project Configure Options"

config PK_KMAP_ATOMIC_LIBPATH
	string "LIBS: Libraries to pass to the linker, e.g. -l<library>"

config PK_KMAP_ATOMIC_CPPFLAGS
	string "CPPFLAGS: C/C++ preprocessor flags, e.g. -I<include dir>"

config PK_KMAP_ATOMIC_DPKCONFIG
	string "PKG_CONFIG_PATH: Directories to add to pkg-config's search path"

config PK_KMAP_ATOMIC_CFLAGS
	string "CFLAGS: C compiler flags"

config PK_KMAP_ATOMIC_LDFLAGS
	string "LDFLAGS: Linker flags"

config PK_KMAP_ATOMIC_CXXFLAGS
	string "CXXFLAGS: C++ compiler flags"

config PK_KMAP_ATOMIC_ASFLAGS
	string "CCASFLAGS: assembler compiler flags (defaults to CFLAGS)"

config PK_KMAP_ATOMIC_BUILDARCH
	string "--host options on configure for Architecture"

endif # PK_KMAP_ATOMIC
```

## package/kmap/kmap_atomic_pfn/Kconfig
```kconfig
menuconfig PK_KMAP_ATOMIC_PFN
	bool "kmap_atomic_pfn()"

if PK_KMAP_ATOMIC_PFN

config PK_KMAP_ATOMIC_PFN_VERSION
	default "0.0.1"
	string "verstion"

config PK_KMAP_ATOMIC_PFN_TAR
	default "tar.gz"
	string "tar type"

config PK_KMAP_ATOMIC_PFN_URL
	default "https://gitee.com/BiscuitOS_team/HardStack/raw/Gitee/Memory-Allocator/Kmap/kmap_atomic_pfn"
	string "url"

config PK_KMAP_ATOMIC_PFN_GITHUB
	string "GitHub"

config PK_KMAP_ATOMIC_PFN_SRCFILE
	default "core.c Makefile Kconfig"
	string "Source code list"

config PK_KMAP_ATOMIC_PFN_CSRCFILE
	string "Compile source code list"

config PK_KMAP_ATOMIC_PFN_CONFIG
	string "CONFIG: Project Configure Options"

config PK_KMAP_ATOMIC_PFN_LIBPATH
	string "LIBS: Libraries to pass to the linker, e.g. -l<library>"

config PK_KMAP_ATOMIC_PFN_CPPFLAGS
	string "CPPFLAGS: C/C++ preprocessor flags, e.g. -I<include dir>"

config PK_KMAP_ATOMIC_PFN_DPKCONFIG
	string "PKG_CONFIG_PATH: Directories to add to pkg-config's search path"

config PK_KMAP_ATOMIC_PFN_CFLAGS
	string "CFLAGS: C compiler flags"

config PK_KMAP_ATOMIC_PFN_LDFLAGS
	string "LDFLAGS: Linker flags"

config PK_KMAP_ATOMIC_PFN_CXXFLAGS
	string "CXXFLAGS: C++ compiler flags"

config PK_KMAP_ATOMIC_PFN_ASFLAGS
	string "CCASFLAGS: assembler compiler flags (defaults to CFLAGS)"

config PK_KMAP_ATOMIC_PFN_BUILDARCH
	string "--host options on configure for Architecture"

endif # PK_KMAP_ATOMIC_PFN
```

## package/kmap/kmap_to_page/Kconfig
```kconfig
menuconfig PK_KMAP_TO_PAGE
	bool "kmap_to_page()"

if PK_KMAP_TO_PAGE

config PK_KMAP_TO_PAGE_VERSION
	default "0.0.1"
	string "verstion"

config PK_KMAP_TO_PAGE_TAR
	default "tar.gz"
	string "tar type"

config PK_KMAP_TO_PAGE_URL
	default "https://gitee.com/BiscuitOS_team/HardStack/raw/Gitee/Memory-Allocator/Kmap/kmap_to_page"
	string "url"

config PK_KMAP_TO_PAGE_GITHUB
	string "GitHub"

config PK_KMAP_TO_PAGE_SRCFILE
	default "core.c Makefile Kconfig"
	string "Source code list"

config PK_KMAP_TO_PAGE_CSRCFILE
	string "Compile source code list"

config PK_KMAP_TO_PAGE_CONFIG
	string "CONFIG: Project Configure Options"

config PK_KMAP_TO_PAGE_LIBPATH
	string "LIBS: Libraries to pass to the linker, e.g. -l<library>"

config PK_KMAP_TO_PAGE_CPPFLAGS
	string "CPPFLAGS: C/C++ preprocessor flags, e.g. -I<include dir>"

config PK_KMAP_TO_PAGE_DPKCONFIG
	string "PKG_CONFIG_PATH: Directories to add to pkg-config's search path"

config PK_KMAP_TO_PAGE_CFLAGS
	string "CFLAGS: C compiler flags"

config PK_KMAP_TO_PAGE_LDFLAGS
	string "LDFLAGS: Linker flags"

config PK_KMAP_TO_PAGE_CXXFLAGS
	string "CXXFLAGS: C++ compiler flags"

config PK_KMAP_TO_PAGE_ASFLAGS
	string "CCASFLAGS: assembler compiler flags (defaults to CFLAGS)"

config PK_KMAP_TO_PAGE_BUILDARCH
	string "--host options on configure for Architecture"

endif # PK_KMAP_TO_PAGE
```

## package/kmap/kmap_userspace/Kconfig
```kconfig
menuconfig PK_KMAP_USERSPACE
	bool "Kmap/Fixmap Memory Allocator on Userspace"

if PK_KMAP_USERSPACE

config PK_KMAP_USERSPACE_VERSION
	default "0.0.1"
	string "verstion"

config PK_KMAP_USERSPACE_TAR
	default "tar.gz"
	string "tar type"

config PK_KMAP_USERSPACE_URL
	default "https://gitee.com/BiscuitOS_team/HardStack/raw/Gitee/Memory-Allocator/Kmap/kmap_userspace"
	string "url"

config PK_KMAP_USERSPACE_GITHUB
	string "GitHub"

config PK_KMAP_USERSPACE_SRCFILE
	default "main.c Makefile README.md include/linux/biscuitos.h include/linux/bitmap.h include/linux/buddy.h include/linux/getorder.h include/linux/gfp.h include/linux/highmem.h include/linux/list.h include/linux/pgtable.h include/linux/slub.h mm/buddy.c mm/highmem.c mm/kasprintf.c mm/pgtable.c mm/slub.c"
	string "Source code list"

config PK_KMAP_USERSPACE_CSRCFILE
	string "Compile source code list"

config PK_KMAP_USERSPACE_CONFIG
	string "CONFIG: Project Configure Options"

config PK_KMAP_USERSPACE_LIBPATH
	string "LIBS: Libraries to pass to the linker, e.g. -l<library>"

config PK_KMAP_USERSPACE_CPPFLAGS
	string "CPPFLAGS: C/C++ preprocessor flags, e.g. -I<include dir>"

config PK_KMAP_USERSPACE_DPKCONFIG
	string "PKG_CONFIG_PATH: Directories to add to pkg-config's search path"

config PK_KMAP_USERSPACE_CFLAGS
	string "CFLAGS: C compiler flags"

config PK_KMAP_USERSPACE_LDFLAGS
	string "LDFLAGS: Linker flags"

config PK_KMAP_USERSPACE_CXXFLAGS
	string "CXXFLAGS: C++ compiler flags"

config PK_KMAP_USERSPACE_ASFLAGS
	string "CCASFLAGS: assembler compiler flags (defaults to CFLAGS)"

config PK_KMAP_USERSPACE_BUILDARCH
	string "--host options on configure for Architecture"

endif # PK_KMAP_USERSPACE
```
