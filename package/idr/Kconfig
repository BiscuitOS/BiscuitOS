## package/idr/Kconfig
```kconfig
menuconfig PK_IDR
	bool "IDR: ID Radix-Tree"

if PK_IDR

# DEFINE_IDR
source package/idr/DEFINE_IDR/Kconfig

# idr_init
source package/idr/idr_init/Kconfig

endif # PK_IDR
```

## package/idr/idr_init/Kconfig
```kconfig
menuconfig PK_IDR_INIT
	bool "idr_init()"

if PK_IDR_INIT

config PK_IDR_INIT_VERSION
	default "0.0.1"
	string "verstion"

config PK_IDR_INIT_TAR
	default "tar.gz"
	string "tar type"

config PK_IDR_INIT_URL
	default "https://gitee.com/BiscuitOS_team/HardStack/raw/Gitee/Algorithem/IDR/API/idr_init"
	string "url"

config PK_IDR_INIT_GITHUB
	string "GitHub"

config PK_IDR_INIT_SRCFILE
	default "idr.c Makefile README.md"
	string "Source code list"

config PK_IDR_INIT_CSRCFILE
	string "Compile source code list"

config PK_IDR_INIT_CONFIG
	string "CONFIG: Project Configure Options"

config PK_IDR_INIT_LIBPATH
	string "LIBS: Libraries to pass to the linker, e.g. -l<library>"

config PK_IDR_INIT_CPPFLAGS
	string "CPPFLAGS: C/C++ preprocessor flags, e.g. -I<include dir>"

config PK_IDR_INIT_DPKCONFIG
	string "PKG_CONFIG_PATH: Directories to add to pkg-config's search path"

config PK_IDR_INIT_CFLAGS
	string "CFLAGS: C compiler flags"

config PK_IDR_INIT_LDFLAGS
	string "LDFLAGS: Linker flags"

config PK_IDR_INIT_CXXFLAGS
	string "CXXFLAGS: C++ compiler flags"

config PK_IDR_INIT_ASFLAGS
	string "CCASFLAGS: assembler compiler flags (defaults to CFLAGS)"

config PK_IDR_INIT_BUILDARCH
	string "--host options on configure for Architecture"

endif # PK_IDR_INIT
```

## package/input/Kconfig
```kconfig
menuconfig PK_INPUT
	bool "Input: Device Driver and Application"

if PK_INPUT

# LDD: Input Device Driver application
source package/input/input_app/Kconfig

# LDD: Input Device Driver Module
source package/input/input_module/Kconfig

# LDD: Input Key Device Driver application
source package/input/input_key_app/Kconfig

# LDD: Input Key Device Driver Module
source package/input/input_key_module/Kconfig

# LDD: Input Touch Device Driver application
source package/input/input_touch_app/Kconfig

# LDD: Input Touch Device Driver Module
source package/input/input_touch_module/Kconfig

endif # PK_INPUT
```

## package/input/input_app/Kconfig
```kconfig
menuconfig PK_INPUT_APP
	select PK_INPUT_MOD
	bool "Input Device Driver Application"

if PK_INPUT_APP

config PK_INPUT_APP_VERSION
	default "0.0.1"
	string "verstion"

config PK_INPUT_APP_TAR
	default "tar.gz"
	string "tar type"

config PK_INPUT_APP_URL
	default "https://gitee.com/BiscuitOS_team/HardStack/raw/Gitee/Device-Driver/input/Base/userland"
	string "url"

config PK_INPUT_APP_GITHUB
	string "GitHub"

config PK_INPUT_APP_SRCFILE
	default "input.c input.sh Makefile"
	string "Source code list"

config PK_INPUT_APP_CSRCFILE
	string "Compile source code list"

config PK_INPUT_APP_CONFIG
	string "CONFIG: Project Configure Options"

config PK_INPUT_APP_LIBPATH
	string "LIBS: Libraries to pass to the linker, e.g. -l<library>"

config PK_INPUT_APP_CPPFLAGS
	string "CPPFLAGS: C/C++ preprocessor flags, e.g. -I<include dir>"

config PK_INPUT_APP_DPKCONFIG
	string "PKG_CONFIG_PATH: Directories to add to pkg-config's search path"

config PK_INPUT_APP_CFLAGS
	string "CFLAGS: C compiler flags"

config PK_INPUT_APP_LDFLAGS
	string "LDFLAGS: Linker flags"

config PK_INPUT_APP_CXXFLAGS
	string "CXXFLAGS: C++ compiler flags"

config PK_INPUT_APP_ASFLAGS
	string "CCASFLAGS: assembler compiler flags (defaults to CFLAGS)"

config PK_INPUT_APP_BUILDARCH
	string "--host options on configure for Architecture"

endif # PK_INPUT_APP
```

## package/input/input_module/Kconfig
```kconfig
menuconfig PK_INPUT_MOD
	bool "Input Device Driver Module"

if PK_INPUT_MOD

config PK_INPUT_MOD_VERSION
	default "0.0.1"
	string "verstion"

config PK_INPUT_MOD_TAR
	default "tar.gz"
	string "tar type"

config PK_INPUT_MOD_URL
	default "https://gitee.com/BiscuitOS_team/HardStack/raw/Gitee/Device-Driver/input/Base/kernel"
	string "url"

config PK_INPUT_MOD_GITHUB
	string "GitHub"

config PK_INPUT_MOD_SRCFILE
	default "input.c Kconfig Makefile"
	string "Source code list"

config PK_INPUT_MOD_CSRCFILE
	string "Compile source code list"

config PK_INPUT_MOD_CONFIG
	string "CONFIG: Project Configure Options"

config PK_INPUT_MOD_LIBPATH
	string "LIBS: Libraries to pass to the linker, e.g. -l<library>"

config PK_INPUT_MOD_CPPFLAGS
	string "CPPFLAGS: C/C++ preprocessor flags, e.g. -I<include dir>"

config PK_INPUT_MOD_DPKCONFIG
	string "PKG_CONFIG_PATH: Directories to add to pkg-config's search path"

config PK_INPUT_MOD_CFLAGS
	string "CFLAGS: C compiler flags"

config PK_INPUT_MOD_LDFLAGS
	string "LDFLAGS: Linker flags"

config PK_INPUT_MOD_CXXFLAGS
	string "CXXFLAGS: C++ compiler flags"

config PK_INPUT_MOD_ASFLAGS
	string "CCASFLAGS: assembler compiler flags (defaults to CFLAGS)"

config PK_INPUT_MOD_BUILDARCH
	string "--host options on configure for Architecture"

endif # PK_INPUT_MOD
```

## package/input/input_touch_app/Kconfig
```kconfig
menuconfig PK_INPUT_TOUCH_APP
	select PK_INPUT_TOUCH_MOD
	bool "Input Touch Device Driver Application"

if PK_INPUT_TOUCH_APP

config PK_INPUT_TOUCH_APP_VERSION
	default "0.0.1"
	string "verstion"

config PK_INPUT_TOUCH_APP_TAR
	default "tar.gz"
	string "tar type"

config PK_INPUT_TOUCH_APP_URL
	default "https://gitee.com/BiscuitOS_team/HardStack/raw/Gitee/Device-Driver/input/touch/userland/"
	string "url"

config PK_INPUT_TOUCH_APP_GITHUB
	string "GitHub"

config PK_INPUT_TOUCH_APP_SRCFILE
	default "input.c input.sh Makefile"
	string "Source code list"

config PK_INPUT_TOUCH_APP_CSRCFILE
	string "Compile source code list"

config PK_INPUT_TOUCH_APP_CONFIG
	string "CONFIG: Project Configure Options"

config PK_INPUT_TOUCH_APP_LIBPATH
	string "LIBS: Libraries to pass to the linker, e.g. -l<library>"

config PK_INPUT_TOUCH_APP_CPPFLAGS
	string "CPPFLAGS: C/C++ preprocessor flags, e.g. -I<include dir>"

config PK_INPUT_TOUCH_APP_DPKCONFIG
	string "PKG_CONFIG_PATH: Directories to add to pkg-config's search path"

config PK_INPUT_TOUCH_APP_CFLAGS
	string "CFLAGS: C compiler flags"

config PK_INPUT_TOUCH_APP_LDFLAGS
	string "LDFLAGS: Linker flags"

config PK_INPUT_TOUCH_APP_CXXFLAGS
	string "CXXFLAGS: C++ compiler flags"

config PK_INPUT_TOUCH_APP_ASFLAGS
	string "CCASFLAGS: assembler compiler flags (defaults to CFLAGS)"

config PK_INPUT_TOUCH_APP_BUILDARCH
	string "--host options on configure for Architecture"

endif # PK_INPUT_TOUCH_APP
```

## package/inputproto/Kconfig
```kconfig
menuconfig PK_INPUTPROTO
	bool "inputproto"

if PK_INPUTPROTO

config PK_INPUTPROTO_VERSION
	default "2.3.2"
	string "verstion"

config PK_INPUTPROTO_TAR
	default "tar.gz"
	string "tar type"

config PK_INPUTPROTO_URL
	default "https://www.x.org/releases/individual/proto/"
	string "url"

config PK_INPUTPROTO_GITHUB
	string "GitHub"

config PK_INPUTPROTO_SRCFILE
	string "Source code list"

config PK_INPUTPROTO_CONFIG
	default "--enable-silent-rules --disable-static"
	string "CONFIG: Project Configure Options"

config PK_INPUTPROTO_LIBPATH
	string "LIBS: Libraries to pass to the linker, e.g. -l<library>"

config PK_INPUTPROTO_CPPFLAGS
	string "CPPFLAGS: C/C++ preprocessor flags, e.g. -I<include dir>"

config PK_INPUTPROTO_DPKCONFIG
	string "PKG_CONFIG_PATH: Directories to add to pkg-config's search path"

config PK_INPUTPROTO_CFLAGS
	string "CFLAGS: C compiler flags"

config PK_INPUTPROTO_LDFLAGS
	string "LDFLAGS: Linker flags"

config PK_INPUTPROTO_CXXFLAGS
	string "CXXFLAGS: C++ compiler flags"

config PK_INPUTPROTO_ASFLAGS
	string "CCASFLAGS: assembler compiler flags (defaults to CFLAGS)"

config PK_INPUTPROTO_BUILDARCH
	default "x86_64-unknown-linux-gnu"
	string "--host options on configure for Architecture"

endif # PK_INPUTPROTO
```

## package/interval-tree/BiscuitOS-file-interval-tree-4.9/Kconfig
```kconfig
menuconfig PK_INTERVAL_TREE_FILE_4_9
	bool "File interval tree on 4.9 kernel"

if PK_INTERVAL_TREE_FILE_4_9

config PK_INTERVAL_TREE_FILE_4_9_VERSION
	default "default"
	string "verstion"

config PK_INTERVAL_TREE_FILE_4_9_TAR
	default "tar.gz"
	string "tar type"

config PK_INTERVAL_TREE_FILE_4_9_URL
	default "https://gitee.com/BiscuitOS_team/HardStack/raw/Gitee/Algorithem/tree/interval-tree/BiscuitOS-file-interval-tree-4.9"
	string "url"

config PK_INTERVAL_TREE_FILE_4_9_GITHUB
	string "GitHub"

config PK_INTERVAL_TREE_FILE_4_9_SRCFILE
	default "main.c Kconfig Makefile file_interval_tree.c file_interval_tree.h RunBiscuitOS.sh"
	string "Source code list"

config PK_INTERVAL_TREE_FILE_4_9_CSRCFILE
	string "Compile source code list"

config PK_INTERVAL_TREE_FILE_4_9_CONFIG
	string "CONFIG: Project Configure Options"

config PK_INTERVAL_TREE_FILE_4_9_LIBPATH
	string "LIBS: Libraries to pass to the linker, e.g. -l<library>"

config PK_INTERVAL_TREE_FILE_4_9_CPPFLAGS
	string "CPPFLAGS: C/C++ preprocessor flags, e.g. -I<include dir>"

config PK_INTERVAL_TREE_FILE_4_9_DPKCONFIG
	string "PKG_CONFIG_PATH: Directories to add to pkg-config's search path"

config PK_INTERVAL_TREE_FILE_4_9_CFLAGS
	string "CFLAGS: C compiler flags"

config PK_INTERVAL_TREE_FILE_4_9_LDFLAGS
	string "LDFLAGS: Linker flags"

config PK_INTERVAL_TREE_FILE_4_9_CXXFLAGS
	string "CXXFLAGS: C++ compiler flags"

config PK_INTERVAL_TREE_FILE_4_9_ASFLAGS
	string "CCASFLAGS: assembler compiler flags (defaults to CFLAGS)"

config PK_INTERVAL_TREE_FILE_4_9_BUILDARCH
	string "--host options on configure for Architecture"

endif # PK_INTERVAL_TREE_FILE_4_9
```

## package/interval-tree/BiscuitOS-file-interval-tree-fork/Kconfig
```kconfig
menuconfig PK_INTERVAL_TREE_FILE_FORK
	bool "File interval tree on forking"

if PK_INTERVAL_TREE_FILE_FORK

config PK_INTERVAL_TREE_FILE_FORK_VERSION
	default "default"
	string "verstion"

config PK_INTERVAL_TREE_FILE_FORK_TAR
	default "tar.gz"
	string "tar type"

config PK_INTERVAL_TREE_FILE_FORK_URL
	default "https://gitee.com/BiscuitOS_team/HardStack/raw/Gitee/Algorithem/tree/interval-tree/BiscuitOS-file-interval-tree-fork"
	string "url"

config PK_INTERVAL_TREE_FILE_FORK_GITHUB
	string "GitHub"

config PK_INTERVAL_TREE_FILE_FORK_SRCFILE
	default "main.c Kconfig Makefile file_interval_tree.c file_interval_tree.h RunBiscuitOS.sh"
	string "Source code list"

config PK_INTERVAL_TREE_FILE_FORK_CSRCFILE
	string "Compile source code list"

config PK_INTERVAL_TREE_FILE_FORK_CONFIG
	string "CONFIG: Project Configure Options"

config PK_INTERVAL_TREE_FILE_FORK_LIBPATH
	string "LIBS: Libraries to pass to the linker, e.g. -l<library>"

config PK_INTERVAL_TREE_FILE_FORK_CPPFLAGS
	string "CPPFLAGS: C/C++ preprocessor flags, e.g. -I<include dir>"

config PK_INTERVAL_TREE_FILE_FORK_DPKCONFIG
	string "PKG_CONFIG_PATH: Directories to add to pkg-config's search path"

config PK_INTERVAL_TREE_FILE_FORK_CFLAGS
	string "CFLAGS: C compiler flags"

config PK_INTERVAL_TREE_FILE_FORK_LDFLAGS
	string "LDFLAGS: Linker flags"

config PK_INTERVAL_TREE_FILE_FORK_CXXFLAGS
	string "CXXFLAGS: C++ compiler flags"

config PK_INTERVAL_TREE_FILE_FORK_ASFLAGS
	string "CCASFLAGS: assembler compiler flags (defaults to CFLAGS)"

config PK_INTERVAL_TREE_FILE_FORK_BUILDARCH
	string "--host options on configure for Architecture"

endif # PK_INTERVAL_TREE_FILE_FORK
```

## package/interval-tree/BiscuitOS-file-interval-tree/Kconfig
```kconfig
menuconfig PK_INTERVAL_TREE_FILE
	bool "File interval tree"

if PK_INTERVAL_TREE_FILE

config PK_INTERVAL_TREE_FILE_VERSION
	default "default"
	string "verstion"

config PK_INTERVAL_TREE_FILE_TAR
	default "tar.gz"
	string "tar type"

config PK_INTERVAL_TREE_FILE_URL
	default "https://gitee.com/BiscuitOS_team/HardStack/raw/Gitee/Algorithem/tree/interval-tree/BiscuitOS-file-interval-tree"
	string "url"

config PK_INTERVAL_TREE_FILE_GITHUB
	string "GitHub"

config PK_INTERVAL_TREE_FILE_SRCFILE
	default "main.c Kconfig Makefile file_interval_tree.c file_interval_tree.h RunBiscuitOS.sh"
	string "Source code list"

config PK_INTERVAL_TREE_FILE_CSRCFILE
	string "Compile source code list"

config PK_INTERVAL_TREE_FILE_CONFIG
	string "CONFIG: Project Configure Options"

config PK_INTERVAL_TREE_FILE_LIBPATH
	string "LIBS: Libraries to pass to the linker, e.g. -l<library>"

config PK_INTERVAL_TREE_FILE_CPPFLAGS
	string "CPPFLAGS: C/C++ preprocessor flags, e.g. -I<include dir>"

config PK_INTERVAL_TREE_FILE_DPKCONFIG
	string "PKG_CONFIG_PATH: Directories to add to pkg-config's search path"

config PK_INTERVAL_TREE_FILE_CFLAGS
	string "CFLAGS: C compiler flags"

config PK_INTERVAL_TREE_FILE_LDFLAGS
	string "LDFLAGS: Linker flags"

config PK_INTERVAL_TREE_FILE_CXXFLAGS
	string "CXXFLAGS: C++ compiler flags"

config PK_INTERVAL_TREE_FILE_ASFLAGS
	string "CCASFLAGS: assembler compiler flags (defaults to CFLAGS)"

config PK_INTERVAL_TREE_FILE_BUILDARCH
	string "--host options on configure for Architecture"

endif # PK_INTERVAL_TREE_FILE
```

## package/interval-tree/Kconfig
```kconfig
menuconfig PK_INTERVAL_TREE
	bool "Interval Tree Algorithem"

if PK_INTERVAL_TREE

# anonymous interval tree
source "package/interval-tree/BiscuitOS-anonymous-interval-tree/Kconfig"

# file interval tree
source "package/interval-tree/BiscuitOS-file-interval-tree/Kconfig"

# file interval tree for forking
source "package/interval-tree/BiscuitOS-file-interval-tree-fork/Kconfig"

# file interval tree on 4.9 kernel
source "package/interval-tree/BiscuitOS-file-interval-tree-4.9/Kconfig"

endif # PK_INTERVAL_TREE
```

## package/intltool/Kconfig
```kconfig
menuconfig PK_INTLTOOL
	bool "intltool"

if PK_INTLTOOL

config INTLTOOL_VERSION
	default "0.40.6"
	string "verstion"

config INTLTOOL_TAR
	default "tar.gz"
	string "tar type"

config INTLTOOL_URL
	default "http://ftp.gnome.org/pub/GNOME/sources/intltool/0.40/"
	string "url"

config INTLTOOL_SRC
	string "source code list"

config INTLTOOL_LDFLAGS
	string "LDFLAGS"

config INTLTOOL_CFLAGS
	string "CFLAGS"

config INTLTOOL_CONFIG
	string "configure"

endif # PK_INTLTOOL
```

## package/jemalloc/Kconfig
```kconfig
menuconfig PK_JEMALLOC
	bool "jemalloc: Jason Evans Malloc"

if PK_JEMALLOC

# jemalloc
source package/jemalloc/jemalloc/Kconfig

endif # PK_JEMALLOC
```

## package/jemalloc/jemalloc/Kconfig
```kconfig
menuconfig PK_JEMALLOC_TOOLS
	bool "jemalloc tools"

if PK_JEMALLOC_TOOLS

config PK_JEMALLOC_TOOLS_VERSION
	default "default"
	string "verstion"

config PK_JEMALLOC_TOOLS_TAR
	default "tar.xz"
	string "tar type"

config PK_JEMALLOC_TOOLS_URL
	default ""
	string "url"

config PK_JEMALLOC_TOOLS_GITHUB
	default "https://github.com/jemalloc/jemalloc.git"
	string "GitHub"

config PK_JEMALLOC_TOOLS_SRCFILE
	string "Source code list"

config PK_JEMALLOC_TOOLS_CONFIG
	default "--enable-silent-rules"
	string "CONFIG: Project Configure Options"

config PK_JEMALLOC_TOOLS_LIBPATH
	string "LIBS: Libraries to pass to the linker, e.g. -l<library>"

config PK_JEMALLOC_TOOLS_CPPFLAGS
	string "CPPFLAGS: C/C++ preprocessor flags, e.g. -I<include dir>"

config PK_JEMALLOC_TOOLS_DPKCONFIG
	string "PKG_CONFIG_PATH: Directories to add to pkg-config's search path"

config PK_JEMALLOC_TOOLS_CFLAGS
	string "CFLAGS: C compiler flags"

config PK_JEMALLOC_TOOLS_LDFLAGS
	string "LDFLAGS: Linker flags"

config PK_JEMALLOC_TOOLS_CXXFLAGS
	string "CXXFLAGS: C++ compiler flags"

config PK_JEMALLOC_TOOLS_ASFLAGS
	string "CCASFLAGS: assembler compiler flags (defaults to CFLAGS)"

config PK_JEMALLOC_TOOLS_BUILDARCH
	default "x86_64-unknown-linux-gnu"
	string "--host options on configure for Architecture"

endif # PK_JEMALLOC_TOOLS
```
