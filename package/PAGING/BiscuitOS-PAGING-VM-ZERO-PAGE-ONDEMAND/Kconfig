## package/PAGING/Kconfig
```kconfig
menuconfig PK_PAGING
	bool "Paging Mechanism"

if PK_PAGING

# Paging
source package/PAGING/BiscuitOS-PAGING/Kconfig

# PGD
source package/PAGING/BiscuitOS-PAGING-PGD/Kconfig

# P4D
source package/PAGING/BiscuitOS-PAGING-P4D/Kconfig

# PUD
source package/PAGING/BiscuitOS-PAGING-PUD/Kconfig

# PMD
source package/PAGING/BiscuitOS-PAGING-PMD/Kconfig

# PTE
source package/PAGING/BiscuitOS-PAGING-PTE/Kconfig

# PGPROT
source package/PAGING/BiscuitOS-PAGING-PGPROT/Kconfig

# 32-Bit Paging mmap 4MiB
source package/PAGING/BiscuitOS-PAGING-32Bit-Paging-MMAP-4MiB/Kconfig

# 32-Bit Paging mmap 4KiB
source package/PAGING/BiscuitOS-PAGING-32Bit-Paging-MMAP-4KiB/Kconfig

# 4-level Paging mmap 1Gig
source package/PAGING/BiscuitOS-PAGING-4level-Paging-MMAP-1Gig/Kconfig

# 4-level Paging mmap 2MiB
source package/PAGING/BiscuitOS-PAGING-4level-Paging-MMAP-2MiB/Kconfig

# 4-level Paging mmap 4KiB
source package/PAGING/BiscuitOS-PAGING-4level-Paging-MMAP-4KiB/Kconfig

# 5-level Paging mmap 1Gig
source package/PAGING/BiscuitOS-PAGING-5level-Paging-MMAP-1Gig/Kconfig

# 5-level Paging mmap 2MiB
source package/PAGING/BiscuitOS-PAGING-5level-Paging-MMAP-2MiB/Kconfig

# 5-level Paging mmap 4KiB
source package/PAGING/BiscuitOS-PAGING-5level-Paging-MMAP-4KiB/Kconfig

# PageWalk Mechanism
source package/PAGING/BiscuitOS-PAGING-PageWalk/Kconfig

# PageWalk: Kernel Space
source package/PAGING/BiscuitOS-PAGING-PageWalk-Kernel/Kconfig

# PageWalk: VMA
source package/PAGING/BiscuitOS-PAGING-PageWalk-VMA/Kconfig

# PageWalk: RANGE
source package/PAGING/BiscuitOS-PAGING-PageWalk-RANGE/Kconfig

# PageWalk: PageCACHE
source package/PAGING/BiscuitOS-PAGING-PageWalk-PageCACHE/Kconfig

# PageWalk: File
source package/PAGING/BiscuitOS-PAGING-PageWalk-File/Kconfig

# PageWalk: Anonymous
source package/PAGING/BiscuitOS-PAGING-PageWalk-Anonymous/Kconfig

# PageWalk: Hugetlbfs
source package/PAGING/BiscuitOS-PAGING-PageWalk-Hugetlbfs/Kconfig

# PageWalk: THP
source package/PAGING/BiscuitOS-PAGING-PageWalk-THP/Kconfig

# PageWalk: MMIO
source package/PAGING/BiscuitOS-PAGING-PageWalk-MMIO/Kconfig

# PageWalk: RSVD-MEM
source package/PAGING/BiscuitOS-PAGING-PageWalk-RSVDMEM/Kconfig

# PageWalk: VMALLOC
source package/PAGING/BiscuitOS-PAGING-PageWalk-VMALLOC/Kconfig

# PageWalk: Permanent
source package/PAGING/BiscuitOS-PAGING-PageWalk-Permanent/Kconfig

# PageWalk: Linear
source package/PAGING/BiscuitOS-PAGING-PageWalk-Linear/Kconfig

# PageWalk: Temporary
source package/PAGING/BiscuitOS-PAGING-PageWalk-Temporary/Kconfig

# PageWalk: IOREMAP
source package/PAGING/BiscuitOS-PAGING-PageWalk-IOREMAP/Kconfig

# PageWalk: CMA
source package/PAGING/BiscuitOS-PAGING-PageWalk-CMA/Kconfig

# PageWalk: DMA
source package/PAGING/BiscuitOS-PAGING-PageWalk-DMA/Kconfig

# PageWalk: Modify
source package/PAGING/BiscuitOS-PAGING-PageWalk-Modify/Kconfig

# PageWalk: ADD
source package/PAGING/BiscuitOS-PAGING-PageWalk-ADD/Kconfig

# PageWalk: USE-CASE SMAPS
source package/PAGING/BiscuitOS-PAGING-PageWalk-SMAPS/Kconfig

# PageWalk: USE-CASE NUMA_MAPS
source package/PAGING/BiscuitOS-PAGING-PageWalk-NUMA-MAPS/Kconfig

# PageWalk: USE-CASE Pagemap
source package/PAGING/BiscuitOS-PAGING-PageWalk-Pagemap/Kconfig

# PageWalk: USE-CASE Clear_refs
source package/PAGING/BiscuitOS-PAGING-PageWalk-CLEAR-Reference/Kconfig

# PageWalk: USE-CASE MAVD_COLD
source package/PAGING/BiscuitOS-PAGING-PageWalk-MADV_COLD/Kconfig

# PageWalk: USE-CASE MAVD_PAGEOUT
source package/PAGING/BiscuitOS-PAGING-PageWalk-MADV_PAGEOUT/Kconfig

# PageWalk: USE-CASE MAVD_FREE
source package/PAGING/BiscuitOS-PAGING-PageWalk-MADV_FREE/Kconfig

# PageWalk: USE-CASE MAVD_WILLNEED
source package/PAGING/BiscuitOS-PAGING-PageWalk-MADV_WILLNEED/Kconfig

# PageWalk: USE-CASE MLOCK
source package/PAGING/BiscuitOS-PAGING-PageWalk-MLOCK/Kconfig

# PageWalk: CBC walk_page_test 65#
source package/PAGING/BiscuitOS-PAGING-PageWalk-CBC-walk_page_test-65/Kconfig

# PageWalk: CBC walk_page_test 76#
source package/PAGING/BiscuitOS-PAGING-PageWalk-CBC-walk_page_test-76/Kconfig

# PageWalk: CBC __walk_page_range 10#
source package/PAGING/BiscuitOS-PAGING-PageWalk-CBC-__walk_page_range-10/Kconfig

# PageWalk: CBC walk_pmd_range 18#
source package/PAGING/BiscuitOS-PAGING-PageWalk-CBC-walk_pmd_range-18/Kconfig

# PageWalk: CBC walk_pmd_range 37#
source package/PAGING/BiscuitOS-PAGING-PageWalk-CBC-walk_pmd_range-37/Kconfig

# PageWalk: CBC walk_pmd_range 49#
source package/PAGING/BiscuitOS-PAGING-PageWalk-CBC-walk_pmd_range-49/Kconfig

# PageWalk: DeepMind MMAP LOCK
source package/PAGING/BiscuitOS-PAGING-PageWalk-DM-MMAP-LOCK/Kconfig

# PageWalk: DeepMind ACTION
source package/PAGING/BiscuitOS-PAGING-PageWalk-DM-ACTION/Kconfig

# PageWalk: DeepMind PTE-LOCK
source package/PAGING/BiscuitOS-PAGING-PageWalk-DM-PTE-LOCK/Kconfig

# PageWalk: DeepMind SPLIT-THP
source package/PAGING/BiscuitOS-PAGING-PageWalk-DM-SPLIT-THP/Kconfig

# PTDUMP: DUMP Current Userspace
source package/PAGING/BiscuitOS-PAGING-PTDUMP-CURRUSER/Kconfig

# PTDUMP: DUMP Current Kernel Space
source package/PAGING/BiscuitOS-PAGING-PTDUMP-CURRKERNEL/Kconfig

# PTDUMP: Check NX
source package/PAGING/BiscuitOS-PAGING-PTDUMP-CHECK-NX/Kconfig

# PROC PageMap
source package/PAGING/BiscuitOS-PAGING-PROC-PageMap/Kconfig

# PROC PageMap: Hugetlbfs
source package/PAGING/BiscuitOS-PAGING-PROC-PageMap-Hugetlbfs/Kconfig

# PROC PageMap: THP
source package/PAGING/BiscuitOS-PAGING-PROC-PageMap-THP/Kconfig

# PROC PageMap: SWAP
source package/PAGING/BiscuitOS-PAGING-PROC-PageMap-SWAP/Kconfig

# PROC PageMap: 1Gig Page
source package/PAGING/BiscuitOS-PAGING-PROC-PageMap-1G/Kconfig

# PROC PageMap: HOLE
source package/PAGING/BiscuitOS-PAGING-PROC-PageMap-HOLE/Kconfig

# PROC PageMap: MMIO
source package/PAGING/BiscuitOS-PAGING-PROC-PageMap-MMIO/Kconfig

# PROC PageMap: Anonymous
source package/PAGING/BiscuitOS-PAGING-PROC-PageMap-ANON/Kconfig

# PROC PageMap: File
source package/PAGING/BiscuitOS-PAGING-PROC-PageMap-FILE/Kconfig

# PROC SMAPS
source package/PAGING/BiscuitOS-PAGING-PROC-SMAPS/Kconfig

# PROC SMAPS: Anonymous
source package/PAGING/BiscuitOS-PAGING-PROC-SMAPS-ANON/Kconfig

# PROC SMAPS: Anonymous Shared
source package/PAGING/BiscuitOS-PAGING-PROC-SMAPS-ANON-SHARED/Kconfig

# PROC SMAPS: Anonymous Private
source package/PAGING/BiscuitOS-PAGING-PROC-SMAPS-ANON-PRIVATE/Kconfig

# PROC SMAPS: File
source package/PAGING/BiscuitOS-PAGING-PROC-SMAPS-FILE/Kconfig

# PROC SMAPS: File Shared
source package/PAGING/BiscuitOS-PAGING-PROC-SMAPS-FILE-PRIVATE/Kconfig

# PROC SMAPS: File Shared
source package/PAGING/BiscuitOS-PAGING-PROC-SMAPS-FILE-SHARED/Kconfig

# PROC SMAPS: SHARED
source package/PAGING/BiscuitOS-PAGING-PROC-SMAPS-SHARED/Kconfig

# PROC SMAPS: Dirty
source package/PAGING/BiscuitOS-PAGING-PROC-SMAPS-DIRTY/Kconfig

# PROC SMAPS: Shmem PMD-Mapped
source package/PAGING/BiscuitOS-PAGING-PROC-SMAPS-SHMEMPMDMAPPED/Kconfig

# PROC SMAPS: Anonymous Huge Page
source package/PAGING/BiscuitOS-PAGING-PROC-SMAPS-ANONHUGEPAGES/Kconfig

# PROC SMAPS: Private Hugetlb
source package/PAGING/BiscuitOS-PAGING-PROC-SMAPS-PRIVATE-HUGETLB/Kconfig

# PROC SMAPS: Shared Hugetlb
source package/PAGING/BiscuitOS-PAGING-PROC-SMAPS-SHARED-HUGETLB/Kconfig

# PROC SMAPS: LOCKED
source package/PAGING/BiscuitOS-PAGING-PROC-SMAPS-LOCKED/Kconfig

# PROC SMAPS: SWAP
source package/PAGING/BiscuitOS-PAGING-PROC-SMAPS-SWAP/Kconfig

# PROC SMAPS: File PMD-Mapped
source package/PAGING/BiscuitOS-PAGING-PROC-SMAPS-FILEPMDMAPPED/Kconfig

# PROC SMAPS: PSS
source package/PAGING/BiscuitOS-PAGING-PROC-SMAPS-PSS/Kconfig

# PROC SMAPS: REFERENCE
source package/PAGING/BiscuitOS-PAGING-PROC-SMAPS-REFERENCE/Kconfig

# PROC SMAPS-ROLLUP
source package/PAGING/BiscuitOS-PAGING-PROC-SMAPS-ROLLUP/Kconfig

# PROC CLEAR-REFS
source package/PAGING/BiscuitOS-PAGING-PROC-CLEAR-REFS/Kconfig

# PROC CLEAR-REFS: Anonymous
source package/PAGING/BiscuitOS-PAGING-PROC-CLEAR-REFS-ANON/Kconfig

# PROC CLEAR-REFS: Anonymous THP
source package/PAGING/BiscuitOS-PAGING-PROC-CLEAR-REFS-ANON-THP/Kconfig

# PROC CLEAR-REFS: Anonymous HUGETLB
source package/PAGING/BiscuitOS-PAGING-PROC-CLEAR-REFS-ANON-HUGETLB/Kconfig

# PROC CLEAR-REFS: File-MApped
source package/PAGING/BiscuitOS-PAGING-PROC-CLEAR-REFS-FILE/Kconfig

# PROC CLEAR-REFS: File-MApped THP
source package/PAGING/BiscuitOS-PAGING-PROC-CLEAR-REFS-FILE-THP/Kconfig

# PROC CLEAR-REFS: File-MApped HUGETLB
source package/PAGING/BiscuitOS-PAGING-PROC-CLEAR-REFS-FILE-HUGETLB/Kconfig

# PROC CLEAR-REFS: SoftDirty
source package/PAGING/BiscuitOS-PAGING-PROC-CLEAR-REFS-SOFTDIRTY/Kconfig

# PROC CLEAR-REFS: HiWater RSS
source package/PAGING/BiscuitOS-PAGING-PROC-CLEAR-REFS-HIWATER-RSS/Kconfig

# Protection Key
source package/PAGING/BiscuitOS-PAGING-PKEY/Kconfig

# PageFault
source package/PAGING/BiscuitOS-PAGING-PF/Kconfig

# PageFault: Trace
source package/PAGING/BiscuitOS-PAGING-PF-TRACE/Kconfig

# PageFault: Anonymous
source package/PAGING/BiscuitOS-PAGING-PF-ANON/Kconfig

# PageFault: Anonymous RO
source package/PAGING/BiscuitOS-PAGING-PF-ANON-RO/Kconfig

# PageFault: Anonymous WP
source package/PAGING/BiscuitOS-PAGING-PF-ANON-WP/Kconfig

# PageFault: Anonymous WP REUSE
source package/PAGING/BiscuitOS-PAGING-PF-ANON-WP-REUSE/Kconfig

# PageFault: Anonymous COW
source package/PAGING/BiscuitOS-PAGING-PF-ANON-COW/Kconfig

# PageFault: Anonymous SWAP
source package/PAGING/BiscuitOS-PAGING-PF-ANON-SWAP/Kconfig

# PageFault: Anonymous ZSWAP
source package/PAGING/BiscuitOS-PAGING-PF-ANON-ZSWAP/Kconfig

# PageFault: Anonymous KSM
source package/PAGING/BiscuitOS-PAGING-PF-ANON-KSM/Kconfig

# PageFault: Anonymous NUMA
source package/PAGING/BiscuitOS-PAGING-PF-ANON-NUMA/Kconfig

# PageFault: Anonymous MCE
source package/PAGING/BiscuitOS-PAGING-PF-ANON-MCE/Kconfig

# PageFault: Anonymous Heap
source package/PAGING/BiscuitOS-PAGING-PF-ANON-HEAP/Kconfig

# PageFault: Anonymous Stack
source package/PAGING/BiscuitOS-PAGING-PF-ANON-STACK/Kconfig

# PageFault: Anonymous Protection Key
source package/PAGING/BiscuitOS-PAGING-PF-ANON-PK/Kconfig

# PageFault: Anonymous THP
source package/PAGING/BiscuitOS-PAGING-PF-ANON-THP/Kconfig

# PageFault: Huge Zero Page
source package/PAGING/BiscuitOS-PAGING-PF-HUGE-ZERO-PAGE/Kconfig

# PageFault: SHMEM
source package/PAGING/BiscuitOS-PAGING-PF-SHMEM/Kconfig

# PageFault: Read-Only SHMEM
source package/PAGING/BiscuitOS-PAGING-PF-SHMEM-RO/Kconfig

# PageFault: SHMEM fork
source package/PAGING/BiscuitOS-PAGING-PF-SHMEM-FORK/Kconfig

# PageFault: SHMEM SWAP
source package/PAGING/BiscuitOS-PAGING-PF-SHMEM-SWAP/Kconfig

# PageFault: SHMEM ZSWAP
source package/PAGING/BiscuitOS-PAGING-PF-SHMEM-ZSWAP/Kconfig

# PageFault: SHMEM MCE
source package/PAGING/BiscuitOS-PAGING-PF-SHMEM-MCE/Kconfig

# PageFault: SHMEM MEMFD
source package/PAGING/BiscuitOS-PAGING-PF-SHMEM-MEMFD/Kconfig

# PageFault: SHMEM SYSV
source package/PAGING/BiscuitOS-PAGING-PF-SHMEM-SYSV/Kconfig

# PageFault: SHMEM DEVSHM
source package/PAGING/BiscuitOS-PAGING-PF-SHMEM-DEVSHM/Kconfig

# PageFault: SHMEM POSIX
source package/PAGING/BiscuitOS-PAGING-PF-SHMEM-POSIX/Kconfig

# PageFault: SHMEM USOCK
source package/PAGING/BiscuitOS-PAGING-PF-SHMEM-USOCK/Kconfig

# PageFault: SHMEM LOCAL
source package/PAGING/BiscuitOS-PAGING-PF-SHMEM-LOCAL/Kconfig

# PageFault: SHMEM THP
source package/PAGING/BiscuitOS-PAGING-PF-SHMEM-THP/Kconfig

# PageFault: SHMEM PK
source package/PAGING/BiscuitOS-PAGING-PF-SHMEM-PK/Kconfig

# PageFault: FILE
source package/PAGING/BiscuitOS-PAGING-PF-FILE/Kconfig

# PageFault: FILE EXT2
source package/PAGING/BiscuitOS-PAGING-PF-FILE-EXT2/Kconfig

# PageFault: FILE EXT2 FAULT AROUND
source package/PAGING/BiscuitOS-PAGING-PF-FILE-EXT2-FR/Kconfig

# PageFault: FILE EXT2 COW
source package/PAGING/BiscuitOS-PAGING-PF-FILE-EXT2-COW/Kconfig

# PageFault: FILE EXT3
source package/PAGING/BiscuitOS-PAGING-PF-FILE-EXT3/Kconfig

# PageFault: FILE EXT3 FAULT AROUND
source package/PAGING/BiscuitOS-PAGING-PF-FILE-EXT3-FR/Kconfig

# PageFault: FILE EXT3 COW
source package/PAGING/BiscuitOS-PAGING-PF-FILE-EXT3-COW/Kconfig

# PageFault: FILE EXT4
source package/PAGING/BiscuitOS-PAGING-PF-FILE-EXT4/Kconfig

# PageFault: FILE EXT4 FAULT AROUND
source package/PAGING/BiscuitOS-PAGING-PF-FILE-EXT4-FR/Kconfig

# PageFault: FILE EXT4 COW
source package/PAGING/BiscuitOS-PAGING-PF-FILE-EXT4-COW/Kconfig

# PageFault: FILE XFS DAX
source package/PAGING/BiscuitOS-PAGING-PF-FILE-XFS-DAX/Kconfig

# PageFault: FILE XFS HUGE DAX
source package/PAGING/BiscuitOS-PAGING-PF-FILE-XFS-HUGE-DAX/Kconfig

# PageFault: FILE MINIXFS
source package/PAGING/BiscuitOS-PAGING-PF-FILE-MINIXFS/Kconfig

# PageFault: FILE MINIXFS FAULT AROUND
source package/PAGING/BiscuitOS-PAGING-PF-FILE-MINIXFS-FR/Kconfig

# PageFault: FILE MINIXFS COW
source package/PAGING/BiscuitOS-PAGING-PF-FILE-MINIXFS-COW/Kconfig

# PageFault: FILE TMPFS
source package/PAGING/BiscuitOS-PAGING-PF-FILE-TMPFS/Kconfig

# PageFault: FILE HUGE-TMPFS
source package/PAGING/BiscuitOS-PAGING-PF-FILE-HUGE-TMPFS/Kconfig

# PageFault: FILE VFAT
source package/PAGING/BiscuitOS-PAGING-PF-FILE-VFAT/Kconfig

# PageFault: FILE VFAT FAULT AROUND
source package/PAGING/BiscuitOS-PAGING-PF-FILE-VFAT-FR/Kconfig

# PageFault: FILE VFAT COW
source package/PAGING/BiscuitOS-PAGING-PF-FILE-VFAT-COW/Kconfig

# PageFault: FILE FAT
source package/PAGING/BiscuitOS-PAGING-PF-FILE-FAT/Kconfig

# PageFault: FILE FAT FAULT AROUND
source package/PAGING/BiscuitOS-PAGING-PF-FILE-FAT-FR/Kconfig

# PageFault: FILE FAT COW
source package/PAGING/BiscuitOS-PAGING-PF-FILE-FAT-COW/Kconfig

# PageFault: FILE MSDOS
source package/PAGING/BiscuitOS-PAGING-PF-FILE-MSDOS/Kconfig

# PageFault: FILE MSDOS FAULT AROUND
source package/PAGING/BiscuitOS-PAGING-PF-FILE-MSDOS-FR/Kconfig

# PageFault: FILE MSDOS COW
source package/PAGING/BiscuitOS-PAGING-PF-FILE-MSDOS-COW/Kconfig

# PageFault: FILE BFS
source package/PAGING/BiscuitOS-PAGING-PF-FILE-BFS/Kconfig

# PageFault: FILE BFS FAULT AROUND
source package/PAGING/BiscuitOS-PAGING-PF-FILE-BFS-FR/Kconfig

# PageFault: FILE BFS COW
source package/PAGING/BiscuitOS-PAGING-PF-FILE-BFS-COW/Kconfig

# PageFault: FILE JFFS2
source package/PAGING/BiscuitOS-PAGING-PF-FILE-JFFS2/Kconfig

# PageFault: FILE JFFS2 FAULT AROUND
source package/PAGING/BiscuitOS-PAGING-PF-FILE-JFFS2-FR/Kconfig

# PageFault: FILE JFFS2 COW
source package/PAGING/BiscuitOS-PAGING-PF-FILE-JFFS2-COW/Kconfig

# PageFault: FILE SQUASHFS
source package/PAGING/BiscuitOS-PAGING-PF-FILE-SQUASHFS/Kconfig

# PageFault: FILE CRAMFS
source package/PAGING/BiscuitOS-PAGING-PF-FILE-CRAMFS/Kconfig

# PageFault: FILE BTRFS
source package/PAGING/BiscuitOS-PAGING-PF-FILE-BTRFS/Kconfig

# PageFault: FILE BTRFS FAULT AROUND
source package/PAGING/BiscuitOS-PAGING-PF-FILE-BTRFS-FR/Kconfig

# PageFault: FILE BTRFS COW
source package/PAGING/BiscuitOS-PAGING-PF-FILE-BTRFS-COW/Kconfig

# PageFault: FILE REISERFS
source package/PAGING/BiscuitOS-PAGING-PF-FILE-REISERFS/Kconfig

# PageFault: FILE REISERFS FAULT AROUND
source package/PAGING/BiscuitOS-PAGING-PF-FILE-REISERFS-FR/Kconfig

# PageFault: FILE REISERFS COW
source package/PAGING/BiscuitOS-PAGING-PF-FILE-REISERFS-COW/Kconfig

# PageFault: FILE JFS
source package/PAGING/BiscuitOS-PAGING-PF-FILE-JFS/Kconfig

# PageFault: FILE JFS FAULT AROUND
source package/PAGING/BiscuitOS-PAGING-PF-FILE-JFS-FR/Kconfig

# PageFault: FILE JFS COW
source package/PAGING/BiscuitOS-PAGING-PF-FILE-JFS-COW/Kconfig

# PageFault: FILE XFS
source package/PAGING/BiscuitOS-PAGING-PF-FILE-XFS/Kconfig

# PageFault: FILE XFS FAULT AROUND
source package/PAGING/BiscuitOS-PAGING-PF-FILE-XFS-FR/Kconfig

# PageFault: FILE XFS COW
source package/PAGING/BiscuitOS-PAGING-PF-FILE-XFS-COW/Kconfig

# PageFault: FILE GFS2
source package/PAGING/BiscuitOS-PAGING-PF-FILE-GFS2/Kconfig

# PageFault: FILE GFS2 FAULT AROUND
source package/PAGING/BiscuitOS-PAGING-PF-FILE-GFS2-FR/Kconfig

# PageFault: FILE GFS2 COW
source package/PAGING/BiscuitOS-PAGING-PF-FILE-GFS2-COW/Kconfig

# PageFault: FILE F2FS
source package/PAGING/BiscuitOS-PAGING-PF-FILE-F2FS/Kconfig

# PageFault: FILE F2FS FAULT AROUND
source package/PAGING/BiscuitOS-PAGING-PF-FILE-F2FS-FR/Kconfig

# PageFault: FILE F2FS COW
source package/PAGING/BiscuitOS-PAGING-PF-FILE-F2FS-COW/Kconfig

# Huge-PageFault: Anonymous THP
source package/PAGING/BiscuitOS-PAGING-HUGE-PF-ANON-THP/Kconfig

# Huge-PageFault: RO Anonymous THP
source package/PAGING/BiscuitOS-PAGING-HUGE-PF-RO-ANON-THP/Kconfig

# Huge-PageFault: WP Anonymous THP
source package/PAGING/BiscuitOS-PAGING-HUGE-PF-WP-ANON-THP/Kconfig

# Huge-PageFault: COW Anonymous THP
source package/PAGING/BiscuitOS-PAGING-HUGE-PF-COW-ANON-THP/Kconfig

# Huge-PageFault: SWAP Anonymous THP
source package/PAGING/BiscuitOS-PAGING-HUGE-PF-SWAP-ANON-THP/Kconfig

# Huge-PageFault: ZSWAP Anonymous THP
source package/PAGING/BiscuitOS-PAGING-HUGE-PF-ZSWAP-ANON-THP/Kconfig

# Huge-PageFault: KSM Anonymous THP
source package/PAGING/BiscuitOS-PAGING-HUGE-PF-KSM-ANON-THP/Kconfig

# Huge-PageFault: NUMA Anonymous THP
source package/PAGING/BiscuitOS-PAGING-HUGE-PF-NUMA-ANON-THP/Kconfig

# Huge-PageFault: EXT4 HUGE DAX
source package/PAGING/BiscuitOS-PAGING-HUGE-PF-EXT4-HUGE-DAX/Kconfig

# Huge-PageFault: XFS HUGE DAX
source package/PAGING/BiscuitOS-PAGING-HUGE-PF-XFS-HUGE-DAX/Kconfig

# Huge-PageFault: PUDMAPPED
source package/PAGING/BiscuitOS-PAGING-HUGE-PF-PUDMAPPED/Kconfig

# PageFault: PFNMAP
source package/PAGING/BiscuitOS-PAGING-PF-PFNMAP/Kconfig

# PageFault: PFNMAP Read-Only
source package/PAGING/BiscuitOS-PAGING-PF-PFNMAP-RO/Kconfig

# PageFault: PFNMAP Write-Protection
source package/PAGING/BiscuitOS-PAGING-PF-PFNMAP-WP/Kconfig

# PageFault: PFNMAP COW
source package/PAGING/BiscuitOS-PAGING-PF-PFNMAP-COW/Kconfig

# PageFault: PFNMAP PMDMAPPED
source package/PAGING/BiscuitOS-PAGING-PF-PFNMAP-PMDMAPPED/Kconfig

# PageFault: PFNMAP PUDMAPPED
source package/PAGING/BiscuitOS-PAGING-PF-PFNMAP-PUDMAPPED/Kconfig

# PageFault: PAGEMAP
source package/PAGING/BiscuitOS-PAGING-PF-PAGEMAP/Kconfig

# PageFault: VMALLOC
source package/PAGING/BiscuitOS-PAGING-PF-VMALLOC/Kconfig

# PageFault: VMALLOC32
source package/PAGING/BiscuitOS-PAGING-PF-VMALLOC32/Kconfig

# PageFault: Anonymous HugeTLB
source package/PAGING/BiscuitOS-PAGING-PF-ANON-HUGETLB/Kconfig

# PageFault: File HugeTLB
source package/PAGING/BiscuitOS-PAGING-PF-FILE-HUGETLB/Kconfig

# PageFault: File DAX
source package/PAGING/BiscuitOS-PAGING-PF-FILE-DAX/Kconfig

# PageFault: File DIRECT-IO
source package/PAGING/BiscuitOS-PAGING-PF-FILE-DIRECTIO/Kconfig

# PageFault ERROR CODE: PF_WRITE
source package/PAGING/BiscuitOS-PAGING-PF-ECODE-WRITE/Kconfig

# PageFault ERROR CODE: PF_WRITE with WP
source package/PAGING/BiscuitOS-PAGING-PF-ECODE-WRITE-WP/Kconfig

# PageFault ERROR CODE: PF_USER
source package/PAGING/BiscuitOS-PAGING-PF-ECODE-USER/Kconfig

# PageFault ERROR CODE: PF_USER Access KVADDR
source package/PAGING/BiscuitOS-PAGING-PF-ECODE-USER-KVADDR/Kconfig

# PageFault ERROR CODE: PF_READ
source package/PAGING/BiscuitOS-PAGING-PF-ECODE-READ/Kconfig

# PageFault ERROR CODE: PF_PRESENT
source package/PAGING/BiscuitOS-PAGING-PF-ECODE-PRESENT/Kconfig

# PageFault ERROR CODE: PF_PRESENT with SWAP
source package/PAGING/BiscuitOS-PAGING-PF-ECODE-PRESENT-SWAP/Kconfig

# PageFault ERROR CODE: PF_PRESENT with ZSWAP
source package/PAGING/BiscuitOS-PAGING-PF-ECODE-PRESENT-ZSWAP/Kconfig

# PageFault ERROR CODE: PF_PROT
source package/PAGING/BiscuitOS-PAGING-PF-ECODE-PROT/Kconfig

# PageFault ERROR CODE: PF_PROT with Protection Key
source package/PAGING/BiscuitOS-PAGING-PF-ECODE-PROT-PK/Kconfig

# PageFault ERROR CODE: PF_PK
source package/PAGING/BiscuitOS-PAGING-PF-ECODE-PK/Kconfig

# PageFault ERROR CODE: PF_SUPER
source package/PAGING/BiscuitOS-PAGING-PF-ECODE-SUPER/Kconfig

# PageFault ERROR CODE: PF_SUPER Access UVADDR
source package/PAGING/BiscuitOS-PAGING-PF-ECODE-SUPER-UVADDR/Kconfig

# PageFault ERROR CODE: PF_RSVD
source package/PAGING/BiscuitOS-PAGING-PF-ECODE-RSVD/Kconfig

# PageFault ERROR CODE: PF_INSTR
source package/PAGING/BiscuitOS-PAGING-PF-ECODE-INSTR/Kconfig

# PageFault: Hugefault
source package/PAGING/BiscuitOS-PAGING-PF-HUGEPF/Kconfig

# PageFault: Hugefault PAGEMAP
source package/PAGING/BiscuitOS-PAGING-PF-HUGEPF-PAGEMAP/Kconfig

# PageFault: Hugefault PFNMAP
source package/PAGING/BiscuitOS-PAGING-PF-HUGEPF-PFNMAP/Kconfig

# PageFault: Hugefault 2MiB PFNMAP
source package/PAGING/BiscuitOS-PAGING-PF-HUGEPF-PFNMAP-2M/Kconfig

# PageFault: Hugefault 1Gig PFNMAP
source package/PAGING/BiscuitOS-PAGING-PF-HUGEPF-PFNMAP-1G/Kconfig

# PageFault: THP - AnonHugepages
source package/PAGING/BiscuitOS-PAGING-PF-THP-ANON/Kconfig

# PageFault: THP - AnonHugepages ZERO
source package/PAGING/BiscuitOS-PAGING-PF-THP-ANON-ZERO/Kconfig

# PageFault: THP - AnonHugepages WP
source package/PAGING/BiscuitOS-PAGING-PF-THP-ANON-WP/Kconfig

# PageFault: THP - AnonHugepages COW
source package/PAGING/BiscuitOS-PAGING-PF-THP-ANON-COW/Kconfig

# PageFault: THP - AnonHugepages SWAP
source package/PAGING/BiscuitOS-PAGING-PF-THP-ANON-SWAP/Kconfig

# PageFault: THP - AnonHugepages ZSWAP
source package/PAGING/BiscuitOS-PAGING-PF-THP-ANON-ZSWAP/Kconfig

# PageFault: HUGETLB
source package/PAGING/BiscuitOS-PAGING-PF-HUGETLB/Kconfig

# PageFault: HUGETLB MCE
source package/PAGING/BiscuitOS-PAGING-PF-HUGETLB-MCE/Kconfig

# PageFault: HUGETLB COW
source package/PAGING/BiscuitOS-PAGING-PF-HUGETLB-COW/Kconfig

# PageFault: HUGETLB COW FAULT
source package/PAGING/BiscuitOS-PAGING-PF-HUGETLB-COW-FAULT/Kconfig

# PageFault: HUGETLB SYSV
source package/PAGING/BiscuitOS-PAGING-PF-HUGETLB-SYSV/Kconfig

# PageFault: HUGETLB POSIX
source package/PAGING/BiscuitOS-PAGING-PF-HUGETLB-POSIX/Kconfig

# PageFault: HUGETLB MEMFD
source package/PAGING/BiscuitOS-PAGING-PF-HUGETLB-MEMFD/Kconfig

# PageFault: HUGETLB OOM
source package/PAGING/BiscuitOS-PAGING-PF-HUGETLB-OOM/Kconfig

# PageFault: HUGETLB WP
source package/PAGING/BiscuitOS-PAGING-PF-HUGETLB-WP/Kconfig

# PageFault: HUGETLB 1G
source package/PAGING/BiscuitOS-PAGING-PF-HUGETLB-1G/Kconfig

# PageFault: HUGETLB SURPLUS
source package/PAGING/BiscuitOS-PAGING-PF-HUGETLB-SURPLUS/Kconfig

# PageFault: Userfaultfd
source package/PAGING/BiscuitOS-PAGING-PF-UFFD/Kconfig

# PageFault: Userfaultfd FORK
source package/PAGING/BiscuitOS-PAGING-PF-UFFD-FORK/Kconfig

# PageFault: Userfaultfd REMAP
source package/PAGING/BiscuitOS-PAGING-PF-UFFD-REMAP/Kconfig

# PageFault: Userfaultfd UNMAP
source package/PAGING/BiscuitOS-PAGING-PF-UFFD-UNMAP/Kconfig

# PageFault: Userfaultfd REMOVE
source package/PAGING/BiscuitOS-PAGING-PF-UFFD-REMOVE/Kconfig

# PageFault: Userfaultfd HUGETLB
source package/PAGING/BiscuitOS-PAGING-PF-UFFD-HUGETLB/Kconfig

# PageFault: Userfaultfd SHMEM
source package/PAGING/BiscuitOS-PAGING-PF-UFFD-SHMEM/Kconfig

# PageFault: Userfaultfd WP
source package/PAGING/BiscuitOS-PAGING-PF-UFFD-WP/Kconfig

# PageFault: Userfaultfd ZERO
source package/PAGING/BiscuitOS-PAGING-PF-UFFD-ZERO/Kconfig

# PageFault: SIGBUS
source package/PAGING/BiscuitOS-PAGING-PF-SIGBUS/Kconfig

# PageFault: SIGEGV
source package/PAGING/BiscuitOS-PAGING-PF-SIGEGV/Kconfig

# PageFault: KERNEL
source package/PAGING/BiscuitOS-PAGING-PF-KERNEL/Kconfig

# PageFault: KERNEL RW
source package/PAGING/BiscuitOS-PAGING-PF-KERNEL-RW/Kconfig

# PageFault: KERNEL NX
source package/PAGING/BiscuitOS-PAGING-PF-KERNEL-NX/Kconfig

# PageFault: KERNEL KPROBE
source package/PAGING/BiscuitOS-PAGING-PF-KERNEL-KPROBE/Kconfig

# PageFault: KERNEL SPUR RW
source package/PAGING/BiscuitOS-PAGING-PF-KERNEL-SPUR-RW/Kconfig

# PageFault: KERNEL SPUR NX
source package/PAGING/BiscuitOS-PAGING-PF-KERNEL-SPUR-NX/Kconfig

# PageFault: ATRP CONSULT
source package/PAGING/BiscuitOS-PAGING-ATPR-CONSULT/Kconfig

# PageFault: ATRP LAZYALLOC
source package/PAGING/BiscuitOS-PAGING-ATPR-LAZY/Kconfig

# PageFault: ATRP PREALLOC
source package/PAGING/BiscuitOS-PAGING-ATPR-PREALLOC/Kconfig

# PageFault: ATRP ONDEMAND
source package/PAGING/BiscuitOS-PAGING-ATPR-ONDEMAND/Kconfig

# CPA
source package/PAGING/BiscuitOS-PAGING-PT-CPA/Kconfig

# Linear-Mapping
source package/PAGING/BiscuitOS-PAGING-LM/Kconfig

# Linear-Mapping: Consult PFN Range
source package/PAGING/BiscuitOS-PAGING-LM-CONSULT-RANGE/Kconfig

# Linear-Mapping: Temporary mapping
source package/PAGING/BiscuitOS-PAGING-LM-TEMP/Kconfig

# Linear-Mapping: Buddy
source package/PAGING/BiscuitOS-PAGING-LM-BUDDY/Kconfig

# Linear-Mapping: MEMBLOCK
source package/PAGING/BiscuitOS-PAGING-LM-MEMBLOCK/Kconfig

# Linear-Mapping: SLAB
source package/PAGING/BiscuitOS-PAGING-LM-SLAB/Kconfig

# VMALLOC-Mapping
source package/PAGING/BiscuitOS-PAGING-VMALLOC/Kconfig

# VMALLOC-Mapping: HUGE
source package/PAGING/BiscuitOS-PAGING-VMALLOC-HUGE/Kconfig

# MMIO-Mapping
source package/PAGING/BiscuitOS-PAGING-MMIO-MAPPING/Kconfig

# PFNMAP: PFNREMAP
source package/PAGING/BiscuitOS-PAGING-PFNMAP-PFNREMAP/Kconfig

# PFNMAP: MEMREMAP
source package/PAGING/BiscuitOS-PAGING-PFNMAP-MEMREMAP/Kconfig

# PFNMAP: CUSTOMIZE PREALLOC
source package/PAGING/BiscuitOS-PAGING-PFNMAP-CUSTOMIZE-PREALLOC/Kconfig

# PFNMAP: CUSTOMIZE LAZYALLOC
source package/PAGING/BiscuitOS-PAGING-PFNMAP-CUSTOMIZE-LAZYALLOC/Kconfig

# PFNMAP: CUSTOMIZE ONDEMAND
source package/PAGING/BiscuitOS-PAGING-PFNMAP-CUSTOMIZE-ONDEMAND/Kconfig

# PFNMAP: CUSTOMIZE 2MiB
source package/PAGING/BiscuitOS-PAGING-PFNMAP-CUSTOMIZE-2M/Kconfig

# PFNMAP: CUSTOMIZE 1Gig
source package/PAGING/BiscuitOS-PAGING-PFNMAP-CUSTOMIZE-1G/Kconfig

# UMSPA: RSVDMEM
source package/PAGING/BiscuitOS-PAGING-UMSPA-RSVDMEM/Kconfig

# UMSPA: MMIO
source package/PAGING/BiscuitOS-PAGING-UMSPA-MMIO/Kconfig

# UMSPA: STRICT OSMEM
source package/PAGING/BiscuitOS-PAGING-UMSPA-STRICT-OSMEM/Kconfig

# TEMPORARY: OSMEM OnDemand
source package/PAGING/BiscuitOS-PAGING-TEMP-OSMEM-ONDEMAND/Kconfig

# TEMPORARY: RSVDMEM OnDemand
source package/PAGING/BiscuitOS-PAGING-TEMP-RSVDMEM-ONDEMAND/Kconfig

# TEMPORARY: MMIO OnDemand
source package/PAGING/BiscuitOS-PAGING-TEMP-MMIO-ONDEMAND/Kconfig

# TEMPORARY: OSMEM
source package/PAGING/BiscuitOS-PAGING-TEMP-OSMEM-MIGRATE/Kconfig

# CPR
source package/PAGING/BiscuitOS-PAGING-PT-CPR/Kconfig

# CPR: SHMEM
source package/PAGING/BiscuitOS-PAGING-PT-CPR-SHMEM/Kconfig

# CPR: FILE
source package/PAGING/BiscuitOS-PAGING-PT-CPR-FILE/Kconfig

# CPR: UFFD WP
source package/PAGING/BiscuitOS-PAGING-PT-CPR-UFFD-WP/Kconfig

# CPR: PFNMAP
source package/PAGING/BiscuitOS-PAGING-PT-CPR-PFNMAP/Kconfig

# CPR: NON ANON-VMA
source package/PAGING/BiscuitOS-PAGING-PT-CPR-NONAV/Kconfig

# CPR: WIPE
source package/PAGING/BiscuitOS-PAGING-PT-CPR-WIPE/Kconfig

# CPR: HUGETLB
source package/PAGING/BiscuitOS-PAGING-PT-CPR-HUGETLB/Kconfig

# LOOKUP-ADDRESS
source package/PAGING/BiscuitOS-PAGING-LOOKUP-ADDR/Kconfig

# LOOKUP-ADDRESS: RSVDMEM
source package/PAGING/BiscuitOS-PAGING-LOOKUP-ADDR-RSVDMEM/Kconfig

# LOOKUP-ADDRESS: VMALLOC
source package/PAGING/BiscuitOS-PAGING-LOOKUP-ADDR-VMALLOC/Kconfig

# LOOKUP-ADDRESS: MMIO
source package/PAGING/BiscuitOS-PAGING-LOOKUP-ADDR-MMIO/Kconfig

# LOOKUP-ADDRESS: MEMBLOCK
source package/PAGING/BiscuitOS-PAGING-LOOKUP-ADDR-MEMBLOCK/Kconfig

# LOOKUP-ADDRESS: FIXMAP
source package/PAGING/BiscuitOS-PAGING-LOOKUP-ADDR-FIXMAP/Kconfig

# LOOKUP-ADDRESS: EARLY
source package/PAGING/BiscuitOS-PAGING-LOOKUP-ADDR-EARLY/Kconfig

# LOOKUP-ADDRESS: PMD
source package/PAGING/BiscuitOS-PAGING-LOOKUP-ADDR-PMD/Kconfig

# FOLLOW USER PT: PTE
source package/PAGING/BiscuitOS-PAGING-PT-FUPT-PTE/Kconfig

# FOLLOW USER PT: PFN
source package/PAGING/BiscuitOS-PAGING-PT-FUPT-PFN/Kconfig

# FOLLOW USER PT: PHYS
source package/PAGING/BiscuitOS-PAGING-PT-FUPT-PHYS/Kconfig

# PT PAGE_PRESENT: Empty
source package/PAGING/BiscuitOS-PAGING-PT-PAGE-PRESENT-EMPTY/Kconfig

# PT PAGE_PRESENT: PROTNONE
source package/PAGING/BiscuitOS-PAGING-PT-PAGE-PRESENT-PROTNONE/Kconfig

# PT PAGE_PRESENT: SWAP
source package/PAGING/BiscuitOS-PAGING-PT-PAGE-PRESENT-SWAP/Kconfig

# PT PAGE_PRESENT: UE
source package/PAGING/BiscuitOS-PAGING-PT-PAGE-PRESENT-UE/Kconfig

# PT PAGE_RW: RO
source package/PAGING/BiscuitOS-PAGING-PT-PAGE-RW-RO/Kconfig

# PT PAGE_RW: ZERO
source package/PAGING/BiscuitOS-PAGING-PT-PAGE-RW-ZERO/Kconfig

# PT PAGE_RW: WP
source package/PAGING/BiscuitOS-PAGING-PT-PAGE-RW-WP/Kconfig

# PT PAGE_RW: PROTNONE
source package/PAGING/BiscuitOS-PAGING-PT-PAGE-RW-PROTNONE/Kconfig

# PT PAGE_ACCESSED: ANON 
source package/PAGING/BiscuitOS-PAGING-PT-PAGE-ACCESSED-ANON/Kconfig

# PT PAGE_ACCESSED: FILE
source package/PAGING/BiscuitOS-PAGING-PT-PAGE-ACCESSED-FILE/Kconfig

# PT PAGE_PK
source package/PAGING/BiscuitOS-PAGING-PT-PAGE-PK/Kconfig

# USER-2-PT: PAGE_PRESENT
source package/PAGING/BiscuitOS-PAGING-PT-U2PT-PAGE-PRESENT/Kconfig

# USER-2-PT: PAGE_USER
source package/PAGING/BiscuitOS-PAGING-PT-U2PT-PAGE-USER/Kconfig

# USER-2-PT: PAGE_RW SET
source package/PAGING/BiscuitOS-PAGING-PT-U2PT-PAGE-RW-SET/Kconfig

# USER-2-PT: PAGE_RW CLEAR
source package/PAGING/BiscuitOS-PAGING-PT-U2PT-PAGE-RW-CLEAR/Kconfig

# USER-2-PT: PAGE_DIRTY SET
source package/PAGING/BiscuitOS-PAGING-PT-U2PT-PAGE-DIRTY-SET/Kconfig

# USER-2-PT: PAGE_SOFT_DIRTY SET
source package/PAGING/BiscuitOS-PAGING-PT-U2PT-PAGE-SOFT-DIRTY-SET/Kconfig

# USER-2-PT: PAGE_ACCESSED SET
source package/PAGING/BiscuitOS-PAGING-PT-U2PT-PAGE-ACCESSED-SET/Kconfig

# USER-2-PT: PAGE_SPECIAL SET
source package/PAGING/BiscuitOS-PAGING-PT-U2PT-PAGE-SPECIAL-SET/Kconfig

# USER-2-PT: PAGE_PK SET
source package/PAGING/BiscuitOS-PAGING-PT-U2PT-PAGE-PK-SET/Kconfig

# USER-2-PT: PAGE_PSE SET
source package/PAGING/BiscuitOS-PAGING-PT-U2PT-PAGE-PSE-SET/Kconfig

# USER-2-PT: PAGE_PAT SET
source package/PAGING/BiscuitOS-PAGING-PT-U2PT-PAGE-PAT-SET/Kconfig

# KERNEL-2-PT: PAGE_KERNEL
source package/PAGING/BiscuitOS-PAGING-PT-K2PT-PAGE-KERNEL/Kconfig

# KERNEL-2-PT: PAGE_KERNEL_NOENC
source package/PAGING/BiscuitOS-PAGING-PT-K2PT-PAGE-KERNEL-NOENC/Kconfig

# KERNEL-2-PT: PAGE_KERNEL_RO
source package/PAGING/BiscuitOS-PAGING-PT-K2PT-PAGE-KERNEL-RO/Kconfig

# KERNEL-2-PT: PAGE_KERNEL_EXEC
source package/PAGING/BiscuitOS-PAGING-PT-K2PT-PAGE-KERNEL-EXEC/Kconfig

# KERNEL-2-PT: PAGE_KERNEL_ROX
source package/PAGING/BiscuitOS-PAGING-PT-K2PT-PAGE-KERNEL-ROX/Kconfig

# KERNEL-2-PT: PAGE_KERNEL_NOCACHE
source package/PAGING/BiscuitOS-PAGING-PT-K2PT-PAGE-KERNEL-NOCACHE/Kconfig

# KERNEL-2-PT: PAGE_KERNEL_VVAR
source package/PAGING/BiscuitOS-PAGING-PT-K2PT-PAGE-KERNEL-VVAR/Kconfig

# KERNEL-2-PT: PAGE_KERNEL_IO
source package/PAGING/BiscuitOS-PAGING-PT-K2PT-PAGE-KERNEL-IO/Kconfig

# KERNEL-2-PT: PAGE_KERNEL_IO_NOCACHE
source package/PAGING/BiscuitOS-PAGING-PT-K2PT-PAGE-KERNEL-IO-NOCACHE/Kconfig

# INTEL PAT
source package/PAGING/BiscuitOS-PAGING-INTEL-PAT/Kconfig

# INTEL MTRRS
source package/PAGING/BiscuitOS-PAGING-INTEL-MTRRS/Kconfig

# INTEL MTRRS IOCTL
source package/PAGING/BiscuitOS-PAGING-INTEL-MTRRS-IOCTL/Kconfig

# INTEL MTRRS IOCTL2
source package/PAGING/BiscuitOS-PAGING-INTEL-MTRRS-IOCTL2/Kconfig

# INTEL PK
source package/PAGING/BiscuitOS-PAGING-INTEL-PK/Kconfig

# TOOLS: KPROBE
source package/PAGING/BiscuitOS-PAGING-TOOLS-KPROBE/Kconfig

# PREALLOC: ANON
source package/PAGING/BiscuitOS-PAGING-VM-PREALLOC-ANON/Kconfig

# PREALLOC: SHMEM
source package/PAGING/BiscuitOS-PAGING-VM-PREALLOC-SHMEM/Kconfig

# PREALLOC: FILE
source package/PAGING/BiscuitOS-PAGING-VM-PREALLOC-FILE/Kconfig

# PREALLOC: PFNMAP
source package/PAGING/BiscuitOS-PAGING-VM-PREALLOC-PFNMAP/Kconfig

# PREALLOC: MMIO
source package/PAGING/BiscuitOS-PAGING-VM-PREALLOC-MMIO/Kconfig

# PREALLOC: DMA
source package/PAGING/BiscuitOS-PAGING-VM-PREALLOC-DMA/Kconfig

# PREALLOC: VMALLOC
source package/PAGING/BiscuitOS-PAGING-VM-PREALLOC-VMALLOC/Kconfig

# PREALLOC: THP
source package/PAGING/BiscuitOS-PAGING-VM-PREALLOC-THP/Kconfig

# PREALLOC: HUGETLB
source package/PAGING/BiscuitOS-PAGING-VM-PREALLOC-HUGETLB/Kconfig

# PREALLOC: DAX
source package/PAGING/BiscuitOS-PAGING-VM-PREALLOC-DAX/Kconfig

# LAZYALLOC: ANON
source package/PAGING/BiscuitOS-PAGING-VM-LAZYALLOC-ANON/Kconfig

# LAZYALLOC: SHMEM
source package/PAGING/BiscuitOS-PAGING-VM-LAZYALLOC-SHMEM/Kconfig

# LAZYALLOC: FILE
source package/PAGING/BiscuitOS-PAGING-VM-LAZYALLOC-FILE/Kconfig

# LAZYALLOC: PFNMAP
source package/PAGING/BiscuitOS-PAGING-VM-LAZYALLOC-PFNMAP/Kconfig

# LAZYALLOC: MMIO
source package/PAGING/BiscuitOS-PAGING-VM-LAZYALLOC-MMIO/Kconfig

# LAZYALLOC: DMA
source package/PAGING/BiscuitOS-PAGING-VM-LAZYALLOC-DMA/Kconfig

# LAZYALLOC: VMALLOC
source package/PAGING/BiscuitOS-PAGING-VM-LAZYALLOC-VMALLOC/Kconfig

# LAZYALLOC: THP
source package/PAGING/BiscuitOS-PAGING-VM-LAZYALLOC-THP/Kconfig

# LAZYALLOC: HUGETLB
source package/PAGING/BiscuitOS-PAGING-VM-LAZYALLOC-HUGETLB/Kconfig

# LAZYALLOC: DAX
source package/PAGING/BiscuitOS-PAGING-VM-LAZYALLOC-DAX/Kconfig

# ONDEMAND: IOCTL
source package/PAGING/BiscuitOS-PAGING-VM-ONDEMAND-IOCTL/Kconfig

# ONDEMAND: MLOCK
source package/PAGING/BiscuitOS-PAGING-VM-ONDEMAND-MLOCK/Kconfig

# ONDEMAND: MADVISE
source package/PAGING/BiscuitOS-PAGING-VM-ONDEMAND-MADVISE/Kconfig

# ZERO PAGE
source package/PAGING/BiscuitOS-PAGING-VM-ZERO-PAGE/Kconfig

# ZERO HPAGE
source package/PAGING/BiscuitOS-PAGING-VM-ZERO-HPAGE/Kconfig

# ZERO PAGE: ONDEMAND
source package/PAGING/BiscuitOS-PAGING-VM-ZERO-PAGE-ONDEMAND/Kconfig

# ZERO COPY: PAGECACHE
source package/PAGING/BiscuitOS-PAGING-VM-ZERO-COPY-PAGECACHE/Kconfig

# ZERO COPY: VMALLOC
source package/PAGING/BiscuitOS-PAGING-VM-ZERO-COPY-VMALLOC/Kconfig

# ZERO COPY: DMA
source package/PAGING/BiscuitOS-PAGING-VM-ZERO-COPY-DMA/Kconfig

# ZERO COPY: DMA-BUF
source package/PAGING/BiscuitOS-PAGING-VM-ZERO-COPY-DMABUF/Kconfig

# RMAP: ANONYMOUS
source package/PAGING/BiscuitOS-PAGING-RMAP-ANON/Kconfig

# RMAP: FILE
source package/PAGING/BiscuitOS-PAGING-RMAP-FILE/Kconfig

# VTP: PAGE
source package/PAGING/BiscuitOS-PAGING-PT-VTP-PAGE/Kconfig

# VTP: PFN
source package/PAGING/BiscuitOS-PAGING-PT-VTP-PFN/Kconfig

# EARLY IO: MMIO
source package/PAGING/BiscuitOS-PAGING-VM-EARLY-IO-MMIO/Kconfig

# EARLY IO: RSVDMEM
source package/PAGING/BiscuitOS-PAGING-VM-EARLY-IO-RSVDMEM/Kconfig

# PERMANENT: MMIO
source package/PAGING/BiscuitOS-PAGING-VM-PERMANENT-MMIO/Kconfig

# PERMANENT: RSVDMEM
source package/PAGING/BiscuitOS-PAGING-VM-PERMANENT-RSVDMEM/Kconfig

# MISC
source package/PAGING/BiscuitOS-PAGING-MISC/Kconfig

# ENGINERRING APPLICATION: SIMPLE ALLOCATOR
source package/PAGING/BiscuitOS-PAGING-EA-SIMPLE-ALLOCATOR/Kconfig

# ENGINERRING APPLICATION: SIMPLE KERNEL ALLOCATOR
source package/PAGING/BiscuitOS-PAGING-EA-SIMPLE-KERNEL-ALLOCATOR/Kconfig

# ENGINERRING APPLICATION: CENTRALIZED MAPPING
source package/PAGING/BiscuitOS-PAGING-EA-CENTRALIZED-MAPPING/Kconfig

endif # PK_PAGING
```
