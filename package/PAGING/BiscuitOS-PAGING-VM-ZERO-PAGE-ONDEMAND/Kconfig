## package/PERF-TOOLS/Kconfig
```kconfig
menuconfig PK_LINUX_PERF
	bool "Perf Tools"

if PK_LINUX_PERF

config PK_LINUX_PERF_VERSION
	default "default"
	string "verstion"

config PK_LINUX_PERF_TAR
	default "tar.gz"
	string "tar type"

config PK_LINUX_PERF_URL
	string "url"

config PK_LINUX_PERF_GITHUB
	string "GitHub"

config PK_LINUX_PERF_SRCFILE
	string "Source code list"

config PK_LINUX_PERF_CONFIG
	string "CONFIG: Project Configure Options"

config PK_LINUX_PERF_LIBPATH
	string "LIBS: Libraries to pass to the linker, e.g. -l<library>"

config PK_LINUX_PERF_CPPFLAGS
	string "CPPFLAGS: C/C++ preprocessor flags, e.g. -I<include dir>"

config PK_LINUX_PERF_DPKCONFIG
	string "PKG_CONFIG_PATH: Directories to add to pkg-config's search path"

config PK_LINUX_PERF_CFLAGS
	string "CFLAGS: C compiler flags"

config PK_LINUX_PERF_LDFLAGS
	string "LDFLAGS: Linker flags"

config PK_LINUX_PERF_CXXFLAGS
	string "CXXFLAGS: C++ compiler flags"

config PK_LINUX_PERF_ASFLAGS
	string "CCASFLAGS: assembler compiler flags (defaults to CFLAGS)"

config PK_LINUX_PERF_BUILDARCH
	default "x86_64-unknown-linux-gnu"
	string "--host options on configure for Architecture"

endif # PK_LINUX_PERF
```

## package/Python/Kconfig
```kconfig
menuconfig PK_PYTHON
	bool "Python"

if PK_PYTHON

config PK_PYTHON_VERSION
	default "2.7.13"
	string "verstion"

config PK_PYTHON_TAR
	default "tar.xz"
	string "tar type"

config PK_PYTHON_URL
	default "https://www.python.org/ftp/python/2.7.13/"
	string "url"

config PK_PYTHON_GITHUB
	string "GitHub"

config PK_PYTHON_SRCFILE
	string "Source code list"

config PK_PYTHON_CONFIG
	default "--with-system-ffi --with-threads --with-pymalloc --without-cxx-main --with-signal-module --enable-shared --enable-ipv6=yes ac_cv_header_bluetooth_bluetooth_h=no ac_cv_header_bluetooth_h=no ac_cv_file__dev_ptmx=yes ac_cv_file__dev_ptc=no --disable-static"
	string "CONFIG: Project Configure Options"

config PK_PYTHON_LIBPATH
	string "LIBS: Libraries to pass to the linker, e.g. -l<library>"

config PK_PYTHON_CPPFLAGS
	string "CPPFLAGS: C/C++ preprocessor flags, e.g. -I<include dir>"

config PK_PYTHON_DPKCONFIG
	string "PKG_CONFIG_PATH: Directories to add to pkg-config's search path"

config PK_PYTHON_CFLAGS
	string "CFLAGS: C compiler flags"

config PK_PYTHON_LDFLAGS
	string "LDFLAGS: Linker flags"

config PK_PYTHON_CXXFLAGS
	string "CXXFLAGS: C++ compiler flags"

config PK_PYTHON_ASFLAGS
	string "CCASFLAGS: assembler compiler flags (defaults to CFLAGS)"

config PK_PYTHON_BUILDARCH
	default "x86_64-unknown-linux-gnu"
	string "--host options on configure for Architecture"

endif # PK_PYTHON
```

## package/Register/Kconfig
```kconfig
menuconfig PK_REGISTER
	bool "Register"

if PK_REGISTER

# X86 Architecture
source package/Register/x86/Kconfig

endif # PK_REGISTER
```

## package/Register/x86/CPUID/CPUID-Default/Kconfig
```kconfig
menuconfig PK_CPUID_DEFAULT
	bool "X86 CPUID Register"

if PK_CPUID_DEFAULT

config PK_CPUID_DEFAULT_VERSION
	default "default"
	string "verstion"

config PK_CPUID_DEFAULT_TAR
	default "tar.gz"
	string "tar type"

config PK_CPUID_DEFAULT_URL
	default "https://gitee.com/BiscuitOS_team/HardStack/raw/Gitee/Architecture/Intel/Register/CPUID/CPUID-Default"
	string "url"

config PK_CPUID_DEFAULT_GITHUB
	string "GitHub"

config PK_CPUID_DEFAULT_SRCFILE
	default "main.c Kconfig Makefile"
	string "Source code list"

config PK_CPUID_DEFAULT_CSRCFILE
	string "Compile source code list"

config PK_CPUID_DEFAULT_CONFIG
	string "CONFIG: Project Configure Options"

config PK_CPUID_DEFAULT_LIBPATH
	string "LIBS: Libraries to pass to the linker, e.g. -l<library>"

config PK_CPUID_DEFAULT_CPPFLAGS
	string "CPPFLAGS: C/C++ preprocessor flags, e.g. -I<include dir>"

config PK_CPUID_DEFAULT_DPKCONFIG
	string "PKG_CONFIG_PATH: Directories to add to pkg-config's search path"

config PK_CPUID_DEFAULT_CFLAGS
	string "CFLAGS: C compiler flags"

config PK_CPUID_DEFAULT_LDFLAGS
	string "LDFLAGS: Linker flags"

config PK_CPUID_DEFAULT_CXXFLAGS
	string "CXXFLAGS: C++ compiler flags"

config PK_CPUID_DEFAULT_ASFLAGS
	string "CCASFLAGS: assembler compiler flags (defaults to CFLAGS)"

config PK_CPUID_DEFAULT_BUILDARCH
	string "--host options on configure for Architecture"

endif # PK_CPUID_DEFAULT
```

## package/Register/x86/CPUID/CPUID.01H/CPUID.01H-Default/Kconfig
```kconfig
menuconfig PK_CPUID.01H_DEFAULT
	bool "X86 CPUID.01H Register"

if PK_CPUID.01H_DEFAULT

config PK_CPUID.01H_DEFAULT_VERSION
	default "default"
	string "verstion"

config PK_CPUID.01H_DEFAULT_TAR
	default "tar.gz"
	string "tar type"

config PK_CPUID.01H_DEFAULT_URL
	default "https://gitee.com/BiscuitOS_team/HardStack/raw/Gitee/Architecture/Intel/Register/CPUID/CPUID.01H/Default"
	string "url"

config PK_CPUID.01H_DEFAULT_GITHUB
	string "GitHub"

config PK_CPUID.01H_DEFAULT_SRCFILE
	default "main.c Kconfig Makefile"
	string "Source code list"

config PK_CPUID.01H_DEFAULT_CSRCFILE
	string "Compile source code list"

config PK_CPUID.01H_DEFAULT_CONFIG
	string "CONFIG: Project Configure Options"

config PK_CPUID.01H_DEFAULT_LIBPATH
	string "LIBS: Libraries to pass to the linker, e.g. -l<library>"

config PK_CPUID.01H_DEFAULT_CPPFLAGS
	string "CPPFLAGS: C/C++ preprocessor flags, e.g. -I<include dir>"

config PK_CPUID.01H_DEFAULT_DPKCONFIG
	string "PKG_CONFIG_PATH: Directories to add to pkg-config's search path"

config PK_CPUID.01H_DEFAULT_CFLAGS
	string "CFLAGS: C compiler flags"

config PK_CPUID.01H_DEFAULT_LDFLAGS
	string "LDFLAGS: Linker flags"

config PK_CPUID.01H_DEFAULT_CXXFLAGS
	string "CXXFLAGS: C++ compiler flags"

config PK_CPUID.01H_DEFAULT_ASFLAGS
	string "CCASFLAGS: assembler compiler flags (defaults to CFLAGS)"

config PK_CPUID.01H_DEFAULT_BUILDARCH
	string "--host options on configure for Architecture"

endif # PK_CPUID.01H_DEFAULT
```

## package/Register/x86/CPUID/CPUID.01H/Kconfig
```kconfig
menuconfig PK_CPUID_01H
	bool "CPUID.01H Register"

if PK_CPUID_01H

# CPUID.01H Default
source "package/Register/x86/CPUID/CPUID.01H/CPUID.01H-Default/Kconfig"

endif # PK_REGISTER_X86
```

## package/Register/x86/CPUID/CPUID.80000008H/Kconfig
```kconfig
menuconfig PK_CPUID_80000008H
	bool "CPUID.80000008H Register"

if PK_CPUID_80000008H

# CPUID.80000008H Default
source "package/Register/x86/CPUID/CPUID.80000008H/CPUID.80000008H-Default/Kconfig"

endif # PK_REGISTER_X86
```

## package/Register/x86/CPUID/Kconfig
```kconfig
menuconfig PK_X86_CPUID
	bool "CPUID"

if PK_X86_CPUID

# CPUID
source "package/Register/x86/CPUID/CPUID-Default/Kconfig"

# CPUID.01H
source "package/Register/x86/CPUID/CPUID.01H/Kconfig"

# CPUID.80000008H
source "package/Register/x86/CPUID/CPUID.80000008H/Kconfig"

endif
```

## package/Register/x86/CR0/Kconfig
```kconfig
menuconfig PK_X86_CR0
	bool "CR0 Control Register"

if PK_X86_CR0

config PK_X86_CR0_VERSION
	default "default"
	string "verstion"

config PK_X86_CR0_TAR
	default "tar.gz"
	string "tar type"

config PK_X86_CR0_URL
	default "https://gitee.com/BiscuitOS_team/HardStack/raw/Gitee/Architecture/Intel/Register/CR0"
	string "url"

config PK_X86_CR0_GITHUB
	string "GitHub"

config PK_X86_CR0_SRCFILE
	default "main.c Kconfig Makefile"
	string "Source code list"

config PK_X86_CR0_CSRCFILE
	string "Compile source code list"

config PK_X86_CR0_CONFIG
	string "CONFIG: Project Configure Options"

config PK_X86_CR0_LIBPATH
	string "LIBS: Libraries to pass to the linker, e.g. -l<library>"

config PK_X86_CR0_CPPFLAGS
	string "CPPFLAGS: C/C++ preprocessor flags, e.g. -I<include dir>"

config PK_X86_CR0_DPKCONFIG
	string "PKG_CONFIG_PATH: Directories to add to pkg-config's search path"

config PK_X86_CR0_CFLAGS
	string "CFLAGS: C compiler flags"

config PK_X86_CR0_LDFLAGS
	string "LDFLAGS: Linker flags"

config PK_X86_CR0_CXXFLAGS
	string "CXXFLAGS: C++ compiler flags"

config PK_X86_CR0_ASFLAGS
	string "CCASFLAGS: assembler compiler flags (defaults to CFLAGS)"

config PK_X86_CR0_BUILDARCH
	string "--host options on configure for Architecture"

endif # PK_X86_CR0
```

## package/Register/x86/CR3/CR3-Default/Kconfig
```kconfig
menuconfig PK_CR3_DEFAULT
	bool "X86 CR3 Register (Common)"

if PK_CR3_DEFAULT

config PK_CR3_DEFAULT_VERSION
	default "default"
	string "verstion"

config PK_CR3_DEFAULT_TAR
	default "tar.gz"
	string "tar type"

config PK_CR3_DEFAULT_URL
	default "https://gitee.com/BiscuitOS_team/HardStack/raw/Gitee/Architecture/Intel/Register/CR3/CR3-Default"
	string "url"

config PK_CR3_DEFAULT_GITHUB
	string "GitHub"

config PK_CR3_DEFAULT_SRCFILE
	default "main.c Kconfig Makefile"
	string "Source code list"

config PK_CR3_DEFAULT_CSRCFILE
	string "Compile source code list"

config PK_CR3_DEFAULT_CONFIG
	string "CONFIG: Project Configure Options"

config PK_CR3_DEFAULT_LIBPATH
	string "LIBS: Libraries to pass to the linker, e.g. -l<library>"

config PK_CR3_DEFAULT_CPPFLAGS
	string "CPPFLAGS: C/C++ preprocessor flags, e.g. -I<include dir>"

config PK_CR3_DEFAULT_DPKCONFIG
	string "PKG_CONFIG_PATH: Directories to add to pkg-config's search path"

config PK_CR3_DEFAULT_CFLAGS
	string "CFLAGS: C compiler flags"

config PK_CR3_DEFAULT_LDFLAGS
	string "LDFLAGS: Linker flags"

config PK_CR3_DEFAULT_CXXFLAGS
	string "CXXFLAGS: C++ compiler flags"

config PK_CR3_DEFAULT_ASFLAGS
	string "CCASFLAGS: assembler compiler flags (defaults to CFLAGS)"

config PK_CR3_DEFAULT_BUILDARCH
	string "--host options on configure for Architecture"

endif # PK_CR3_DEFAULT
```

## package/Register/x86/CR3/Kconfig
```kconfig
menuconfig PK_X86_CR3
	bool "CR3 Register"

if PK_X86_CR3

# Default
source "package/Register/x86/CR3/CR3-Default/Kconfig"

endif # PK_REGISTER_X86
```

## package/Register/x86/CR4/Kconfig
```kconfig
menuconfig PK_X86_CR4
	bool "CR4 Control Register"

if PK_X86_CR4

config PK_X86_CR4_VERSION
	default "default"
	string "verstion"

config PK_X86_CR4_TAR
	default "tar.gz"
	string "tar type"

config PK_X86_CR4_URL
	default "https://gitee.com/BiscuitOS_team/HardStack/raw/Gitee/Architecture/Intel/Register/CR4"
	string "url"

config PK_X86_CR4_GITHUB
	string "GitHub"

config PK_X86_CR4_SRCFILE
	default "main.c Kconfig Makefile"
	string "Source code list"

config PK_X86_CR4_CSRCFILE
	string "Compile source code list"

config PK_X86_CR4_CONFIG
	string "CONFIG: Project Configure Options"

config PK_X86_CR4_LIBPATH
	string "LIBS: Libraries to pass to the linker, e.g. -l<library>"

config PK_X86_CR4_CPPFLAGS
	string "CPPFLAGS: C/C++ preprocessor flags, e.g. -I<include dir>"

config PK_X86_CR4_DPKCONFIG
	string "PKG_CONFIG_PATH: Directories to add to pkg-config's search path"

config PK_X86_CR4_CFLAGS
	string "CFLAGS: C compiler flags"

config PK_X86_CR4_LDFLAGS
	string "LDFLAGS: Linker flags"

config PK_X86_CR4_CXXFLAGS
	string "CXXFLAGS: C++ compiler flags"

config PK_X86_CR4_ASFLAGS
	string "CCASFLAGS: assembler compiler flags (defaults to CFLAGS)"

config PK_X86_CR4_BUILDARCH
	string "--host options on configure for Architecture"

endif # PK_X86_CR4
```

## package/Register/x86/EFLAGS/EFLAGS-Default/Kconfig
```kconfig
menuconfig PK_EFLAGS_DEFAULT
	bool "X86 EFLAGS Register"

if PK_EFLAGS_DEFAULT

config PK_EFLAGS_DEFAULT_VERSION
	default "default"
	string "verstion"

config PK_EFLAGS_DEFAULT_TAR
	default "tar.gz"
	string "tar type"

config PK_EFLAGS_DEFAULT_URL
	default "https://gitee.com/BiscuitOS_team/HardStack/raw/Gitee/Architecture/Intel/Register/EFLAGS/default"
	string "url"

config PK_EFLAGS_DEFAULT_GITHUB
	string "GitHub"

config PK_EFLAGS_DEFAULT_SRCFILE
	default "main.c Kconfig Makefile"
	string "Source code list"

config PK_EFLAGS_DEFAULT_CSRCFILE
	string "Compile source code list"

config PK_EFLAGS_DEFAULT_CONFIG
	string "CONFIG: Project Configure Options"

config PK_EFLAGS_DEFAULT_LIBPATH
	string "LIBS: Libraries to pass to the linker, e.g. -l<library>"

config PK_EFLAGS_DEFAULT_CPPFLAGS
	string "CPPFLAGS: C/C++ preprocessor flags, e.g. -I<include dir>"

config PK_EFLAGS_DEFAULT_DPKCONFIG
	string "PKG_CONFIG_PATH: Directories to add to pkg-config's search path"

config PK_EFLAGS_DEFAULT_CFLAGS
	string "CFLAGS: C compiler flags"

config PK_EFLAGS_DEFAULT_LDFLAGS
	string "LDFLAGS: Linker flags"

config PK_EFLAGS_DEFAULT_CXXFLAGS
	string "CXXFLAGS: C++ compiler flags"

config PK_EFLAGS_DEFAULT_ASFLAGS
	string "CCASFLAGS: assembler compiler flags (defaults to CFLAGS)"

config PK_EFLAGS_DEFAULT_BUILDARCH
	string "--host options on configure for Architecture"

endif # PK_EFLAGS_DEFAULT
```

## package/Register/x86/EFLAGS/Kconfig
```kconfig
menuconfig PK_X86_EFLAGS
	bool "EFLAGS Register"

if PK_X86_EFLAGS

# MSR_IA32_EFER
source "package/Register/x86/EFLAGS/EFLAGS-Default/Kconfig"

endif # PK_REGISTER_X86
```

## package/Register/x86/Kconfig
```kconfig
menuconfig PK_REGISTER_X86
	bool "X86/i386/X64 Register"

if PK_REGISTER_X86

# CPID
source "package/Register/x86/CPUID/Kconfig"

# CR0
source "package/Register/x86/CR0/Kconfig"

# CR3
source "package/Register/x86/CR3/Kconfig"

# CR4
source "package/Register/x86/CR4/Kconfig"

# EFLAGS
source "package/Register/x86/EFLAGS/Kconfig"

# MSR
source "package/Register/x86/MSR/Kconfig"

endif # PK_REGISTER_X86
```

## package/Register/x86/MSR/Kconfig
```kconfig
menuconfig PK_X86_MSR
	bool "MSR Register"

if PK_X86_MSR

# MSR_IA32_EFER
source "package/Register/x86/MSR/MSR-IA32_EFER/Kconfig"

# MSR_IA32_MTRRCAP
source "package/Register/x86/MSR/MSR-IA32_MTRRCAP/Kconfig"

# MSR_IA32_MTRR_DEF_TYPE
source "package/Register/x86/MSR/MSR-IA32_MTRR_DEF_TYPE/Kconfig"

# MSR_IA32_MTRR_FIX64K_00000
source "package/Register/x86/MSR/MSR-IA32_MTRR_FIX64K_00000/Kconfig"

# MSR_IA32_MTRR_FIX16K_80000
source "package/Register/x86/MSR/MSR-IA32_MTRR_FIX16K_80000/Kconfig"

# MSR_IA32_MTRR_FIX16K_A0000
source "package/Register/x86/MSR/MSR-IA32_MTRR_FIX16K_A0000/Kconfig"

# MSR_IA32_MTRR_FIX4K_C0000
source "package/Register/x86/MSR/MSR-IA32_MTRR_FIX4K_C0000/Kconfig"

# MSR_IA32_MTRR_FIX4K_C8000
source "package/Register/x86/MSR/MSR-IA32_MTRR_FIX4K_C8000/Kconfig"

# MSR_IA32_MTRR_FIX4K_D0000
source "package/Register/x86/MSR/MSR-IA32_MTRR_FIX4K_D0000/Kconfig"

# MSR_IA32_MTRR_FIX4K_D8000
source "package/Register/x86/MSR/MSR-IA32_MTRR_FIX4K_D8000/Kconfig"

# MSR_IA32_MTRR_FIX4K_E0000
source "package/Register/x86/MSR/MSR-IA32_MTRR_FIX4K_E0000/Kconfig"

# MSR_IA32_MTRR_FIX4K_E8000
source "package/Register/x86/MSR/MSR-IA32_MTRR_FIX4K_E8000/Kconfig"

# MSR_IA32_MTRR_FIX4K_F0000
source "package/Register/x86/MSR/MSR-IA32_MTRR_FIX4K_F0000/Kconfig"

# MSR_IA32_MTRR_FIX4K_F8000
source "package/Register/x86/MSR/MSR-IA32_MTRR_FIX4K_F8000/Kconfig"

# MSR_IA32_MTRR_PHYSBASEn
source "package/Register/x86/MSR/MSR-IA32_MTRR_PHYSBASEn/Kconfig"

# MSR_IA32_MTRR_PHYSMASKn
source "package/Register/x86/MSR/MSR-IA32_MTRR_PHYSMASKn/Kconfig"

endif # PK_REGISTER_X86
```
