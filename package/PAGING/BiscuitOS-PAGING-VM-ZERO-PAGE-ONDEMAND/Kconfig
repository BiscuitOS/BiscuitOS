## package/PAGING/BiscuitOS-PAGING-VM-ZERO-PAGE-ONDEMAND/Kconfig
```kconfig
menuconfig PK_PAGING_VM_ZERO_PAGE_ONDEMAND
	bool "ZERO PAGE with OnDemand"

if PK_PAGING_VM_ZERO_PAGE_ONDEMAND

config PK_PAGING_VM_ZERO_PAGE_ONDEMAND_VERSION
	default "default"
	string "verstion"

config PK_PAGING_VM_ZERO_PAGE_ONDEMAND_TAR
	default "tar.gz"
	string "tar type"

config PK_PAGING_VM_ZERO_PAGE_ONDEMAND_URL
	default "https://gitee.com/BiscuitOS_team/HardStack/raw/Gitee/Memory-Allocator/PAGING-MECH/BiscuitOS-PAGING-VM-ZERO-PAGE-ONDEMAND"
	string "url"

config PK_PAGING_VM_ZERO_PAGE_ONDEMAND_GITHUB
	string "GitHub"

config PK_PAGING_VM_ZERO_PAGE_ONDEMAND_SRCFILE
	default "main.c Makefile RunBiscuitOS.sh"
	string "Source code list"

config PK_PAGING_VM_ZERO_PAGE_ONDEMAND_CSRCFILE
	string "Compile source code list"

config PK_PAGING_VM_ZERO_PAGE_ONDEMAND_CONFIG
	string "CONFIG: Project Configure Options"

config PK_PAGING_VM_ZERO_PAGE_ONDEMAND_LIBPATH
	string "LIBS: Libraries to pass to the linker, e.g. -l<library>"

config PK_PAGING_VM_ZERO_PAGE_ONDEMAND_CPPFLAGS
	string "CPPFLAGS: C/C++ preprocessor flags, e.g. -I<include dir>"

config PK_PAGING_VM_ZERO_PAGE_ONDEMAND_DPKCONFIG
	string "PKG_CONFIG_PATH: Directories to add to pkg-config's search path"

config PK_PAGING_VM_ZERO_PAGE_ONDEMAND_CFLAGS
	string "CFLAGS: C compiler flags"

config PK_PAGING_VM_ZERO_PAGE_ONDEMAND_LDFLAGS
	string "LDFLAGS: Linker flags"

config PK_PAGING_VM_ZERO_PAGE_ONDEMAND_CXXFLAGS
	string "CXXFLAGS: C++ compiler flags"

config PK_PAGING_VM_ZERO_PAGE_ONDEMAND_ASFLAGS
	string "CCASFLAGS: assembler compiler flags (defaults to CFLAGS)"

config PK_PAGING_VM_ZERO_PAGE_ONDEMAND_BUILDARCH
	string "--host options on configure for Architecture"

endif # PK_PAGING_VM_ZERO_PAGE_ONDEMAND
```

## package/PAGING/BiscuitOS-PAGING-VMALLOC-HUGE/Kconfig
```kconfig
menuconfig PK_PAGING_VMALLOC_HUGE
	bool "VMALLOC Mapping: HugePage"

if PK_PAGING_VMALLOC_HUGE

config PK_PAGING_VMALLOC_HUGE_VERSION
	default "default"
	string "verstion"

config PK_PAGING_VMALLOC_HUGE_TAR
	default "tar.gz"
	string "tar type"

config PK_PAGING_VMALLOC_HUGE_URL
	default "https://gitee.com/BiscuitOS_team/HardStack/raw/Gitee/Memory-Allocator/PAGING-MECH/BiscuitOS-PAGING-VMALLOC-HUGE"
	string "url"

config PK_PAGING_VMALLOC_HUGE_GITHUB
	string "GitHub"

config PK_PAGING_VMALLOC_HUGE_SRCFILE
	default "main.c Makefile Kconfig Makefile.host RunBiscuitOS.sh"
	string "Source code list"

config PK_PAGING_VMALLOC_HUGE_CSRCFILE
	string "Compile source code list"

config PK_PAGING_VMALLOC_HUGE_CONFIG
	string "CONFIG: Project Configure Options"

config PK_PAGING_VMALLOC_HUGE_LIBPATH
	string "LIBS: Libraries to pass to the linker, e.g. -l<library>"

config PK_PAGING_VMALLOC_HUGE_CPPFLAGS
	string "CPPFLAGS: C/C++ preprocessor flags, e.g. -I<include dir>"

config PK_PAGING_VMALLOC_HUGE_DPKCONFIG
	string "PKG_CONFIG_PATH: Directories to add to pkg-config's search path"

config PK_PAGING_VMALLOC_HUGE_CFLAGS
	string "CFLAGS: C compiler flags"

config PK_PAGING_VMALLOC_HUGE_LDFLAGS
	string "LDFLAGS: Linker flags"

config PK_PAGING_VMALLOC_HUGE_CXXFLAGS
	string "CXXFLAGS: C++ compiler flags"

config PK_PAGING_VMALLOC_HUGE_ASFLAGS
	string "CCASFLAGS: assembler compiler flags (defaults to CFLAGS)"

config PK_PAGING_VMALLOC_HUGE_BUILDARCH
	string "--host options on configure for Architecture"

endif # PK_PAGING_VMALLOC_HUGE
```

## package/PAGING/BiscuitOS-PAGING-VMALLOC/Kconfig
```kconfig
menuconfig PK_PAGING_VMALLOC
	bool "VMALLOC Mapping"

if PK_PAGING_VMALLOC

config PK_PAGING_VMALLOC_VERSION
	default "default"
	string "verstion"

config PK_PAGING_VMALLOC_TAR
	default "tar.gz"
	string "tar type"

config PK_PAGING_VMALLOC_URL
	default "https://gitee.com/BiscuitOS_team/HardStack/raw/Gitee/Memory-Allocator/PAGING-MECH/BiscuitOS-PAGING-VMALLOC"
	string "url"

config PK_PAGING_VMALLOC_GITHUB
	string "GitHub"

config PK_PAGING_VMALLOC_SRCFILE
	default "main.c Makefile Kconfig Makefile.host RunBiscuitOS.sh"
	string "Source code list"

config PK_PAGING_VMALLOC_CSRCFILE
	string "Compile source code list"

config PK_PAGING_VMALLOC_CONFIG
	string "CONFIG: Project Configure Options"

config PK_PAGING_VMALLOC_LIBPATH
	string "LIBS: Libraries to pass to the linker, e.g. -l<library>"

config PK_PAGING_VMALLOC_CPPFLAGS
	string "CPPFLAGS: C/C++ preprocessor flags, e.g. -I<include dir>"

config PK_PAGING_VMALLOC_DPKCONFIG
	string "PKG_CONFIG_PATH: Directories to add to pkg-config's search path"

config PK_PAGING_VMALLOC_CFLAGS
	string "CFLAGS: C compiler flags"

config PK_PAGING_VMALLOC_LDFLAGS
	string "LDFLAGS: Linker flags"

config PK_PAGING_VMALLOC_CXXFLAGS
	string "CXXFLAGS: C++ compiler flags"

config PK_PAGING_VMALLOC_ASFLAGS
	string "CCASFLAGS: assembler compiler flags (defaults to CFLAGS)"

config PK_PAGING_VMALLOC_BUILDARCH
	string "--host options on configure for Architecture"

endif # PK_PAGING_VMALLOC
```
