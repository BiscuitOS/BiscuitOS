## package/Register/x86/MSR/MSR-IA32_EFER/Kconfig
```kconfig
menuconfig PK_MSR_IA32_EFER
	bool "MSR IA32_EFER"

if PK_MSR_IA32_EFER

config PK_MSR_IA32_EFER_VERSION
	default "default"
	string "verstion"

config PK_MSR_IA32_EFER_TAR
	default "tar.gz"
	string "tar type"

config PK_MSR_IA32_EFER_URL
	default "https://gitee.com/BiscuitOS_team/HardStack/raw/Gitee/Architecture/Intel/Register/MSR-IA32_EFER"
	string "url"

config PK_MSR_IA32_EFER_GITHUB
	string "GitHub"

config PK_MSR_IA32_EFER_SRCFILE
	default "main.c Kconfig Makefile"
	string "Source code list"

config PK_MSR_IA32_EFER_CSRCFILE
	string "Compile source code list"

config PK_MSR_IA32_EFER_CONFIG
	string "CONFIG: Project Configure Options"

config PK_MSR_IA32_EFER_LIBPATH
	string "LIBS: Libraries to pass to the linker, e.g. -l<library>"

config PK_MSR_IA32_EFER_CPPFLAGS
	string "CPPFLAGS: C/C++ preprocessor flags, e.g. -I<include dir>"

config PK_MSR_IA32_EFER_DPKCONFIG
	string "PKG_CONFIG_PATH: Directories to add to pkg-config's search path"

config PK_MSR_IA32_EFER_CFLAGS
	string "CFLAGS: C compiler flags"

config PK_MSR_IA32_EFER_LDFLAGS
	string "LDFLAGS: Linker flags"

config PK_MSR_IA32_EFER_CXXFLAGS
	string "CXXFLAGS: C++ compiler flags"

config PK_MSR_IA32_EFER_ASFLAGS
	string "CCASFLAGS: assembler compiler flags (defaults to CFLAGS)"

config PK_MSR_IA32_EFER_BUILDARCH
	string "--host options on configure for Architecture"

endif # PK_MSR_IA32_EFER
```

## package/Register/x86/MSR/MSR-IA32_MTRRCAP/Kconfig
```kconfig
menuconfig PK_MSR_IA32_MTRRCAP
	bool "MSR IA32_MTRRCAP"

if PK_MSR_IA32_MTRRCAP

config PK_MSR_IA32_MTRRCAP_VERSION
	default "default"
	string "verstion"

config PK_MSR_IA32_MTRRCAP_TAR
	default "tar.gz"
	string "tar type"

config PK_MSR_IA32_MTRRCAP_URL
	default "https://gitee.com/BiscuitOS_team/HardStack/raw/Gitee/Architecture/Intel/Register/MSR-IA32_MTRRCAP"
	string "url"

config PK_MSR_IA32_MTRRCAP_GITHUB
	string "GitHub"

config PK_MSR_IA32_MTRRCAP_SRCFILE
	default "main.c Kconfig Makefile"
	string "Source code list"

config PK_MSR_IA32_MTRRCAP_CSRCFILE
	string "Compile source code list"

config PK_MSR_IA32_MTRRCAP_CONFIG
	string "CONFIG: Project Configure Options"

config PK_MSR_IA32_MTRRCAP_LIBPATH
	string "LIBS: Libraries to pass to the linker, e.g. -l<library>"

config PK_MSR_IA32_MTRRCAP_CPPFLAGS
	string "CPPFLAGS: C/C++ preprocessor flags, e.g. -I<include dir>"

config PK_MSR_IA32_MTRRCAP_DPKCONFIG
	string "PKG_CONFIG_PATH: Directories to add to pkg-config's search path"

config PK_MSR_IA32_MTRRCAP_CFLAGS
	string "CFLAGS: C compiler flags"

config PK_MSR_IA32_MTRRCAP_LDFLAGS
	string "LDFLAGS: Linker flags"

config PK_MSR_IA32_MTRRCAP_CXXFLAGS
	string "CXXFLAGS: C++ compiler flags"

config PK_MSR_IA32_MTRRCAP_ASFLAGS
	string "CCASFLAGS: assembler compiler flags (defaults to CFLAGS)"

config PK_MSR_IA32_MTRRCAP_BUILDARCH
	string "--host options on configure for Architecture"

endif # PK_MSR_IA32_MTRRCAP
```

## package/Register/x86/MSR/MSR-IA32_MTRR_DEF_TYPE/Kconfig
```kconfig
menuconfig PK_MSR_IA32_MTRR_DEF_TYPE
	bool "MSR IA32_MTRR_DEF_TYPE"

if PK_MSR_IA32_MTRR_DEF_TYPE

config PK_MSR_IA32_MTRR_DEF_TYPE_VERSION
	default "default"
	string "verstion"

config PK_MSR_IA32_MTRR_DEF_TYPE_TAR
	default "tar.gz"
	string "tar type"

config PK_MSR_IA32_MTRR_DEF_TYPE_URL
	default "https://gitee.com/BiscuitOS_team/HardStack/raw/Gitee/Architecture/Intel/Register/MSR-IA32_MTRR_DEF_TYPE"
	string "url"

config PK_MSR_IA32_MTRR_DEF_TYPE_GITHUB
	string "GitHub"

config PK_MSR_IA32_MTRR_DEF_TYPE_SRCFILE
	default "main.c Kconfig Makefile"
	string "Source code list"

config PK_MSR_IA32_MTRR_DEF_TYPE_CSRCFILE
	string "Compile source code list"

config PK_MSR_IA32_MTRR_DEF_TYPE_CONFIG
	string "CONFIG: Project Configure Options"

config PK_MSR_IA32_MTRR_DEF_TYPE_LIBPATH
	string "LIBS: Libraries to pass to the linker, e.g. -l<library>"

config PK_MSR_IA32_MTRR_DEF_TYPE_CPPFLAGS
	string "CPPFLAGS: C/C++ preprocessor flags, e.g. -I<include dir>"

config PK_MSR_IA32_MTRR_DEF_TYPE_DPKCONFIG
	string "PKG_CONFIG_PATH: Directories to add to pkg-config's search path"

config PK_MSR_IA32_MTRR_DEF_TYPE_CFLAGS
	string "CFLAGS: C compiler flags"

config PK_MSR_IA32_MTRR_DEF_TYPE_LDFLAGS
	string "LDFLAGS: Linker flags"

config PK_MSR_IA32_MTRR_DEF_TYPE_CXXFLAGS
	string "CXXFLAGS: C++ compiler flags"

config PK_MSR_IA32_MTRR_DEF_TYPE_ASFLAGS
	string "CCASFLAGS: assembler compiler flags (defaults to CFLAGS)"

config PK_MSR_IA32_MTRR_DEF_TYPE_BUILDARCH
	string "--host options on configure for Architecture"

endif # PK_MSR_IA32_MTRR_DEF_TYPE
```

## package/Register/x86/MSR/MSR-IA32_MTRR_FIX16K_80000/Kconfig
```kconfig
menuconfig PK_MSR_IA32_MTRR_FIX16K_80000
	bool "MSR IA32_MTRR_FIX16K_80000"

if PK_MSR_IA32_MTRR_FIX16K_80000

config PK_MSR_IA32_MTRR_FIX16K_80000_VERSION
	default "default"
	string "verstion"

config PK_MSR_IA32_MTRR_FIX16K_80000_TAR
	default "tar.gz"
	string "tar type"

config PK_MSR_IA32_MTRR_FIX16K_80000_URL
	default "https://gitee.com/BiscuitOS_team/HardStack/raw/Gitee/Architecture/Intel/Register/MSR-IA32_MTRR_FIX16K_80000"
	string "url"

config PK_MSR_IA32_MTRR_FIX16K_80000_GITHUB
	string "GitHub"

config PK_MSR_IA32_MTRR_FIX16K_80000_SRCFILE
	default "main.c Kconfig Makefile"
	string "Source code list"

config PK_MSR_IA32_MTRR_FIX16K_80000_CSRCFILE
	string "Compile source code list"

config PK_MSR_IA32_MTRR_FIX16K_80000_CONFIG
	string "CONFIG: Project Configure Options"

config PK_MSR_IA32_MTRR_FIX16K_80000_LIBPATH
	string "LIBS: Libraries to pass to the linker, e.g. -l<library>"

config PK_MSR_IA32_MTRR_FIX16K_80000_CPPFLAGS
	string "CPPFLAGS: C/C++ preprocessor flags, e.g. -I<include dir>"

config PK_MSR_IA32_MTRR_FIX16K_80000_DPKCONFIG
	string "PKG_CONFIG_PATH: Directories to add to pkg-config's search path"

config PK_MSR_IA32_MTRR_FIX16K_80000_CFLAGS
	string "CFLAGS: C compiler flags"

config PK_MSR_IA32_MTRR_FIX16K_80000_LDFLAGS
	string "LDFLAGS: Linker flags"

config PK_MSR_IA32_MTRR_FIX16K_80000_CXXFLAGS
	string "CXXFLAGS: C++ compiler flags"

config PK_MSR_IA32_MTRR_FIX16K_80000_ASFLAGS
	string "CCASFLAGS: assembler compiler flags (defaults to CFLAGS)"

config PK_MSR_IA32_MTRR_FIX16K_80000_BUILDARCH
	string "--host options on configure for Architecture"

endif # PK_MSR_IA32_MTRR_FIX16K_80000
```

## package/Register/x86/MSR/MSR-IA32_MTRR_FIX4K_C8000/Kconfig
```kconfig
menuconfig PK_MSR_IA32_MTRR_FIX4K_C8000
	bool "MSR IA32_MTRR_FIX4K_C8000"

if PK_MSR_IA32_MTRR_FIX4K_C8000

config PK_MSR_IA32_MTRR_FIX4K_C8000_VERSION
	default "default"
	string "verstion"

config PK_MSR_IA32_MTRR_FIX4K_C8000_TAR
	default "tar.gz"
	string "tar type"

config PK_MSR_IA32_MTRR_FIX4K_C8000_URL
	default "https://gitee.com/BiscuitOS_team/HardStack/raw/Gitee/Architecture/Intel/Register/MSR-IA32_MTRR_FIX4K_C8000"
	string "url"

config PK_MSR_IA32_MTRR_FIX4K_C8000_GITHUB
	string "GitHub"

config PK_MSR_IA32_MTRR_FIX4K_C8000_SRCFILE
	default "main.c Kconfig Makefile"
	string "Source code list"

config PK_MSR_IA32_MTRR_FIX4K_C8000_CSRCFILE
	string "Compile source code list"

config PK_MSR_IA32_MTRR_FIX4K_C8000_CONFIG
	string "CONFIG: Project Configure Options"

config PK_MSR_IA32_MTRR_FIX4K_C8000_LIBPATH
	string "LIBS: Libraries to pass to the linker, e.g. -l<library>"

config PK_MSR_IA32_MTRR_FIX4K_C8000_CPPFLAGS
	string "CPPFLAGS: C/C++ preprocessor flags, e.g. -I<include dir>"

config PK_MSR_IA32_MTRR_FIX4K_C8000_DPKCONFIG
	string "PKG_CONFIG_PATH: Directories to add to pkg-config's search path"

config PK_MSR_IA32_MTRR_FIX4K_C8000_CFLAGS
	string "CFLAGS: C compiler flags"

config PK_MSR_IA32_MTRR_FIX4K_C8000_LDFLAGS
	string "LDFLAGS: Linker flags"

config PK_MSR_IA32_MTRR_FIX4K_C8000_CXXFLAGS
	string "CXXFLAGS: C++ compiler flags"

config PK_MSR_IA32_MTRR_FIX4K_C8000_ASFLAGS
	string "CCASFLAGS: assembler compiler flags (defaults to CFLAGS)"

config PK_MSR_IA32_MTRR_FIX4K_C8000_BUILDARCH
	string "--host options on configure for Architecture"

endif # PK_MSR_IA32_MTRR_FIX4K_C8000
```
