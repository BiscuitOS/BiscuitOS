## package/PAGING/BiscuitOS-PAGING-PF-ANON-RO/Kconfig
```kconfig
menuconfig PK_PAGING_PF_ANON_RO
	bool "Page Fault with Anonymous on RO(Read-Only Zero Page)"

if PK_PAGING_PF_ANON_RO

config PK_PAGING_PF_ANON_RO_VERSION
	default "default"
	string "verstion"

config PK_PAGING_PF_ANON_RO_TAR
	default "tar.gz"
	string "tar type"

config PK_PAGING_PF_ANON_RO_URL
	default "https://gitee.com/BiscuitOS_team/HardStack/raw/Gitee/Memory-Allocator/PAGING-MECH/BiscuitOS-PAGING-PF-ANON-RO"
	string "url"

config PK_PAGING_PF_ANON_RO_GITHUB
	string "GitHub"

config PK_PAGING_PF_ANON_RO_SRCFILE
	default "main.c Makefile RunBiscuitOS.sh"
	string "Source code list"

config PK_PAGING_PF_ANON_RO_CSRCFILE
	string "Compile source code list"

config PK_PAGING_PF_ANON_RO_CONFIG
	string "CONFIG: Project Configure Options"

config PK_PAGING_PF_ANON_RO_LIBPATH
	string "LIBS: Libraries to pass to the linker, e.g. -l<library>"

config PK_PAGING_PF_ANON_RO_CPPFLAGS
	string "CPPFLAGS: C/C++ preprocessor flags, e.g. -I<include dir>"

config PK_PAGING_PF_ANON_RO_DPKCONFIG
	string "PKG_CONFIG_PATH: Directories to add to pkg-config's search path"

config PK_PAGING_PF_ANON_RO_CFLAGS
	string "CFLAGS: C compiler flags"

config PK_PAGING_PF_ANON_RO_LDFLAGS
	string "LDFLAGS: Linker flags"

config PK_PAGING_PF_ANON_RO_CXXFLAGS
	string "CXXFLAGS: C++ compiler flags"

config PK_PAGING_PF_ANON_RO_ASFLAGS
	string "CCASFLAGS: assembler compiler flags (defaults to CFLAGS)"

config PK_PAGING_PF_ANON_RO_BUILDARCH
	string "--host options on configure for Architecture"

endif # PK_PAGING_PF_ANON_RO
```

## package/PAGING/BiscuitOS-PAGING-PF-ANON-STACK/Kconfig
```kconfig
menuconfig PK_PAGING_PF_ANON_STACK
	bool "Page Fault with Anonymous on Stack"

if PK_PAGING_PF_ANON_STACK

config PK_PAGING_PF_ANON_STACK_VERSION
	default "default"
	string "verstion"

config PK_PAGING_PF_ANON_STACK_TAR
	default "tar.gz"
	string "tar type"

config PK_PAGING_PF_ANON_STACK_URL
	default "https://gitee.com/BiscuitOS_team/HardStack/raw/Gitee/Memory-Allocator/PAGING-MECH/BiscuitOS-PAGING-PF-ANON-STACK"
	string "url"

config PK_PAGING_PF_ANON_STACK_GITHUB
	string "GitHub"

config PK_PAGING_PF_ANON_STACK_SRCFILE
	default "main.c Makefile RunBiscuitOS.sh"
	string "Source code list"

config PK_PAGING_PF_ANON_STACK_CSRCFILE
	string "Compile source code list"

config PK_PAGING_PF_ANON_STACK_CONFIG
	string "CONFIG: Project Configure Options"

config PK_PAGING_PF_ANON_STACK_LIBPATH
	string "LIBS: Libraries to pass to the linker, e.g. -l<library>"

config PK_PAGING_PF_ANON_STACK_CPPFLAGS
	string "CPPFLAGS: C/C++ preprocessor flags, e.g. -I<include dir>"

config PK_PAGING_PF_ANON_STACK_DPKCONFIG
	string "PKG_CONFIG_PATH: Directories to add to pkg-config's search path"

config PK_PAGING_PF_ANON_STACK_CFLAGS
	string "CFLAGS: C compiler flags"

config PK_PAGING_PF_ANON_STACK_LDFLAGS
	string "LDFLAGS: Linker flags"

config PK_PAGING_PF_ANON_STACK_CXXFLAGS
	string "CXXFLAGS: C++ compiler flags"

config PK_PAGING_PF_ANON_STACK_ASFLAGS
	string "CCASFLAGS: assembler compiler flags (defaults to CFLAGS)"

config PK_PAGING_PF_ANON_STACK_BUILDARCH
	string "--host options on configure for Architecture"

endif # PK_PAGING_PF_ANON_STACK
```

## package/PAGING/BiscuitOS-PAGING-PF-ANON-WP-REUSE/Kconfig
```kconfig
menuconfig PK_PAGING_PF_ANON_WP_REUSE
	bool "Page Fault with Anonymous on WP(REUSE PAGE)"

if PK_PAGING_PF_ANON_WP_REUSE

config PK_PAGING_PF_ANON_WP_REUSE_VERSION
	default "default"
	string "verstion"

config PK_PAGING_PF_ANON_WP_REUSE_TAR
	default "tar.gz"
	string "tar type"

config PK_PAGING_PF_ANON_WP_REUSE_URL
	default "https://gitee.com/BiscuitOS_team/HardStack/raw/Gitee/Memory-Allocator/PAGING-MECH/BiscuitOS-PAGING-PF-ANON-WP-REUSE"
	string "url"

config PK_PAGING_PF_ANON_WP_REUSE_GITHUB
	string "GitHub"

config PK_PAGING_PF_ANON_WP_REUSE_SRCFILE
	default "main.c Makefile RunBiscuitOS.sh"
	string "Source code list"

config PK_PAGING_PF_ANON_WP_REUSE_CSRCFILE
	string "Compile source code list"

config PK_PAGING_PF_ANON_WP_REUSE_CONFIG
	string "CONFIG: Project Configure Options"

config PK_PAGING_PF_ANON_WP_REUSE_LIBPATH
	string "LIBS: Libraries to pass to the linker, e.g. -l<library>"

config PK_PAGING_PF_ANON_WP_REUSE_CPPFLAGS
	string "CPPFLAGS: C/C++ preprocessor flags, e.g. -I<include dir>"

config PK_PAGING_PF_ANON_WP_REUSE_DPKCONFIG
	string "PKG_CONFIG_PATH: Directories to add to pkg-config's search path"

config PK_PAGING_PF_ANON_WP_REUSE_CFLAGS
	string "CFLAGS: C compiler flags"

config PK_PAGING_PF_ANON_WP_REUSE_LDFLAGS
	string "LDFLAGS: Linker flags"

config PK_PAGING_PF_ANON_WP_REUSE_CXXFLAGS
	string "CXXFLAGS: C++ compiler flags"

config PK_PAGING_PF_ANON_WP_REUSE_ASFLAGS
	string "CCASFLAGS: assembler compiler flags (defaults to CFLAGS)"

config PK_PAGING_PF_ANON_WP_REUSE_BUILDARCH
	string "--host options on configure for Architecture"

endif # PK_PAGING_PF_ANON_WP_REUSE
```

## package/PAGING/BiscuitOS-PAGING-PF-ECODE-INSTR/Kconfig
```kconfig
menuconfig PK_PAGING_PF_ECODE_INSTR
	bool "Page Fault ERROR CODE: PF_INSTR"

if PK_PAGING_PF_ECODE_INSTR

config PK_PAGING_PF_ECODE_INSTR_VERSION
	default "default"
	string "verstion"

config PK_PAGING_PF_ECODE_INSTR_TAR
	default "tar.gz"
	string "tar type"

config PK_PAGING_PF_ECODE_INSTR_URL
	default "https://gitee.com/BiscuitOS_team/HardStack/raw/Gitee/Memory-Allocator/PAGING-MECH/BiscuitOS-PAGING-PF-ECODE-INSTR"
	string "url"

config PK_PAGING_PF_ECODE_INSTR_GITHUB
	string "GitHub"

config PK_PAGING_PF_ECODE_INSTR_SRCFILE
	default "main.c Makefile RunBiscuitOS.sh"
	string "Source code list"

config PK_PAGING_PF_ECODE_INSTR_CSRCFILE
	string "Compile source code list"

config PK_PAGING_PF_ECODE_INSTR_CONFIG
	string "CONFIG: Project Configure Options"

config PK_PAGING_PF_ECODE_INSTR_LIBPATH
	string "LIBS: Libraries to pass to the linker, e.g. -l<library>"

config PK_PAGING_PF_ECODE_INSTR_CPPFLAGS
	string "CPPFLAGS: C/C++ preprocessor flags, e.g. -I<include dir>"

config PK_PAGING_PF_ECODE_INSTR_DPKCONFIG
	string "PKG_CONFIG_PATH: Directories to add to pkg-config's search path"

config PK_PAGING_PF_ECODE_INSTR_CFLAGS
	string "CFLAGS: C compiler flags"

config PK_PAGING_PF_ECODE_INSTR_LDFLAGS
	string "LDFLAGS: Linker flags"

config PK_PAGING_PF_ECODE_INSTR_CXXFLAGS
	string "CXXFLAGS: C++ compiler flags"

config PK_PAGING_PF_ECODE_INSTR_ASFLAGS
	string "CCASFLAGS: assembler compiler flags (defaults to CFLAGS)"

config PK_PAGING_PF_ECODE_INSTR_BUILDARCH
	string "--host options on configure for Architecture"

endif # PK_PAGING_PF_ECODE_INSTR
```

## package/PAGING/BiscuitOS-PAGING-PF-ECODE-PRESENT/Kconfig
```kconfig
menuconfig PK_PAGING_PF_ECODE_PRESENT
	bool "Page Fault ERROR CODE: PF_PRESENT"

if PK_PAGING_PF_ECODE_PRESENT

config PK_PAGING_PF_ECODE_PRESENT_VERSION
	default "default"
	string "verstion"

config PK_PAGING_PF_ECODE_PRESENT_TAR
	default "tar.gz"
	string "tar type"

config PK_PAGING_PF_ECODE_PRESENT_URL
	default "https://gitee.com/BiscuitOS_team/HardStack/raw/Gitee/Memory-Allocator/PAGING-MECH/BiscuitOS-PAGING-PF-ECODE-PRESENT"
	string "url"

config PK_PAGING_PF_ECODE_PRESENT_GITHUB
	string "GitHub"

config PK_PAGING_PF_ECODE_PRESENT_SRCFILE
	default "main.c Makefile RunBiscuitOS.sh"
	string "Source code list"

config PK_PAGING_PF_ECODE_PRESENT_CSRCFILE
	string "Compile source code list"

config PK_PAGING_PF_ECODE_PRESENT_CONFIG
	string "CONFIG: Project Configure Options"

config PK_PAGING_PF_ECODE_PRESENT_LIBPATH
	string "LIBS: Libraries to pass to the linker, e.g. -l<library>"

config PK_PAGING_PF_ECODE_PRESENT_CPPFLAGS
	string "CPPFLAGS: C/C++ preprocessor flags, e.g. -I<include dir>"

config PK_PAGING_PF_ECODE_PRESENT_DPKCONFIG
	string "PKG_CONFIG_PATH: Directories to add to pkg-config's search path"

config PK_PAGING_PF_ECODE_PRESENT_CFLAGS
	string "CFLAGS: C compiler flags"

config PK_PAGING_PF_ECODE_PRESENT_LDFLAGS
	string "LDFLAGS: Linker flags"

config PK_PAGING_PF_ECODE_PRESENT_CXXFLAGS
	string "CXXFLAGS: C++ compiler flags"

config PK_PAGING_PF_ECODE_PRESENT_ASFLAGS
	string "CCASFLAGS: assembler compiler flags (defaults to CFLAGS)"

config PK_PAGING_PF_ECODE_PRESENT_BUILDARCH
	string "--host options on configure for Architecture"

endif # PK_PAGING_PF_ECODE_PRESENT
```

## package/PAGING/BiscuitOS-PAGING-PF-ECODE-PROT-PK/Kconfig
```kconfig
menuconfig PK_PAGING_PF_ECODE_PROT_PK
	bool "Page Fault ERROR CODE: PF_PROT with Protection Key"

if PK_PAGING_PF_ECODE_PROT_PK

config PK_PAGING_PF_ECODE_PROT_PK_VERSION
	default "default"
	string "verstion"

config PK_PAGING_PF_ECODE_PROT_PK_TAR
	default "tar.gz"
	string "tar type"

config PK_PAGING_PF_ECODE_PROT_PK_URL
	default "https://gitee.com/BiscuitOS_team/HardStack/raw/Gitee/Memory-Allocator/PAGING-MECH/BiscuitOS-PAGING-PF-ECODE-PROT-PK"
	string "url"

config PK_PAGING_PF_ECODE_PROT_PK_GITHUB
	string "GitHub"

config PK_PAGING_PF_ECODE_PROT_PK_SRCFILE
	default "main.c Makefile RunBiscuitOS.sh"
	string "Source code list"

config PK_PAGING_PF_ECODE_PROT_PK_CSRCFILE
	string "Compile source code list"

config PK_PAGING_PF_ECODE_PROT_PK_CONFIG
	string "CONFIG: Project Configure Options"

config PK_PAGING_PF_ECODE_PROT_PK_LIBPATH
	string "LIBS: Libraries to pass to the linker, e.g. -l<library>"

config PK_PAGING_PF_ECODE_PROT_PK_CPPFLAGS
	string "CPPFLAGS: C/C++ preprocessor flags, e.g. -I<include dir>"

config PK_PAGING_PF_ECODE_PROT_PK_DPKCONFIG
	string "PKG_CONFIG_PATH: Directories to add to pkg-config's search path"

config PK_PAGING_PF_ECODE_PROT_PK_CFLAGS
	string "CFLAGS: C compiler flags"

config PK_PAGING_PF_ECODE_PROT_PK_LDFLAGS
	string "LDFLAGS: Linker flags"

config PK_PAGING_PF_ECODE_PROT_PK_CXXFLAGS
	string "CXXFLAGS: C++ compiler flags"

config PK_PAGING_PF_ECODE_PROT_PK_ASFLAGS
	string "CCASFLAGS: assembler compiler flags (defaults to CFLAGS)"

config PK_PAGING_PF_ECODE_PROT_PK_BUILDARCH
	string "--host options on configure for Architecture"

endif # PK_PAGING_PF_ECODE_PROT_PK
```

## package/PAGING/BiscuitOS-PAGING-PF-ECODE-PROT/Kconfig
```kconfig
menuconfig PK_PAGING_PF_ECODE_PROT
	bool "Page Fault ERROR CODE: PF_PROT"

if PK_PAGING_PF_ECODE_PROT

config PK_PAGING_PF_ECODE_PROT_VERSION
	default "default"
	string "verstion"

config PK_PAGING_PF_ECODE_PROT_TAR
	default "tar.gz"
	string "tar type"

config PK_PAGING_PF_ECODE_PROT_URL
	default "https://gitee.com/BiscuitOS_team/HardStack/raw/Gitee/Memory-Allocator/PAGING-MECH/BiscuitOS-PAGING-PF-ECODE-PROT"
	string "url"

config PK_PAGING_PF_ECODE_PROT_GITHUB
	string "GitHub"

config PK_PAGING_PF_ECODE_PROT_SRCFILE
	default "main.c Makefile RunBiscuitOS.sh"
	string "Source code list"

config PK_PAGING_PF_ECODE_PROT_CSRCFILE
	string "Compile source code list"

config PK_PAGING_PF_ECODE_PROT_CONFIG
	string "CONFIG: Project Configure Options"

config PK_PAGING_PF_ECODE_PROT_LIBPATH
	string "LIBS: Libraries to pass to the linker, e.g. -l<library>"

config PK_PAGING_PF_ECODE_PROT_CPPFLAGS
	string "CPPFLAGS: C/C++ preprocessor flags, e.g. -I<include dir>"

config PK_PAGING_PF_ECODE_PROT_DPKCONFIG
	string "PKG_CONFIG_PATH: Directories to add to pkg-config's search path"

config PK_PAGING_PF_ECODE_PROT_CFLAGS
	string "CFLAGS: C compiler flags"

config PK_PAGING_PF_ECODE_PROT_LDFLAGS
	string "LDFLAGS: Linker flags"

config PK_PAGING_PF_ECODE_PROT_CXXFLAGS
	string "CXXFLAGS: C++ compiler flags"

config PK_PAGING_PF_ECODE_PROT_ASFLAGS
	string "CCASFLAGS: assembler compiler flags (defaults to CFLAGS)"

config PK_PAGING_PF_ECODE_PROT_BUILDARCH
	string "--host options on configure for Architecture"

endif # PK_PAGING_PF_ECODE_PROT
```

## package/PAGING/BiscuitOS-PAGING-PF-ECODE-READ/Kconfig
```kconfig
menuconfig PK_PAGING_PF_ECODE_READ
	bool "Page Fault ERROR CODE: PF_READ"

if PK_PAGING_PF_ECODE_READ

config PK_PAGING_PF_ECODE_READ_VERSION
	default "default"
	string "verstion"

config PK_PAGING_PF_ECODE_READ_TAR
	default "tar.gz"
	string "tar type"

config PK_PAGING_PF_ECODE_READ_URL
	default "https://gitee.com/BiscuitOS_team/HardStack/raw/Gitee/Memory-Allocator/PAGING-MECH/BiscuitOS-PAGING-PF-ECODE-READ"
	string "url"

config PK_PAGING_PF_ECODE_READ_GITHUB
	string "GitHub"

config PK_PAGING_PF_ECODE_READ_SRCFILE
	default "main.c Makefile RunBiscuitOS.sh"
	string "Source code list"

config PK_PAGING_PF_ECODE_READ_CSRCFILE
	string "Compile source code list"

config PK_PAGING_PF_ECODE_READ_CONFIG
	string "CONFIG: Project Configure Options"

config PK_PAGING_PF_ECODE_READ_LIBPATH
	string "LIBS: Libraries to pass to the linker, e.g. -l<library>"

config PK_PAGING_PF_ECODE_READ_CPPFLAGS
	string "CPPFLAGS: C/C++ preprocessor flags, e.g. -I<include dir>"

config PK_PAGING_PF_ECODE_READ_DPKCONFIG
	string "PKG_CONFIG_PATH: Directories to add to pkg-config's search path"

config PK_PAGING_PF_ECODE_READ_CFLAGS
	string "CFLAGS: C compiler flags"

config PK_PAGING_PF_ECODE_READ_LDFLAGS
	string "LDFLAGS: Linker flags"

config PK_PAGING_PF_ECODE_READ_CXXFLAGS
	string "CXXFLAGS: C++ compiler flags"

config PK_PAGING_PF_ECODE_READ_ASFLAGS
	string "CCASFLAGS: assembler compiler flags (defaults to CFLAGS)"

config PK_PAGING_PF_ECODE_READ_BUILDARCH
	string "--host options on configure for Architecture"

endif # PK_PAGING_PF_ECODE_READ
```

## package/PAGING/BiscuitOS-PAGING-PF-ECODE-RSVD/Kconfig
```kconfig
menuconfig PK_PAGING_PF_ECODE_RSVD
	bool "Page Fault ERROR CODE: PF_RSVD"

if PK_PAGING_PF_ECODE_RSVD

config PK_PAGING_PF_ECODE_RSVD_VERSION
	default "default"
	string "verstion"

config PK_PAGING_PF_ECODE_RSVD_TAR
	default "tar.gz"
	string "tar type"

config PK_PAGING_PF_ECODE_RSVD_URL
	default "https://gitee.com/BiscuitOS_team/HardStack/raw/Gitee/Memory-Allocator/PAGING-MECH/BiscuitOS-PAGING-PF-ECODE-RSVD"
	string "url"

config PK_PAGING_PF_ECODE_RSVD_GITHUB
	string "GitHub"

config PK_PAGING_PF_ECODE_RSVD_SRCFILE
	default "Kconfig Makefile main.c app.c Makefile.app RunBiscuitOS.sh"
	string "Source code list"

config PK_PAGING_PF_ECODE_RSVD_CSRCFILE
	string "Compile source code list"

config PK_PAGING_PF_ECODE_RSVD_CONFIG
	string "CONFIG: Project Configure Options"

config PK_PAGING_PF_ECODE_RSVD_LIBPATH
	string "LIBS: Libraries to pass to the linker, e.g. -l<library>"

config PK_PAGING_PF_ECODE_RSVD_CPPFLAGS
	string "CPPFLAGS: C/C++ preprocessor flags, e.g. -I<include dir>"

config PK_PAGING_PF_ECODE_RSVD_DPKCONFIG
	string "PKG_CONFIG_PATH: Directories to add to pkg-config's search path"

config PK_PAGING_PF_ECODE_RSVD_CFLAGS
	string "CFLAGS: C compiler flags"

config PK_PAGING_PF_ECODE_RSVD_LDFLAGS
	string "LDFLAGS: Linker flags"

config PK_PAGING_PF_ECODE_RSVD_CXXFLAGS
	string "CXXFLAGS: C++ compiler flags"

config PK_PAGING_PF_ECODE_RSVD_ASFLAGS
	string "CCASFLAGS: assembler compiler flags (defaults to CFLAGS)"

config PK_PAGING_PF_ECODE_RSVD_BUILDARCH
	string "--host options on configure for Architecture"

endif # PK_PAGING_PF_ECODE_RSVD
```
