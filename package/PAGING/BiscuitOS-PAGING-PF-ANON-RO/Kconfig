## package/PAGING/BiscuitOS-PAGING-PF-FILE-DAX/Kconfig
```kconfig
menuconfig PK_PAGING_PF_FILE_DAX
	select PK_E2FSPROGS
	bool "Page Fault with File-Mapped DAX"

if PK_PAGING_PF_FILE_DAX

config PK_PAGING_PF_FILE_DAX_VERSION
	default "default"
	string "verstion"

config PK_PAGING_PF_FILE_DAX_TAR
	default "tar.gz"
	string "tar type"

config PK_PAGING_PF_FILE_DAX_URL
	default "https://gitee.com/BiscuitOS_team/HardStack/raw/Gitee/Memory-Allocator/PAGING-MECH/BiscuitOS-PAGING-PF-FILE-DAX"
	string "url"

config PK_PAGING_PF_FILE_DAX_GITHUB
	string "GitHub"

config PK_PAGING_PF_FILE_DAX_SRCFILE
	default "main.c Makefile RunBiscuitOS.sh"
	string "Source code list"

config PK_PAGING_PF_FILE_DAX_CSRCFILE
	string "Compile source code list"

config PK_PAGING_PF_FILE_DAX_CONFIG
	string "CONFIG: Project Configure Options"

config PK_PAGING_PF_FILE_DAX_LIBPATH
	string "LIBS: Libraries to pass to the linker, e.g. -l<library>"

config PK_PAGING_PF_FILE_DAX_CPPFLAGS
	string "CPPFLAGS: C/C++ preprocessor flags, e.g. -I<include dir>"

config PK_PAGING_PF_FILE_DAX_DPKCONFIG
	string "PKG_CONFIG_PATH: Directories to add to pkg-config's search path"

config PK_PAGING_PF_FILE_DAX_CFLAGS
	string "CFLAGS: C compiler flags"

config PK_PAGING_PF_FILE_DAX_LDFLAGS
	string "LDFLAGS: Linker flags"

config PK_PAGING_PF_FILE_DAX_CXXFLAGS
	string "CXXFLAGS: C++ compiler flags"

config PK_PAGING_PF_FILE_DAX_ASFLAGS
	string "CCASFLAGS: assembler compiler flags (defaults to CFLAGS)"

config PK_PAGING_PF_FILE_DAX_BUILDARCH
	string "--host options on configure for Architecture"

endif # PK_PAGING_PF_FILE_DAX
```

## package/PAGING/BiscuitOS-PAGING-PF-FILE-DIRECTIO/Kconfig
```kconfig
menuconfig PK_PAGING_PF_FILE_DIRECTIO
	bool "Page Fault with File-Mapped DIRECT-IO"

if PK_PAGING_PF_FILE_DIRECTIO

config PK_PAGING_PF_FILE_DIRECTIO_VERSION
	default "default"
	string "verstion"

config PK_PAGING_PF_FILE_DIRECTIO_TAR
	default "tar.gz"
	string "tar type"

config PK_PAGING_PF_FILE_DIRECTIO_URL
	default "https://gitee.com/BiscuitOS_team/HardStack/raw/Gitee/Memory-Allocator/PAGING-MECH/BiscuitOS-PAGING-PF-FILE-DIRECTIO"
	string "url"

config PK_PAGING_PF_FILE_DIRECTIO_GITHUB
	string "GitHub"

config PK_PAGING_PF_FILE_DIRECTIO_SRCFILE
	default "main.c Makefile RunBiscuitOS.sh"
	string "Source code list"

config PK_PAGING_PF_FILE_DIRECTIO_CSRCFILE
	string "Compile source code list"

config PK_PAGING_PF_FILE_DIRECTIO_CONFIG
	string "CONFIG: Project Configure Options"

config PK_PAGING_PF_FILE_DIRECTIO_LIBPATH
	string "LIBS: Libraries to pass to the linker, e.g. -l<library>"

config PK_PAGING_PF_FILE_DIRECTIO_CPPFLAGS
	string "CPPFLAGS: C/C++ preprocessor flags, e.g. -I<include dir>"

config PK_PAGING_PF_FILE_DIRECTIO_DPKCONFIG
	string "PKG_CONFIG_PATH: Directories to add to pkg-config's search path"

config PK_PAGING_PF_FILE_DIRECTIO_CFLAGS
	string "CFLAGS: C compiler flags"

config PK_PAGING_PF_FILE_DIRECTIO_LDFLAGS
	string "LDFLAGS: Linker flags"

config PK_PAGING_PF_FILE_DIRECTIO_CXXFLAGS
	string "CXXFLAGS: C++ compiler flags"

config PK_PAGING_PF_FILE_DIRECTIO_ASFLAGS
	string "CCASFLAGS: assembler compiler flags (defaults to CFLAGS)"

config PK_PAGING_PF_FILE_DIRECTIO_BUILDARCH
	string "--host options on configure for Architecture"

endif # PK_PAGING_PF_FILE_DIRECTIO
```

## package/PAGING/BiscuitOS-PAGING-PF-FILE-EXT3/Kconfig
```kconfig
menuconfig PK_PAGING_PF_FILE_EXT3
	bool "Page Fault with File-Mapped EXT3 FS"

if PK_PAGING_PF_FILE_EXT3

config PK_PAGING_PF_FILE_EXT3_VERSION
	default "default"
	string "verstion"

config PK_PAGING_PF_FILE_EXT3_TAR
	default "tar.gz"
	string "tar type"

config PK_PAGING_PF_FILE_EXT3_URL
	default "https://gitee.com/BiscuitOS_team/HardStack/raw/Gitee/Memory-Allocator/PAGING-MECH/BiscuitOS-PAGING-PF-FILE-EXT3"
	string "url"

config PK_PAGING_PF_FILE_EXT3_GITHUB
	string "GitHub"

config PK_PAGING_PF_FILE_EXT3_SRCFILE
	default "main.c Makefile RunBiscuitOS.sh"
	string "Source code list"

config PK_PAGING_PF_FILE_EXT3_CSRCFILE
	string "Compile source code list"

config PK_PAGING_PF_FILE_EXT3_CONFIG
	string "CONFIG: Project Configure Options"

config PK_PAGING_PF_FILE_EXT3_LIBPATH
	string "LIBS: Libraries to pass to the linker, e.g. -l<library>"

config PK_PAGING_PF_FILE_EXT3_CPPFLAGS
	string "CPPFLAGS: C/C++ preprocessor flags, e.g. -I<include dir>"

config PK_PAGING_PF_FILE_EXT3_DPKCONFIG
	string "PKG_CONFIG_PATH: Directories to add to pkg-config's search path"

config PK_PAGING_PF_FILE_EXT3_CFLAGS
	string "CFLAGS: C compiler flags"

config PK_PAGING_PF_FILE_EXT3_LDFLAGS
	string "LDFLAGS: Linker flags"

config PK_PAGING_PF_FILE_EXT3_CXXFLAGS
	string "CXXFLAGS: C++ compiler flags"

config PK_PAGING_PF_FILE_EXT3_ASFLAGS
	string "CCASFLAGS: assembler compiler flags (defaults to CFLAGS)"

config PK_PAGING_PF_FILE_EXT3_BUILDARCH
	string "--host options on configure for Architecture"

endif # PK_PAGING_PF_FILE_EXT3
```

## package/PAGING/BiscuitOS-PAGING-PF-FILE-EXT4/Kconfig
```kconfig
menuconfig PK_PAGING_PF_FILE_EXT4
	bool "Page Fault with File-Mapped EXT4 FS"

if PK_PAGING_PF_FILE_EXT4

config PK_PAGING_PF_FILE_EXT4_VERSION
	default "default"
	string "verstion"

config PK_PAGING_PF_FILE_EXT4_TAR
	default "tar.gz"
	string "tar type"

config PK_PAGING_PF_FILE_EXT4_URL
	default "https://gitee.com/BiscuitOS_team/HardStack/raw/Gitee/Memory-Allocator/PAGING-MECH/BiscuitOS-PAGING-PF-FILE-EXT4"
	string "url"

config PK_PAGING_PF_FILE_EXT4_GITHUB
	string "GitHub"

config PK_PAGING_PF_FILE_EXT4_SRCFILE
	default "main.c Makefile RunBiscuitOS.sh"
	string "Source code list"

config PK_PAGING_PF_FILE_EXT4_CSRCFILE
	string "Compile source code list"

config PK_PAGING_PF_FILE_EXT4_CONFIG
	string "CONFIG: Project Configure Options"

config PK_PAGING_PF_FILE_EXT4_LIBPATH
	string "LIBS: Libraries to pass to the linker, e.g. -l<library>"

config PK_PAGING_PF_FILE_EXT4_CPPFLAGS
	string "CPPFLAGS: C/C++ preprocessor flags, e.g. -I<include dir>"

config PK_PAGING_PF_FILE_EXT4_DPKCONFIG
	string "PKG_CONFIG_PATH: Directories to add to pkg-config's search path"

config PK_PAGING_PF_FILE_EXT4_CFLAGS
	string "CFLAGS: C compiler flags"

config PK_PAGING_PF_FILE_EXT4_LDFLAGS
	string "LDFLAGS: Linker flags"

config PK_PAGING_PF_FILE_EXT4_CXXFLAGS
	string "CXXFLAGS: C++ compiler flags"

config PK_PAGING_PF_FILE_EXT4_ASFLAGS
	string "CCASFLAGS: assembler compiler flags (defaults to CFLAGS)"

config PK_PAGING_PF_FILE_EXT4_BUILDARCH
	string "--host options on configure for Architecture"

endif # PK_PAGING_PF_FILE_EXT4
```

## package/PAGING/BiscuitOS-PAGING-PF-FILE-F2FS/Kconfig
```kconfig
menuconfig PK_PAGING_PF_FILE_F2FS
	bool "Page Fault with File-Mapped F2FS"

if PK_PAGING_PF_FILE_F2FS

config PK_PAGING_PF_FILE_F2FS_VERSION
	default "default"
	string "verstion"

config PK_PAGING_PF_FILE_F2FS_TAR
	default "tar.gz"
	string "tar type"

config PK_PAGING_PF_FILE_F2FS_URL
	default "https://gitee.com/BiscuitOS_team/HardStack/raw/Gitee/Memory-Allocator/PAGING-MECH/BiscuitOS-PAGING-PF-FILE-F2FS"
	string "url"

config PK_PAGING_PF_FILE_F2FS_GITHUB
	string "GitHub"

config PK_PAGING_PF_FILE_F2FS_SRCFILE
	default "main.c Makefile RunBiscuitOS.sh"
	string "Source code list"

config PK_PAGING_PF_FILE_F2FS_CSRCFILE
	string "Compile source code list"

config PK_PAGING_PF_FILE_F2FS_CONFIG
	string "CONFIG: Project Configure Options"

config PK_PAGING_PF_FILE_F2FS_LIBPATH
	string "LIBS: Libraries to pass to the linker, e.g. -l<library>"

config PK_PAGING_PF_FILE_F2FS_CPPFLAGS
	string "CPPFLAGS: C/C++ preprocessor flags, e.g. -I<include dir>"

config PK_PAGING_PF_FILE_F2FS_DPKCONFIG
	string "PKG_CONFIG_PATH: Directories to add to pkg-config's search path"

config PK_PAGING_PF_FILE_F2FS_CFLAGS
	string "CFLAGS: C compiler flags"

config PK_PAGING_PF_FILE_F2FS_LDFLAGS
	string "LDFLAGS: Linker flags"

config PK_PAGING_PF_FILE_F2FS_CXXFLAGS
	string "CXXFLAGS: C++ compiler flags"

config PK_PAGING_PF_FILE_F2FS_ASFLAGS
	string "CCASFLAGS: assembler compiler flags (defaults to CFLAGS)"

config PK_PAGING_PF_FILE_F2FS_BUILDARCH
	string "--host options on configure for Architecture"

endif # PK_PAGING_PF_FILE_F2FS
```

## package/PAGING/BiscuitOS-PAGING-PF-FILE-FAT/Kconfig
```kconfig
menuconfig PK_PAGING_PF_FILE_FAT
	bool "Page Fault with File-Mapped FAT FS"

if PK_PAGING_PF_FILE_FAT

config PK_PAGING_PF_FILE_FAT_VERSION
	default "default"
	string "verstion"

config PK_PAGING_PF_FILE_FAT_TAR
	default "tar.gz"
	string "tar type"

config PK_PAGING_PF_FILE_FAT_URL
	default "https://gitee.com/BiscuitOS_team/HardStack/raw/Gitee/Memory-Allocator/PAGING-MECH/BiscuitOS-PAGING-PF-FILE-FAT"
	string "url"

config PK_PAGING_PF_FILE_FAT_GITHUB
	string "GitHub"

config PK_PAGING_PF_FILE_FAT_SRCFILE
	default "main.c Makefile RunBiscuitOS.sh"
	string "Source code list"

config PK_PAGING_PF_FILE_FAT_CSRCFILE
	string "Compile source code list"

config PK_PAGING_PF_FILE_FAT_CONFIG
	string "CONFIG: Project Configure Options"

config PK_PAGING_PF_FILE_FAT_LIBPATH
	string "LIBS: Libraries to pass to the linker, e.g. -l<library>"

config PK_PAGING_PF_FILE_FAT_CPPFLAGS
	string "CPPFLAGS: C/C++ preprocessor flags, e.g. -I<include dir>"

config PK_PAGING_PF_FILE_FAT_DPKCONFIG
	string "PKG_CONFIG_PATH: Directories to add to pkg-config's search path"

config PK_PAGING_PF_FILE_FAT_CFLAGS
	string "CFLAGS: C compiler flags"

config PK_PAGING_PF_FILE_FAT_LDFLAGS
	string "LDFLAGS: Linker flags"

config PK_PAGING_PF_FILE_FAT_CXXFLAGS
	string "CXXFLAGS: C++ compiler flags"

config PK_PAGING_PF_FILE_FAT_ASFLAGS
	string "CCASFLAGS: assembler compiler flags (defaults to CFLAGS)"

config PK_PAGING_PF_FILE_FAT_BUILDARCH
	string "--host options on configure for Architecture"

endif # PK_PAGING_PF_FILE_FAT
```

## package/PAGING/BiscuitOS-PAGING-PF-FILE-JFS-FR/Kconfig
```kconfig
menuconfig PK_PAGING_PF_FILE_JFS_FR
	bool "Page Fault with File-Mapped JFS FAULT AROUND"

if PK_PAGING_PF_FILE_JFS_FR

config PK_PAGING_PF_FILE_JFS_FR_VERSION
	default "default"
	string "verstion"

config PK_PAGING_PF_FILE_JFS_FR_TAR
	default "tar.gz"
	string "tar type"

config PK_PAGING_PF_FILE_JFS_FR_URL
	default "https://gitee.com/BiscuitOS_team/HardStack/raw/Gitee/Memory-Allocator/PAGING-MECH/BiscuitOS-PAGING-PF-FILE-JFS-FR"
	string "url"

config PK_PAGING_PF_FILE_JFS_FR_GITHUB
	string "GitHub"

config PK_PAGING_PF_FILE_JFS_FR_SRCFILE
	default "main.c Makefile RunBiscuitOS.sh"
	string "Source code list"

config PK_PAGING_PF_FILE_JFS_FR_CSRCFILE
	string "Compile source code list"

config PK_PAGING_PF_FILE_JFS_FR_CONFIG
	string "CONFIG: Project Configure Options"

config PK_PAGING_PF_FILE_JFS_FR_LIBPATH
	string "LIBS: Libraries to pass to the linker, e.g. -l<library>"

config PK_PAGING_PF_FILE_JFS_FR_CPPFLAGS
	string "CPPFLAGS: C/C++ preprocessor flags, e.g. -I<include dir>"

config PK_PAGING_PF_FILE_JFS_FR_DPKCONFIG
	string "PKG_CONFIG_PATH: Directories to add to pkg-config's search path"

config PK_PAGING_PF_FILE_JFS_FR_CFLAGS
	string "CFLAGS: C compiler flags"

config PK_PAGING_PF_FILE_JFS_FR_LDFLAGS
	string "LDFLAGS: Linker flags"

config PK_PAGING_PF_FILE_JFS_FR_CXXFLAGS
	string "CXXFLAGS: C++ compiler flags"

config PK_PAGING_PF_FILE_JFS_FR_ASFLAGS
	string "CCASFLAGS: assembler compiler flags (defaults to CFLAGS)"

config PK_PAGING_PF_FILE_JFS_FR_BUILDARCH
	string "--host options on configure for Architecture"

endif # PK_PAGING_PF_FILE_JFS_FR
```
