## package/PAGING/BiscuitOS-PAGING-PF-ECODE-SUPER-UVADDR/Kconfig
```kconfig
menuconfig PK_PAGING_PF_ECODE_SUPER_UVADDR
	bool "Page Fault ERROR CODE: PF_SUPER Access UVADDR"

if PK_PAGING_PF_ECODE_SUPER_UVADDR

config PK_PAGING_PF_ECODE_SUPER_UVADDR_VERSION
	default "default"
	string "verstion"

config PK_PAGING_PF_ECODE_SUPER_UVADDR_TAR
	default "tar.gz"
	string "tar type"

config PK_PAGING_PF_ECODE_SUPER_UVADDR_URL
	default "https://gitee.com/BiscuitOS_team/HardStack/raw/Gitee/Memory-Allocator/PAGING-MECH/BiscuitOS-PAGING-PF-ECODE-SUPER-UVADDR"
	string "url"

config PK_PAGING_PF_ECODE_SUPER_UVADDR_GITHUB
	string "GitHub"

config PK_PAGING_PF_ECODE_SUPER_UVADDR_SRCFILE
	default "main.c Makefile RunBiscuitOS.sh app.c Kconfig Makefile.host"
	string "Source code list"

config PK_PAGING_PF_ECODE_SUPER_UVADDR_CSRCFILE
	string "Compile source code list"

config PK_PAGING_PF_ECODE_SUPER_UVADDR_CONFIG
	string "CONFIG: Project Configure Options"

config PK_PAGING_PF_ECODE_SUPER_UVADDR_LIBPATH
	string "LIBS: Libraries to pass to the linker, e.g. -l<library>"

config PK_PAGING_PF_ECODE_SUPER_UVADDR_CPPFLAGS
	string "CPPFLAGS: C/C++ preprocessor flags, e.g. -I<include dir>"

config PK_PAGING_PF_ECODE_SUPER_UVADDR_DPKCONFIG
	string "PKG_CONFIG_PATH: Directories to add to pkg-config's search path"

config PK_PAGING_PF_ECODE_SUPER_UVADDR_CFLAGS
	string "CFLAGS: C compiler flags"

config PK_PAGING_PF_ECODE_SUPER_UVADDR_LDFLAGS
	string "LDFLAGS: Linker flags"

config PK_PAGING_PF_ECODE_SUPER_UVADDR_CXXFLAGS
	string "CXXFLAGS: C++ compiler flags"

config PK_PAGING_PF_ECODE_SUPER_UVADDR_ASFLAGS
	string "CCASFLAGS: assembler compiler flags (defaults to CFLAGS)"

config PK_PAGING_PF_ECODE_SUPER_UVADDR_BUILDARCH
	string "--host options on configure for Architecture"

endif # PK_PAGING_PF_ECODE_SUPER_UVADDR
```

## package/PAGING/BiscuitOS-PAGING-PF-ECODE-SUPER/Kconfig
```kconfig
menuconfig PK_PAGING_PF_ECODE_SUPER
	bool "Page Fault ERROR CODE: PF_SUPER"

if PK_PAGING_PF_ECODE_SUPER

config PK_PAGING_PF_ECODE_SUPER_VERSION
	default "default"
	string "verstion"

config PK_PAGING_PF_ECODE_SUPER_TAR
	default "tar.gz"
	string "tar type"

config PK_PAGING_PF_ECODE_SUPER_URL
	default "https://gitee.com/BiscuitOS_team/HardStack/raw/Gitee/Memory-Allocator/PAGING-MECH/BiscuitOS-PAGING-PF-ECODE-SUPER"
	string "url"

config PK_PAGING_PF_ECODE_SUPER_GITHUB
	string "GitHub"

config PK_PAGING_PF_ECODE_SUPER_SRCFILE
	default "Kconfig Makefile main.c"
	string "Source code list"

config PK_PAGING_PF_ECODE_SUPER_CSRCFILE
	string "Compile source code list"

config PK_PAGING_PF_ECODE_SUPER_CONFIG
	string "CONFIG: Project Configure Options"

config PK_PAGING_PF_ECODE_SUPER_LIBPATH
	string "LIBS: Libraries to pass to the linker, e.g. -l<library>"

config PK_PAGING_PF_ECODE_SUPER_CPPFLAGS
	string "CPPFLAGS: C/C++ preprocessor flags, e.g. -I<include dir>"

config PK_PAGING_PF_ECODE_SUPER_DPKCONFIG
	string "PKG_CONFIG_PATH: Directories to add to pkg-config's search path"

config PK_PAGING_PF_ECODE_SUPER_CFLAGS
	string "CFLAGS: C compiler flags"

config PK_PAGING_PF_ECODE_SUPER_LDFLAGS
	string "LDFLAGS: Linker flags"

config PK_PAGING_PF_ECODE_SUPER_CXXFLAGS
	string "CXXFLAGS: C++ compiler flags"

config PK_PAGING_PF_ECODE_SUPER_ASFLAGS
	string "CCASFLAGS: assembler compiler flags (defaults to CFLAGS)"

config PK_PAGING_PF_ECODE_SUPER_BUILDARCH
	string "--host options on configure for Architecture"

endif # PK_PAGING_PF_ECODE_SUPER
```

## package/PAGING/BiscuitOS-PAGING-PF-ECODE-USER-KVADDR/Kconfig
```kconfig
menuconfig PK_PAGING_PF_ECODE_USER_KVADDR
	bool "Page Fault ERROR CODE: PF_USER Access KVADDR"

if PK_PAGING_PF_ECODE_USER_KVADDR

config PK_PAGING_PF_ECODE_USER_KVADDR_VERSION
	default "default"
	string "verstion"

config PK_PAGING_PF_ECODE_USER_KVADDR_TAR
	default "tar.gz"
	string "tar type"

config PK_PAGING_PF_ECODE_USER_KVADDR_URL
	default "https://gitee.com/BiscuitOS_team/HardStack/raw/Gitee/Memory-Allocator/PAGING-MECH/BiscuitOS-PAGING-PF-ECODE-USER-KVADDR"
	string "url"

config PK_PAGING_PF_ECODE_USER_KVADDR_GITHUB
	string "GitHub"

config PK_PAGING_PF_ECODE_USER_KVADDR_SRCFILE
	default "main.c Makefile RunBiscuitOS.sh app.c Kconfig Makefile.app"
	string "Source code list"

config PK_PAGING_PF_ECODE_USER_KVADDR_CSRCFILE
	string "Compile source code list"

config PK_PAGING_PF_ECODE_USER_KVADDR_CONFIG
	string "CONFIG: Project Configure Options"

config PK_PAGING_PF_ECODE_USER_KVADDR_LIBPATH
	string "LIBS: Libraries to pass to the linker, e.g. -l<library>"

config PK_PAGING_PF_ECODE_USER_KVADDR_CPPFLAGS
	string "CPPFLAGS: C/C++ preprocessor flags, e.g. -I<include dir>"

config PK_PAGING_PF_ECODE_USER_KVADDR_DPKCONFIG
	string "PKG_CONFIG_PATH: Directories to add to pkg-config's search path"

config PK_PAGING_PF_ECODE_USER_KVADDR_CFLAGS
	string "CFLAGS: C compiler flags"

config PK_PAGING_PF_ECODE_USER_KVADDR_LDFLAGS
	string "LDFLAGS: Linker flags"

config PK_PAGING_PF_ECODE_USER_KVADDR_CXXFLAGS
	string "CXXFLAGS: C++ compiler flags"

config PK_PAGING_PF_ECODE_USER_KVADDR_ASFLAGS
	string "CCASFLAGS: assembler compiler flags (defaults to CFLAGS)"

config PK_PAGING_PF_ECODE_USER_KVADDR_BUILDARCH
	string "--host options on configure for Architecture"

endif # PK_PAGING_PF_ECODE_USER_KVADDR
```

## package/PAGING/BiscuitOS-PAGING-PF-ECODE-USER/Kconfig
```kconfig
menuconfig PK_PAGING_PF_ECODE_USER
	bool "Page Fault ERROR CODE: PF_USER"

if PK_PAGING_PF_ECODE_USER

config PK_PAGING_PF_ECODE_USER_VERSION
	default "default"
	string "verstion"

config PK_PAGING_PF_ECODE_USER_TAR
	default "tar.gz"
	string "tar type"

config PK_PAGING_PF_ECODE_USER_URL
	default "https://gitee.com/BiscuitOS_team/HardStack/raw/Gitee/Memory-Allocator/PAGING-MECH/BiscuitOS-PAGING-PF-ECODE-USER"
	string "url"

config PK_PAGING_PF_ECODE_USER_GITHUB
	string "GitHub"

config PK_PAGING_PF_ECODE_USER_SRCFILE
	default "main.c Makefile RunBiscuitOS.sh"
	string "Source code list"

config PK_PAGING_PF_ECODE_USER_CSRCFILE
	string "Compile source code list"

config PK_PAGING_PF_ECODE_USER_CONFIG
	string "CONFIG: Project Configure Options"

config PK_PAGING_PF_ECODE_USER_LIBPATH
	string "LIBS: Libraries to pass to the linker, e.g. -l<library>"

config PK_PAGING_PF_ECODE_USER_CPPFLAGS
	string "CPPFLAGS: C/C++ preprocessor flags, e.g. -I<include dir>"

config PK_PAGING_PF_ECODE_USER_DPKCONFIG
	string "PKG_CONFIG_PATH: Directories to add to pkg-config's search path"

config PK_PAGING_PF_ECODE_USER_CFLAGS
	string "CFLAGS: C compiler flags"

config PK_PAGING_PF_ECODE_USER_LDFLAGS
	string "LDFLAGS: Linker flags"

config PK_PAGING_PF_ECODE_USER_CXXFLAGS
	string "CXXFLAGS: C++ compiler flags"

config PK_PAGING_PF_ECODE_USER_ASFLAGS
	string "CCASFLAGS: assembler compiler flags (defaults to CFLAGS)"

config PK_PAGING_PF_ECODE_USER_BUILDARCH
	string "--host options on configure for Architecture"

endif # PK_PAGING_PF_ECODE_USER
```

## package/PAGING/BiscuitOS-PAGING-PF-ECODE-WRITE-WP/Kconfig
```kconfig
menuconfig PK_PAGING_PF_ECODE_WRITE_WP
	bool "Page Fault ERROR CODE: PF_WRITE with WP"

if PK_PAGING_PF_ECODE_WRITE_WP

config PK_PAGING_PF_ECODE_WRITE_WP_VERSION
	default "default"
	string "verstion"

config PK_PAGING_PF_ECODE_WRITE_WP_TAR
	default "tar.gz"
	string "tar type"

config PK_PAGING_PF_ECODE_WRITE_WP_URL
	default "https://gitee.com/BiscuitOS_team/HardStack/raw/Gitee/Memory-Allocator/PAGING-MECH/BiscuitOS-PAGING-PF-ECODE-WRITE-WP"
	string "url"

config PK_PAGING_PF_ECODE_WRITE_WP_GITHUB
	string "GitHub"

config PK_PAGING_PF_ECODE_WRITE_WP_SRCFILE
	default "main.c Makefile RunBiscuitOS.sh"
	string "Source code list"

config PK_PAGING_PF_ECODE_WRITE_WP_CSRCFILE
	string "Compile source code list"

config PK_PAGING_PF_ECODE_WRITE_WP_CONFIG
	string "CONFIG: Project Configure Options"

config PK_PAGING_PF_ECODE_WRITE_WP_LIBPATH
	string "LIBS: Libraries to pass to the linker, e.g. -l<library>"

config PK_PAGING_PF_ECODE_WRITE_WP_CPPFLAGS
	string "CPPFLAGS: C/C++ preprocessor flags, e.g. -I<include dir>"

config PK_PAGING_PF_ECODE_WRITE_WP_DPKCONFIG
	string "PKG_CONFIG_PATH: Directories to add to pkg-config's search path"

config PK_PAGING_PF_ECODE_WRITE_WP_CFLAGS
	string "CFLAGS: C compiler flags"

config PK_PAGING_PF_ECODE_WRITE_WP_LDFLAGS
	string "LDFLAGS: Linker flags"

config PK_PAGING_PF_ECODE_WRITE_WP_CXXFLAGS
	string "CXXFLAGS: C++ compiler flags"

config PK_PAGING_PF_ECODE_WRITE_WP_ASFLAGS
	string "CCASFLAGS: assembler compiler flags (defaults to CFLAGS)"

config PK_PAGING_PF_ECODE_WRITE_WP_BUILDARCH
	string "--host options on configure for Architecture"

endif # PK_PAGING_PF_ECODE_WRITE_WP
```

## package/PAGING/BiscuitOS-PAGING-PF-ECODE-WRITE/Kconfig
```kconfig
menuconfig PK_PAGING_PF_ECODE_WRITE
	bool "Page Fault ERROR CODE: PF_WRITE"

if PK_PAGING_PF_ECODE_WRITE

config PK_PAGING_PF_ECODE_WRITE_VERSION
	default "default"
	string "verstion"

config PK_PAGING_PF_ECODE_WRITE_TAR
	default "tar.gz"
	string "tar type"

config PK_PAGING_PF_ECODE_WRITE_URL
	default "https://gitee.com/BiscuitOS_team/HardStack/raw/Gitee/Memory-Allocator/PAGING-MECH/BiscuitOS-PAGING-PF-ECODE-WRITE"
	string "url"

config PK_PAGING_PF_ECODE_WRITE_GITHUB
	string "GitHub"

config PK_PAGING_PF_ECODE_WRITE_SRCFILE
	default "main.c Makefile RunBiscuitOS.sh"
	string "Source code list"

config PK_PAGING_PF_ECODE_WRITE_CSRCFILE
	string "Compile source code list"

config PK_PAGING_PF_ECODE_WRITE_CONFIG
	string "CONFIG: Project Configure Options"

config PK_PAGING_PF_ECODE_WRITE_LIBPATH
	string "LIBS: Libraries to pass to the linker, e.g. -l<library>"

config PK_PAGING_PF_ECODE_WRITE_CPPFLAGS
	string "CPPFLAGS: C/C++ preprocessor flags, e.g. -I<include dir>"

config PK_PAGING_PF_ECODE_WRITE_DPKCONFIG
	string "PKG_CONFIG_PATH: Directories to add to pkg-config's search path"

config PK_PAGING_PF_ECODE_WRITE_CFLAGS
	string "CFLAGS: C compiler flags"

config PK_PAGING_PF_ECODE_WRITE_LDFLAGS
	string "LDFLAGS: Linker flags"

config PK_PAGING_PF_ECODE_WRITE_CXXFLAGS
	string "CXXFLAGS: C++ compiler flags"

config PK_PAGING_PF_ECODE_WRITE_ASFLAGS
	string "CCASFLAGS: assembler compiler flags (defaults to CFLAGS)"

config PK_PAGING_PF_ECODE_WRITE_BUILDARCH
	string "--host options on configure for Architecture"

endif # PK_PAGING_PF_ECODE_WRITE
```

## package/PAGING/BiscuitOS-PAGING-PF-FILE-BTRFS-COW/Kconfig
```kconfig
menuconfig PK_PAGING_PF_FILE_BTRFS_COW
	bool "Page Fault with File-Mapped BTRFS COW"

if PK_PAGING_PF_FILE_BTRFS_COW

config PK_PAGING_PF_FILE_BTRFS_COW_VERSION
	default "default"
	string "verstion"

config PK_PAGING_PF_FILE_BTRFS_COW_TAR
	default "tar.gz"
	string "tar type"

config PK_PAGING_PF_FILE_BTRFS_COW_URL
	default "https://gitee.com/BiscuitOS_team/HardStack/raw/Gitee/Memory-Allocator/PAGING-MECH/BiscuitOS-PAGING-PF-FILE-BTRFS-COW"
	string "url"

config PK_PAGING_PF_FILE_BTRFS_COW_GITHUB
	string "GitHub"

config PK_PAGING_PF_FILE_BTRFS_COW_SRCFILE
	default "main.c Makefile RunBiscuitOS.sh"
	string "Source code list"

config PK_PAGING_PF_FILE_BTRFS_COW_CSRCFILE
	string "Compile source code list"

config PK_PAGING_PF_FILE_BTRFS_COW_CONFIG
	string "CONFIG: Project Configure Options"

config PK_PAGING_PF_FILE_BTRFS_COW_LIBPATH
	string "LIBS: Libraries to pass to the linker, e.g. -l<library>"

config PK_PAGING_PF_FILE_BTRFS_COW_CPPFLAGS
	string "CPPFLAGS: C/C++ preprocessor flags, e.g. -I<include dir>"

config PK_PAGING_PF_FILE_BTRFS_COW_DPKCONFIG
	string "PKG_CONFIG_PATH: Directories to add to pkg-config's search path"

config PK_PAGING_PF_FILE_BTRFS_COW_CFLAGS
	string "CFLAGS: C compiler flags"

config PK_PAGING_PF_FILE_BTRFS_COW_LDFLAGS
	string "LDFLAGS: Linker flags"

config PK_PAGING_PF_FILE_BTRFS_COW_CXXFLAGS
	string "CXXFLAGS: C++ compiler flags"

config PK_PAGING_PF_FILE_BTRFS_COW_ASFLAGS
	string "CCASFLAGS: assembler compiler flags (defaults to CFLAGS)"

config PK_PAGING_PF_FILE_BTRFS_COW_BUILDARCH
	string "--host options on configure for Architecture"

endif # PK_PAGING_PF_FILE_BTRFS_COW
```

## package/PAGING/BiscuitOS-PAGING-PF-FILE-BTRFS/Kconfig
```kconfig
menuconfig PK_PAGING_PF_FILE_BTRFS
	bool "Page Fault with File-Mapped BTRFS"

if PK_PAGING_PF_FILE_BTRFS

config PK_PAGING_PF_FILE_BTRFS_VERSION
	default "default"
	string "verstion"

config PK_PAGING_PF_FILE_BTRFS_TAR
	default "tar.gz"
	string "tar type"

config PK_PAGING_PF_FILE_BTRFS_URL
	default "https://gitee.com/BiscuitOS_team/HardStack/raw/Gitee/Memory-Allocator/PAGING-MECH/BiscuitOS-PAGING-PF-FILE-BTRFS"
	string "url"

config PK_PAGING_PF_FILE_BTRFS_GITHUB
	string "GitHub"

config PK_PAGING_PF_FILE_BTRFS_SRCFILE
	default "main.c Makefile RunBiscuitOS.sh"
	string "Source code list"

config PK_PAGING_PF_FILE_BTRFS_CSRCFILE
	string "Compile source code list"

config PK_PAGING_PF_FILE_BTRFS_CONFIG
	string "CONFIG: Project Configure Options"

config PK_PAGING_PF_FILE_BTRFS_LIBPATH
	string "LIBS: Libraries to pass to the linker, e.g. -l<library>"

config PK_PAGING_PF_FILE_BTRFS_CPPFLAGS
	string "CPPFLAGS: C/C++ preprocessor flags, e.g. -I<include dir>"

config PK_PAGING_PF_FILE_BTRFS_DPKCONFIG
	string "PKG_CONFIG_PATH: Directories to add to pkg-config's search path"

config PK_PAGING_PF_FILE_BTRFS_CFLAGS
	string "CFLAGS: C compiler flags"

config PK_PAGING_PF_FILE_BTRFS_LDFLAGS
	string "LDFLAGS: Linker flags"

config PK_PAGING_PF_FILE_BTRFS_CXXFLAGS
	string "CXXFLAGS: C++ compiler flags"

config PK_PAGING_PF_FILE_BTRFS_ASFLAGS
	string "CCASFLAGS: assembler compiler flags (defaults to CFLAGS)"

config PK_PAGING_PF_FILE_BTRFS_BUILDARCH
	string "--host options on configure for Architecture"

endif # PK_PAGING_PF_FILE_BTRFS
```

## package/PAGING/BiscuitOS-PAGING-PF-FILE-CRAMFS/Kconfig
```kconfig
menuconfig PK_PAGING_PF_FILE_CRAMFS
	bool "Page Fault with File-Mapped CRAMFS"

if PK_PAGING_PF_FILE_CRAMFS

config PK_PAGING_PF_FILE_CRAMFS_VERSION
	default "default"
	string "verstion"

config PK_PAGING_PF_FILE_CRAMFS_TAR
	default "tar.gz"
	string "tar type"

config PK_PAGING_PF_FILE_CRAMFS_URL
	default "https://gitee.com/BiscuitOS_team/HardStack/raw/Gitee/Memory-Allocator/PAGING-MECH/BiscuitOS-PAGING-PF-FILE-CRAMFS"
	string "url"

config PK_PAGING_PF_FILE_CRAMFS_GITHUB
	string "GitHub"

config PK_PAGING_PF_FILE_CRAMFS_SRCFILE
	default "main.c Makefile RunBiscuitOS.sh"
	string "Source code list"

config PK_PAGING_PF_FILE_CRAMFS_CSRCFILE
	string "Compile source code list"

config PK_PAGING_PF_FILE_CRAMFS_CONFIG
	string "CONFIG: Project Configure Options"

config PK_PAGING_PF_FILE_CRAMFS_LIBPATH
	string "LIBS: Libraries to pass to the linker, e.g. -l<library>"

config PK_PAGING_PF_FILE_CRAMFS_CPPFLAGS
	string "CPPFLAGS: C/C++ preprocessor flags, e.g. -I<include dir>"

config PK_PAGING_PF_FILE_CRAMFS_DPKCONFIG
	string "PKG_CONFIG_PATH: Directories to add to pkg-config's search path"

config PK_PAGING_PF_FILE_CRAMFS_CFLAGS
	string "CFLAGS: C compiler flags"

config PK_PAGING_PF_FILE_CRAMFS_LDFLAGS
	string "LDFLAGS: Linker flags"

config PK_PAGING_PF_FILE_CRAMFS_CXXFLAGS
	string "CXXFLAGS: C++ compiler flags"

config PK_PAGING_PF_FILE_CRAMFS_ASFLAGS
	string "CCASFLAGS: assembler compiler flags (defaults to CFLAGS)"

config PK_PAGING_PF_FILE_CRAMFS_BUILDARCH
	string "--host options on configure for Architecture"

endif # PK_PAGING_PF_FILE_CRAMFS
```
