## package/PAGING/BiscuitOS-PAGING-PT-U2PT-PAGE-RW-CLEAR/Kconfig
```kconfig
menuconfig PK_PAGING_PT_U2PT_PAGE_RW_CLEAR
	bool "User with PageTable: CLEAR _PAGE_RW"

if PK_PAGING_PT_U2PT_PAGE_RW_CLEAR

config PK_PAGING_PT_U2PT_PAGE_RW_CLEAR_VERSION
	default "default"
	string "verstion"

config PK_PAGING_PT_U2PT_PAGE_RW_CLEAR_TAR
	default "tar.gz"
	string "tar type"

config PK_PAGING_PT_U2PT_PAGE_RW_CLEAR_URL
	default "https://gitee.com/BiscuitOS_team/HardStack/raw/Gitee/Memory-Allocator/PAGING-MECH/BiscuitOS-PAGING-PT-U2PT-PAGE-RW-CLEAR"
	string "url"

config PK_PAGING_PT_U2PT_PAGE_RW_CLEAR_GITHUB
	string "GitHub"

config PK_PAGING_PT_U2PT_PAGE_RW_CLEAR_SRCFILE
	default "main.c Makefile RunBiscuitOS.sh"
	string "Source code list"

config PK_PAGING_PT_U2PT_PAGE_RW_CLEAR_CSRCFILE
	string "Compile source code list"

config PK_PAGING_PT_U2PT_PAGE_RW_CLEAR_CONFIG
	string "CONFIG: Project Configure Options"

config PK_PAGING_PT_U2PT_PAGE_RW_CLEAR_LIBPATH
	string "LIBS: Libraries to pass to the linker, e.g. -l<library>"

config PK_PAGING_PT_U2PT_PAGE_RW_CLEAR_CPPFLAGS
	string "CPPFLAGS: C/C++ preprocessor flags, e.g. -I<include dir>"

config PK_PAGING_PT_U2PT_PAGE_RW_CLEAR_DPKCONFIG
	string "PKG_CONFIG_PATH: Directories to add to pkg-config's search path"

config PK_PAGING_PT_U2PT_PAGE_RW_CLEAR_CFLAGS
	string "CFLAGS: C compiler flags"

config PK_PAGING_PT_U2PT_PAGE_RW_CLEAR_LDFLAGS
	string "LDFLAGS: Linker flags"

config PK_PAGING_PT_U2PT_PAGE_RW_CLEAR_CXXFLAGS
	string "CXXFLAGS: C++ compiler flags"

config PK_PAGING_PT_U2PT_PAGE_RW_CLEAR_ASFLAGS
	string "CCASFLAGS: assembler compiler flags (defaults to CFLAGS)"

config PK_PAGING_PT_U2PT_PAGE_RW_CLEAR_BUILDARCH
	string "--host options on configure for Architecture"

endif # PK_PAGING_PT_U2PT_PAGE_RW_CLEAR
```

## package/PAGING/BiscuitOS-PAGING-PT-U2PT-PAGE-SPECIAL-SET/Kconfig
```kconfig
menuconfig PK_PAGING_PT_U2PT_PAGE_SPECIAL_SET
	bool "User with PageTable: SET _PAGE_SPECIAL"

if PK_PAGING_PT_U2PT_PAGE_SPECIAL_SET

config PK_PAGING_PT_U2PT_PAGE_SPECIAL_SET_VERSION
	default "default"
	string "verstion"

config PK_PAGING_PT_U2PT_PAGE_SPECIAL_SET_TAR
	default "tar.gz"
	string "tar type"

config PK_PAGING_PT_U2PT_PAGE_SPECIAL_SET_URL
	default "https://gitee.com/BiscuitOS_team/HardStack/raw/Gitee/Memory-Allocator/PAGING-MECH/BiscuitOS-PAGING-PT-U2PT-PAGE-SPECIAL-SET"
	string "url"

config PK_PAGING_PT_U2PT_PAGE_SPECIAL_SET_GITHUB
	string "GitHub"

config PK_PAGING_PT_U2PT_PAGE_SPECIAL_SET_SRCFILE
	default "main.c Makefile RunBiscuitOS.sh"
	string "Source code list"

config PK_PAGING_PT_U2PT_PAGE_SPECIAL_SET_CSRCFILE
	string "Compile source code list"

config PK_PAGING_PT_U2PT_PAGE_SPECIAL_SET_CONFIG
	string "CONFIG: Project Configure Options"

config PK_PAGING_PT_U2PT_PAGE_SPECIAL_SET_LIBPATH
	string "LIBS: Libraries to pass to the linker, e.g. -l<library>"

config PK_PAGING_PT_U2PT_PAGE_SPECIAL_SET_CPPFLAGS
	string "CPPFLAGS: C/C++ preprocessor flags, e.g. -I<include dir>"

config PK_PAGING_PT_U2PT_PAGE_SPECIAL_SET_DPKCONFIG
	string "PKG_CONFIG_PATH: Directories to add to pkg-config's search path"

config PK_PAGING_PT_U2PT_PAGE_SPECIAL_SET_CFLAGS
	string "CFLAGS: C compiler flags"

config PK_PAGING_PT_U2PT_PAGE_SPECIAL_SET_LDFLAGS
	string "LDFLAGS: Linker flags"

config PK_PAGING_PT_U2PT_PAGE_SPECIAL_SET_CXXFLAGS
	string "CXXFLAGS: C++ compiler flags"

config PK_PAGING_PT_U2PT_PAGE_SPECIAL_SET_ASFLAGS
	string "CCASFLAGS: assembler compiler flags (defaults to CFLAGS)"

config PK_PAGING_PT_U2PT_PAGE_SPECIAL_SET_BUILDARCH
	string "--host options on configure for Architecture"

endif # PK_PAGING_PT_U2PT_PAGE_SPECIAL_SET
```

## package/PAGING/BiscuitOS-PAGING-PT-U2PT-PAGE-USER/Kconfig
```kconfig
menuconfig PK_PAGING_PT_U2PT_PAGE_USER
	bool "User with PageTable: SET _PAGE_USER"

if PK_PAGING_PT_U2PT_PAGE_USER

config PK_PAGING_PT_U2PT_PAGE_USER_VERSION
	default "default"
	string "verstion"

config PK_PAGING_PT_U2PT_PAGE_USER_TAR
	default "tar.gz"
	string "tar type"

config PK_PAGING_PT_U2PT_PAGE_USER_URL
	default "https://gitee.com/BiscuitOS_team/HardStack/raw/Gitee/Memory-Allocator/PAGING-MECH/BiscuitOS-PAGING-PT-U2PT-PAGE-USER"
	string "url"

config PK_PAGING_PT_U2PT_PAGE_USER_GITHUB
	string "GitHub"

config PK_PAGING_PT_U2PT_PAGE_USER_SRCFILE
	default "main.c Makefile RunBiscuitOS.sh"
	string "Source code list"

config PK_PAGING_PT_U2PT_PAGE_USER_CSRCFILE
	string "Compile source code list"

config PK_PAGING_PT_U2PT_PAGE_USER_CONFIG
	string "CONFIG: Project Configure Options"

config PK_PAGING_PT_U2PT_PAGE_USER_LIBPATH
	string "LIBS: Libraries to pass to the linker, e.g. -l<library>"

config PK_PAGING_PT_U2PT_PAGE_USER_CPPFLAGS
	string "CPPFLAGS: C/C++ preprocessor flags, e.g. -I<include dir>"

config PK_PAGING_PT_U2PT_PAGE_USER_DPKCONFIG
	string "PKG_CONFIG_PATH: Directories to add to pkg-config's search path"

config PK_PAGING_PT_U2PT_PAGE_USER_CFLAGS
	string "CFLAGS: C compiler flags"

config PK_PAGING_PT_U2PT_PAGE_USER_LDFLAGS
	string "LDFLAGS: Linker flags"

config PK_PAGING_PT_U2PT_PAGE_USER_CXXFLAGS
	string "CXXFLAGS: C++ compiler flags"

config PK_PAGING_PT_U2PT_PAGE_USER_ASFLAGS
	string "CCASFLAGS: assembler compiler flags (defaults to CFLAGS)"

config PK_PAGING_PT_U2PT_PAGE_USER_BUILDARCH
	string "--host options on configure for Architecture"

endif # PK_PAGING_PT_U2PT_PAGE_USER
```

## package/PAGING/BiscuitOS-PAGING-PT-VTP-PFN/Kconfig
```kconfig
menuconfig PK_PAGING_PT_VTP_PFN
	bool "VTP: VMALLOC TO PFN"

if PK_PAGING_PT_VTP_PFN

config PK_PAGING_PT_VTP_PFN_VERSION
	default "default"
	string "verstion"

config PK_PAGING_PT_VTP_PFN_TAR
	default "tar.gz"
	string "tar type"

config PK_PAGING_PT_VTP_PFN_URL
	default "https://gitee.com/BiscuitOS_team/HardStack/raw/Gitee/Memory-Allocator/PAGING-MECH/BiscuitOS-PAGING-PT-VTP-PFN"
	string "url"

config PK_PAGING_PT_VTP_PFN_GITHUB
	string "GitHub"

config PK_PAGING_PT_VTP_PFN_SRCFILE
	default "main.c Makefile RunBiscuitOS.sh Makefile.host Kconfig"
	string "Source code list"

config PK_PAGING_PT_VTP_PFN_CSRCFILE
	string "Compile source code list"

config PK_PAGING_PT_VTP_PFN_CONFIG
	string "CONFIG: Project Configure Options"

config PK_PAGING_PT_VTP_PFN_LIBPATH
	string "LIBS: Libraries to pass to the linker, e.g. -l<library>"

config PK_PAGING_PT_VTP_PFN_CPPFLAGS
	string "CPPFLAGS: C/C++ preprocessor flags, e.g. -I<include dir>"

config PK_PAGING_PT_VTP_PFN_DPKCONFIG
	string "PKG_CONFIG_PATH: Directories to add to pkg-config's search path"

config PK_PAGING_PT_VTP_PFN_CFLAGS
	string "CFLAGS: C compiler flags"

config PK_PAGING_PT_VTP_PFN_LDFLAGS
	string "LDFLAGS: Linker flags"

config PK_PAGING_PT_VTP_PFN_CXXFLAGS
	string "CXXFLAGS: C++ compiler flags"

config PK_PAGING_PT_VTP_PFN_ASFLAGS
	string "CCASFLAGS: assembler compiler flags (defaults to CFLAGS)"

config PK_PAGING_PT_VTP_PFN_BUILDARCH
	string "--host options on configure for Architecture"

endif # PK_PAGING_PT_VTP_PFN
```

## package/PAGING/BiscuitOS-PAGING-PTDUMP-CHECK-NX/Kconfig
```kconfig
menuconfig PK_PAGING_PTDUMP_CHECK_NX
	bool "PTDUMP: Check NX Region"

if PK_PAGING_PTDUMP_CHECK_NX

config PK_PAGING_PTDUMP_CHECK_NX_VERSION
	default "default"
	string "verstion"

config PK_PAGING_PTDUMP_CHECK_NX_TAR
	default "tar.gz"
	string "tar type"

config PK_PAGING_PTDUMP_CHECK_NX_URL
	default "https://gitee.com/BiscuitOS_team/HardStack/raw/Gitee/Memory-Allocator/PAGING-MECH/BiscuitOS-PAGING-PTDUMP-CHECK-NX"
	string "url"

config PK_PAGING_PTDUMP_CHECK_NX_GITHUB
	string "GitHub"

config PK_PAGING_PTDUMP_CHECK_NX_SRCFILE
	default "main.c Makefile Kconfig Makefile.app RunBiscuitOS.sh app.c"
	string "Source code list"

config PK_PAGING_PTDUMP_CHECK_NX_CSRCFILE
	string "Compile source code list"

config PK_PAGING_PTDUMP_CHECK_NX_CONFIG
	string "CONFIG: Project Configure Options"

config PK_PAGING_PTDUMP_CHECK_NX_LIBPATH
	string "LIBS: Libraries to pass to the linker, e.g. -l<library>"

config PK_PAGING_PTDUMP_CHECK_NX_CPPFLAGS
	string "CPPFLAGS: C/C++ preprocessor flags, e.g. -I<include dir>"

config PK_PAGING_PTDUMP_CHECK_NX_DPKCONFIG
	string "PKG_CONFIG_PATH: Directories to add to pkg-config's search path"

config PK_PAGING_PTDUMP_CHECK_NX_CFLAGS
	string "CFLAGS: C compiler flags"

config PK_PAGING_PTDUMP_CHECK_NX_LDFLAGS
	string "LDFLAGS: Linker flags"

config PK_PAGING_PTDUMP_CHECK_NX_CXXFLAGS
	string "CXXFLAGS: C++ compiler flags"

config PK_PAGING_PTDUMP_CHECK_NX_ASFLAGS
	string "CCASFLAGS: assembler compiler flags (defaults to CFLAGS)"

config PK_PAGING_PTDUMP_CHECK_NX_BUILDARCH
	string "--host options on configure for Architecture"

endif # PK_PAGING_PTDUMP_CHECK_NX
```

## package/PAGING/BiscuitOS-PAGING-PTDUMP-CURRUSER/Kconfig
```kconfig
menuconfig PK_PAGING_PTDUMP_CURRUSER
	bool "PTDUMP: DUMP Current Userspace PageTable"

if PK_PAGING_PTDUMP_CURRUSER

config PK_PAGING_PTDUMP_CURRUSER_VERSION
	default "default"
	string "verstion"

config PK_PAGING_PTDUMP_CURRUSER_TAR
	default "tar.gz"
	string "tar type"

config PK_PAGING_PTDUMP_CURRUSER_URL
	default "https://gitee.com/BiscuitOS_team/HardStack/raw/Gitee/Memory-Allocator/PAGING-MECH/BiscuitOS-PAGING-PTDUMP-CURRUSER"
	string "url"

config PK_PAGING_PTDUMP_CURRUSER_GITHUB
	string "GitHub"

config PK_PAGING_PTDUMP_CURRUSER_SRCFILE
	default "main.c Makefile"
	string "Source code list"

config PK_PAGING_PTDUMP_CURRUSER_CSRCFILE
	string "Compile source code list"

config PK_PAGING_PTDUMP_CURRUSER_CONFIG
	string "CONFIG: Project Configure Options"

config PK_PAGING_PTDUMP_CURRUSER_LIBPATH
	string "LIBS: Libraries to pass to the linker, e.g. -l<library>"

config PK_PAGING_PTDUMP_CURRUSER_CPPFLAGS
	string "CPPFLAGS: C/C++ preprocessor flags, e.g. -I<include dir>"

config PK_PAGING_PTDUMP_CURRUSER_DPKCONFIG
	string "PKG_CONFIG_PATH: Directories to add to pkg-config's search path"

config PK_PAGING_PTDUMP_CURRUSER_CFLAGS
	string "CFLAGS: C compiler flags"

config PK_PAGING_PTDUMP_CURRUSER_LDFLAGS
	string "LDFLAGS: Linker flags"

config PK_PAGING_PTDUMP_CURRUSER_CXXFLAGS
	string "CXXFLAGS: C++ compiler flags"

config PK_PAGING_PTDUMP_CURRUSER_ASFLAGS
	string "CCASFLAGS: assembler compiler flags (defaults to CFLAGS)"

config PK_PAGING_PTDUMP_CURRUSER_BUILDARCH
	string "--host options on configure for Architecture"

endif # PK_PAGING_PTDUMP_CURRUSER
```

## package/PAGING/BiscuitOS-PAGING-PTE/Kconfig
```kconfig
menuconfig PK_PAGING_PTE
	bool "PTE(Page Table)"

if PK_PAGING_PTE

config PK_PAGING_PTE_VERSION
	default "default"
	string "verstion"

config PK_PAGING_PTE_TAR
	default "tar.gz"
	string "tar type"

config PK_PAGING_PTE_URL
	default "https://gitee.com/BiscuitOS_team/HardStack/raw/Gitee/Memory-Allocator/PAGING-MECH/BiscuitOS-PAGING-PTE"
	string "url"

config PK_PAGING_PTE_GITHUB
	string "GitHub"

config PK_PAGING_PTE_SRCFILE
	default "main.c Makefile Kconfig Makefile.app RunBiscuitOS.sh app.c"
	string "Source code list"

config PK_PAGING_PTE_CSRCFILE
	string "Compile source code list"

config PK_PAGING_PTE_CONFIG
	string "CONFIG: Project Configure Options"

config PK_PAGING_PTE_LIBPATH
	string "LIBS: Libraries to pass to the linker, e.g. -l<library>"

config PK_PAGING_PTE_CPPFLAGS
	string "CPPFLAGS: C/C++ preprocessor flags, e.g. -I<include dir>"

config PK_PAGING_PTE_DPKCONFIG
	string "PKG_CONFIG_PATH: Directories to add to pkg-config's search path"

config PK_PAGING_PTE_CFLAGS
	string "CFLAGS: C compiler flags"

config PK_PAGING_PTE_LDFLAGS
	string "LDFLAGS: Linker flags"

config PK_PAGING_PTE_CXXFLAGS
	string "CXXFLAGS: C++ compiler flags"

config PK_PAGING_PTE_ASFLAGS
	string "CCASFLAGS: assembler compiler flags (defaults to CFLAGS)"

config PK_PAGING_PTE_BUILDARCH
	string "--host options on configure for Architecture"

endif # PK_PAGING_PTE
```
