## package/PAGING/BiscuitOS-PAGING-PT-CPR/Kconfig
```kconfig
menuconfig PK_PAGING_PT_CPR
	bool "Copy-Page-Range(CPR)"

if PK_PAGING_PT_CPR

config PK_PAGING_PT_CPR_VERSION
	default "default"
	string "verstion"

config PK_PAGING_PT_CPR_TAR
	default "tar.gz"
	string "tar type"

config PK_PAGING_PT_CPR_URL
	default "https://gitee.com/BiscuitOS_team/HardStack/raw/Gitee/Memory-Allocator/PAGING-MECH/BiscuitOS-PAGING-PT-CPR"
	string "url"

config PK_PAGING_PT_CPR_GITHUB
	string "GitHub"

config PK_PAGING_PT_CPR_SRCFILE
	default "main.c Makefile RunBiscuitOS.sh"
	string "Source code list"

config PK_PAGING_PT_CPR_CSRCFILE
	string "Compile source code list"

config PK_PAGING_PT_CPR_CONFIG
	string "CONFIG: Project Configure Options"

config PK_PAGING_PT_CPR_LIBPATH
	string "LIBS: Libraries to pass to the linker, e.g. -l<library>"

config PK_PAGING_PT_CPR_CPPFLAGS
	string "CPPFLAGS: C/C++ preprocessor flags, e.g. -I<include dir>"

config PK_PAGING_PT_CPR_DPKCONFIG
	string "PKG_CONFIG_PATH: Directories to add to pkg-config's search path"

config PK_PAGING_PT_CPR_CFLAGS
	string "CFLAGS: C compiler flags"

config PK_PAGING_PT_CPR_LDFLAGS
	string "LDFLAGS: Linker flags"

config PK_PAGING_PT_CPR_CXXFLAGS
	string "CXXFLAGS: C++ compiler flags"

config PK_PAGING_PT_CPR_ASFLAGS
	string "CCASFLAGS: assembler compiler flags (defaults to CFLAGS)"

config PK_PAGING_PT_CPR_BUILDARCH
	string "--host options on configure for Architecture"

endif # PK_PAGING_PT_CPR
```

## package/PAGING/BiscuitOS-PAGING-PT-FUPT-PHYS/Kconfig
```kconfig
menuconfig PK_PAGING_PT_FUPT_PHYS
	bool "FOLLOW USERSPACE PGTABLE: Consult PHYS"

if PK_PAGING_PT_FUPT_PHYS

config PK_PAGING_PT_FUPT_PHYS_VERSION
	default "default"
	string "verstion"

config PK_PAGING_PT_FUPT_PHYS_TAR
	default "tar.gz"
	string "tar type"

config PK_PAGING_PT_FUPT_PHYS_URL
	default "https://gitee.com/BiscuitOS_team/HardStack/raw/Gitee/Memory-Allocator/PAGING-MECH/BiscuitOS-PAGING-PT-FUPT-PHYS"
	string "url"

config PK_PAGING_PT_FUPT_PHYS_GITHUB
	string "GitHub"

config PK_PAGING_PT_FUPT_PHYS_SRCFILE
	default "main.c Makefile Kconfig Makefile.app RunBiscuitOS.sh app.c"
	string "Source code list"

config PK_PAGING_PT_FUPT_PHYS_CSRCFILE
	string "Compile source code list"

config PK_PAGING_PT_FUPT_PHYS_CONFIG
	string "CONFIG: Project Configure Options"

config PK_PAGING_PT_FUPT_PHYS_LIBPATH
	string "LIBS: Libraries to pass to the linker, e.g. -l<library>"

config PK_PAGING_PT_FUPT_PHYS_CPPFLAGS
	string "CPPFLAGS: C/C++ preprocessor flags, e.g. -I<include dir>"

config PK_PAGING_PT_FUPT_PHYS_DPKCONFIG
	string "PKG_CONFIG_PATH: Directories to add to pkg-config's search path"

config PK_PAGING_PT_FUPT_PHYS_CFLAGS
	string "CFLAGS: C compiler flags"

config PK_PAGING_PT_FUPT_PHYS_LDFLAGS
	string "LDFLAGS: Linker flags"

config PK_PAGING_PT_FUPT_PHYS_CXXFLAGS
	string "CXXFLAGS: C++ compiler flags"

config PK_PAGING_PT_FUPT_PHYS_ASFLAGS
	string "CCASFLAGS: assembler compiler flags (defaults to CFLAGS)"

config PK_PAGING_PT_FUPT_PHYS_BUILDARCH
	string "--host options on configure for Architecture"

endif # PK_PAGING_PT_FUPT_PHYS
```

## package/PAGING/BiscuitOS-PAGING-PT-FUPT-PTE/Kconfig
```kconfig
menuconfig PK_PAGING_PT_FUPT_PTE
	bool "FOLLOW USERSPACE PGTABLE: Consult PTE"

if PK_PAGING_PT_FUPT_PTE

config PK_PAGING_PT_FUPT_PTE_VERSION
	default "default"
	string "verstion"

config PK_PAGING_PT_FUPT_PTE_TAR
	default "tar.gz"
	string "tar type"

config PK_PAGING_PT_FUPT_PTE_URL
	default "https://gitee.com/BiscuitOS_team/HardStack/raw/Gitee/Memory-Allocator/PAGING-MECH/BiscuitOS-PAGING-PT-FUPT-PTE"
	string "url"

config PK_PAGING_PT_FUPT_PTE_GITHUB
	string "GitHub"

config PK_PAGING_PT_FUPT_PTE_SRCFILE
	default "app.c Kconfig main.c Makefile Makefile.host RunBiscuitOS.sh"
	string "Source code list"

config PK_PAGING_PT_FUPT_PTE_CSRCFILE
	string "Compile source code list"

config PK_PAGING_PT_FUPT_PTE_CONFIG
	string "CONFIG: Project Configure Options"

config PK_PAGING_PT_FUPT_PTE_LIBPATH
	string "LIBS: Libraries to pass to the linker, e.g. -l<library>"

config PK_PAGING_PT_FUPT_PTE_CPPFLAGS
	string "CPPFLAGS: C/C++ preprocessor flags, e.g. -I<include dir>"

config PK_PAGING_PT_FUPT_PTE_DPKCONFIG
	string "PKG_CONFIG_PATH: Directories to add to pkg-config's search path"

config PK_PAGING_PT_FUPT_PTE_CFLAGS
	string "CFLAGS: C compiler flags"

config PK_PAGING_PT_FUPT_PTE_LDFLAGS
	string "LDFLAGS: Linker flags"

config PK_PAGING_PT_FUPT_PTE_CXXFLAGS
	string "CXXFLAGS: C++ compiler flags"

config PK_PAGING_PT_FUPT_PTE_ASFLAGS
	string "CCASFLAGS: assembler compiler flags (defaults to CFLAGS)"

config PK_PAGING_PT_FUPT_PTE_BUILDARCH
	string "--host options on configure for Architecture"

endif # PK_PAGING_PT_FUPT_PTE
```

## package/PAGING/BiscuitOS-PAGING-PT-K2PT-PAGE-KERNEL-EXEC/Kconfig
```kconfig
menuconfig PK_PAGING_PT_K2PT_PAGE_KERNEL_EXEC
	bool "Kernel with PageTable: PAGE_KERNEL_EXEC"

if PK_PAGING_PT_K2PT_PAGE_KERNEL_EXEC

config PK_PAGING_PT_K2PT_PAGE_KERNEL_EXEC_VERSION
	default "default"
	string "verstion"

config PK_PAGING_PT_K2PT_PAGE_KERNEL_EXEC_TAR
	default "tar.gz"
	string "tar type"

config PK_PAGING_PT_K2PT_PAGE_KERNEL_EXEC_URL
	default "https://gitee.com/BiscuitOS_team/HardStack/raw/Gitee/Memory-Allocator/PAGING-MECH/BiscuitOS-PAGING-PT-K2PT-PAGE-KERNEL-EXEC"
	string "url"

config PK_PAGING_PT_K2PT_PAGE_KERNEL_EXEC_GITHUB
	string "GitHub"

config PK_PAGING_PT_K2PT_PAGE_KERNEL_EXEC_SRCFILE
	default "main.c Makefile Kconfig"
	string "Source code list"

config PK_PAGING_PT_K2PT_PAGE_KERNEL_EXEC_CSRCFILE
	string "Compile source code list"

config PK_PAGING_PT_K2PT_PAGE_KERNEL_EXEC_CONFIG
	string "CONFIG: Project Configure Options"

config PK_PAGING_PT_K2PT_PAGE_KERNEL_EXEC_LIBPATH
	string "LIBS: Libraries to pass to the linker, e.g. -l<library>"

config PK_PAGING_PT_K2PT_PAGE_KERNEL_EXEC_CPPFLAGS
	string "CPPFLAGS: C/C++ preprocessor flags, e.g. -I<include dir>"

config PK_PAGING_PT_K2PT_PAGE_KERNEL_EXEC_DPKCONFIG
	string "PKG_CONFIG_PATH: Directories to add to pkg-config's search path"

config PK_PAGING_PT_K2PT_PAGE_KERNEL_EXEC_CFLAGS
	string "CFLAGS: C compiler flags"

config PK_PAGING_PT_K2PT_PAGE_KERNEL_EXEC_LDFLAGS
	string "LDFLAGS: Linker flags"

config PK_PAGING_PT_K2PT_PAGE_KERNEL_EXEC_CXXFLAGS
	string "CXXFLAGS: C++ compiler flags"

config PK_PAGING_PT_K2PT_PAGE_KERNEL_EXEC_ASFLAGS
	string "CCASFLAGS: assembler compiler flags (defaults to CFLAGS)"

config PK_PAGING_PT_K2PT_PAGE_KERNEL_EXEC_BUILDARCH
	string "--host options on configure for Architecture"

endif # PK_PAGING_PT_K2PT_PAGE_KERNEL_EXEC
```

## package/PAGING/BiscuitOS-PAGING-PT-K2PT-PAGE-KERNEL-IO-NOCACHE/Kconfig
```kconfig
menuconfig PK_PAGING_PT_K2PT_PAGE_KERNEL_IO_UC
	bool "Kernel with PageTable: PAGE_KERNEL_IO_NOCACHE"

if PK_PAGING_PT_K2PT_PAGE_KERNEL_IO_UC

config PK_PAGING_PT_K2PT_PAGE_KERNEL_IO_UC_VERSION
	default "default"
	string "verstion"

config PK_PAGING_PT_K2PT_PAGE_KERNEL_IO_UC_TAR
	default "tar.gz"
	string "tar type"

config PK_PAGING_PT_K2PT_PAGE_KERNEL_IO_UC_URL
	default "https://gitee.com/BiscuitOS_team/HardStack/raw/Gitee/Memory-Allocator/PAGING-MECH/BiscuitOS-PAGING-PT-K2PT-PAGE-KERNEL-IO-NOCACHE"
	string "url"

config PK_PAGING_PT_K2PT_PAGE_KERNEL_IO_UC_GITHUB
	string "GitHub"

config PK_PAGING_PT_K2PT_PAGE_KERNEL_IO_UC_SRCFILE
	default "main.c Makefile RunBiscuitOS.sh Kconfig Makefile.host"
	string "Source code list"

config PK_PAGING_PT_K2PT_PAGE_KERNEL_IO_UC_CSRCFILE
	string "Compile source code list"

config PK_PAGING_PT_K2PT_PAGE_KERNEL_IO_UC_CONFIG
	string "CONFIG: Project Configure Options"

config PK_PAGING_PT_K2PT_PAGE_KERNEL_IO_UC_LIBPATH
	string "LIBS: Libraries to pass to the linker, e.g. -l<library>"

config PK_PAGING_PT_K2PT_PAGE_KERNEL_IO_UC_CPPFLAGS
	string "CPPFLAGS: C/C++ preprocessor flags, e.g. -I<include dir>"

config PK_PAGING_PT_K2PT_PAGE_KERNEL_IO_UC_DPKCONFIG
	string "PKG_CONFIG_PATH: Directories to add to pkg-config's search path"

config PK_PAGING_PT_K2PT_PAGE_KERNEL_IO_UC_CFLAGS
	string "CFLAGS: C compiler flags"

config PK_PAGING_PT_K2PT_PAGE_KERNEL_IO_UC_LDFLAGS
	string "LDFLAGS: Linker flags"

config PK_PAGING_PT_K2PT_PAGE_KERNEL_IO_UC_CXXFLAGS
	string "CXXFLAGS: C++ compiler flags"

config PK_PAGING_PT_K2PT_PAGE_KERNEL_IO_UC_ASFLAGS
	string "CCASFLAGS: assembler compiler flags (defaults to CFLAGS)"

config PK_PAGING_PT_K2PT_PAGE_KERNEL_IO_UC_BUILDARCH
	string "--host options on configure for Architecture"

endif # PK_PAGING_PT_K2PT_PAGE_KERNEL_IO_UC
```

## package/PAGING/BiscuitOS-PAGING-PT-K2PT-PAGE-KERNEL-IO/Kconfig
```kconfig
menuconfig PK_PAGING_PT_K2PT_PAGE_KERNEL_IO
	bool "Kernel with PageTable: PAGE_KERNEL_IO"

if PK_PAGING_PT_K2PT_PAGE_KERNEL_IO

config PK_PAGING_PT_K2PT_PAGE_KERNEL_IO_VERSION
	default "default"
	string "verstion"

config PK_PAGING_PT_K2PT_PAGE_KERNEL_IO_TAR
	default "tar.gz"
	string "tar type"

config PK_PAGING_PT_K2PT_PAGE_KERNEL_IO_URL
	default "https://gitee.com/BiscuitOS_team/HardStack/raw/Gitee/Memory-Allocator/PAGING-MECH/BiscuitOS-PAGING-PT-K2PT-PAGE-KERNEL-IO"
	string "url"

config PK_PAGING_PT_K2PT_PAGE_KERNEL_IO_GITHUB
	string "GitHub"

config PK_PAGING_PT_K2PT_PAGE_KERNEL_IO_SRCFILE
	default "main.c Makefile RunBiscuitOS.sh Kconfig Makefile.host"
	string "Source code list"

config PK_PAGING_PT_K2PT_PAGE_KERNEL_IO_CSRCFILE
	string "Compile source code list"

config PK_PAGING_PT_K2PT_PAGE_KERNEL_IO_CONFIG
	string "CONFIG: Project Configure Options"

config PK_PAGING_PT_K2PT_PAGE_KERNEL_IO_LIBPATH
	string "LIBS: Libraries to pass to the linker, e.g. -l<library>"

config PK_PAGING_PT_K2PT_PAGE_KERNEL_IO_CPPFLAGS
	string "CPPFLAGS: C/C++ preprocessor flags, e.g. -I<include dir>"

config PK_PAGING_PT_K2PT_PAGE_KERNEL_IO_DPKCONFIG
	string "PKG_CONFIG_PATH: Directories to add to pkg-config's search path"

config PK_PAGING_PT_K2PT_PAGE_KERNEL_IO_CFLAGS
	string "CFLAGS: C compiler flags"

config PK_PAGING_PT_K2PT_PAGE_KERNEL_IO_LDFLAGS
	string "LDFLAGS: Linker flags"

config PK_PAGING_PT_K2PT_PAGE_KERNEL_IO_CXXFLAGS
	string "CXXFLAGS: C++ compiler flags"

config PK_PAGING_PT_K2PT_PAGE_KERNEL_IO_ASFLAGS
	string "CCASFLAGS: assembler compiler flags (defaults to CFLAGS)"

config PK_PAGING_PT_K2PT_PAGE_KERNEL_IO_BUILDARCH
	string "--host options on configure for Architecture"

endif # PK_PAGING_PT_K2PT_PAGE_KERNEL_IO
```

## package/PAGING/BiscuitOS-PAGING-PT-K2PT-PAGE-KERNEL-NOCACHE/Kconfig
```kconfig
menuconfig PK_PAGING_PT_K2PT_PAGE_KERNEL_NOCACHE
	bool "Kernel with PageTable: PAGE_KERNEL_NOCACHE"

if PK_PAGING_PT_K2PT_PAGE_KERNEL_NOCACHE

config PK_PAGING_PT_K2PT_PAGE_KERNEL_NOCACHE_VERSION
	default "default"
	string "verstion"

config PK_PAGING_PT_K2PT_PAGE_KERNEL_NOCACHE_TAR
	default "tar.gz"
	string "tar type"

config PK_PAGING_PT_K2PT_PAGE_KERNEL_NOCACHE_URL
	default "https://gitee.com/BiscuitOS_team/HardStack/raw/Gitee/Memory-Allocator/PAGING-MECH/BiscuitOS-PAGING-PT-K2PT-PAGE-KERNEL-NOCACHE"
	string "url"

config PK_PAGING_PT_K2PT_PAGE_KERNEL_NOCACHE_GITHUB
	string "GitHub"

config PK_PAGING_PT_K2PT_PAGE_KERNEL_NOCACHE_SRCFILE
	default "main.c Makefile RunBiscuitOS.sh Kconfig Makefile.host"
	string "Source code list"

config PK_PAGING_PT_K2PT_PAGE_KERNEL_NOCACHE_CSRCFILE
	string "Compile source code list"

config PK_PAGING_PT_K2PT_PAGE_KERNEL_NOCACHE_CONFIG
	string "CONFIG: Project Configure Options"

config PK_PAGING_PT_K2PT_PAGE_KERNEL_NOCACHE_LIBPATH
	string "LIBS: Libraries to pass to the linker, e.g. -l<library>"

config PK_PAGING_PT_K2PT_PAGE_KERNEL_NOCACHE_CPPFLAGS
	string "CPPFLAGS: C/C++ preprocessor flags, e.g. -I<include dir>"

config PK_PAGING_PT_K2PT_PAGE_KERNEL_NOCACHE_DPKCONFIG
	string "PKG_CONFIG_PATH: Directories to add to pkg-config's search path"

config PK_PAGING_PT_K2PT_PAGE_KERNEL_NOCACHE_CFLAGS
	string "CFLAGS: C compiler flags"

config PK_PAGING_PT_K2PT_PAGE_KERNEL_NOCACHE_LDFLAGS
	string "LDFLAGS: Linker flags"

config PK_PAGING_PT_K2PT_PAGE_KERNEL_NOCACHE_CXXFLAGS
	string "CXXFLAGS: C++ compiler flags"

config PK_PAGING_PT_K2PT_PAGE_KERNEL_NOCACHE_ASFLAGS
	string "CCASFLAGS: assembler compiler flags (defaults to CFLAGS)"

config PK_PAGING_PT_K2PT_PAGE_KERNEL_NOCACHE_BUILDARCH
	string "--host options on configure for Architecture"

endif # PK_PAGING_PT_K2PT_PAGE_KERNEL_NOCACHE
```

## package/PAGING/BiscuitOS-PAGING-PT-K2PT-PAGE-KERNEL-NOENC/Kconfig
```kconfig
menuconfig PK_PAGING_PT_K2PT_PAGE_KERNEL_NOENC
	bool "Kernel with PageTable: PAGE_KERNEL_NOENC"

if PK_PAGING_PT_K2PT_PAGE_KERNEL_NOENC

config PK_PAGING_PT_K2PT_PAGE_KERNEL_NOENC_VERSION
	default "default"
	string "verstion"

config PK_PAGING_PT_K2PT_PAGE_KERNEL_NOENC_TAR
	default "tar.gz"
	string "tar type"

config PK_PAGING_PT_K2PT_PAGE_KERNEL_NOENC_URL
	default "https://gitee.com/BiscuitOS_team/HardStack/raw/Gitee/Memory-Allocator/PAGING-MECH/BiscuitOS-PAGING-PT-K2PT-PAGE-KERNEL-NOENC"
	string "url"

config PK_PAGING_PT_K2PT_PAGE_KERNEL_NOENC_GITHUB
	string "GitHub"

config PK_PAGING_PT_K2PT_PAGE_KERNEL_NOENC_SRCFILE
	default "main.c Makefile RunBiscuitOS.sh Kconfig Makefile.host"
	string "Source code list"

config PK_PAGING_PT_K2PT_PAGE_KERNEL_NOENC_CSRCFILE
	string "Compile source code list"

config PK_PAGING_PT_K2PT_PAGE_KERNEL_NOENC_CONFIG
	string "CONFIG: Project Configure Options"

config PK_PAGING_PT_K2PT_PAGE_KERNEL_NOENC_LIBPATH
	string "LIBS: Libraries to pass to the linker, e.g. -l<library>"

config PK_PAGING_PT_K2PT_PAGE_KERNEL_NOENC_CPPFLAGS
	string "CPPFLAGS: C/C++ preprocessor flags, e.g. -I<include dir>"

config PK_PAGING_PT_K2PT_PAGE_KERNEL_NOENC_DPKCONFIG
	string "PKG_CONFIG_PATH: Directories to add to pkg-config's search path"

config PK_PAGING_PT_K2PT_PAGE_KERNEL_NOENC_CFLAGS
	string "CFLAGS: C compiler flags"

config PK_PAGING_PT_K2PT_PAGE_KERNEL_NOENC_LDFLAGS
	string "LDFLAGS: Linker flags"

config PK_PAGING_PT_K2PT_PAGE_KERNEL_NOENC_CXXFLAGS
	string "CXXFLAGS: C++ compiler flags"

config PK_PAGING_PT_K2PT_PAGE_KERNEL_NOENC_ASFLAGS
	string "CCASFLAGS: assembler compiler flags (defaults to CFLAGS)"

config PK_PAGING_PT_K2PT_PAGE_KERNEL_NOENC_BUILDARCH
	string "--host options on configure for Architecture"

endif # PK_PAGING_PT_K2PT_PAGE_KERNEL_NOENC
```

## package/PAGING/BiscuitOS-PAGING-PT-K2PT-PAGE-KERNEL-RO/Kconfig
```kconfig
menuconfig PK_PAGING_PT_K2PT_PAGE_KERNEL_RO
	bool "Kernel with PageTable: PAGE_KERNEL_RO"

if PK_PAGING_PT_K2PT_PAGE_KERNEL_RO

config PK_PAGING_PT_K2PT_PAGE_KERNEL_RO_VERSION
	default "default"
	string "verstion"

config PK_PAGING_PT_K2PT_PAGE_KERNEL_RO_TAR
	default "tar.gz"
	string "tar type"

config PK_PAGING_PT_K2PT_PAGE_KERNEL_RO_URL
	default "https://gitee.com/BiscuitOS_team/HardStack/raw/Gitee/Memory-Allocator/PAGING-MECH/BiscuitOS-PAGING-PT-K2PT-PAGE-KERNEL-RO"
	string "url"

config PK_PAGING_PT_K2PT_PAGE_KERNEL_RO_GITHUB
	string "GitHub"

config PK_PAGING_PT_K2PT_PAGE_KERNEL_RO_SRCFILE
	default "main.c Makefile RunBiscuitOS.sh Kconfig Makefile.host"
	string "Source code list"

config PK_PAGING_PT_K2PT_PAGE_KERNEL_RO_CSRCFILE
	string "Compile source code list"

config PK_PAGING_PT_K2PT_PAGE_KERNEL_RO_CONFIG
	string "CONFIG: Project Configure Options"

config PK_PAGING_PT_K2PT_PAGE_KERNEL_RO_LIBPATH
	string "LIBS: Libraries to pass to the linker, e.g. -l<library>"

config PK_PAGING_PT_K2PT_PAGE_KERNEL_RO_CPPFLAGS
	string "CPPFLAGS: C/C++ preprocessor flags, e.g. -I<include dir>"

config PK_PAGING_PT_K2PT_PAGE_KERNEL_RO_DPKCONFIG
	string "PKG_CONFIG_PATH: Directories to add to pkg-config's search path"

config PK_PAGING_PT_K2PT_PAGE_KERNEL_RO_CFLAGS
	string "CFLAGS: C compiler flags"

config PK_PAGING_PT_K2PT_PAGE_KERNEL_RO_LDFLAGS
	string "LDFLAGS: Linker flags"

config PK_PAGING_PT_K2PT_PAGE_KERNEL_RO_CXXFLAGS
	string "CXXFLAGS: C++ compiler flags"

config PK_PAGING_PT_K2PT_PAGE_KERNEL_RO_ASFLAGS
	string "CCASFLAGS: assembler compiler flags (defaults to CFLAGS)"

config PK_PAGING_PT_K2PT_PAGE_KERNEL_RO_BUILDARCH
	string "--host options on configure for Architecture"

endif # PK_PAGING_PT_K2PT_PAGE_KERNEL_RO
```
