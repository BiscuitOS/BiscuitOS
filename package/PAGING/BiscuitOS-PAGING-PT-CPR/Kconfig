## package/PAGING/BiscuitOS-PAGING-PT-K2PT-PAGE-KERNEL-ROX/Kconfig
```kconfig
menuconfig PK_PAGING_PT_K2PT_PAGE_KERNEL_ROX
	bool "Kernel with PageTable: PAGE_KERNEL_ROX"

if PK_PAGING_PT_K2PT_PAGE_KERNEL_ROX

config PK_PAGING_PT_K2PT_PAGE_KERNEL_ROX_VERSION
	default "default"
	string "verstion"

config PK_PAGING_PT_K2PT_PAGE_KERNEL_ROX_TAR
	default "tar.gz"
	string "tar type"

config PK_PAGING_PT_K2PT_PAGE_KERNEL_ROX_URL
	default "https://gitee.com/BiscuitOS_team/HardStack/raw/Gitee/Memory-Allocator/PAGING-MECH/BiscuitOS-PAGING-PT-K2PT-PAGE-KERNEL-ROX"
	string "url"

config PK_PAGING_PT_K2PT_PAGE_KERNEL_ROX_GITHUB
	string "GitHub"

config PK_PAGING_PT_K2PT_PAGE_KERNEL_ROX_SRCFILE
	default "main.c Makefile Kconfig"
	string "Source code list"

config PK_PAGING_PT_K2PT_PAGE_KERNEL_ROX_CSRCFILE
	string "Compile source code list"

config PK_PAGING_PT_K2PT_PAGE_KERNEL_ROX_CONFIG
	string "CONFIG: Project Configure Options"

config PK_PAGING_PT_K2PT_PAGE_KERNEL_ROX_LIBPATH
	string "LIBS: Libraries to pass to the linker, e.g. -l<library>"

config PK_PAGING_PT_K2PT_PAGE_KERNEL_ROX_CPPFLAGS
	string "CPPFLAGS: C/C++ preprocessor flags, e.g. -I<include dir>"

config PK_PAGING_PT_K2PT_PAGE_KERNEL_ROX_DPKCONFIG
	string "PKG_CONFIG_PATH: Directories to add to pkg-config's search path"

config PK_PAGING_PT_K2PT_PAGE_KERNEL_ROX_CFLAGS
	string "CFLAGS: C compiler flags"

config PK_PAGING_PT_K2PT_PAGE_KERNEL_ROX_LDFLAGS
	string "LDFLAGS: Linker flags"

config PK_PAGING_PT_K2PT_PAGE_KERNEL_ROX_CXXFLAGS
	string "CXXFLAGS: C++ compiler flags"

config PK_PAGING_PT_K2PT_PAGE_KERNEL_ROX_ASFLAGS
	string "CCASFLAGS: assembler compiler flags (defaults to CFLAGS)"

config PK_PAGING_PT_K2PT_PAGE_KERNEL_ROX_BUILDARCH
	string "--host options on configure for Architecture"

endif # PK_PAGING_PT_K2PT_PAGE_KERNEL_ROX
```

## package/PAGING/BiscuitOS-PAGING-PT-K2PT-PAGE-KERNEL-VVAR/Kconfig
```kconfig
menuconfig PK_PAGING_PT_K2PT_PAGE_KERNEL_VVAR
	bool "Kernel with PageTable: PAGE_KERNEL_VVAR"

if PK_PAGING_PT_K2PT_PAGE_KERNEL_VVAR

config PK_PAGING_PT_K2PT_PAGE_KERNEL_VVAR_VERSION
	default "default"
	string "verstion"

config PK_PAGING_PT_K2PT_PAGE_KERNEL_VVAR_TAR
	default "tar.gz"
	string "tar type"

config PK_PAGING_PT_K2PT_PAGE_KERNEL_VVAR_URL
	default "https://gitee.com/BiscuitOS_team/HardStack/raw/Gitee/Memory-Allocator/PAGING-MECH/BiscuitOS-PAGING-PT-K2PT-PAGE-KERNEL-VVAR"
	string "url"

config PK_PAGING_PT_K2PT_PAGE_KERNEL_VVAR_GITHUB
	string "GitHub"

config PK_PAGING_PT_K2PT_PAGE_KERNEL_VVAR_SRCFILE
	default "main.c Makefile RunBiscuitOS.sh Kconfig Makefile.host"
	string "Source code list"

config PK_PAGING_PT_K2PT_PAGE_KERNEL_VVAR_CSRCFILE
	string "Compile source code list"

config PK_PAGING_PT_K2PT_PAGE_KERNEL_VVAR_CONFIG
	string "CONFIG: Project Configure Options"

config PK_PAGING_PT_K2PT_PAGE_KERNEL_VVAR_LIBPATH
	string "LIBS: Libraries to pass to the linker, e.g. -l<library>"

config PK_PAGING_PT_K2PT_PAGE_KERNEL_VVAR_CPPFLAGS
	string "CPPFLAGS: C/C++ preprocessor flags, e.g. -I<include dir>"

config PK_PAGING_PT_K2PT_PAGE_KERNEL_VVAR_DPKCONFIG
	string "PKG_CONFIG_PATH: Directories to add to pkg-config's search path"

config PK_PAGING_PT_K2PT_PAGE_KERNEL_VVAR_CFLAGS
	string "CFLAGS: C compiler flags"

config PK_PAGING_PT_K2PT_PAGE_KERNEL_VVAR_LDFLAGS
	string "LDFLAGS: Linker flags"

config PK_PAGING_PT_K2PT_PAGE_KERNEL_VVAR_CXXFLAGS
	string "CXXFLAGS: C++ compiler flags"

config PK_PAGING_PT_K2PT_PAGE_KERNEL_VVAR_ASFLAGS
	string "CCASFLAGS: assembler compiler flags (defaults to CFLAGS)"

config PK_PAGING_PT_K2PT_PAGE_KERNEL_VVAR_BUILDARCH
	string "--host options on configure for Architecture"

endif # PK_PAGING_PT_K2PT_PAGE_KERNEL_VVAR
```

## package/PAGING/BiscuitOS-PAGING-PT-PAGE-ACCESSED-FILE/Kconfig
```kconfig
menuconfig PK_PAGING_PT_PAGE_ACCESSED_FILE
	bool "PAGE_ACCESSED: CLEAR on FILE"

if PK_PAGING_PT_PAGE_ACCESSED_FILE

config PK_PAGING_PT_PAGE_ACCESSED_FILE_VERSION
	default "default"
	string "verstion"

config PK_PAGING_PT_PAGE_ACCESSED_FILE_TAR
	default "tar.gz"
	string "tar type"

config PK_PAGING_PT_PAGE_ACCESSED_FILE_URL
	default "https://gitee.com/BiscuitOS_team/HardStack/raw/Gitee/Memory-Allocator/PAGING-MECH/BiscuitOS-PAGING-PT-PAGE-ACCESSED-FILE"
	string "url"

config PK_PAGING_PT_PAGE_ACCESSED_FILE_GITHUB
	string "GitHub"

config PK_PAGING_PT_PAGE_ACCESSED_FILE_SRCFILE
	default "main.c Makefile RunBiscuitOS.sh"
	string "Source code list"

config PK_PAGING_PT_PAGE_ACCESSED_FILE_CSRCFILE
	string "Compile source code list"

config PK_PAGING_PT_PAGE_ACCESSED_FILE_CONFIG
	string "CONFIG: Project Configure Options"

config PK_PAGING_PT_PAGE_ACCESSED_FILE_LIBPATH
	string "LIBS: Libraries to pass to the linker, e.g. -l<library>"

config PK_PAGING_PT_PAGE_ACCESSED_FILE_CPPFLAGS
	string "CPPFLAGS: C/C++ preprocessor flags, e.g. -I<include dir>"

config PK_PAGING_PT_PAGE_ACCESSED_FILE_DPKCONFIG
	string "PKG_CONFIG_PATH: Directories to add to pkg-config's search path"

config PK_PAGING_PT_PAGE_ACCESSED_FILE_CFLAGS
	string "CFLAGS: C compiler flags"

config PK_PAGING_PT_PAGE_ACCESSED_FILE_LDFLAGS
	string "LDFLAGS: Linker flags"

config PK_PAGING_PT_PAGE_ACCESSED_FILE_CXXFLAGS
	string "CXXFLAGS: C++ compiler flags"

config PK_PAGING_PT_PAGE_ACCESSED_FILE_ASFLAGS
	string "CCASFLAGS: assembler compiler flags (defaults to CFLAGS)"

config PK_PAGING_PT_PAGE_ACCESSED_FILE_BUILDARCH
	string "--host options on configure for Architecture"

endif # PK_PAGING_PT_PAGE_ACCESSED_FILE
```

## package/PAGING/BiscuitOS-PAGING-PT-PAGE-PRESENT-EMPTY/Kconfig
```kconfig
menuconfig PK_PAGING_PT_PAGE_PRESENT_EMPTY
	bool "PAGE_PRESENT: Empty Entry"

if PK_PAGING_PT_PAGE_PRESENT_EMPTY

config PK_PAGING_PT_PAGE_PRESENT_EMPTY_VERSION
	default "default"
	string "verstion"

config PK_PAGING_PT_PAGE_PRESENT_EMPTY_TAR
	default "tar.gz"
	string "tar type"

config PK_PAGING_PT_PAGE_PRESENT_EMPTY_URL
	default "https://gitee.com/BiscuitOS_team/HardStack/raw/Gitee/Memory-Allocator/PAGING-MECH/BiscuitOS-PAGING-PT-PAGE-PRESENT-EMPTY"
	string "url"

config PK_PAGING_PT_PAGE_PRESENT_EMPTY_GITHUB
	string "GitHub"

config PK_PAGING_PT_PAGE_PRESENT_EMPTY_SRCFILE
	default "main.c Makefile RunBiscuitOS.sh"
	string "Source code list"

config PK_PAGING_PT_PAGE_PRESENT_EMPTY_CSRCFILE
	string "Compile source code list"

config PK_PAGING_PT_PAGE_PRESENT_EMPTY_CONFIG
	string "CONFIG: Project Configure Options"

config PK_PAGING_PT_PAGE_PRESENT_EMPTY_LIBPATH
	string "LIBS: Libraries to pass to the linker, e.g. -l<library>"

config PK_PAGING_PT_PAGE_PRESENT_EMPTY_CPPFLAGS
	string "CPPFLAGS: C/C++ preprocessor flags, e.g. -I<include dir>"

config PK_PAGING_PT_PAGE_PRESENT_EMPTY_DPKCONFIG
	string "PKG_CONFIG_PATH: Directories to add to pkg-config's search path"

config PK_PAGING_PT_PAGE_PRESENT_EMPTY_CFLAGS
	string "CFLAGS: C compiler flags"

config PK_PAGING_PT_PAGE_PRESENT_EMPTY_LDFLAGS
	string "LDFLAGS: Linker flags"

config PK_PAGING_PT_PAGE_PRESENT_EMPTY_CXXFLAGS
	string "CXXFLAGS: C++ compiler flags"

config PK_PAGING_PT_PAGE_PRESENT_EMPTY_ASFLAGS
	string "CCASFLAGS: assembler compiler flags (defaults to CFLAGS)"

config PK_PAGING_PT_PAGE_PRESENT_EMPTY_BUILDARCH
	string "--host options on configure for Architecture"

endif # PK_PAGING_PT_PAGE_PRESENT_EMPTY
```

## package/PAGING/BiscuitOS-PAGING-PT-PAGE-PRESENT-PROTNONE/Kconfig
```kconfig
menuconfig PK_PAGING_PT_PAGE_PRESENT_PROTNONE
	bool "PAGE_PRESENT: PROTNONE"

if PK_PAGING_PT_PAGE_PRESENT_PROTNONE

config PK_PAGING_PT_PAGE_PRESENT_PROTNONE_VERSION
	default "default"
	string "verstion"

config PK_PAGING_PT_PAGE_PRESENT_PROTNONE_TAR
	default "tar.gz"
	string "tar type"

config PK_PAGING_PT_PAGE_PRESENT_PROTNONE_URL
	default "https://gitee.com/BiscuitOS_team/HardStack/raw/Gitee/Memory-Allocator/PAGING-MECH/BiscuitOS-PAGING-PT-PAGE-PRESENT-PROTNONE"
	string "url"

config PK_PAGING_PT_PAGE_PRESENT_PROTNONE_GITHUB
	string "GitHub"

config PK_PAGING_PT_PAGE_PRESENT_PROTNONE_SRCFILE
	default "main.c Makefile RunBiscuitOS.sh"
	string "Source code list"

config PK_PAGING_PT_PAGE_PRESENT_PROTNONE_CSRCFILE
	string "Compile source code list"

config PK_PAGING_PT_PAGE_PRESENT_PROTNONE_CONFIG
	string "CONFIG: Project Configure Options"

config PK_PAGING_PT_PAGE_PRESENT_PROTNONE_LIBPATH
	string "LIBS: Libraries to pass to the linker, e.g. -l<library>"

config PK_PAGING_PT_PAGE_PRESENT_PROTNONE_CPPFLAGS
	string "CPPFLAGS: C/C++ preprocessor flags, e.g. -I<include dir>"

config PK_PAGING_PT_PAGE_PRESENT_PROTNONE_DPKCONFIG
	string "PKG_CONFIG_PATH: Directories to add to pkg-config's search path"

config PK_PAGING_PT_PAGE_PRESENT_PROTNONE_CFLAGS
	string "CFLAGS: C compiler flags"

config PK_PAGING_PT_PAGE_PRESENT_PROTNONE_LDFLAGS
	string "LDFLAGS: Linker flags"

config PK_PAGING_PT_PAGE_PRESENT_PROTNONE_CXXFLAGS
	string "CXXFLAGS: C++ compiler flags"

config PK_PAGING_PT_PAGE_PRESENT_PROTNONE_ASFLAGS
	string "CCASFLAGS: assembler compiler flags (defaults to CFLAGS)"

config PK_PAGING_PT_PAGE_PRESENT_PROTNONE_BUILDARCH
	string "--host options on configure for Architecture"

endif # PK_PAGING_PT_PAGE_PRESENT_PROTNONE
```

## package/PAGING/BiscuitOS-PAGING-PT-PAGE-PRESENT-UE/Kconfig
```kconfig
menuconfig PK_PAGING_PT_PAGE_PRESENT_UE
	bool "PAGE_PRESENT: UE Entry"

if PK_PAGING_PT_PAGE_PRESENT_UE

config PK_PAGING_PT_PAGE_PRESENT_UE_VERSION
	default "default"
	string "verstion"

config PK_PAGING_PT_PAGE_PRESENT_UE_TAR
	default "tar.gz"
	string "tar type"

config PK_PAGING_PT_PAGE_PRESENT_UE_URL
	default "https://gitee.com/BiscuitOS_team/HardStack/raw/Gitee/Memory-Allocator/PAGING-MECH/BiscuitOS-PAGING-PT-PAGE-PRESENT-UE"
	string "url"

config PK_PAGING_PT_PAGE_PRESENT_UE_GITHUB
	string "GitHub"

config PK_PAGING_PT_PAGE_PRESENT_UE_SRCFILE
	default "main.c Makefile RunBiscuitOS.sh"
	string "Source code list"

config PK_PAGING_PT_PAGE_PRESENT_UE_CSRCFILE
	string "Compile source code list"

config PK_PAGING_PT_PAGE_PRESENT_UE_CONFIG
	string "CONFIG: Project Configure Options"

config PK_PAGING_PT_PAGE_PRESENT_UE_LIBPATH
	string "LIBS: Libraries to pass to the linker, e.g. -l<library>"

config PK_PAGING_PT_PAGE_PRESENT_UE_CPPFLAGS
	string "CPPFLAGS: C/C++ preprocessor flags, e.g. -I<include dir>"

config PK_PAGING_PT_PAGE_PRESENT_UE_DPKCONFIG
	string "PKG_CONFIG_PATH: Directories to add to pkg-config's search path"

config PK_PAGING_PT_PAGE_PRESENT_UE_CFLAGS
	string "CFLAGS: C compiler flags"

config PK_PAGING_PT_PAGE_PRESENT_UE_LDFLAGS
	string "LDFLAGS: Linker flags"

config PK_PAGING_PT_PAGE_PRESENT_UE_CXXFLAGS
	string "CXXFLAGS: C++ compiler flags"

config PK_PAGING_PT_PAGE_PRESENT_UE_ASFLAGS
	string "CCASFLAGS: assembler compiler flags (defaults to CFLAGS)"

config PK_PAGING_PT_PAGE_PRESENT_UE_BUILDARCH
	string "--host options on configure for Architecture"

endif # PK_PAGING_PT_PAGE_PRESENT_UE
```

## package/PAGING/BiscuitOS-PAGING-PT-PAGE-RW-PROTNONE/Kconfig
```kconfig
menuconfig PK_PAGING_PT_PAGE_RW_PROTNONE
	bool "PAGE_RW: PROTNONE"

if PK_PAGING_PT_PAGE_RW_PROTNONE

config PK_PAGING_PT_PAGE_RW_PROTNONE_VERSION
	default "default"
	string "verstion"

config PK_PAGING_PT_PAGE_RW_PROTNONE_TAR
	default "tar.gz"
	string "tar type"

config PK_PAGING_PT_PAGE_RW_PROTNONE_URL
	default "https://gitee.com/BiscuitOS_team/HardStack/raw/Gitee/Memory-Allocator/PAGING-MECH/BiscuitOS-PAGING-PT-PAGE-RW-PROTNONE"
	string "url"

config PK_PAGING_PT_PAGE_RW_PROTNONE_GITHUB
	string "GitHub"

config PK_PAGING_PT_PAGE_RW_PROTNONE_SRCFILE
	default "main.c Makefile RunBiscuitOS.sh"
	string "Source code list"

config PK_PAGING_PT_PAGE_RW_PROTNONE_CSRCFILE
	string "Compile source code list"

config PK_PAGING_PT_PAGE_RW_PROTNONE_CONFIG
	string "CONFIG: Project Configure Options"

config PK_PAGING_PT_PAGE_RW_PROTNONE_LIBPATH
	string "LIBS: Libraries to pass to the linker, e.g. -l<library>"

config PK_PAGING_PT_PAGE_RW_PROTNONE_CPPFLAGS
	string "CPPFLAGS: C/C++ preprocessor flags, e.g. -I<include dir>"

config PK_PAGING_PT_PAGE_RW_PROTNONE_DPKCONFIG
	string "PKG_CONFIG_PATH: Directories to add to pkg-config's search path"

config PK_PAGING_PT_PAGE_RW_PROTNONE_CFLAGS
	string "CFLAGS: C compiler flags"

config PK_PAGING_PT_PAGE_RW_PROTNONE_LDFLAGS
	string "LDFLAGS: Linker flags"

config PK_PAGING_PT_PAGE_RW_PROTNONE_CXXFLAGS
	string "CXXFLAGS: C++ compiler flags"

config PK_PAGING_PT_PAGE_RW_PROTNONE_ASFLAGS
	string "CCASFLAGS: assembler compiler flags (defaults to CFLAGS)"

config PK_PAGING_PT_PAGE_RW_PROTNONE_BUILDARCH
	string "--host options on configure for Architecture"

endif # PK_PAGING_PT_PAGE_RW_PROTNONE
```

## package/PAGING/BiscuitOS-PAGING-PT-PAGE-RW-ZERO/Kconfig
```kconfig
menuconfig PK_PAGING_PT_PAGE_RW_ZERO
	bool "PAGE_RW: ZERO PAGE"

if PK_PAGING_PT_PAGE_RW_ZERO

config PK_PAGING_PT_PAGE_RW_ZERO_VERSION
	default "default"
	string "verstion"

config PK_PAGING_PT_PAGE_RW_ZERO_TAR
	default "tar.gz"
	string "tar type"

config PK_PAGING_PT_PAGE_RW_ZERO_URL
	default "https://gitee.com/BiscuitOS_team/HardStack/raw/Gitee/Memory-Allocator/PAGING-MECH/BiscuitOS-PAGING-PT-PAGE-RW-ZERO"
	string "url"

config PK_PAGING_PT_PAGE_RW_ZERO_GITHUB
	string "GitHub"

config PK_PAGING_PT_PAGE_RW_ZERO_SRCFILE
	default "main.c Makefile RunBiscuitOS.sh"
	string "Source code list"

config PK_PAGING_PT_PAGE_RW_ZERO_CSRCFILE
	string "Compile source code list"

config PK_PAGING_PT_PAGE_RW_ZERO_CONFIG
	string "CONFIG: Project Configure Options"

config PK_PAGING_PT_PAGE_RW_ZERO_LIBPATH
	string "LIBS: Libraries to pass to the linker, e.g. -l<library>"

config PK_PAGING_PT_PAGE_RW_ZERO_CPPFLAGS
	string "CPPFLAGS: C/C++ preprocessor flags, e.g. -I<include dir>"

config PK_PAGING_PT_PAGE_RW_ZERO_DPKCONFIG
	string "PKG_CONFIG_PATH: Directories to add to pkg-config's search path"

config PK_PAGING_PT_PAGE_RW_ZERO_CFLAGS
	string "CFLAGS: C compiler flags"

config PK_PAGING_PT_PAGE_RW_ZERO_LDFLAGS
	string "LDFLAGS: Linker flags"

config PK_PAGING_PT_PAGE_RW_ZERO_CXXFLAGS
	string "CXXFLAGS: C++ compiler flags"

config PK_PAGING_PT_PAGE_RW_ZERO_ASFLAGS
	string "CCASFLAGS: assembler compiler flags (defaults to CFLAGS)"

config PK_PAGING_PT_PAGE_RW_ZERO_BUILDARCH
	string "--host options on configure for Architecture"

endif # PK_PAGING_PT_PAGE_RW_ZERO
```

## package/PAGING/BiscuitOS-PAGING-PT-U2PT-PAGE-PRESENT/Kconfig
```kconfig
menuconfig PK_PAGING_PT_U2PT_PAGE_PRESENT
	bool "User with PageTable: SET _PAGE_PRESENT"

if PK_PAGING_PT_U2PT_PAGE_PRESENT

config PK_PAGING_PT_U2PT_PAGE_PRESENT_VERSION
	default "default"
	string "verstion"

config PK_PAGING_PT_U2PT_PAGE_PRESENT_TAR
	default "tar.gz"
	string "tar type"

config PK_PAGING_PT_U2PT_PAGE_PRESENT_URL
	default "https://gitee.com/BiscuitOS_team/HardStack/raw/Gitee/Memory-Allocator/PAGING-MECH/BiscuitOS-PAGING-PT-U2PT-PAGE-PRESENT"
	string "url"

config PK_PAGING_PT_U2PT_PAGE_PRESENT_GITHUB
	string "GitHub"

config PK_PAGING_PT_U2PT_PAGE_PRESENT_SRCFILE
	default "main.c Makefile RunBiscuitOS.sh"
	string "Source code list"

config PK_PAGING_PT_U2PT_PAGE_PRESENT_CSRCFILE
	string "Compile source code list"

config PK_PAGING_PT_U2PT_PAGE_PRESENT_CONFIG
	string "CONFIG: Project Configure Options"

config PK_PAGING_PT_U2PT_PAGE_PRESENT_LIBPATH
	string "LIBS: Libraries to pass to the linker, e.g. -l<library>"

config PK_PAGING_PT_U2PT_PAGE_PRESENT_CPPFLAGS
	string "CPPFLAGS: C/C++ preprocessor flags, e.g. -I<include dir>"

config PK_PAGING_PT_U2PT_PAGE_PRESENT_DPKCONFIG
	string "PKG_CONFIG_PATH: Directories to add to pkg-config's search path"

config PK_PAGING_PT_U2PT_PAGE_PRESENT_CFLAGS
	string "CFLAGS: C compiler flags"

config PK_PAGING_PT_U2PT_PAGE_PRESENT_LDFLAGS
	string "LDFLAGS: Linker flags"

config PK_PAGING_PT_U2PT_PAGE_PRESENT_CXXFLAGS
	string "CXXFLAGS: C++ compiler flags"

config PK_PAGING_PT_U2PT_PAGE_PRESENT_ASFLAGS
	string "CCASFLAGS: assembler compiler flags (defaults to CFLAGS)"

config PK_PAGING_PT_U2PT_PAGE_PRESENT_BUILDARCH
	string "--host options on configure for Architecture"

endif # PK_PAGING_PT_U2PT_PAGE_PRESENT
```
