## package/PAGING/BiscuitOS-PAGING-VM-PREALLOC-MMIO/Kconfig
```kconfig
menuconfig PK_PAGING_VM_PREALLOC_MMIO
	bool "USER PREALLOC: MMIO Memory"

if PK_PAGING_VM_PREALLOC_MMIO

config PK_PAGING_VM_PREALLOC_MMIO_VERSION
	default "default"
	string "verstion"

config PK_PAGING_VM_PREALLOC_MMIO_TAR
	default "tar.gz"
	string "tar type"

config PK_PAGING_VM_PREALLOC_MMIO_URL
	default "https://gitee.com/BiscuitOS_team/HardStack/raw/Gitee/Memory-Allocator/PAGING-MECH/BiscuitOS-PAGING-VM-PREALLOC-MMIO"
	string "url"

config PK_PAGING_VM_PREALLOC_MMIO_GITHUB
	string "GitHub"

config PK_PAGING_VM_PREALLOC_MMIO_SRCFILE
	default "app.c main.c Makefile Kconfig Makefile.host RunBiscuitOS.sh"
	string "Source code list"

config PK_PAGING_VM_PREALLOC_MMIO_CSRCFILE
	string "Compile source code list"

config PK_PAGING_VM_PREALLOC_MMIO_CONFIG
	string "CONFIG: Project Configure Options"

config PK_PAGING_VM_PREALLOC_MMIO_LIBPATH
	string "LIBS: Libraries to pass to the linker, e.g. -l<library>"

config PK_PAGING_VM_PREALLOC_MMIO_CPPFLAGS
	string "CPPFLAGS: C/C++ preprocessor flags, e.g. -I<include dir>"

config PK_PAGING_VM_PREALLOC_MMIO_DPKCONFIG
	string "PKG_CONFIG_PATH: Directories to add to pkg-config's search path"

config PK_PAGING_VM_PREALLOC_MMIO_CFLAGS
	string "CFLAGS: C compiler flags"

config PK_PAGING_VM_PREALLOC_MMIO_LDFLAGS
	string "LDFLAGS: Linker flags"

config PK_PAGING_VM_PREALLOC_MMIO_CXXFLAGS
	string "CXXFLAGS: C++ compiler flags"

config PK_PAGING_VM_PREALLOC_MMIO_ASFLAGS
	string "CCASFLAGS: assembler compiler flags (defaults to CFLAGS)"

config PK_PAGING_VM_PREALLOC_MMIO_BUILDARCH
	string "--host options on configure for Architecture"

endif # PK_PAGING_VM_PREALLOC_MMIO
```

## package/PAGING/BiscuitOS-PAGING-VM-PREALLOC-THP/Kconfig
```kconfig
menuconfig PK_PAGING_VM_PREALLOC_THP
	bool "USER PREALLOC: THP Memory"

if PK_PAGING_VM_PREALLOC_THP

config PK_PAGING_VM_PREALLOC_THP_VERSION
	default "default"
	string "verstion"

config PK_PAGING_VM_PREALLOC_THP_TAR
	default "tar.gz"
	string "tar type"

config PK_PAGING_VM_PREALLOC_THP_URL
	default "https://gitee.com/BiscuitOS_team/HardStack/raw/Gitee/Memory-Allocator/PAGING-MECH/BiscuitOS-PAGING-VM-PREALLOC-THP"
	string "url"

config PK_PAGING_VM_PREALLOC_THP_GITHUB
	string "GitHub"

config PK_PAGING_VM_PREALLOC_THP_SRCFILE
	default "main.c Makefile RunBiscuitOS.sh"
	string "Source code list"

config PK_PAGING_VM_PREALLOC_THP_CSRCFILE
	string "Compile source code list"

config PK_PAGING_VM_PREALLOC_THP_CONFIG
	string "CONFIG: Project Configure Options"

config PK_PAGING_VM_PREALLOC_THP_LIBPATH
	string "LIBS: Libraries to pass to the linker, e.g. -l<library>"

config PK_PAGING_VM_PREALLOC_THP_CPPFLAGS
	string "CPPFLAGS: C/C++ preprocessor flags, e.g. -I<include dir>"

config PK_PAGING_VM_PREALLOC_THP_DPKCONFIG
	string "PKG_CONFIG_PATH: Directories to add to pkg-config's search path"

config PK_PAGING_VM_PREALLOC_THP_CFLAGS
	string "CFLAGS: C compiler flags"

config PK_PAGING_VM_PREALLOC_THP_LDFLAGS
	string "LDFLAGS: Linker flags"

config PK_PAGING_VM_PREALLOC_THP_CXXFLAGS
	string "CXXFLAGS: C++ compiler flags"

config PK_PAGING_VM_PREALLOC_THP_ASFLAGS
	string "CCASFLAGS: assembler compiler flags (defaults to CFLAGS)"

config PK_PAGING_VM_PREALLOC_THP_BUILDARCH
	string "--host options on configure for Architecture"

endif # PK_PAGING_VM_PREALLOC_THP
```

## package/PAGING/BiscuitOS-PAGING-VM-ZERO-COPY-DMA/Kconfig
```kconfig
menuconfig PK_PAGING_VM_ZERO_COPY_DMA
	bool "ZERO COPY: DMA"

if PK_PAGING_VM_ZERO_COPY_DMA

config PK_PAGING_VM_ZERO_COPY_DMA_VERSION
	default "default"
	string "verstion"

config PK_PAGING_VM_ZERO_COPY_DMA_TAR
	default "tar.gz"
	string "tar type"

config PK_PAGING_VM_ZERO_COPY_DMA_URL
	default "https://gitee.com/BiscuitOS_team/HardStack/raw/Gitee/Memory-Allocator/PAGING-MECH/BiscuitOS-PAGING-VM-ZERO-COPY-DMA"
	string "url"

config PK_PAGING_VM_ZERO_COPY_DMA_GITHUB
	string "GitHub"

config PK_PAGING_VM_ZERO_COPY_DMA_SRCFILE
	default "main.c Makefile RunBiscuitOS.sh app.c Kconfig Makefile.host"
	string "Source code list"

config PK_PAGING_VM_ZERO_COPY_DMA_CSRCFILE
	string "Compile source code list"

config PK_PAGING_VM_ZERO_COPY_DMA_CONFIG
	string "CONFIG: Project Configure Options"

config PK_PAGING_VM_ZERO_COPY_DMA_LIBPATH
	string "LIBS: Libraries to pass to the linker, e.g. -l<library>"

config PK_PAGING_VM_ZERO_COPY_DMA_CPPFLAGS
	string "CPPFLAGS: C/C++ preprocessor flags, e.g. -I<include dir>"

config PK_PAGING_VM_ZERO_COPY_DMA_DPKCONFIG
	string "PKG_CONFIG_PATH: Directories to add to pkg-config's search path"

config PK_PAGING_VM_ZERO_COPY_DMA_CFLAGS
	string "CFLAGS: C compiler flags"

config PK_PAGING_VM_ZERO_COPY_DMA_LDFLAGS
	string "LDFLAGS: Linker flags"

config PK_PAGING_VM_ZERO_COPY_DMA_CXXFLAGS
	string "CXXFLAGS: C++ compiler flags"

config PK_PAGING_VM_ZERO_COPY_DMA_ASFLAGS
	string "CCASFLAGS: assembler compiler flags (defaults to CFLAGS)"

config PK_PAGING_VM_ZERO_COPY_DMA_BUILDARCH
	string "--host options on configure for Architecture"

endif # PK_PAGING_VM_ZERO_COPY_DMA
```

## package/PAGING/BiscuitOS-PAGING-VM-ZERO-COPY-DMABUF/Kconfig
```kconfig
menuconfig PK_PAGING_VM_ZERO_COPY_DMABUF
	bool "ZERO COPY: DMABUF"

if PK_PAGING_VM_ZERO_COPY_DMABUF

config PK_PAGING_VM_ZERO_COPY_DMABUF_VERSION
	default "default"
	string "verstion"

config PK_PAGING_VM_ZERO_COPY_DMABUF_TAR
	default "tar.gz"
	string "tar type"

config PK_PAGING_VM_ZERO_COPY_DMABUF_URL
	default "https://gitee.com/BiscuitOS_team/HardStack/raw/Gitee/Memory-Allocator/PAGING-MECH/BiscuitOS-PAGING-VM-ZERO-COPY-DMABUF"
	string "url"

config PK_PAGING_VM_ZERO_COPY_DMABUF_GITHUB
	string "GitHub"

config PK_PAGING_VM_ZERO_COPY_DMABUF_SRCFILE
	default "APP-Export-Capture.c APP-Import-GPUA.c APP-Import-GPUB.c DMABUF-Export-Capture.c DMABUF-Import-GPUA.c DMABUF-Import-GPUB.c Kconfig Makefile Makefile.host RunBiscuitOS.sh"
	string "Source code list"

config PK_PAGING_VM_ZERO_COPY_DMABUF_CSRCFILE
	string "Compile source code list"

config PK_PAGING_VM_ZERO_COPY_DMABUF_CONFIG
	string "CONFIG: Project Configure Options"

config PK_PAGING_VM_ZERO_COPY_DMABUF_LIBPATH
	string "LIBS: Libraries to pass to the linker, e.g. -l<library>"

config PK_PAGING_VM_ZERO_COPY_DMABUF_CPPFLAGS
	string "CPPFLAGS: C/C++ preprocessor flags, e.g. -I<include dir>"

config PK_PAGING_VM_ZERO_COPY_DMABUF_DPKCONFIG
	string "PKG_CONFIG_PATH: Directories to add to pkg-config's search path"

config PK_PAGING_VM_ZERO_COPY_DMABUF_CFLAGS
	string "CFLAGS: C compiler flags"

config PK_PAGING_VM_ZERO_COPY_DMABUF_LDFLAGS
	string "LDFLAGS: Linker flags"

config PK_PAGING_VM_ZERO_COPY_DMABUF_CXXFLAGS
	string "CXXFLAGS: C++ compiler flags"

config PK_PAGING_VM_ZERO_COPY_DMABUF_ASFLAGS
	string "CCASFLAGS: assembler compiler flags (defaults to CFLAGS)"

config PK_PAGING_VM_ZERO_COPY_DMABUF_BUILDARCH
	string "--host options on configure for Architecture"

endif # PK_PAGING_VM_ZERO_COPY_DMABUF
```

## package/PAGING/BiscuitOS-PAGING-VM-ZERO-COPY-PAGECACHE/Kconfig
```kconfig
menuconfig PK_PAGING_VM_ZERO_COPY_PAGECACHE
	bool "ZERO COPY: PAGECACHE"

if PK_PAGING_VM_ZERO_COPY_PAGECACHE

config PK_PAGING_VM_ZERO_COPY_PAGECACHE_VERSION
	default "default"
	string "verstion"

config PK_PAGING_VM_ZERO_COPY_PAGECACHE_TAR
	default "tar.gz"
	string "tar type"

config PK_PAGING_VM_ZERO_COPY_PAGECACHE_URL
	default "https://gitee.com/BiscuitOS_team/HardStack/raw/Gitee/Memory-Allocator/PAGING-MECH/BiscuitOS-PAGING-VM-ZERO-COPY-PAGECACHE"
	string "url"

config PK_PAGING_VM_ZERO_COPY_PAGECACHE_GITHUB
	string "GitHub"

config PK_PAGING_VM_ZERO_COPY_PAGECACHE_SRCFILE
	default "main.c Makefile RunBiscuitOS.sh"
	string "Source code list"

config PK_PAGING_VM_ZERO_COPY_PAGECACHE_CSRCFILE
	string "Compile source code list"

config PK_PAGING_VM_ZERO_COPY_PAGECACHE_CONFIG
	string "CONFIG: Project Configure Options"

config PK_PAGING_VM_ZERO_COPY_PAGECACHE_LIBPATH
	string "LIBS: Libraries to pass to the linker, e.g. -l<library>"

config PK_PAGING_VM_ZERO_COPY_PAGECACHE_CPPFLAGS
	string "CPPFLAGS: C/C++ preprocessor flags, e.g. -I<include dir>"

config PK_PAGING_VM_ZERO_COPY_PAGECACHE_DPKCONFIG
	string "PKG_CONFIG_PATH: Directories to add to pkg-config's search path"

config PK_PAGING_VM_ZERO_COPY_PAGECACHE_CFLAGS
	string "CFLAGS: C compiler flags"

config PK_PAGING_VM_ZERO_COPY_PAGECACHE_LDFLAGS
	string "LDFLAGS: Linker flags"

config PK_PAGING_VM_ZERO_COPY_PAGECACHE_CXXFLAGS
	string "CXXFLAGS: C++ compiler flags"

config PK_PAGING_VM_ZERO_COPY_PAGECACHE_ASFLAGS
	string "CCASFLAGS: assembler compiler flags (defaults to CFLAGS)"

config PK_PAGING_VM_ZERO_COPY_PAGECACHE_BUILDARCH
	string "--host options on configure for Architecture"

endif # PK_PAGING_VM_ZERO_COPY_PAGECACHE
```

## package/PAGING/BiscuitOS-PAGING-VM-ZERO-COPY-VMALLOC/Kconfig
```kconfig
menuconfig PK_PAGING_VM_ZERO_COPY_VMALLOC
	bool "ZERO COPY: VMALLOC"

if PK_PAGING_VM_ZERO_COPY_VMALLOC

config PK_PAGING_VM_ZERO_COPY_VMALLOC_VERSION
	default "default"
	string "verstion"

config PK_PAGING_VM_ZERO_COPY_VMALLOC_TAR
	default "tar.gz"
	string "tar type"

config PK_PAGING_VM_ZERO_COPY_VMALLOC_URL
	default "https://gitee.com/BiscuitOS_team/HardStack/raw/Gitee/Memory-Allocator/PAGING-MECH/BiscuitOS-PAGING-VM-ZERO-COPY-VMALLOC"
	string "url"

config PK_PAGING_VM_ZERO_COPY_VMALLOC_GITHUB
	string "GitHub"

config PK_PAGING_VM_ZERO_COPY_VMALLOC_SRCFILE
	default "main.c Makefile RunBiscuitOS.sh app.c Kconfig Makefile.host"
	string "Source code list"

config PK_PAGING_VM_ZERO_COPY_VMALLOC_CSRCFILE
	string "Compile source code list"

config PK_PAGING_VM_ZERO_COPY_VMALLOC_CONFIG
	string "CONFIG: Project Configure Options"

config PK_PAGING_VM_ZERO_COPY_VMALLOC_LIBPATH
	string "LIBS: Libraries to pass to the linker, e.g. -l<library>"

config PK_PAGING_VM_ZERO_COPY_VMALLOC_CPPFLAGS
	string "CPPFLAGS: C/C++ preprocessor flags, e.g. -I<include dir>"

config PK_PAGING_VM_ZERO_COPY_VMALLOC_DPKCONFIG
	string "PKG_CONFIG_PATH: Directories to add to pkg-config's search path"

config PK_PAGING_VM_ZERO_COPY_VMALLOC_CFLAGS
	string "CFLAGS: C compiler flags"

config PK_PAGING_VM_ZERO_COPY_VMALLOC_LDFLAGS
	string "LDFLAGS: Linker flags"

config PK_PAGING_VM_ZERO_COPY_VMALLOC_CXXFLAGS
	string "CXXFLAGS: C++ compiler flags"

config PK_PAGING_VM_ZERO_COPY_VMALLOC_ASFLAGS
	string "CCASFLAGS: assembler compiler flags (defaults to CFLAGS)"

config PK_PAGING_VM_ZERO_COPY_VMALLOC_BUILDARCH
	string "--host options on configure for Architecture"

endif # PK_PAGING_VM_ZERO_COPY_VMALLOC
```

## package/PAGING/BiscuitOS-PAGING-VM-ZERO-HPAGE/Kconfig
```kconfig
menuconfig PK_PAGING_VM_ZERO_HPAGE
	bool "ZERO HUGE PAGE(2MiB)"

if PK_PAGING_VM_ZERO_HPAGE

config PK_PAGING_VM_ZERO_HPAGE_VERSION
	default "default"
	string "verstion"

config PK_PAGING_VM_ZERO_HPAGE_TAR
	default "tar.gz"
	string "tar type"

config PK_PAGING_VM_ZERO_HPAGE_URL
	default "https://gitee.com/BiscuitOS_team/HardStack/raw/Gitee/Memory-Allocator/PAGING-MECH/BiscuitOS-PAGING-VM-ZERO-HPAGE"
	string "url"

config PK_PAGING_VM_ZERO_HPAGE_GITHUB
	string "GitHub"

config PK_PAGING_VM_ZERO_HPAGE_SRCFILE
	default "main.c Makefile RunBiscuitOS.sh"
	string "Source code list"

config PK_PAGING_VM_ZERO_HPAGE_CSRCFILE
	string "Compile source code list"

config PK_PAGING_VM_ZERO_HPAGE_CONFIG
	string "CONFIG: Project Configure Options"

config PK_PAGING_VM_ZERO_HPAGE_LIBPATH
	string "LIBS: Libraries to pass to the linker, e.g. -l<library>"

config PK_PAGING_VM_ZERO_HPAGE_CPPFLAGS
	string "CPPFLAGS: C/C++ preprocessor flags, e.g. -I<include dir>"

config PK_PAGING_VM_ZERO_HPAGE_DPKCONFIG
	string "PKG_CONFIG_PATH: Directories to add to pkg-config's search path"

config PK_PAGING_VM_ZERO_HPAGE_CFLAGS
	string "CFLAGS: C compiler flags"

config PK_PAGING_VM_ZERO_HPAGE_LDFLAGS
	string "LDFLAGS: Linker flags"

config PK_PAGING_VM_ZERO_HPAGE_CXXFLAGS
	string "CXXFLAGS: C++ compiler flags"

config PK_PAGING_VM_ZERO_HPAGE_ASFLAGS
	string "CCASFLAGS: assembler compiler flags (defaults to CFLAGS)"

config PK_PAGING_VM_ZERO_HPAGE_BUILDARCH
	string "--host options on configure for Architecture"

endif # PK_PAGING_VM_ZERO_HPAGE
```
