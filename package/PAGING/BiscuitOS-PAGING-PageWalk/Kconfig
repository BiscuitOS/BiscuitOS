## package/PAGING/BiscuitOS-PAGING-VM-LAZYALLOC-HUGETLB/Kconfig
```kconfig
menuconfig PK_PAGING_VM_LAZYALLOC_HUGETLB
	bool "USER LAZYALLOC: HUGETLB Memory"

if PK_PAGING_VM_LAZYALLOC_HUGETLB

config PK_PAGING_VM_LAZYALLOC_HUGETLB_VERSION
	default "default"
	string "verstion"

config PK_PAGING_VM_LAZYALLOC_HUGETLB_TAR
	default "tar.gz"
	string "tar type"

config PK_PAGING_VM_LAZYALLOC_HUGETLB_URL
	default "https://gitee.com/BiscuitOS_team/HardStack/raw/Gitee/Memory-Allocator/PAGING-MECH/BiscuitOS-PAGING-VM-LAZYALLOC-HUGETLB"
	string "url"

config PK_PAGING_VM_LAZYALLOC_HUGETLB_GITHUB
	string "GitHub"

config PK_PAGING_VM_LAZYALLOC_HUGETLB_SRCFILE
	default "main.c Makefile RunBiscuitOS.sh"
	string "Source code list"

config PK_PAGING_VM_LAZYALLOC_HUGETLB_CSRCFILE
	string "Compile source code list"

config PK_PAGING_VM_LAZYALLOC_HUGETLB_CONFIG
	string "CONFIG: Project Configure Options"

config PK_PAGING_VM_LAZYALLOC_HUGETLB_LIBPATH
	string "LIBS: Libraries to pass to the linker, e.g. -l<library>"

config PK_PAGING_VM_LAZYALLOC_HUGETLB_CPPFLAGS
	string "CPPFLAGS: C/C++ preprocessor flags, e.g. -I<include dir>"

config PK_PAGING_VM_LAZYALLOC_HUGETLB_DPKCONFIG
	string "PKG_CONFIG_PATH: Directories to add to pkg-config's search path"

config PK_PAGING_VM_LAZYALLOC_HUGETLB_CFLAGS
	string "CFLAGS: C compiler flags"

config PK_PAGING_VM_LAZYALLOC_HUGETLB_LDFLAGS
	string "LDFLAGS: Linker flags"

config PK_PAGING_VM_LAZYALLOC_HUGETLB_CXXFLAGS
	string "CXXFLAGS: C++ compiler flags"

config PK_PAGING_VM_LAZYALLOC_HUGETLB_ASFLAGS
	string "CCASFLAGS: assembler compiler flags (defaults to CFLAGS)"

config PK_PAGING_VM_LAZYALLOC_HUGETLB_BUILDARCH
	string "--host options on configure for Architecture"

endif # PK_PAGING_VM_LAZYALLOC_HUGETLB
```

## package/PAGING/BiscuitOS-PAGING-VM-LAZYALLOC-MMIO/Kconfig
```kconfig
menuconfig PK_PAGING_VM_LAZYALLOC_MMIO
	bool "USER LAZYALLOC: MMIO Memory"

if PK_PAGING_VM_LAZYALLOC_MMIO

config PK_PAGING_VM_LAZYALLOC_MMIO_VERSION
	default "default"
	string "verstion"

config PK_PAGING_VM_LAZYALLOC_MMIO_TAR
	default "tar.gz"
	string "tar type"

config PK_PAGING_VM_LAZYALLOC_MMIO_URL
	default "https://gitee.com/BiscuitOS_team/HardStack/raw/Gitee/Memory-Allocator/PAGING-MECH/BiscuitOS-PAGING-VM-LAZYALLOC-MMIO"
	string "url"

config PK_PAGING_VM_LAZYALLOC_MMIO_GITHUB
	string "GitHub"

config PK_PAGING_VM_LAZYALLOC_MMIO_SRCFILE
	default "main.c Makefile RunBiscuitOS.sh app.c Kconfig Makefile.host"
	string "Source code list"

config PK_PAGING_VM_LAZYALLOC_MMIO_CSRCFILE
	string "Compile source code list"

config PK_PAGING_VM_LAZYALLOC_MMIO_CONFIG
	string "CONFIG: Project Configure Options"

config PK_PAGING_VM_LAZYALLOC_MMIO_LIBPATH
	string "LIBS: Libraries to pass to the linker, e.g. -l<library>"

config PK_PAGING_VM_LAZYALLOC_MMIO_CPPFLAGS
	string "CPPFLAGS: C/C++ preprocessor flags, e.g. -I<include dir>"

config PK_PAGING_VM_LAZYALLOC_MMIO_DPKCONFIG
	string "PKG_CONFIG_PATH: Directories to add to pkg-config's search path"

config PK_PAGING_VM_LAZYALLOC_MMIO_CFLAGS
	string "CFLAGS: C compiler flags"

config PK_PAGING_VM_LAZYALLOC_MMIO_LDFLAGS
	string "LDFLAGS: Linker flags"

config PK_PAGING_VM_LAZYALLOC_MMIO_CXXFLAGS
	string "CXXFLAGS: C++ compiler flags"

config PK_PAGING_VM_LAZYALLOC_MMIO_ASFLAGS
	string "CCASFLAGS: assembler compiler flags (defaults to CFLAGS)"

config PK_PAGING_VM_LAZYALLOC_MMIO_BUILDARCH
	string "--host options on configure for Architecture"

endif # PK_PAGING_VM_LAZYALLOC_MMIO
```

## package/PAGING/BiscuitOS-PAGING-VM-LAZYALLOC-PFNMAP/Kconfig
```kconfig
menuconfig PK_PAGING_VM_LAZYALLOC_PFNMAP
	bool "USER LAZYALLOC: PFNMAP Memory"

if PK_PAGING_VM_LAZYALLOC_PFNMAP

config PK_PAGING_VM_LAZYALLOC_PFNMAP_VERSION
	default "default"
	string "verstion"

config PK_PAGING_VM_LAZYALLOC_PFNMAP_TAR
	default "tar.gz"
	string "tar type"

config PK_PAGING_VM_LAZYALLOC_PFNMAP_URL
	default "https://gitee.com/BiscuitOS_team/HardStack/raw/Gitee/Memory-Allocator/PAGING-MECH/BiscuitOS-PAGING-VM-LAZYALLOC-PFNMAP"
	string "url"

config PK_PAGING_VM_LAZYALLOC_PFNMAP_GITHUB
	string "GitHub"

config PK_PAGING_VM_LAZYALLOC_PFNMAP_SRCFILE
	default "main.c Makefile RunBiscuitOS.sh app.c Kconfig Makefile.host"
	string "Source code list"

config PK_PAGING_VM_LAZYALLOC_PFNMAP_CSRCFILE
	string "Compile source code list"

config PK_PAGING_VM_LAZYALLOC_PFNMAP_CONFIG
	string "CONFIG: Project Configure Options"

config PK_PAGING_VM_LAZYALLOC_PFNMAP_LIBPATH
	string "LIBS: Libraries to pass to the linker, e.g. -l<library>"

config PK_PAGING_VM_LAZYALLOC_PFNMAP_CPPFLAGS
	string "CPPFLAGS: C/C++ preprocessor flags, e.g. -I<include dir>"

config PK_PAGING_VM_LAZYALLOC_PFNMAP_DPKCONFIG
	string "PKG_CONFIG_PATH: Directories to add to pkg-config's search path"

config PK_PAGING_VM_LAZYALLOC_PFNMAP_CFLAGS
	string "CFLAGS: C compiler flags"

config PK_PAGING_VM_LAZYALLOC_PFNMAP_LDFLAGS
	string "LDFLAGS: Linker flags"

config PK_PAGING_VM_LAZYALLOC_PFNMAP_CXXFLAGS
	string "CXXFLAGS: C++ compiler flags"

config PK_PAGING_VM_LAZYALLOC_PFNMAP_ASFLAGS
	string "CCASFLAGS: assembler compiler flags (defaults to CFLAGS)"

config PK_PAGING_VM_LAZYALLOC_PFNMAP_BUILDARCH
	string "--host options on configure for Architecture"

endif # PK_PAGING_VM_LAZYALLOC_PFNMAP
```

## package/PAGING/BiscuitOS-PAGING-VM-LAZYALLOC-VMALLOC/Kconfig
```kconfig
menuconfig PK_PAGING_VM_LAZYALLOC_VMALLOC
	bool "USER LAZYALLOC: VMALLOC Memory"

if PK_PAGING_VM_LAZYALLOC_VMALLOC

config PK_PAGING_VM_LAZYALLOC_VMALLOC_VERSION
	default "default"
	string "verstion"

config PK_PAGING_VM_LAZYALLOC_VMALLOC_TAR
	default "tar.gz"
	string "tar type"

config PK_PAGING_VM_LAZYALLOC_VMALLOC_URL
	default "https://gitee.com/BiscuitOS_team/HardStack/raw/Gitee/Memory-Allocator/PAGING-MECH/BiscuitOS-PAGING-VM-LAZYALLOC-VMALLOC"
	string "url"

config PK_PAGING_VM_LAZYALLOC_VMALLOC_GITHUB
	string "GitHub"

config PK_PAGING_VM_LAZYALLOC_VMALLOC_SRCFILE
	default "main.c Makefile RunBiscuitOS.sh app.c Kconfig Makefile.host"
	string "Source code list"

config PK_PAGING_VM_LAZYALLOC_VMALLOC_CSRCFILE
	string "Compile source code list"

config PK_PAGING_VM_LAZYALLOC_VMALLOC_CONFIG
	string "CONFIG: Project Configure Options"

config PK_PAGING_VM_LAZYALLOC_VMALLOC_LIBPATH
	string "LIBS: Libraries to pass to the linker, e.g. -l<library>"

config PK_PAGING_VM_LAZYALLOC_VMALLOC_CPPFLAGS
	string "CPPFLAGS: C/C++ preprocessor flags, e.g. -I<include dir>"

config PK_PAGING_VM_LAZYALLOC_VMALLOC_DPKCONFIG
	string "PKG_CONFIG_PATH: Directories to add to pkg-config's search path"

config PK_PAGING_VM_LAZYALLOC_VMALLOC_CFLAGS
	string "CFLAGS: C compiler flags"

config PK_PAGING_VM_LAZYALLOC_VMALLOC_LDFLAGS
	string "LDFLAGS: Linker flags"

config PK_PAGING_VM_LAZYALLOC_VMALLOC_CXXFLAGS
	string "CXXFLAGS: C++ compiler flags"

config PK_PAGING_VM_LAZYALLOC_VMALLOC_ASFLAGS
	string "CCASFLAGS: assembler compiler flags (defaults to CFLAGS)"

config PK_PAGING_VM_LAZYALLOC_VMALLOC_BUILDARCH
	string "--host options on configure for Architecture"

endif # PK_PAGING_VM_LAZYALLOC_VMALLOC
```

## package/PAGING/BiscuitOS-PAGING-VM-ONDEMAND-IOCTL/Kconfig
```kconfig
menuconfig PK_PAGING_VM_ONDEMAND_IOCTL
	bool "USER ONDEMAND: IOCTL"

if PK_PAGING_VM_ONDEMAND_IOCTL

config PK_PAGING_VM_ONDEMAND_IOCTL_VERSION
	default "default"
	string "verstion"

config PK_PAGING_VM_ONDEMAND_IOCTL_TAR
	default "tar.gz"
	string "tar type"

config PK_PAGING_VM_ONDEMAND_IOCTL_URL
	default "https://gitee.com/BiscuitOS_team/HardStack/raw/Gitee/Memory-Allocator/PAGING-MECH/BiscuitOS-PAGING-VM-ONDEMAND-IOCTL"
	string "url"

config PK_PAGING_VM_ONDEMAND_IOCTL_GITHUB
	string "GitHub"

config PK_PAGING_VM_ONDEMAND_IOCTL_SRCFILE
	default "main.c Makefile RunBiscuitOS.sh app.c Kconfig Makefile.host"
	string "Source code list"

config PK_PAGING_VM_ONDEMAND_IOCTL_CSRCFILE
	string "Compile source code list"

config PK_PAGING_VM_ONDEMAND_IOCTL_CONFIG
	string "CONFIG: Project Configure Options"

config PK_PAGING_VM_ONDEMAND_IOCTL_LIBPATH
	string "LIBS: Libraries to pass to the linker, e.g. -l<library>"

config PK_PAGING_VM_ONDEMAND_IOCTL_CPPFLAGS
	string "CPPFLAGS: C/C++ preprocessor flags, e.g. -I<include dir>"

config PK_PAGING_VM_ONDEMAND_IOCTL_DPKCONFIG
	string "PKG_CONFIG_PATH: Directories to add to pkg-config's search path"

config PK_PAGING_VM_ONDEMAND_IOCTL_CFLAGS
	string "CFLAGS: C compiler flags"

config PK_PAGING_VM_ONDEMAND_IOCTL_LDFLAGS
	string "LDFLAGS: Linker flags"

config PK_PAGING_VM_ONDEMAND_IOCTL_CXXFLAGS
	string "CXXFLAGS: C++ compiler flags"

config PK_PAGING_VM_ONDEMAND_IOCTL_ASFLAGS
	string "CCASFLAGS: assembler compiler flags (defaults to CFLAGS)"

config PK_PAGING_VM_ONDEMAND_IOCTL_BUILDARCH
	string "--host options on configure for Architecture"

endif # PK_PAGING_VM_ONDEMAND_IOCTL
```

## package/PAGING/BiscuitOS-PAGING-VM-ONDEMAND-MADVISE/Kconfig
```kconfig
menuconfig PK_PAGING_VM_ONDEMAND_MADVISE
	bool "USER ONDEMAND: MADVISE"

if PK_PAGING_VM_ONDEMAND_MADVISE

config PK_PAGING_VM_ONDEMAND_MADVISE_VERSION
	default "default"
	string "verstion"

config PK_PAGING_VM_ONDEMAND_MADVISE_TAR
	default "tar.gz"
	string "tar type"

config PK_PAGING_VM_ONDEMAND_MADVISE_URL
	default "https://gitee.com/BiscuitOS_team/HardStack/raw/Gitee/Memory-Allocator/PAGING-MECH/BiscuitOS-PAGING-VM-ONDEMAND-MADVISE"
	string "url"

config PK_PAGING_VM_ONDEMAND_MADVISE_GITHUB
	string "GitHub"

config PK_PAGING_VM_ONDEMAND_MADVISE_SRCFILE
	default "main.c Makefile RunBiscuitOS.sh"
	string "Source code list"

config PK_PAGING_VM_ONDEMAND_MADVISE_CSRCFILE
	string "Compile source code list"

config PK_PAGING_VM_ONDEMAND_MADVISE_CONFIG
	string "CONFIG: Project Configure Options"

config PK_PAGING_VM_ONDEMAND_MADVISE_LIBPATH
	string "LIBS: Libraries to pass to the linker, e.g. -l<library>"

config PK_PAGING_VM_ONDEMAND_MADVISE_CPPFLAGS
	string "CPPFLAGS: C/C++ preprocessor flags, e.g. -I<include dir>"

config PK_PAGING_VM_ONDEMAND_MADVISE_DPKCONFIG
	string "PKG_CONFIG_PATH: Directories to add to pkg-config's search path"

config PK_PAGING_VM_ONDEMAND_MADVISE_CFLAGS
	string "CFLAGS: C compiler flags"

config PK_PAGING_VM_ONDEMAND_MADVISE_LDFLAGS
	string "LDFLAGS: Linker flags"

config PK_PAGING_VM_ONDEMAND_MADVISE_CXXFLAGS
	string "CXXFLAGS: C++ compiler flags"

config PK_PAGING_VM_ONDEMAND_MADVISE_ASFLAGS
	string "CCASFLAGS: assembler compiler flags (defaults to CFLAGS)"

config PK_PAGING_VM_ONDEMAND_MADVISE_BUILDARCH
	string "--host options on configure for Architecture"

endif # PK_PAGING_VM_ONDEMAND_MADVISE
```

## package/PAGING/BiscuitOS-PAGING-VM-ONDEMAND-MLOCK/Kconfig
```kconfig
menuconfig PK_PAGING_VM_ONDEMAND_MLOCK
	bool "USER ONDEMAND: MLOCK"

if PK_PAGING_VM_ONDEMAND_MLOCK

config PK_PAGING_VM_ONDEMAND_MLOCK_VERSION
	default "default"
	string "verstion"

config PK_PAGING_VM_ONDEMAND_MLOCK_TAR
	default "tar.gz"
	string "tar type"

config PK_PAGING_VM_ONDEMAND_MLOCK_URL
	default "https://gitee.com/BiscuitOS_team/HardStack/raw/Gitee/Memory-Allocator/PAGING-MECH/BiscuitOS-PAGING-VM-ONDEMAND-MLOCK"
	string "url"

config PK_PAGING_VM_ONDEMAND_MLOCK_GITHUB
	string "GitHub"

config PK_PAGING_VM_ONDEMAND_MLOCK_SRCFILE
	default "main.c Makefile RunBiscuitOS.sh"
	string "Source code list"

config PK_PAGING_VM_ONDEMAND_MLOCK_CSRCFILE
	string "Compile source code list"

config PK_PAGING_VM_ONDEMAND_MLOCK_CONFIG
	string "CONFIG: Project Configure Options"

config PK_PAGING_VM_ONDEMAND_MLOCK_LIBPATH
	string "LIBS: Libraries to pass to the linker, e.g. -l<library>"

config PK_PAGING_VM_ONDEMAND_MLOCK_CPPFLAGS
	string "CPPFLAGS: C/C++ preprocessor flags, e.g. -I<include dir>"

config PK_PAGING_VM_ONDEMAND_MLOCK_DPKCONFIG
	string "PKG_CONFIG_PATH: Directories to add to pkg-config's search path"

config PK_PAGING_VM_ONDEMAND_MLOCK_CFLAGS
	string "CFLAGS: C compiler flags"

config PK_PAGING_VM_ONDEMAND_MLOCK_LDFLAGS
	string "LDFLAGS: Linker flags"

config PK_PAGING_VM_ONDEMAND_MLOCK_CXXFLAGS
	string "CXXFLAGS: C++ compiler flags"

config PK_PAGING_VM_ONDEMAND_MLOCK_ASFLAGS
	string "CCASFLAGS: assembler compiler flags (defaults to CFLAGS)"

config PK_PAGING_VM_ONDEMAND_MLOCK_BUILDARCH
	string "--host options on configure for Architecture"

endif # PK_PAGING_VM_ONDEMAND_MLOCK
```

## package/PAGING/BiscuitOS-PAGING-VM-PERMANENT-RSVDMEM/Kconfig
```kconfig
menuconfig PK_PAGING_VM_PERMANENT_RSVDMEM
	bool "PERMANENT MAPPING: RSVDMEM"

if PK_PAGING_VM_PERMANENT_RSVDMEM

config PK_PAGING_VM_PERMANENT_RSVDMEM_VERSION
	default "default"
	string "verstion"

config PK_PAGING_VM_PERMANENT_RSVDMEM_TAR
	default "tar.gz"
	string "tar type"

config PK_PAGING_VM_PERMANENT_RSVDMEM_URL
	default "https://gitee.com/BiscuitOS_team/HardStack/raw/Gitee/Memory-Allocator/PAGING-MECH/BiscuitOS-PAGING-VM-PERMANENT-RSVDMEM"
	string "url"

config PK_PAGING_VM_PERMANENT_RSVDMEM_GITHUB
	string "GitHub"

config PK_PAGING_VM_PERMANENT_RSVDMEM_SRCFILE
	default "main.c Makefile Kconfig"
	string "Source code list"

config PK_PAGING_VM_PERMANENT_RSVDMEM_CSRCFILE
	string "Compile source code list"

config PK_PAGING_VM_PERMANENT_RSVDMEM_CONFIG
	string "CONFIG: Project Configure Options"

config PK_PAGING_VM_PERMANENT_RSVDMEM_LIBPATH
	string "LIBS: Libraries to pass to the linker, e.g. -l<library>"

config PK_PAGING_VM_PERMANENT_RSVDMEM_CPPFLAGS
	string "CPPFLAGS: C/C++ preprocessor flags, e.g. -I<include dir>"

config PK_PAGING_VM_PERMANENT_RSVDMEM_DPKCONFIG
	string "PKG_CONFIG_PATH: Directories to add to pkg-config's search path"

config PK_PAGING_VM_PERMANENT_RSVDMEM_CFLAGS
	string "CFLAGS: C compiler flags"

config PK_PAGING_VM_PERMANENT_RSVDMEM_LDFLAGS
	string "LDFLAGS: Linker flags"

config PK_PAGING_VM_PERMANENT_RSVDMEM_CXXFLAGS
	string "CXXFLAGS: C++ compiler flags"

config PK_PAGING_VM_PERMANENT_RSVDMEM_ASFLAGS
	string "CCASFLAGS: assembler compiler flags (defaults to CFLAGS)"

config PK_PAGING_VM_PERMANENT_RSVDMEM_BUILDARCH
	string "--host options on configure for Architecture"

endif # PK_PAGING_VM_PERMANENT_RSVDMEM
```

## package/PAGING/BiscuitOS-PAGING-VM-PREALLOC-DMA/Kconfig
```kconfig
menuconfig PK_PAGING_VM_PREALLOC_DMA
	bool "USER PREALLOC: DMA Memory"

if PK_PAGING_VM_PREALLOC_DMA

config PK_PAGING_VM_PREALLOC_DMA_VERSION
	default "default"
	string "verstion"

config PK_PAGING_VM_PREALLOC_DMA_TAR
	default "tar.gz"
	string "tar type"

config PK_PAGING_VM_PREALLOC_DMA_URL
	default "https://gitee.com/BiscuitOS_team/HardStack/raw/Gitee/Memory-Allocator/PAGING-MECH/BiscuitOS-PAGING-VM-PREALLOC-DMA"
	string "url"

config PK_PAGING_VM_PREALLOC_DMA_GITHUB
	string "GitHub"

config PK_PAGING_VM_PREALLOC_DMA_SRCFILE
	default "app.c main.c Makefile Makefile.app Kconfig RunBiscuitOS.sh"
	string "Source code list"

config PK_PAGING_VM_PREALLOC_DMA_CSRCFILE
	string "Compile source code list"

config PK_PAGING_VM_PREALLOC_DMA_CONFIG
	string "CONFIG: Project Configure Options"

config PK_PAGING_VM_PREALLOC_DMA_LIBPATH
	string "LIBS: Libraries to pass to the linker, e.g. -l<library>"

config PK_PAGING_VM_PREALLOC_DMA_CPPFLAGS
	string "CPPFLAGS: C/C++ preprocessor flags, e.g. -I<include dir>"

config PK_PAGING_VM_PREALLOC_DMA_DPKCONFIG
	string "PKG_CONFIG_PATH: Directories to add to pkg-config's search path"

config PK_PAGING_VM_PREALLOC_DMA_CFLAGS
	string "CFLAGS: C compiler flags"

config PK_PAGING_VM_PREALLOC_DMA_LDFLAGS
	string "LDFLAGS: Linker flags"

config PK_PAGING_VM_PREALLOC_DMA_CXXFLAGS
	string "CXXFLAGS: C++ compiler flags"

config PK_PAGING_VM_PREALLOC_DMA_ASFLAGS
	string "CCASFLAGS: assembler compiler flags (defaults to CFLAGS)"

config PK_PAGING_VM_PREALLOC_DMA_BUILDARCH
	string "--host options on configure for Architecture"

endif # PK_PAGING_VM_PREALLOC_DMA
```
