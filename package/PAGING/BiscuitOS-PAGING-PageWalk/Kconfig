## package/PAGING/BiscuitOS-PAGING-PageWalk/Kconfig
```kconfig
menuconfig PK_PAGING_PAGEWALK
	bool "Page Walk Mechanism"

if PK_PAGING_PAGEWALK

config PK_PAGING_PAGEWALK_VERSION
	default "default"
	string "verstion"

config PK_PAGING_PAGEWALK_TAR
	default "tar.gz"
	string "tar type"

config PK_PAGING_PAGEWALK_URL
	default "https://gitee.com/BiscuitOS_team/HardStack/raw/Gitee/Memory-Allocator/PAGING-MECH/BiscuitOS-PAGING-PageWalk"
	string "url"

config PK_PAGING_PAGEWALK_GITHUB
	string "GitHub"

config PK_PAGING_PAGEWALK_SRCFILE
	default "main.c Makefile Kconfig Makefile.app RunBiscuitOS.sh app.c"
	string "Source code list"

config PK_PAGING_PAGEWALK_CSRCFILE
	string "Compile source code list"

config PK_PAGING_PAGEWALK_CONFIG
	string "CONFIG: Project Configure Options"

config PK_PAGING_PAGEWALK_LIBPATH
	string "LIBS: Libraries to pass to the linker, e.g. -l<library>"

config PK_PAGING_PAGEWALK_CPPFLAGS
	string "CPPFLAGS: C/C++ preprocessor flags, e.g. -I<include dir>"

config PK_PAGING_PAGEWALK_DPKCONFIG
	string "PKG_CONFIG_PATH: Directories to add to pkg-config's search path"

config PK_PAGING_PAGEWALK_CFLAGS
	string "CFLAGS: C compiler flags"

config PK_PAGING_PAGEWALK_LDFLAGS
	string "LDFLAGS: Linker flags"

config PK_PAGING_PAGEWALK_CXXFLAGS
	string "CXXFLAGS: C++ compiler flags"

config PK_PAGING_PAGEWALK_ASFLAGS
	string "CCASFLAGS: assembler compiler flags (defaults to CFLAGS)"

config PK_PAGING_PAGEWALK_BUILDARCH
	string "--host options on configure for Architecture"

endif # PK_PAGING_PAGEWALK
```

## package/PAGING/BiscuitOS-PAGING-RMAP-ANON/Kconfig
```kconfig
menuconfig PK_PAGING_RMAP_ANON
	bool "RMAP: ANONYMOUS"

if PK_PAGING_RMAP_ANON

config PK_PAGING_RMAP_ANON_VERSION
	default "default"
	string "verstion"

config PK_PAGING_RMAP_ANON_TAR
	default "tar.gz"
	string "tar type"

config PK_PAGING_RMAP_ANON_URL
	default "https://gitee.com/BiscuitOS_team/HardStack/raw/Gitee/Memory-Allocator/PAGING-MECH/BiscuitOS-PAGING-RMAP-ANON"
	string "url"

config PK_PAGING_RMAP_ANON_GITHUB
	string "GitHub"

config PK_PAGING_RMAP_ANON_SRCFILE
	default "main.c Makefile RunBiscuitOS.sh Makefile.app app.c Kconfig"
	string "Source code list"

config PK_PAGING_RMAP_ANON_CSRCFILE
	string "Compile source code list"

config PK_PAGING_RMAP_ANON_CONFIG
	string "CONFIG: Project Configure Options"

config PK_PAGING_RMAP_ANON_LIBPATH
	string "LIBS: Libraries to pass to the linker, e.g. -l<library>"

config PK_PAGING_RMAP_ANON_CPPFLAGS
	string "CPPFLAGS: C/C++ preprocessor flags, e.g. -I<include dir>"

config PK_PAGING_RMAP_ANON_DPKCONFIG
	string "PKG_CONFIG_PATH: Directories to add to pkg-config's search path"

config PK_PAGING_RMAP_ANON_CFLAGS
	string "CFLAGS: C compiler flags"

config PK_PAGING_RMAP_ANON_LDFLAGS
	string "LDFLAGS: Linker flags"

config PK_PAGING_RMAP_ANON_CXXFLAGS
	string "CXXFLAGS: C++ compiler flags"

config PK_PAGING_RMAP_ANON_ASFLAGS
	string "CCASFLAGS: assembler compiler flags (defaults to CFLAGS)"

config PK_PAGING_RMAP_ANON_BUILDARCH
	string "--host options on configure for Architecture"

endif # PK_PAGING_RMAP_ANON
```

## package/PAGING/BiscuitOS-PAGING-RMAP-FILE/Kconfig
```kconfig
menuconfig PK_PAGING_RMAP_FILE
	bool "RMAP: FILE-MAPPING"

if PK_PAGING_RMAP_FILE

config PK_PAGING_RMAP_FILE_VERSION
	default "default"
	string "verstion"

config PK_PAGING_RMAP_FILE_TAR
	default "tar.gz"
	string "tar type"

config PK_PAGING_RMAP_FILE_URL
	default "https://gitee.com/BiscuitOS_team/HardStack/raw/Gitee/Memory-Allocator/PAGING-MECH/BiscuitOS-PAGING-RMAP-FILE"
	string "url"

config PK_PAGING_RMAP_FILE_GITHUB
	string "GitHub"

config PK_PAGING_RMAP_FILE_SRCFILE
	default "main.c Makefile RunBiscuitOS.sh Makefile.app app.c Kconfig"
	string "Source code list"

config PK_PAGING_RMAP_FILE_CSRCFILE
	string "Compile source code list"

config PK_PAGING_RMAP_FILE_CONFIG
	string "CONFIG: Project Configure Options"

config PK_PAGING_RMAP_FILE_LIBPATH
	string "LIBS: Libraries to pass to the linker, e.g. -l<library>"

config PK_PAGING_RMAP_FILE_CPPFLAGS
	string "CPPFLAGS: C/C++ preprocessor flags, e.g. -I<include dir>"

config PK_PAGING_RMAP_FILE_DPKCONFIG
	string "PKG_CONFIG_PATH: Directories to add to pkg-config's search path"

config PK_PAGING_RMAP_FILE_CFLAGS
	string "CFLAGS: C compiler flags"

config PK_PAGING_RMAP_FILE_LDFLAGS
	string "LDFLAGS: Linker flags"

config PK_PAGING_RMAP_FILE_CXXFLAGS
	string "CXXFLAGS: C++ compiler flags"

config PK_PAGING_RMAP_FILE_ASFLAGS
	string "CCASFLAGS: assembler compiler flags (defaults to CFLAGS)"

config PK_PAGING_RMAP_FILE_BUILDARCH
	string "--host options on configure for Architecture"

endif # PK_PAGING_RMAP_FILE
```

## package/PAGING/BiscuitOS-PAGING-TEMP-OSMEM-MIGRATE/Kconfig
```kconfig
menuconfig PK_PAGING_TEMP_OSMEM_MIGRATE
	bool "TEMPORARY MAPPING: OSMEM MIGRATE"
	select PK_NUMA
	select PK_NUMACTL_LIBNUMA

if PK_PAGING_TEMP_OSMEM_MIGRATE

config PK_PAGING_TEMP_OSMEM_MIGRATE_VERSION
	default "default"
	string "verstion"

config PK_PAGING_TEMP_OSMEM_MIGRATE_TAR
	default "tar.gz"
	string "tar type"

config PK_PAGING_TEMP_OSMEM_MIGRATE_URL
	default "https://gitee.com/BiscuitOS_team/HardStack/raw/Gitee/Memory-Allocator/PAGING-MECH/BiscuitOS-PAGING-TEMP-OSMEM-MIGRATE"
	string "url"

config PK_PAGING_TEMP_OSMEM_MIGRATE_GITHUB
	string "GitHub"

config PK_PAGING_TEMP_OSMEM_MIGRATE_SRCFILE
	default "main.c Makefile RunBiscuitOS.sh"
	string "Source code list"

config PK_PAGING_TEMP_OSMEM_MIGRATE_CSRCFILE
	string "Compile source code list"

config PK_PAGING_TEMP_OSMEM_MIGRATE_CONFIG
	string "CONFIG: Project Configure Options"

config PK_PAGING_TEMP_OSMEM_MIGRATE_LIBPATH
	string "LIBS: Libraries to pass to the linker, e.g. -l<library>"

config PK_PAGING_TEMP_OSMEM_MIGRATE_CPPFLAGS
	string "CPPFLAGS: C/C++ preprocessor flags, e.g. -I<include dir>"

config PK_PAGING_TEMP_OSMEM_MIGRATE_DPKCONFIG
	string "PKG_CONFIG_PATH: Directories to add to pkg-config's search path"

config PK_PAGING_TEMP_OSMEM_MIGRATE_CFLAGS
	string "CFLAGS: C compiler flags"

config PK_PAGING_TEMP_OSMEM_MIGRATE_LDFLAGS
	string "LDFLAGS: Linker flags"

config PK_PAGING_TEMP_OSMEM_MIGRATE_CXXFLAGS
	string "CXXFLAGS: C++ compiler flags"

config PK_PAGING_TEMP_OSMEM_MIGRATE_ASFLAGS
	string "CCASFLAGS: assembler compiler flags (defaults to CFLAGS)"

config PK_PAGING_TEMP_OSMEM_MIGRATE_BUILDARCH
	string "--host options on configure for Architecture"

endif # PK_PAGING_TEMP_OSMEM_MIGRATE
```

## package/PAGING/BiscuitOS-PAGING-TOOLS-KPROBE/Kconfig
```kconfig
menuconfig PK_PAGING_TOOLS_KPROBE
	bool "PAGING TOOLS: Kprobe"

if PK_PAGING_TOOLS_KPROBE

config PK_PAGING_TOOLS_KPROBE_VERSION
	default "default"
	string "verstion"

config PK_PAGING_TOOLS_KPROBE_TAR
	default "tar.gz"
	string "tar type"

config PK_PAGING_TOOLS_KPROBE_URL
	default "https://gitee.com/BiscuitOS_team/HardStack/raw/Gitee/Memory-Allocator/PAGING-MECH/BiscuitOS-PAGING-TOOLS-KPROBE"
	string "url"

config PK_PAGING_TOOLS_KPROBE_GITHUB
	string "GitHub"

config PK_PAGING_TOOLS_KPROBE_SRCFILE
	default "main.c Makefile RunBiscuitOS.sh app.c Makefile.host"
	string "Source code list"

config PK_PAGING_TOOLS_KPROBE_CSRCFILE
	string "Compile source code list"

config PK_PAGING_TOOLS_KPROBE_CONFIG
	string "CONFIG: Project Configure Options"

config PK_PAGING_TOOLS_KPROBE_LIBPATH
	string "LIBS: Libraries to pass to the linker, e.g. -l<library>"

config PK_PAGING_TOOLS_KPROBE_CPPFLAGS
	string "CPPFLAGS: C/C++ preprocessor flags, e.g. -I<include dir>"

config PK_PAGING_TOOLS_KPROBE_DPKCONFIG
	string "PKG_CONFIG_PATH: Directories to add to pkg-config's search path"

config PK_PAGING_TOOLS_KPROBE_CFLAGS
	string "CFLAGS: C compiler flags"

config PK_PAGING_TOOLS_KPROBE_LDFLAGS
	string "LDFLAGS: Linker flags"

config PK_PAGING_TOOLS_KPROBE_CXXFLAGS
	string "CXXFLAGS: C++ compiler flags"

config PK_PAGING_TOOLS_KPROBE_ASFLAGS
	string "CCASFLAGS: assembler compiler flags (defaults to CFLAGS)"

config PK_PAGING_TOOLS_KPROBE_BUILDARCH
	string "--host options on configure for Architecture"

endif # PK_PAGING_TOOLS_KPROBE
```

## package/PAGING/BiscuitOS-PAGING-UMSPA-STRICT-OSMEM/Kconfig
```kconfig
menuconfig PK_PAGING_UMSPA_STRICT_OSMEM
	bool "UMSPA: STRICT OSMEM"

if PK_PAGING_UMSPA_STRICT_OSMEM

config PK_PAGING_UMSPA_STRICT_OSMEM_VERSION
	default "default"
	string "verstion"

config PK_PAGING_UMSPA_STRICT_OSMEM_TAR
	default "tar.gz"
	string "tar type"

config PK_PAGING_UMSPA_STRICT_OSMEM_URL
	default "https://gitee.com/BiscuitOS_team/HardStack/raw/Gitee/Memory-Allocator/PAGING-MECH/BiscuitOS-PAGING-UMSPA-STRICT-OSMEM"
	string "url"

config PK_PAGING_UMSPA_STRICT_OSMEM_GITHUB
	string "GitHub"

config PK_PAGING_UMSPA_STRICT_OSMEM_SRCFILE
	default "main.c Makefile RunBiscuitOS.sh"
	string "Source code list"

config PK_PAGING_UMSPA_STRICT_OSMEM_CSRCFILE
	string "Compile source code list"

config PK_PAGING_UMSPA_STRICT_OSMEM_CONFIG
	string "CONFIG: Project Configure Options"

config PK_PAGING_UMSPA_STRICT_OSMEM_LIBPATH
	string "LIBS: Libraries to pass to the linker, e.g. -l<library>"

config PK_PAGING_UMSPA_STRICT_OSMEM_CPPFLAGS
	string "CPPFLAGS: C/C++ preprocessor flags, e.g. -I<include dir>"

config PK_PAGING_UMSPA_STRICT_OSMEM_DPKCONFIG
	string "PKG_CONFIG_PATH: Directories to add to pkg-config's search path"

config PK_PAGING_UMSPA_STRICT_OSMEM_CFLAGS
	string "CFLAGS: C compiler flags"

config PK_PAGING_UMSPA_STRICT_OSMEM_LDFLAGS
	string "LDFLAGS: Linker flags"

config PK_PAGING_UMSPA_STRICT_OSMEM_CXXFLAGS
	string "CXXFLAGS: C++ compiler flags"

config PK_PAGING_UMSPA_STRICT_OSMEM_ASFLAGS
	string "CCASFLAGS: assembler compiler flags (defaults to CFLAGS)"

config PK_PAGING_UMSPA_STRICT_OSMEM_BUILDARCH
	string "--host options on configure for Architecture"

endif # PK_PAGING_UMSPA_STRICT_OSMEM
```

## package/PAGING/BiscuitOS-PAGING-VM-EARLY-IO-RSVDMEM/Kconfig
```kconfig
menuconfig PK_PAGING_VM_EARLY_IO_RSVDMEM
	bool "EARLY MMIO/RSVDMEM MAPPING: RSVDMEM"

if PK_PAGING_VM_EARLY_IO_RSVDMEM

config PK_PAGING_VM_EARLY_IO_RSVDMEM_VERSION
	default "default"
	string "verstion"

config PK_PAGING_VM_EARLY_IO_RSVDMEM_TAR
	default "tar.gz"
	string "tar type"

config PK_PAGING_VM_EARLY_IO_RSVDMEM_URL
	default "https://gitee.com/BiscuitOS_team/HardStack/raw/Gitee/Memory-Allocator/PAGING-MECH/BiscuitOS-PAGING-VM-EARLY-IO-RSVDMEM"
	string "url"

config PK_PAGING_VM_EARLY_IO_RSVDMEM_GITHUB
	string "GitHub"

config PK_PAGING_VM_EARLY_IO_RSVDMEM_SRCFILE
	default "main.c Makefile Kconfig BiscuitOS_Insert.bs"
	string "Source code list"

config PK_PAGING_VM_EARLY_IO_RSVDMEM_CSRCFILE
	string "Compile source code list"

config PK_PAGING_VM_EARLY_IO_RSVDMEM_CONFIG
	string "CONFIG: Project Configure Options"

config PK_PAGING_VM_EARLY_IO_RSVDMEM_LIBPATH
	string "LIBS: Libraries to pass to the linker, e.g. -l<library>"

config PK_PAGING_VM_EARLY_IO_RSVDMEM_CPPFLAGS
	string "CPPFLAGS: C/C++ preprocessor flags, e.g. -I<include dir>"

config PK_PAGING_VM_EARLY_IO_RSVDMEM_DPKCONFIG
	string "PKG_CONFIG_PATH: Directories to add to pkg-config's search path"

config PK_PAGING_VM_EARLY_IO_RSVDMEM_CFLAGS
	string "CFLAGS: C compiler flags"

config PK_PAGING_VM_EARLY_IO_RSVDMEM_LDFLAGS
	string "LDFLAGS: Linker flags"

config PK_PAGING_VM_EARLY_IO_RSVDMEM_CXXFLAGS
	string "CXXFLAGS: C++ compiler flags"

config PK_PAGING_VM_EARLY_IO_RSVDMEM_ASFLAGS
	string "CCASFLAGS: assembler compiler flags (defaults to CFLAGS)"

config PK_PAGING_VM_EARLY_IO_RSVDMEM_BUILDARCH
	string "--host options on configure for Architecture"

endif # PK_PAGING_VM_EARLY_IO_RSVDMEM
```

## package/PAGING/BiscuitOS-PAGING-VM-LAZYALLOC-DAX/Kconfig
```kconfig
menuconfig PK_PAGING_VM_LAZYALLOC_DAX
	select PK_E2FSPROGS
	bool "USER LAZYALLOC: DAX Memory"

if PK_PAGING_VM_LAZYALLOC_DAX

config PK_PAGING_VM_LAZYALLOC_DAX_VERSION
	default "default"
	string "verstion"

config PK_PAGING_VM_LAZYALLOC_DAX_TAR
	default "tar.gz"
	string "tar type"

config PK_PAGING_VM_LAZYALLOC_DAX_URL
	default "https://gitee.com/BiscuitOS_team/HardStack/raw/Gitee/Memory-Allocator/PAGING-MECH/BiscuitOS-PAGING-VM-LAZYALLOC-DAX"
	string "url"

config PK_PAGING_VM_LAZYALLOC_DAX_GITHUB
	string "GitHub"

config PK_PAGING_VM_LAZYALLOC_DAX_SRCFILE
	default "main.c Makefile RunBiscuitOS.sh"
	string "Source code list"

config PK_PAGING_VM_LAZYALLOC_DAX_CSRCFILE
	string "Compile source code list"

config PK_PAGING_VM_LAZYALLOC_DAX_CONFIG
	string "CONFIG: Project Configure Options"

config PK_PAGING_VM_LAZYALLOC_DAX_LIBPATH
	string "LIBS: Libraries to pass to the linker, e.g. -l<library>"

config PK_PAGING_VM_LAZYALLOC_DAX_CPPFLAGS
	string "CPPFLAGS: C/C++ preprocessor flags, e.g. -I<include dir>"

config PK_PAGING_VM_LAZYALLOC_DAX_DPKCONFIG
	string "PKG_CONFIG_PATH: Directories to add to pkg-config's search path"

config PK_PAGING_VM_LAZYALLOC_DAX_CFLAGS
	string "CFLAGS: C compiler flags"

config PK_PAGING_VM_LAZYALLOC_DAX_LDFLAGS
	string "LDFLAGS: Linker flags"

config PK_PAGING_VM_LAZYALLOC_DAX_CXXFLAGS
	string "CXXFLAGS: C++ compiler flags"

config PK_PAGING_VM_LAZYALLOC_DAX_ASFLAGS
	string "CCASFLAGS: assembler compiler flags (defaults to CFLAGS)"

config PK_PAGING_VM_LAZYALLOC_DAX_BUILDARCH
	string "--host options on configure for Architecture"

endif # PK_PAGING_VM_LAZYALLOC_DAX
```

## package/PAGING/BiscuitOS-PAGING-VM-LAZYALLOC-FILE/Kconfig
```kconfig
menuconfig PK_PAGING_VM_LAZYALLOC_FILE
	bool "USER LAZYALLOC: FILE-MAPPING Memory"

if PK_PAGING_VM_LAZYALLOC_FILE

config PK_PAGING_VM_LAZYALLOC_FILE_VERSION
	default "default"
	string "verstion"

config PK_PAGING_VM_LAZYALLOC_FILE_TAR
	default "tar.gz"
	string "tar type"

config PK_PAGING_VM_LAZYALLOC_FILE_URL
	default "https://gitee.com/BiscuitOS_team/HardStack/raw/Gitee/Memory-Allocator/PAGING-MECH/BiscuitOS-PAGING-VM-LAZYALLOC-FILE"
	string "url"

config PK_PAGING_VM_LAZYALLOC_FILE_GITHUB
	string "GitHub"

config PK_PAGING_VM_LAZYALLOC_FILE_SRCFILE
	default "main.c Makefile RunBiscuitOS.sh"
	string "Source code list"

config PK_PAGING_VM_LAZYALLOC_FILE_CSRCFILE
	string "Compile source code list"

config PK_PAGING_VM_LAZYALLOC_FILE_CONFIG
	string "CONFIG: Project Configure Options"

config PK_PAGING_VM_LAZYALLOC_FILE_LIBPATH
	string "LIBS: Libraries to pass to the linker, e.g. -l<library>"

config PK_PAGING_VM_LAZYALLOC_FILE_CPPFLAGS
	string "CPPFLAGS: C/C++ preprocessor flags, e.g. -I<include dir>"

config PK_PAGING_VM_LAZYALLOC_FILE_DPKCONFIG
	string "PKG_CONFIG_PATH: Directories to add to pkg-config's search path"

config PK_PAGING_VM_LAZYALLOC_FILE_CFLAGS
	string "CFLAGS: C compiler flags"

config PK_PAGING_VM_LAZYALLOC_FILE_LDFLAGS
	string "LDFLAGS: Linker flags"

config PK_PAGING_VM_LAZYALLOC_FILE_CXXFLAGS
	string "CXXFLAGS: C++ compiler flags"

config PK_PAGING_VM_LAZYALLOC_FILE_ASFLAGS
	string "CCASFLAGS: assembler compiler flags (defaults to CFLAGS)"

config PK_PAGING_VM_LAZYALLOC_FILE_BUILDARCH
	string "--host options on configure for Architecture"

endif # PK_PAGING_VM_LAZYALLOC_FILE
```
