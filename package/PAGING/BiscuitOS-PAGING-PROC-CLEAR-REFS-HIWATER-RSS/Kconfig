## package/PAGING/BiscuitOS-PAGING-PROC-SMAPS-ANONHUGEPAGES/Kconfig
```kconfig
menuconfig PK_PAGING_PROC_SMAPS_ANONHUGEPAGES
	bool "PROC SMAPS with Anonymous HugePage(THP)"

if PK_PAGING_PROC_SMAPS_ANONHUGEPAGES

config PK_PAGING_PROC_SMAPS_ANONHUGEPAGES_VERSION
	default "default"
	string "verstion"

config PK_PAGING_PROC_SMAPS_ANONHUGEPAGES_TAR
	default "tar.gz"
	string "tar type"

config PK_PAGING_PROC_SMAPS_ANONHUGEPAGES_URL
	default "https://gitee.com/BiscuitOS_team/HardStack/raw/Gitee/Memory-Allocator/PAGING-MECH/BiscuitOS-PAGING-PROC-SMAPS-ANONHUGEPAGES"
	string "url"

config PK_PAGING_PROC_SMAPS_ANONHUGEPAGES_GITHUB
	string "GitHub"

config PK_PAGING_PROC_SMAPS_ANONHUGEPAGES_SRCFILE
	default "main.c Makefile RunBiscuitOS.sh"
	string "Source code list"

config PK_PAGING_PROC_SMAPS_ANONHUGEPAGES_CSRCFILE
	string "Compile source code list"

config PK_PAGING_PROC_SMAPS_ANONHUGEPAGES_CONFIG
	string "CONFIG: Project Configure Options"

config PK_PAGING_PROC_SMAPS_ANONHUGEPAGES_LIBPATH
	string "LIBS: Libraries to pass to the linker, e.g. -l<library>"

config PK_PAGING_PROC_SMAPS_ANONHUGEPAGES_CPPFLAGS
	string "CPPFLAGS: C/C++ preprocessor flags, e.g. -I<include dir>"

config PK_PAGING_PROC_SMAPS_ANONHUGEPAGES_DPKCONFIG
	string "PKG_CONFIG_PATH: Directories to add to pkg-config's search path"

config PK_PAGING_PROC_SMAPS_ANONHUGEPAGES_CFLAGS
	string "CFLAGS: C compiler flags"

config PK_PAGING_PROC_SMAPS_ANONHUGEPAGES_LDFLAGS
	string "LDFLAGS: Linker flags"

config PK_PAGING_PROC_SMAPS_ANONHUGEPAGES_CXXFLAGS
	string "CXXFLAGS: C++ compiler flags"

config PK_PAGING_PROC_SMAPS_ANONHUGEPAGES_ASFLAGS
	string "CCASFLAGS: assembler compiler flags (defaults to CFLAGS)"

config PK_PAGING_PROC_SMAPS_ANONHUGEPAGES_BUILDARCH
	string "--host options on configure for Architecture"

endif # PK_PAGING_PROC_SMAPS_ANONHUGEPAGES
```

## package/PAGING/BiscuitOS-PAGING-PROC-SMAPS-DIRTY/Kconfig
```kconfig
menuconfig PK_PAGING_PROC_SMAPS_DIRTY
	bool "PROC SMAPS with Dirty/Clean Memory"

if PK_PAGING_PROC_SMAPS_DIRTY

config PK_PAGING_PROC_SMAPS_DIRTY_VERSION
	default "default"
	string "verstion"

config PK_PAGING_PROC_SMAPS_DIRTY_TAR
	default "tar.gz"
	string "tar type"

config PK_PAGING_PROC_SMAPS_DIRTY_URL
	default "https://gitee.com/BiscuitOS_team/HardStack/raw/Gitee/Memory-Allocator/PAGING-MECH/BiscuitOS-PAGING-PROC-SMAPS-DIRTY"
	string "url"

config PK_PAGING_PROC_SMAPS_DIRTY_GITHUB
	string "GitHub"

config PK_PAGING_PROC_SMAPS_DIRTY_SRCFILE
	default "main.c Makefile RunBiscuitOS.sh"
	string "Source code list"

config PK_PAGING_PROC_SMAPS_DIRTY_CSRCFILE
	string "Compile source code list"

config PK_PAGING_PROC_SMAPS_DIRTY_CONFIG
	string "CONFIG: Project Configure Options"

config PK_PAGING_PROC_SMAPS_DIRTY_LIBPATH
	string "LIBS: Libraries to pass to the linker, e.g. -l<library>"

config PK_PAGING_PROC_SMAPS_DIRTY_CPPFLAGS
	string "CPPFLAGS: C/C++ preprocessor flags, e.g. -I<include dir>"

config PK_PAGING_PROC_SMAPS_DIRTY_DPKCONFIG
	string "PKG_CONFIG_PATH: Directories to add to pkg-config's search path"

config PK_PAGING_PROC_SMAPS_DIRTY_CFLAGS
	string "CFLAGS: C compiler flags"

config PK_PAGING_PROC_SMAPS_DIRTY_LDFLAGS
	string "LDFLAGS: Linker flags"

config PK_PAGING_PROC_SMAPS_DIRTY_CXXFLAGS
	string "CXXFLAGS: C++ compiler flags"

config PK_PAGING_PROC_SMAPS_DIRTY_ASFLAGS
	string "CCASFLAGS: assembler compiler flags (defaults to CFLAGS)"

config PK_PAGING_PROC_SMAPS_DIRTY_BUILDARCH
	string "--host options on configure for Architecture"

endif # PK_PAGING_PROC_SMAPS_DIRTY
```

## package/PAGING/BiscuitOS-PAGING-PROC-SMAPS-FILE-SHARED/Kconfig
```kconfig
menuconfig PK_PAGING_PROC_SMAPS_FILE_SHARED
	bool "PROC SMAPS with File Shared Memory"

if PK_PAGING_PROC_SMAPS_FILE_SHARED

config PK_PAGING_PROC_SMAPS_FILE_SHARED_VERSION
	default "default"
	string "verstion"

config PK_PAGING_PROC_SMAPS_FILE_SHARED_TAR
	default "tar.gz"
	string "tar type"

config PK_PAGING_PROC_SMAPS_FILE_SHARED_URL
	default "https://gitee.com/BiscuitOS_team/HardStack/raw/Gitee/Memory-Allocator/PAGING-MECH/BiscuitOS-PAGING-PROC-SMAPS-FILE-SHARED"
	string "url"

config PK_PAGING_PROC_SMAPS_FILE_SHARED_GITHUB
	string "GitHub"

config PK_PAGING_PROC_SMAPS_FILE_SHARED_SRCFILE
	default "main.c Makefile RunBiscuitOS.sh"
	string "Source code list"

config PK_PAGING_PROC_SMAPS_FILE_SHARED_CSRCFILE
	string "Compile source code list"

config PK_PAGING_PROC_SMAPS_FILE_SHARED_CONFIG
	string "CONFIG: Project Configure Options"

config PK_PAGING_PROC_SMAPS_FILE_SHARED_LIBPATH
	string "LIBS: Libraries to pass to the linker, e.g. -l<library>"

config PK_PAGING_PROC_SMAPS_FILE_SHARED_CPPFLAGS
	string "CPPFLAGS: C/C++ preprocessor flags, e.g. -I<include dir>"

config PK_PAGING_PROC_SMAPS_FILE_SHARED_DPKCONFIG
	string "PKG_CONFIG_PATH: Directories to add to pkg-config's search path"

config PK_PAGING_PROC_SMAPS_FILE_SHARED_CFLAGS
	string "CFLAGS: C compiler flags"

config PK_PAGING_PROC_SMAPS_FILE_SHARED_LDFLAGS
	string "LDFLAGS: Linker flags"

config PK_PAGING_PROC_SMAPS_FILE_SHARED_CXXFLAGS
	string "CXXFLAGS: C++ compiler flags"

config PK_PAGING_PROC_SMAPS_FILE_SHARED_ASFLAGS
	string "CCASFLAGS: assembler compiler flags (defaults to CFLAGS)"

config PK_PAGING_PROC_SMAPS_FILE_SHARED_BUILDARCH
	string "--host options on configure for Architecture"

endif # PK_PAGING_PROC_SMAPS_FILE_SHARED
```

## package/PAGING/BiscuitOS-PAGING-PROC-SMAPS-FILEPMDMAPPED/Kconfig
```kconfig
menuconfig PK_PAGING_PROC_SMAPS_FILEPMDMAPPED
	bool "PROC SMAPS with File PMD-Mapped Memory"

if PK_PAGING_PROC_SMAPS_FILEPMDMAPPED

config PK_PAGING_PROC_SMAPS_FILEPMDMAPPED_VERSION
	default "default"
	string "verstion"

config PK_PAGING_PROC_SMAPS_FILEPMDMAPPED_TAR
	default "tar.gz"
	string "tar type"

config PK_PAGING_PROC_SMAPS_FILEPMDMAPPED_URL
	default "https://gitee.com/BiscuitOS_team/HardStack/raw/Gitee/Memory-Allocator/PAGING-MECH/BiscuitOS-PAGING-PROC-SMAPS-FILEPMDMAPPED"
	string "url"

config PK_PAGING_PROC_SMAPS_FILEPMDMAPPED_GITHUB
	string "GitHub"

config PK_PAGING_PROC_SMAPS_FILEPMDMAPPED_SRCFILE
	default "app.c Kconfig Makefile.app main.c Makefile RunBiscuitOS.sh"
	string "Source code list"

config PK_PAGING_PROC_SMAPS_FILEPMDMAPPED_CSRCFILE
	string "Compile source code list"

config PK_PAGING_PROC_SMAPS_FILEPMDMAPPED_CONFIG
	string "CONFIG: Project Configure Options"

config PK_PAGING_PROC_SMAPS_FILEPMDMAPPED_LIBPATH
	string "LIBS: Libraries to pass to the linker, e.g. -l<library>"

config PK_PAGING_PROC_SMAPS_FILEPMDMAPPED_CPPFLAGS
	string "CPPFLAGS: C/C++ preprocessor flags, e.g. -I<include dir>"

config PK_PAGING_PROC_SMAPS_FILEPMDMAPPED_DPKCONFIG
	string "PKG_CONFIG_PATH: Directories to add to pkg-config's search path"

config PK_PAGING_PROC_SMAPS_FILEPMDMAPPED_CFLAGS
	string "CFLAGS: C compiler flags"

config PK_PAGING_PROC_SMAPS_FILEPMDMAPPED_LDFLAGS
	string "LDFLAGS: Linker flags"

config PK_PAGING_PROC_SMAPS_FILEPMDMAPPED_CXXFLAGS
	string "CXXFLAGS: C++ compiler flags"

config PK_PAGING_PROC_SMAPS_FILEPMDMAPPED_ASFLAGS
	string "CCASFLAGS: assembler compiler flags (defaults to CFLAGS)"

config PK_PAGING_PROC_SMAPS_FILEPMDMAPPED_BUILDARCH
	string "--host options on configure for Architecture"

endif # PK_PAGING_PROC_SMAPS_FILEPMDMAPPED
```

## package/PAGING/BiscuitOS-PAGING-PROC-SMAPS-LOCKED/Kconfig
```kconfig
menuconfig PK_PAGING_PROC_SMAPS_LOCKED
	bool "PROC SMAPS with LOCKED Memory"

if PK_PAGING_PROC_SMAPS_LOCKED

config PK_PAGING_PROC_SMAPS_LOCKED_VERSION
	default "default"
	string "verstion"

config PK_PAGING_PROC_SMAPS_LOCKED_TAR
	default "tar.gz"
	string "tar type"

config PK_PAGING_PROC_SMAPS_LOCKED_URL
	default "https://gitee.com/BiscuitOS_team/HardStack/raw/Gitee/Memory-Allocator/PAGING-MECH/BiscuitOS-PAGING-PROC-SMAPS-LOCKED"
	string "url"

config PK_PAGING_PROC_SMAPS_LOCKED_GITHUB
	string "GitHub"

config PK_PAGING_PROC_SMAPS_LOCKED_SRCFILE
	default "main.c Makefile RunBiscuitOS.sh"
	string "Source code list"

config PK_PAGING_PROC_SMAPS_LOCKED_CSRCFILE
	string "Compile source code list"

config PK_PAGING_PROC_SMAPS_LOCKED_CONFIG
	string "CONFIG: Project Configure Options"

config PK_PAGING_PROC_SMAPS_LOCKED_LIBPATH
	string "LIBS: Libraries to pass to the linker, e.g. -l<library>"

config PK_PAGING_PROC_SMAPS_LOCKED_CPPFLAGS
	string "CPPFLAGS: C/C++ preprocessor flags, e.g. -I<include dir>"

config PK_PAGING_PROC_SMAPS_LOCKED_DPKCONFIG
	string "PKG_CONFIG_PATH: Directories to add to pkg-config's search path"

config PK_PAGING_PROC_SMAPS_LOCKED_CFLAGS
	string "CFLAGS: C compiler flags"

config PK_PAGING_PROC_SMAPS_LOCKED_LDFLAGS
	string "LDFLAGS: Linker flags"

config PK_PAGING_PROC_SMAPS_LOCKED_CXXFLAGS
	string "CXXFLAGS: C++ compiler flags"

config PK_PAGING_PROC_SMAPS_LOCKED_ASFLAGS
	string "CCASFLAGS: assembler compiler flags (defaults to CFLAGS)"

config PK_PAGING_PROC_SMAPS_LOCKED_BUILDARCH
	string "--host options on configure for Architecture"

endif # PK_PAGING_PROC_SMAPS_LOCKED
```

## package/PAGING/BiscuitOS-PAGING-PROC-SMAPS-PSS/Kconfig
```kconfig
menuconfig PK_PAGING_PROC_SMAPS_PSS
	bool "PROC SMAPS with PSS"

if PK_PAGING_PROC_SMAPS_PSS

config PK_PAGING_PROC_SMAPS_PSS_VERSION
	default "default"
	string "verstion"

config PK_PAGING_PROC_SMAPS_PSS_TAR
	default "tar.gz"
	string "tar type"

config PK_PAGING_PROC_SMAPS_PSS_URL
	default "https://gitee.com/BiscuitOS_team/HardStack/raw/Gitee/Memory-Allocator/PAGING-MECH/BiscuitOS-PAGING-PROC-SMAPS-PSS"
	string "url"

config PK_PAGING_PROC_SMAPS_PSS_GITHUB
	string "GitHub"

config PK_PAGING_PROC_SMAPS_PSS_SRCFILE
	default "main.c Makefile RunBiscuitOS.sh"
	string "Source code list"

config PK_PAGING_PROC_SMAPS_PSS_CSRCFILE
	string "Compile source code list"

config PK_PAGING_PROC_SMAPS_PSS_CONFIG
	string "CONFIG: Project Configure Options"

config PK_PAGING_PROC_SMAPS_PSS_LIBPATH
	string "LIBS: Libraries to pass to the linker, e.g. -l<library>"

config PK_PAGING_PROC_SMAPS_PSS_CPPFLAGS
	string "CPPFLAGS: C/C++ preprocessor flags, e.g. -I<include dir>"

config PK_PAGING_PROC_SMAPS_PSS_DPKCONFIG
	string "PKG_CONFIG_PATH: Directories to add to pkg-config's search path"

config PK_PAGING_PROC_SMAPS_PSS_CFLAGS
	string "CFLAGS: C compiler flags"

config PK_PAGING_PROC_SMAPS_PSS_LDFLAGS
	string "LDFLAGS: Linker flags"

config PK_PAGING_PROC_SMAPS_PSS_CXXFLAGS
	string "CXXFLAGS: C++ compiler flags"

config PK_PAGING_PROC_SMAPS_PSS_ASFLAGS
	string "CCASFLAGS: assembler compiler flags (defaults to CFLAGS)"

config PK_PAGING_PROC_SMAPS_PSS_BUILDARCH
	string "--host options on configure for Architecture"

endif # PK_PAGING_PROC_SMAPS_PSS
```

## package/PAGING/BiscuitOS-PAGING-PROC-SMAPS-REFERENCE/Kconfig
```kconfig
menuconfig PK_PAGING_PROC_SMAPS_REFERENCE
	bool "PROC SMAPS with Reference"

if PK_PAGING_PROC_SMAPS_REFERENCE

config PK_PAGING_PROC_SMAPS_REFERENCE_VERSION
	default "default"
	string "verstion"

config PK_PAGING_PROC_SMAPS_REFERENCE_TAR
	default "tar.gz"
	string "tar type"

config PK_PAGING_PROC_SMAPS_REFERENCE_URL
	default "https://gitee.com/BiscuitOS_team/HardStack/raw/Gitee/Memory-Allocator/PAGING-MECH/BiscuitOS-PAGING-PROC-SMAPS-REFERENCE"
	string "url"

config PK_PAGING_PROC_SMAPS_REFERENCE_GITHUB
	string "GitHub"

config PK_PAGING_PROC_SMAPS_REFERENCE_SRCFILE
	default "main.c Makefile RunBiscuitOS.sh"
	string "Source code list"

config PK_PAGING_PROC_SMAPS_REFERENCE_CSRCFILE
	string "Compile source code list"

config PK_PAGING_PROC_SMAPS_REFERENCE_CONFIG
	string "CONFIG: Project Configure Options"

config PK_PAGING_PROC_SMAPS_REFERENCE_LIBPATH
	string "LIBS: Libraries to pass to the linker, e.g. -l<library>"

config PK_PAGING_PROC_SMAPS_REFERENCE_CPPFLAGS
	string "CPPFLAGS: C/C++ preprocessor flags, e.g. -I<include dir>"

config PK_PAGING_PROC_SMAPS_REFERENCE_DPKCONFIG
	string "PKG_CONFIG_PATH: Directories to add to pkg-config's search path"

config PK_PAGING_PROC_SMAPS_REFERENCE_CFLAGS
	string "CFLAGS: C compiler flags"

config PK_PAGING_PROC_SMAPS_REFERENCE_LDFLAGS
	string "LDFLAGS: Linker flags"

config PK_PAGING_PROC_SMAPS_REFERENCE_CXXFLAGS
	string "CXXFLAGS: C++ compiler flags"

config PK_PAGING_PROC_SMAPS_REFERENCE_ASFLAGS
	string "CCASFLAGS: assembler compiler flags (defaults to CFLAGS)"

config PK_PAGING_PROC_SMAPS_REFERENCE_BUILDARCH
	string "--host options on configure for Architecture"

endif # PK_PAGING_PROC_SMAPS_REFERENCE
```

## package/PAGING/BiscuitOS-PAGING-PROC-SMAPS-ROLLUP/Kconfig
```kconfig
menuconfig PK_PAGING_PROC_SMAPS_ROLLUP
	bool "PROC SMAPS-ROLLUP"

if PK_PAGING_PROC_SMAPS_ROLLUP

config PK_PAGING_PROC_SMAPS_ROLLUP_VERSION
	default "default"
	string "verstion"

config PK_PAGING_PROC_SMAPS_ROLLUP_TAR
	default "tar.gz"
	string "tar type"

config PK_PAGING_PROC_SMAPS_ROLLUP_URL
	default "https://gitee.com/BiscuitOS_team/HardStack/raw/Gitee/Memory-Allocator/PAGING-MECH/BiscuitOS-PAGING-PROC-SMAPS-ROLLUP"
	string "url"

config PK_PAGING_PROC_SMAPS_ROLLUP_GITHUB
	string "GitHub"

config PK_PAGING_PROC_SMAPS_ROLLUP_SRCFILE
	default "main.c Makefile RunBiscuitOS.sh"
	string "Source code list"

config PK_PAGING_PROC_SMAPS_ROLLUP_CSRCFILE
	string "Compile source code list"

config PK_PAGING_PROC_SMAPS_ROLLUP_CONFIG
	string "CONFIG: Project Configure Options"

config PK_PAGING_PROC_SMAPS_ROLLUP_LIBPATH
	string "LIBS: Libraries to pass to the linker, e.g. -l<library>"

config PK_PAGING_PROC_SMAPS_ROLLUP_CPPFLAGS
	string "CPPFLAGS: C/C++ preprocessor flags, e.g. -I<include dir>"

config PK_PAGING_PROC_SMAPS_ROLLUP_DPKCONFIG
	string "PKG_CONFIG_PATH: Directories to add to pkg-config's search path"

config PK_PAGING_PROC_SMAPS_ROLLUP_CFLAGS
	string "CFLAGS: C compiler flags"

config PK_PAGING_PROC_SMAPS_ROLLUP_LDFLAGS
	string "LDFLAGS: Linker flags"

config PK_PAGING_PROC_SMAPS_ROLLUP_CXXFLAGS
	string "CXXFLAGS: C++ compiler flags"

config PK_PAGING_PROC_SMAPS_ROLLUP_ASFLAGS
	string "CCASFLAGS: assembler compiler flags (defaults to CFLAGS)"

config PK_PAGING_PROC_SMAPS_ROLLUP_BUILDARCH
	string "--host options on configure for Architecture"

endif # PK_PAGING_PROC_SMAPS_ROLLUP
```

## package/PAGING/BiscuitOS-PAGING-PROC-SMAPS-SHARED/Kconfig
```kconfig
menuconfig PK_PAGING_PROC_SMAPS_SHARED
	bool "PROC SMAPS with Shared/Private Memory"

if PK_PAGING_PROC_SMAPS_SHARED

config PK_PAGING_PROC_SMAPS_SHARED_VERSION
	default "default"
	string "verstion"

config PK_PAGING_PROC_SMAPS_SHARED_TAR
	default "tar.gz"
	string "tar type"

config PK_PAGING_PROC_SMAPS_SHARED_URL
	default "https://gitee.com/BiscuitOS_team/HardStack/raw/Gitee/Memory-Allocator/PAGING-MECH/BiscuitOS-PAGING-PROC-SMAPS-SHARED"
	string "url"

config PK_PAGING_PROC_SMAPS_SHARED_GITHUB
	string "GitHub"

config PK_PAGING_PROC_SMAPS_SHARED_SRCFILE
	default "main.c Makefile RunBiscuitOS.sh"
	string "Source code list"

config PK_PAGING_PROC_SMAPS_SHARED_CSRCFILE
	string "Compile source code list"

config PK_PAGING_PROC_SMAPS_SHARED_CONFIG
	string "CONFIG: Project Configure Options"

config PK_PAGING_PROC_SMAPS_SHARED_LIBPATH
	string "LIBS: Libraries to pass to the linker, e.g. -l<library>"

config PK_PAGING_PROC_SMAPS_SHARED_CPPFLAGS
	string "CPPFLAGS: C/C++ preprocessor flags, e.g. -I<include dir>"

config PK_PAGING_PROC_SMAPS_SHARED_DPKCONFIG
	string "PKG_CONFIG_PATH: Directories to add to pkg-config's search path"

config PK_PAGING_PROC_SMAPS_SHARED_CFLAGS
	string "CFLAGS: C compiler flags"

config PK_PAGING_PROC_SMAPS_SHARED_LDFLAGS
	string "LDFLAGS: Linker flags"

config PK_PAGING_PROC_SMAPS_SHARED_CXXFLAGS
	string "CXXFLAGS: C++ compiler flags"

config PK_PAGING_PROC_SMAPS_SHARED_ASFLAGS
	string "CCASFLAGS: assembler compiler flags (defaults to CFLAGS)"

config PK_PAGING_PROC_SMAPS_SHARED_BUILDARCH
	string "--host options on configure for Architecture"

endif # PK_PAGING_PROC_SMAPS_SHARED
```
