## package/PAGING/BiscuitOS-PAGING-PROC-CLEAR-REFS-HIWATER-RSS/Kconfig
```kconfig
menuconfig PK_PAGING_PROC_CLEAR_REFS_HIWATER_RSS
	bool "PROC Clear Referenced with HIWATER RSS"

if PK_PAGING_PROC_CLEAR_REFS_HIWATER_RSS

config PK_PAGING_PROC_CLEAR_REFS_HIWATER_RSS_VERSION
	default "default"
	string "verstion"

config PK_PAGING_PROC_CLEAR_REFS_HIWATER_RSS_TAR
	default "tar.gz"
	string "tar type"

config PK_PAGING_PROC_CLEAR_REFS_HIWATER_RSS_URL
	default "https://gitee.com/BiscuitOS_team/HardStack/raw/Gitee/Memory-Allocator/PAGING-MECH/BiscuitOS-PAGING-PROC-CLEAR-REFS-HIWATER-RSS"
	string "url"

config PK_PAGING_PROC_CLEAR_REFS_HIWATER_RSS_GITHUB
	string "GitHub"

config PK_PAGING_PROC_CLEAR_REFS_HIWATER_RSS_SRCFILE
	default "main.c Makefile RunBiscuitOS.sh"
	string "Source code list"

config PK_PAGING_PROC_CLEAR_REFS_HIWATER_RSS_CSRCFILE
	string "Compile source code list"

config PK_PAGING_PROC_CLEAR_REFS_HIWATER_RSS_CONFIG
	string "CONFIG: Project Configure Options"

config PK_PAGING_PROC_CLEAR_REFS_HIWATER_RSS_LIBPATH
	string "LIBS: Libraries to pass to the linker, e.g. -l<library>"

config PK_PAGING_PROC_CLEAR_REFS_HIWATER_RSS_CPPFLAGS
	string "CPPFLAGS: C/C++ preprocessor flags, e.g. -I<include dir>"

config PK_PAGING_PROC_CLEAR_REFS_HIWATER_RSS_DPKCONFIG
	string "PKG_CONFIG_PATH: Directories to add to pkg-config's search path"

config PK_PAGING_PROC_CLEAR_REFS_HIWATER_RSS_CFLAGS
	string "CFLAGS: C compiler flags"

config PK_PAGING_PROC_CLEAR_REFS_HIWATER_RSS_LDFLAGS
	string "LDFLAGS: Linker flags"

config PK_PAGING_PROC_CLEAR_REFS_HIWATER_RSS_CXXFLAGS
	string "CXXFLAGS: C++ compiler flags"

config PK_PAGING_PROC_CLEAR_REFS_HIWATER_RSS_ASFLAGS
	string "CCASFLAGS: assembler compiler flags (defaults to CFLAGS)"

config PK_PAGING_PROC_CLEAR_REFS_HIWATER_RSS_BUILDARCH
	string "--host options on configure for Architecture"

endif # PK_PAGING_PROC_CLEAR_REFS_HIWATER_RSS
```

## package/PAGING/BiscuitOS-PAGING-PROC-CLEAR-REFS-SOFTDIRTY/Kconfig
```kconfig
menuconfig PK_PAGING_PROC_CLEAR_REFS_SOFTDIRTY
	bool "PROC Clear Referenced with Soft Dirty"

if PK_PAGING_PROC_CLEAR_REFS_SOFTDIRTY

config PK_PAGING_PROC_CLEAR_REFS_SOFTDIRTY_VERSION
	default "default"
	string "verstion"

config PK_PAGING_PROC_CLEAR_REFS_SOFTDIRTY_TAR
	default "tar.gz"
	string "tar type"

config PK_PAGING_PROC_CLEAR_REFS_SOFTDIRTY_URL
	default "https://gitee.com/BiscuitOS_team/HardStack/raw/Gitee/Memory-Allocator/PAGING-MECH/BiscuitOS-PAGING-PROC-CLEAR-REFS-SOFTDIRTY"
	string "url"

config PK_PAGING_PROC_CLEAR_REFS_SOFTDIRTY_GITHUB
	string "GitHub"

config PK_PAGING_PROC_CLEAR_REFS_SOFTDIRTY_SRCFILE
	default "main.c softdirty.c Makefile RunBiscuitOS.sh"
	string "Source code list"

config PK_PAGING_PROC_CLEAR_REFS_SOFTDIRTY_CSRCFILE
	string "Compile source code list"

config PK_PAGING_PROC_CLEAR_REFS_SOFTDIRTY_CONFIG
	string "CONFIG: Project Configure Options"

config PK_PAGING_PROC_CLEAR_REFS_SOFTDIRTY_LIBPATH
	string "LIBS: Libraries to pass to the linker, e.g. -l<library>"

config PK_PAGING_PROC_CLEAR_REFS_SOFTDIRTY_CPPFLAGS
	string "CPPFLAGS: C/C++ preprocessor flags, e.g. -I<include dir>"

config PK_PAGING_PROC_CLEAR_REFS_SOFTDIRTY_DPKCONFIG
	string "PKG_CONFIG_PATH: Directories to add to pkg-config's search path"

config PK_PAGING_PROC_CLEAR_REFS_SOFTDIRTY_CFLAGS
	string "CFLAGS: C compiler flags"

config PK_PAGING_PROC_CLEAR_REFS_SOFTDIRTY_LDFLAGS
	string "LDFLAGS: Linker flags"

config PK_PAGING_PROC_CLEAR_REFS_SOFTDIRTY_CXXFLAGS
	string "CXXFLAGS: C++ compiler flags"

config PK_PAGING_PROC_CLEAR_REFS_SOFTDIRTY_ASFLAGS
	string "CCASFLAGS: assembler compiler flags (defaults to CFLAGS)"

config PK_PAGING_PROC_CLEAR_REFS_SOFTDIRTY_BUILDARCH
	string "--host options on configure for Architecture"

endif # PK_PAGING_PROC_CLEAR_REFS_SOFTDIRTY
```

## package/PAGING/BiscuitOS-PAGING-PROC-CLEAR-REFS/Kconfig
```kconfig
menuconfig PK_PAGING_PROC_CLEAR_REFS
	bool "PROC Clear Referenced"

if PK_PAGING_PROC_CLEAR_REFS

config PK_PAGING_PROC_CLEAR_REFS_VERSION
	default "default"
	string "verstion"

config PK_PAGING_PROC_CLEAR_REFS_TAR
	default "tar.gz"
	string "tar type"

config PK_PAGING_PROC_CLEAR_REFS_URL
	default "https://gitee.com/BiscuitOS_team/HardStack/raw/Gitee/Memory-Allocator/PAGING-MECH/BiscuitOS-PAGING-PROC-CLEAR-REFS"
	string "url"

config PK_PAGING_PROC_CLEAR_REFS_GITHUB
	string "GitHub"

config PK_PAGING_PROC_CLEAR_REFS_SRCFILE
	default "main.c Makefile RunBiscuitOS.sh"
	string "Source code list"

config PK_PAGING_PROC_CLEAR_REFS_CSRCFILE
	string "Compile source code list"

config PK_PAGING_PROC_CLEAR_REFS_CONFIG
	string "CONFIG: Project Configure Options"

config PK_PAGING_PROC_CLEAR_REFS_LIBPATH
	string "LIBS: Libraries to pass to the linker, e.g. -l<library>"

config PK_PAGING_PROC_CLEAR_REFS_CPPFLAGS
	string "CPPFLAGS: C/C++ preprocessor flags, e.g. -I<include dir>"

config PK_PAGING_PROC_CLEAR_REFS_DPKCONFIG
	string "PKG_CONFIG_PATH: Directories to add to pkg-config's search path"

config PK_PAGING_PROC_CLEAR_REFS_CFLAGS
	string "CFLAGS: C compiler flags"

config PK_PAGING_PROC_CLEAR_REFS_LDFLAGS
	string "LDFLAGS: Linker flags"

config PK_PAGING_PROC_CLEAR_REFS_CXXFLAGS
	string "CXXFLAGS: C++ compiler flags"

config PK_PAGING_PROC_CLEAR_REFS_ASFLAGS
	string "CCASFLAGS: assembler compiler flags (defaults to CFLAGS)"

config PK_PAGING_PROC_CLEAR_REFS_BUILDARCH
	string "--host options on configure for Architecture"

endif # PK_PAGING_PROC_CLEAR_REFS
```

## package/PAGING/BiscuitOS-PAGING-PROC-PageMap-ANON/Kconfig
```kconfig
menuconfig PK_PAGING_PROC_PAGEMAP_ANON
	bool "PROC PageMap with Anonymous"

if PK_PAGING_PROC_PAGEMAP_ANON

config PK_PAGING_PROC_PAGEMAP_ANON_VERSION
	default "default"
	string "verstion"

config PK_PAGING_PROC_PAGEMAP_ANON_TAR
	default "tar.gz"
	string "tar type"

config PK_PAGING_PROC_PAGEMAP_ANON_URL
	default "https://gitee.com/BiscuitOS_team/HardStack/raw/Gitee/Memory-Allocator/PAGING-MECH/BiscuitOS-PAGING-PROC-PageMap-ANON"
	string "url"

config PK_PAGING_PROC_PAGEMAP_ANON_GITHUB
	string "GitHub"

config PK_PAGING_PROC_PAGEMAP_ANON_SRCFILE
	default "main.c Makefile RunBiscuitOS.sh"
	string "Source code list"

config PK_PAGING_PROC_PAGEMAP_ANON_CSRCFILE
	string "Compile source code list"

config PK_PAGING_PROC_PAGEMAP_ANON_CONFIG
	string "CONFIG: Project Configure Options"

config PK_PAGING_PROC_PAGEMAP_ANON_LIBPATH
	string "LIBS: Libraries to pass to the linker, e.g. -l<library>"

config PK_PAGING_PROC_PAGEMAP_ANON_CPPFLAGS
	string "CPPFLAGS: C/C++ preprocessor flags, e.g. -I<include dir>"

config PK_PAGING_PROC_PAGEMAP_ANON_DPKCONFIG
	string "PKG_CONFIG_PATH: Directories to add to pkg-config's search path"

config PK_PAGING_PROC_PAGEMAP_ANON_CFLAGS
	string "CFLAGS: C compiler flags"

config PK_PAGING_PROC_PAGEMAP_ANON_LDFLAGS
	string "LDFLAGS: Linker flags"

config PK_PAGING_PROC_PAGEMAP_ANON_CXXFLAGS
	string "CXXFLAGS: C++ compiler flags"

config PK_PAGING_PROC_PAGEMAP_ANON_ASFLAGS
	string "CCASFLAGS: assembler compiler flags (defaults to CFLAGS)"

config PK_PAGING_PROC_PAGEMAP_ANON_BUILDARCH
	string "--host options on configure for Architecture"

endif # PK_PAGING_PROC_PAGEMAP_ANON
```

## package/PAGING/BiscuitOS-PAGING-PROC-PageMap-FILE/Kconfig
```kconfig
menuconfig PK_PAGING_PROC_PAGEMAP_FILE
	bool "PROC PageMap with File"

if PK_PAGING_PROC_PAGEMAP_FILE

config PK_PAGING_PROC_PAGEMAP_FILE_VERSION
	default "default"
	string "verstion"

config PK_PAGING_PROC_PAGEMAP_FILE_TAR
	default "tar.gz"
	string "tar type"

config PK_PAGING_PROC_PAGEMAP_FILE_URL
	default "https://gitee.com/BiscuitOS_team/HardStack/raw/Gitee/Memory-Allocator/PAGING-MECH/BiscuitOS-PAGING-PROC-PageMap-FILE"
	string "url"

config PK_PAGING_PROC_PAGEMAP_FILE_GITHUB
	string "GitHub"

config PK_PAGING_PROC_PAGEMAP_FILE_SRCFILE
	default "main.c Makefile RunBiscuitOS.sh"
	string "Source code list"

config PK_PAGING_PROC_PAGEMAP_FILE_CSRCFILE
	string "Compile source code list"

config PK_PAGING_PROC_PAGEMAP_FILE_CONFIG
	string "CONFIG: Project Configure Options"

config PK_PAGING_PROC_PAGEMAP_FILE_LIBPATH
	string "LIBS: Libraries to pass to the linker, e.g. -l<library>"

config PK_PAGING_PROC_PAGEMAP_FILE_CPPFLAGS
	string "CPPFLAGS: C/C++ preprocessor flags, e.g. -I<include dir>"

config PK_PAGING_PROC_PAGEMAP_FILE_DPKCONFIG
	string "PKG_CONFIG_PATH: Directories to add to pkg-config's search path"

config PK_PAGING_PROC_PAGEMAP_FILE_CFLAGS
	string "CFLAGS: C compiler flags"

config PK_PAGING_PROC_PAGEMAP_FILE_LDFLAGS
	string "LDFLAGS: Linker flags"

config PK_PAGING_PROC_PAGEMAP_FILE_CXXFLAGS
	string "CXXFLAGS: C++ compiler flags"

config PK_PAGING_PROC_PAGEMAP_FILE_ASFLAGS
	string "CCASFLAGS: assembler compiler flags (defaults to CFLAGS)"

config PK_PAGING_PROC_PAGEMAP_FILE_BUILDARCH
	string "--host options on configure for Architecture"

endif # PK_PAGING_PROC_PAGEMAP_FILE
```

## package/PAGING/BiscuitOS-PAGING-PROC-PageMap-HOLE/Kconfig
```kconfig
menuconfig PK_PAGING_PROC_PAGEMAP_HOLE
	bool "PROC PageMap with HOLE"

if PK_PAGING_PROC_PAGEMAP_HOLE

config PK_PAGING_PROC_PAGEMAP_HOLE_VERSION
	default "default"
	string "verstion"

config PK_PAGING_PROC_PAGEMAP_HOLE_TAR
	default "tar.gz"
	string "tar type"

config PK_PAGING_PROC_PAGEMAP_HOLE_URL
	default "https://gitee.com/BiscuitOS_team/HardStack/raw/Gitee/Memory-Allocator/PAGING-MECH/BiscuitOS-PAGING-PROC-PageMap-HOLE"
	string "url"

config PK_PAGING_PROC_PAGEMAP_HOLE_GITHUB
	string "GitHub"

config PK_PAGING_PROC_PAGEMAP_HOLE_SRCFILE
	default "main.c Makefile RunBiscuitOS.sh"
	string "Source code list"

config PK_PAGING_PROC_PAGEMAP_HOLE_CSRCFILE
	string "Compile source code list"

config PK_PAGING_PROC_PAGEMAP_HOLE_CONFIG
	string "CONFIG: Project Configure Options"

config PK_PAGING_PROC_PAGEMAP_HOLE_LIBPATH
	string "LIBS: Libraries to pass to the linker, e.g. -l<library>"

config PK_PAGING_PROC_PAGEMAP_HOLE_CPPFLAGS
	string "CPPFLAGS: C/C++ preprocessor flags, e.g. -I<include dir>"

config PK_PAGING_PROC_PAGEMAP_HOLE_DPKCONFIG
	string "PKG_CONFIG_PATH: Directories to add to pkg-config's search path"

config PK_PAGING_PROC_PAGEMAP_HOLE_CFLAGS
	string "CFLAGS: C compiler flags"

config PK_PAGING_PROC_PAGEMAP_HOLE_LDFLAGS
	string "LDFLAGS: Linker flags"

config PK_PAGING_PROC_PAGEMAP_HOLE_CXXFLAGS
	string "CXXFLAGS: C++ compiler flags"

config PK_PAGING_PROC_PAGEMAP_HOLE_ASFLAGS
	string "CCASFLAGS: assembler compiler flags (defaults to CFLAGS)"

config PK_PAGING_PROC_PAGEMAP_HOLE_BUILDARCH
	string "--host options on configure for Architecture"

endif # PK_PAGING_PROC_PAGEMAP_HOLE
```

## package/PAGING/BiscuitOS-PAGING-PROC-PageMap-MMIO/Kconfig
```kconfig
menuconfig PK_PAGING_PROC_PAGEMAP_MMIO
	bool "PROC PageMap with MMIO"

if PK_PAGING_PROC_PAGEMAP_MMIO

config PK_PAGING_PROC_PAGEMAP_MMIO_VERSION
	default "default"
	string "verstion"

config PK_PAGING_PROC_PAGEMAP_MMIO_TAR
	default "tar.gz"
	string "tar type"

config PK_PAGING_PROC_PAGEMAP_MMIO_URL
	default "https://gitee.com/BiscuitOS_team/HardStack/raw/Gitee/Memory-Allocator/PAGING-MECH/BiscuitOS-PAGING-PROC-PageMap-MMIO"
	string "url"

config PK_PAGING_PROC_PAGEMAP_MMIO_GITHUB
	string "GitHub"

config PK_PAGING_PROC_PAGEMAP_MMIO_SRCFILE
	default "main.c Makefile RunBiscuitOS.sh app.c Kconfig Makefile.host"
	string "Source code list"

config PK_PAGING_PROC_PAGEMAP_MMIO_CSRCFILE
	string "Compile source code list"

config PK_PAGING_PROC_PAGEMAP_MMIO_CONFIG
	string "CONFIG: Project Configure Options"

config PK_PAGING_PROC_PAGEMAP_MMIO_LIBPATH
	string "LIBS: Libraries to pass to the linker, e.g. -l<library>"

config PK_PAGING_PROC_PAGEMAP_MMIO_CPPFLAGS
	string "CPPFLAGS: C/C++ preprocessor flags, e.g. -I<include dir>"

config PK_PAGING_PROC_PAGEMAP_MMIO_DPKCONFIG
	string "PKG_CONFIG_PATH: Directories to add to pkg-config's search path"

config PK_PAGING_PROC_PAGEMAP_MMIO_CFLAGS
	string "CFLAGS: C compiler flags"

config PK_PAGING_PROC_PAGEMAP_MMIO_LDFLAGS
	string "LDFLAGS: Linker flags"

config PK_PAGING_PROC_PAGEMAP_MMIO_CXXFLAGS
	string "CXXFLAGS: C++ compiler flags"

config PK_PAGING_PROC_PAGEMAP_MMIO_ASFLAGS
	string "CCASFLAGS: assembler compiler flags (defaults to CFLAGS)"

config PK_PAGING_PROC_PAGEMAP_MMIO_BUILDARCH
	string "--host options on configure for Architecture"

endif # PK_PAGING_PROC_PAGEMAP_MMIO
```

## package/PAGING/BiscuitOS-PAGING-PROC-PageMap/Kconfig
```kconfig
menuconfig PK_PAGING_PROC_PAGEMAP
	bool "PROC PageMap"

if PK_PAGING_PROC_PAGEMAP

config PK_PAGING_PROC_PAGEMAP_VERSION
	default "default"
	string "verstion"

config PK_PAGING_PROC_PAGEMAP_TAR
	default "tar.gz"
	string "tar type"

config PK_PAGING_PROC_PAGEMAP_URL
	default "https://gitee.com/BiscuitOS_team/HardStack/raw/Gitee/Memory-Allocator/PAGING-MECH/BiscuitOS-PAGING-PROC-PageMap"
	string "url"

config PK_PAGING_PROC_PAGEMAP_GITHUB
	string "GitHub"

config PK_PAGING_PROC_PAGEMAP_SRCFILE
	default "main.c Makefile RunBiscuitOS.sh"
	string "Source code list"

config PK_PAGING_PROC_PAGEMAP_CSRCFILE
	string "Compile source code list"

config PK_PAGING_PROC_PAGEMAP_CONFIG
	string "CONFIG: Project Configure Options"

config PK_PAGING_PROC_PAGEMAP_LIBPATH
	string "LIBS: Libraries to pass to the linker, e.g. -l<library>"

config PK_PAGING_PROC_PAGEMAP_CPPFLAGS
	string "CPPFLAGS: C/C++ preprocessor flags, e.g. -I<include dir>"

config PK_PAGING_PROC_PAGEMAP_DPKCONFIG
	string "PKG_CONFIG_PATH: Directories to add to pkg-config's search path"

config PK_PAGING_PROC_PAGEMAP_CFLAGS
	string "CFLAGS: C compiler flags"

config PK_PAGING_PROC_PAGEMAP_LDFLAGS
	string "LDFLAGS: Linker flags"

config PK_PAGING_PROC_PAGEMAP_CXXFLAGS
	string "CXXFLAGS: C++ compiler flags"

config PK_PAGING_PROC_PAGEMAP_ASFLAGS
	string "CCASFLAGS: assembler compiler flags (defaults to CFLAGS)"

config PK_PAGING_PROC_PAGEMAP_BUILDARCH
	string "--host options on configure for Architecture"

endif # PK_PAGING_PROC_PAGEMAP
```

## package/PAGING/BiscuitOS-PAGING-PROC-SMAPS-ANON-PRIVATE/Kconfig
```kconfig
menuconfig PK_PAGING_PROC_SMAPS_ANON_PRIVATE
	bool "PROC SMAPS with Anonymous Private Memory"

if PK_PAGING_PROC_SMAPS_ANON_PRIVATE

config PK_PAGING_PROC_SMAPS_ANON_PRIVATE_VERSION
	default "default"
	string "verstion"

config PK_PAGING_PROC_SMAPS_ANON_PRIVATE_TAR
	default "tar.gz"
	string "tar type"

config PK_PAGING_PROC_SMAPS_ANON_PRIVATE_URL
	default "https://gitee.com/BiscuitOS_team/HardStack/raw/Gitee/Memory-Allocator/PAGING-MECH/BiscuitOS-PAGING-PROC-SMAPS-ANON-PRIVATE"
	string "url"

config PK_PAGING_PROC_SMAPS_ANON_PRIVATE_GITHUB
	string "GitHub"

config PK_PAGING_PROC_SMAPS_ANON_PRIVATE_SRCFILE
	default "main.c Makefile RunBiscuitOS.sh"
	string "Source code list"

config PK_PAGING_PROC_SMAPS_ANON_PRIVATE_CSRCFILE
	string "Compile source code list"

config PK_PAGING_PROC_SMAPS_ANON_PRIVATE_CONFIG
	string "CONFIG: Project Configure Options"

config PK_PAGING_PROC_SMAPS_ANON_PRIVATE_LIBPATH
	string "LIBS: Libraries to pass to the linker, e.g. -l<library>"

config PK_PAGING_PROC_SMAPS_ANON_PRIVATE_CPPFLAGS
	string "CPPFLAGS: C/C++ preprocessor flags, e.g. -I<include dir>"

config PK_PAGING_PROC_SMAPS_ANON_PRIVATE_DPKCONFIG
	string "PKG_CONFIG_PATH: Directories to add to pkg-config's search path"

config PK_PAGING_PROC_SMAPS_ANON_PRIVATE_CFLAGS
	string "CFLAGS: C compiler flags"

config PK_PAGING_PROC_SMAPS_ANON_PRIVATE_LDFLAGS
	string "LDFLAGS: Linker flags"

config PK_PAGING_PROC_SMAPS_ANON_PRIVATE_CXXFLAGS
	string "CXXFLAGS: C++ compiler flags"

config PK_PAGING_PROC_SMAPS_ANON_PRIVATE_ASFLAGS
	string "CCASFLAGS: assembler compiler flags (defaults to CFLAGS)"

config PK_PAGING_PROC_SMAPS_ANON_PRIVATE_BUILDARCH
	string "--host options on configure for Architecture"

endif # PK_PAGING_PROC_SMAPS_ANON_PRIVATE
```
