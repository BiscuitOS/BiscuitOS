## package/PAGING/BiscuitOS-PAGING-PROC-SMAPS-SHMEMPMDMAPPED/Kconfig
```kconfig
menuconfig PK_PAGING_PROC_SMAPS_SHMEMPMDMAPPED
	bool "PROC SMAPS with Shmem PMD-Mapped Memory"

if PK_PAGING_PROC_SMAPS_SHMEMPMDMAPPED

config PK_PAGING_PROC_SMAPS_SHMEMPMDMAPPED_VERSION
	default "default"
	string "verstion"

config PK_PAGING_PROC_SMAPS_SHMEMPMDMAPPED_TAR
	default "tar.gz"
	string "tar type"

config PK_PAGING_PROC_SMAPS_SHMEMPMDMAPPED_URL
	default "https://gitee.com/BiscuitOS_team/HardStack/raw/Gitee/Memory-Allocator/PAGING-MECH/BiscuitOS-PAGING-PROC-SMAPS-SHMEMPMDMAPPED"
	string "url"

config PK_PAGING_PROC_SMAPS_SHMEMPMDMAPPED_GITHUB
	string "GitHub"

config PK_PAGING_PROC_SMAPS_SHMEMPMDMAPPED_SRCFILE
	default "main.c Makefile RunBiscuitOS.sh"
	string "Source code list"

config PK_PAGING_PROC_SMAPS_SHMEMPMDMAPPED_CSRCFILE
	string "Compile source code list"

config PK_PAGING_PROC_SMAPS_SHMEMPMDMAPPED_CONFIG
	string "CONFIG: Project Configure Options"

config PK_PAGING_PROC_SMAPS_SHMEMPMDMAPPED_LIBPATH
	string "LIBS: Libraries to pass to the linker, e.g. -l<library>"

config PK_PAGING_PROC_SMAPS_SHMEMPMDMAPPED_CPPFLAGS
	string "CPPFLAGS: C/C++ preprocessor flags, e.g. -I<include dir>"

config PK_PAGING_PROC_SMAPS_SHMEMPMDMAPPED_DPKCONFIG
	string "PKG_CONFIG_PATH: Directories to add to pkg-config's search path"

config PK_PAGING_PROC_SMAPS_SHMEMPMDMAPPED_CFLAGS
	string "CFLAGS: C compiler flags"

config PK_PAGING_PROC_SMAPS_SHMEMPMDMAPPED_LDFLAGS
	string "LDFLAGS: Linker flags"

config PK_PAGING_PROC_SMAPS_SHMEMPMDMAPPED_CXXFLAGS
	string "CXXFLAGS: C++ compiler flags"

config PK_PAGING_PROC_SMAPS_SHMEMPMDMAPPED_ASFLAGS
	string "CCASFLAGS: assembler compiler flags (defaults to CFLAGS)"

config PK_PAGING_PROC_SMAPS_SHMEMPMDMAPPED_BUILDARCH
	string "--host options on configure for Architecture"

endif # PK_PAGING_PROC_SMAPS_SHMEMPMDMAPPED
```

## package/PAGING/BiscuitOS-PAGING-PROC-SMAPS-SWAP/Kconfig
```kconfig
menuconfig PK_PAGING_PROC_SMAPS_SWAP
	bool "PROC SMAPS with SWAP-OUT Memory"

if PK_PAGING_PROC_SMAPS_SWAP

config PK_PAGING_PROC_SMAPS_SWAP_VERSION
	default "default"
	string "verstion"

config PK_PAGING_PROC_SMAPS_SWAP_TAR
	default "tar.gz"
	string "tar type"

config PK_PAGING_PROC_SMAPS_SWAP_URL
	default "https://gitee.com/BiscuitOS_team/HardStack/raw/Gitee/Memory-Allocator/PAGING-MECH/BiscuitOS-PAGING-PROC-SMAPS-SWAP"
	string "url"

config PK_PAGING_PROC_SMAPS_SWAP_GITHUB
	string "GitHub"

config PK_PAGING_PROC_SMAPS_SWAP_SRCFILE
	default "main.c Makefile RunBiscuitOS.sh"
	string "Source code list"

config PK_PAGING_PROC_SMAPS_SWAP_CSRCFILE
	string "Compile source code list"

config PK_PAGING_PROC_SMAPS_SWAP_CONFIG
	string "CONFIG: Project Configure Options"

config PK_PAGING_PROC_SMAPS_SWAP_LIBPATH
	string "LIBS: Libraries to pass to the linker, e.g. -l<library>"

config PK_PAGING_PROC_SMAPS_SWAP_CPPFLAGS
	string "CPPFLAGS: C/C++ preprocessor flags, e.g. -I<include dir>"

config PK_PAGING_PROC_SMAPS_SWAP_DPKCONFIG
	string "PKG_CONFIG_PATH: Directories to add to pkg-config's search path"

config PK_PAGING_PROC_SMAPS_SWAP_CFLAGS
	string "CFLAGS: C compiler flags"

config PK_PAGING_PROC_SMAPS_SWAP_LDFLAGS
	string "LDFLAGS: Linker flags"

config PK_PAGING_PROC_SMAPS_SWAP_CXXFLAGS
	string "CXXFLAGS: C++ compiler flags"

config PK_PAGING_PROC_SMAPS_SWAP_ASFLAGS
	string "CCASFLAGS: assembler compiler flags (defaults to CFLAGS)"

config PK_PAGING_PROC_SMAPS_SWAP_BUILDARCH
	string "--host options on configure for Architecture"

endif # PK_PAGING_PROC_SMAPS_SWAP
```

## package/PAGING/BiscuitOS-PAGING-PT-CPA/Kconfig
```kconfig
menuconfig PK_PAGING_PT_CPA
	bool "CPA: Change Page Attribute"

if PK_PAGING_PT_CPA

config PK_PAGING_PT_CPA_VERSION
	default "default"
	string "verstion"

config PK_PAGING_PT_CPA_TAR
	default "tar.gz"
	string "tar type"

config PK_PAGING_PT_CPA_URL
	default "https://gitee.com/BiscuitOS_team/HardStack/raw/Gitee/Memory-Allocator/PAGING-MECH/BiscuitOS-PAGING-PT-CPA"
	string "url"

config PK_PAGING_PT_CPA_GITHUB
	string "GitHub"

config PK_PAGING_PT_CPA_SRCFILE
	default "main.c Makefile Kconfig"
	string "Source code list"

config PK_PAGING_PT_CPA_CSRCFILE
	string "Compile source code list"

config PK_PAGING_PT_CPA_CONFIG
	string "CONFIG: Project Configure Options"

config PK_PAGING_PT_CPA_LIBPATH
	string "LIBS: Libraries to pass to the linker, e.g. -l<library>"

config PK_PAGING_PT_CPA_CPPFLAGS
	string "CPPFLAGS: C/C++ preprocessor flags, e.g. -I<include dir>"

config PK_PAGING_PT_CPA_DPKCONFIG
	string "PKG_CONFIG_PATH: Directories to add to pkg-config's search path"

config PK_PAGING_PT_CPA_CFLAGS
	string "CFLAGS: C compiler flags"

config PK_PAGING_PT_CPA_LDFLAGS
	string "LDFLAGS: Linker flags"

config PK_PAGING_PT_CPA_CXXFLAGS
	string "CXXFLAGS: C++ compiler flags"

config PK_PAGING_PT_CPA_ASFLAGS
	string "CCASFLAGS: assembler compiler flags (defaults to CFLAGS)"

config PK_PAGING_PT_CPA_BUILDARCH
	string "--host options on configure for Architecture"

endif # PK_PAGING_PT_CPA
```

## package/PAGING/BiscuitOS-PAGING-PT-CPR-HUGETLB/Kconfig
```kconfig
menuconfig PK_PAGING_PT_CPR_HUGETLB
	bool "Copy-Page-Range(CPR): HUGETLB"

if PK_PAGING_PT_CPR_HUGETLB

config PK_PAGING_PT_CPR_HUGETLB_VERSION
	default "default"
	string "verstion"

config PK_PAGING_PT_CPR_HUGETLB_TAR
	default "tar.gz"
	string "tar type"

config PK_PAGING_PT_CPR_HUGETLB_URL
	default "https://gitee.com/BiscuitOS_team/HardStack/raw/Gitee/Memory-Allocator/PAGING-MECH/BiscuitOS-PAGING-PT-CPR-HUGETLB"
	string "url"

config PK_PAGING_PT_CPR_HUGETLB_GITHUB
	string "GitHub"

config PK_PAGING_PT_CPR_HUGETLB_SRCHUGETLB
	default "main.c Makefile RunBiscuitOS.sh"
	string "Source code list"

config PK_PAGING_PT_CPR_HUGETLB_CSRCHUGETLB
	string "Compile source code list"

config PK_PAGING_PT_CPR_HUGETLB_CONFIG
	string "CONFIG: Project Configure Options"

config PK_PAGING_PT_CPR_HUGETLB_LIBPATH
	string "LIBS: Libraries to pass to the linker, e.g. -l<library>"

config PK_PAGING_PT_CPR_HUGETLB_CPPFLAGS
	string "CPPFLAGS: C/C++ preprocessor flags, e.g. -I<include dir>"

config PK_PAGING_PT_CPR_HUGETLB_DPKCONFIG
	string "PKG_CONFIG_PATH: Directories to add to pkg-config's search path"

config PK_PAGING_PT_CPR_HUGETLB_CFLAGS
	string "CFLAGS: C compiler flags"

config PK_PAGING_PT_CPR_HUGETLB_LDFLAGS
	string "LDFLAGS: Linker flags"

config PK_PAGING_PT_CPR_HUGETLB_CXXFLAGS
	string "CXXFLAGS: C++ compiler flags"

config PK_PAGING_PT_CPR_HUGETLB_ASFLAGS
	string "CCASFLAGS: assembler compiler flags (defaults to CFLAGS)"

config PK_PAGING_PT_CPR_HUGETLB_BUILDARCH
	string "--host options on configure for Architecture"

endif # PK_PAGING_PT_CPR_HUGETLB
```

## package/PAGING/BiscuitOS-PAGING-PT-CPR-PFNMAP/Kconfig
```kconfig
menuconfig PK_PAGING_PT_CPR_PFNMAP
	bool "Copy-Page-Range(CPR): PFNMAP MAPPING"

if PK_PAGING_PT_CPR_PFNMAP

config PK_PAGING_PT_CPR_PFNMAP_VERSION
	default "default"
	string "verstion"

config PK_PAGING_PT_CPR_PFNMAP_TAR
	default "tar.gz"
	string "tar type"

config PK_PAGING_PT_CPR_PFNMAP_URL
	default "https://gitee.com/BiscuitOS_team/HardStack/raw/Gitee/Memory-Allocator/PAGING-MECH/BiscuitOS-PAGING-PT-CPR-PFNMAP"
	string "url"

config PK_PAGING_PT_CPR_PFNMAP_GITHUB
	string "GitHub"

config PK_PAGING_PT_CPR_PFNMAP_SRCPFNMAP
	default "main.c Makefile RunBiscuitOS.sh"
	string "Source code list"

config PK_PAGING_PT_CPR_PFNMAP_CSRCPFNMAP
	string "Compile source code list"

config PK_PAGING_PT_CPR_PFNMAP_CONFIG
	string "CONFIG: Project Configure Options"

config PK_PAGING_PT_CPR_PFNMAP_LIBPATH
	string "LIBS: Libraries to pass to the linker, e.g. -l<library>"

config PK_PAGING_PT_CPR_PFNMAP_CPPFLAGS
	string "CPPFLAGS: C/C++ preprocessor flags, e.g. -I<include dir>"

config PK_PAGING_PT_CPR_PFNMAP_DPKCONFIG
	string "PKG_CONFIG_PATH: Directories to add to pkg-config's search path"

config PK_PAGING_PT_CPR_PFNMAP_CFLAGS
	string "CFLAGS: C compiler flags"

config PK_PAGING_PT_CPR_PFNMAP_LDFLAGS
	string "LDFLAGS: Linker flags"

config PK_PAGING_PT_CPR_PFNMAP_CXXFLAGS
	string "CXXFLAGS: C++ compiler flags"

config PK_PAGING_PT_CPR_PFNMAP_ASFLAGS
	string "CCASFLAGS: assembler compiler flags (defaults to CFLAGS)"

config PK_PAGING_PT_CPR_PFNMAP_BUILDARCH
	string "--host options on configure for Architecture"

endif # PK_PAGING_PT_CPR_PFNMAP
```

## package/PAGING/BiscuitOS-PAGING-PT-CPR-SHMEM/Kconfig
```kconfig
menuconfig PK_PAGING_PT_CPR_SHMEM
	bool "Copy-Page-Range(CPR): SHMEM"

if PK_PAGING_PT_CPR_SHMEM

config PK_PAGING_PT_CPR_SHMEM_VERSION
	default "default"
	string "verstion"

config PK_PAGING_PT_CPR_SHMEM_TAR
	default "tar.gz"
	string "tar type"

config PK_PAGING_PT_CPR_SHMEM_URL
	default "https://gitee.com/BiscuitOS_team/HardStack/raw/Gitee/Memory-Allocator/PAGING-MECH/BiscuitOS-PAGING-PT-CPR-SHMEM"
	string "url"

config PK_PAGING_PT_CPR_SHMEM_GITHUB
	string "GitHub"

config PK_PAGING_PT_CPR_SHMEM_SRCFILE
	default "main.c Makefile RunBiscuitOS.sh"
	string "Source code list"

config PK_PAGING_PT_CPR_SHMEM_CSRCFILE
	string "Compile source code list"

config PK_PAGING_PT_CPR_SHMEM_CONFIG
	string "CONFIG: Project Configure Options"

config PK_PAGING_PT_CPR_SHMEM_LIBPATH
	string "LIBS: Libraries to pass to the linker, e.g. -l<library>"

config PK_PAGING_PT_CPR_SHMEM_CPPFLAGS
	string "CPPFLAGS: C/C++ preprocessor flags, e.g. -I<include dir>"

config PK_PAGING_PT_CPR_SHMEM_DPKCONFIG
	string "PKG_CONFIG_PATH: Directories to add to pkg-config's search path"

config PK_PAGING_PT_CPR_SHMEM_CFLAGS
	string "CFLAGS: C compiler flags"

config PK_PAGING_PT_CPR_SHMEM_LDFLAGS
	string "LDFLAGS: Linker flags"

config PK_PAGING_PT_CPR_SHMEM_CXXFLAGS
	string "CXXFLAGS: C++ compiler flags"

config PK_PAGING_PT_CPR_SHMEM_ASFLAGS
	string "CCASFLAGS: assembler compiler flags (defaults to CFLAGS)"

config PK_PAGING_PT_CPR_SHMEM_BUILDARCH
	string "--host options on configure for Architecture"

endif # PK_PAGING_PT_CPR_SHMEM
```

## package/PAGING/BiscuitOS-PAGING-PT-CPR-WIPE/Kconfig
```kconfig
menuconfig PK_PAGING_PT_CPR_WIPE
	bool "Copy-Page-Range(CPR): WIPE ON FORK"

if PK_PAGING_PT_CPR_WIPE

config PK_PAGING_PT_CPR_WIPE_VERSION
	default "default"
	string "verstion"

config PK_PAGING_PT_CPR_WIPE_TAR
	default "tar.gz"
	string "tar type"

config PK_PAGING_PT_CPR_WIPE_URL
	default "https://gitee.com/BiscuitOS_team/HardStack/raw/Gitee/Memory-Allocator/PAGING-MECH/BiscuitOS-PAGING-PT-CPR-WIPE"
	string "url"

config PK_PAGING_PT_CPR_WIPE_GITHUB
	string "GitHub"

config PK_PAGING_PT_CPR_WIPE_SRCWIPE
	default "main.c Makefile RunBiscuitOS.sh"
	string "Source code list"

config PK_PAGING_PT_CPR_WIPE_CSRCWIPE
	string "Compile source code list"

config PK_PAGING_PT_CPR_WIPE_CONFIG
	string "CONFIG: Project Configure Options"

config PK_PAGING_PT_CPR_WIPE_LIBPATH
	string "LIBS: Libraries to pass to the linker, e.g. -l<library>"

config PK_PAGING_PT_CPR_WIPE_CPPFLAGS
	string "CPPFLAGS: C/C++ preprocessor flags, e.g. -I<include dir>"

config PK_PAGING_PT_CPR_WIPE_DPKCONFIG
	string "PKG_CONFIG_PATH: Directories to add to pkg-config's search path"

config PK_PAGING_PT_CPR_WIPE_CFLAGS
	string "CFLAGS: C compiler flags"

config PK_PAGING_PT_CPR_WIPE_LDFLAGS
	string "LDFLAGS: Linker flags"

config PK_PAGING_PT_CPR_WIPE_CXXFLAGS
	string "CXXFLAGS: C++ compiler flags"

config PK_PAGING_PT_CPR_WIPE_ASFLAGS
	string "CCASFLAGS: assembler compiler flags (defaults to CFLAGS)"

config PK_PAGING_PT_CPR_WIPE_BUILDARCH
	string "--host options on configure for Architecture"

endif # PK_PAGING_PT_CPR_WIPE
```
