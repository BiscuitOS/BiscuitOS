## package/PAGING/BiscuitOS-PAGING-PageWalk-DM-PTE-LOCK/Kconfig
```kconfig
menuconfig PK_PAGING_PAGEWALK_DM_PTE_LOCK
	bool "PageWalk DeepMind: PTE-LOCK"

if PK_PAGING_PAGEWALK_DM_PTE_LOCK

config PK_PAGING_PAGEWALK_DM_PTE_LOCK_VERSION
	default "default"
	string "verstion"

config PK_PAGING_PAGEWALK_DM_PTE_LOCK_TAR
	default "tar.gz"
	string "tar type"

config PK_PAGING_PAGEWALK_DM_PTE_LOCK_URL
	default "https://gitee.com/BiscuitOS_team/HardStack/raw/Gitee/Memory-Allocator/PAGING-MECH/BiscuitOS-PAGING-PageWalk-DM-PTE-LOCK"
	string "url"

config PK_PAGING_PAGEWALK_DM_PTE_LOCK_GITHUB
	string "GitHub"

config PK_PAGING_PAGEWALK_DM_PTE_LOCK_SRCFILE
	default "main.c Makefile Kconfig Mafile.app RunBiscuitOS.sh app.c"
	string "Source code list"

config PK_PAGING_PAGEWALK_DM_PTE_LOCK_CSRCFILE
	string "Compile source code list"

config PK_PAGING_PAGEWALK_DM_PTE_LOCK_CONFIG
	string "CONFIG: Project Configure Options"

config PK_PAGING_PAGEWALK_DM_PTE_LOCK_LIBPATH
	string "LIBS: Libraries to pass to the linker, e.g. -l<library>"

config PK_PAGING_PAGEWALK_DM_PTE_LOCK_CPPFLAGS
	string "CPPFLAGS: C/C++ preprocessor flags, e.g. -I<include dir>"

config PK_PAGING_PAGEWALK_DM_PTE_LOCK_DPKCONFIG
	string "PKG_CONFIG_PATH: Directories to add to pkg-config's search path"

config PK_PAGING_PAGEWALK_DM_PTE_LOCK_CFLAGS
	string "CFLAGS: C compiler flags"

config PK_PAGING_PAGEWALK_DM_PTE_LOCK_LDFLAGS
	string "LDFLAGS: Linker flags"

config PK_PAGING_PAGEWALK_DM_PTE_LOCK_CXXFLAGS
	string "CXXFLAGS: C++ compiler flags"

config PK_PAGING_PAGEWALK_DM_PTE_LOCK_ASFLAGS
	string "CCASFLAGS: assembler compiler flags (defaults to CFLAGS)"

config PK_PAGING_PAGEWALK_DM_PTE_LOCK_BUILDARCH
	string "--host options on configure for Architecture"

endif # PK_PAGING_PAGEWALK_DM_PTE_LOCK
```

## package/PAGING/BiscuitOS-PAGING-PageWalk-DM-SPLIT-THP/Kconfig
```kconfig
menuconfig PK_PAGING_PAGEWALK_DM_SPLIT_THP
	bool "PageWalk DeepMind: Split THP Hugepage"

if PK_PAGING_PAGEWALK_DM_SPLIT_THP

config PK_PAGING_PAGEWALK_DM_SPLIT_THP_VERSION
	default "default"
	string "verstion"

config PK_PAGING_PAGEWALK_DM_SPLIT_THP_TAR
	default "tar.gz"
	string "tar type"

config PK_PAGING_PAGEWALK_DM_SPLIT_THP_URL
	default "https://gitee.com/BiscuitOS_team/HardStack/raw/Gitee/Memory-Allocator/PAGING-MECH/BiscuitOS-PAGING-PageWalk-DM-SPLIT-THP"
	string "url"

config PK_PAGING_PAGEWALK_DM_SPLIT_THP_GITHUB
	string "GitHub"

config PK_PAGING_PAGEWALK_DM_SPLIT_THP_SRCFILE
	default "main.c Makefile Kconfig Makefile.app RunBiscuitOS.sh app.c"
	string "Source code list"

config PK_PAGING_PAGEWALK_DM_SPLIT_THP_CSRCFILE
	string "Compile source code list"

config PK_PAGING_PAGEWALK_DM_SPLIT_THP_CONFIG
	string "CONFIG: Project Configure Options"

config PK_PAGING_PAGEWALK_DM_SPLIT_THP_LIBPATH
	string "LIBS: Libraries to pass to the linker, e.g. -l<library>"

config PK_PAGING_PAGEWALK_DM_SPLIT_THP_CPPFLAGS
	string "CPPFLAGS: C/C++ preprocessor flags, e.g. -I<include dir>"

config PK_PAGING_PAGEWALK_DM_SPLIT_THP_DPKCONFIG
	string "PKG_CONFIG_PATH: Directories to add to pkg-config's search path"

config PK_PAGING_PAGEWALK_DM_SPLIT_THP_CFLAGS
	string "CFLAGS: C compiler flags"

config PK_PAGING_PAGEWALK_DM_SPLIT_THP_LDFLAGS
	string "LDFLAGS: Linker flags"

config PK_PAGING_PAGEWALK_DM_SPLIT_THP_CXXFLAGS
	string "CXXFLAGS: C++ compiler flags"

config PK_PAGING_PAGEWALK_DM_SPLIT_THP_ASFLAGS
	string "CCASFLAGS: assembler compiler flags (defaults to CFLAGS)"

config PK_PAGING_PAGEWALK_DM_SPLIT_THP_BUILDARCH
	string "--host options on configure for Architecture"

endif # PK_PAGING_PAGEWALK_DM_SPLIT_THP
```

## package/PAGING/BiscuitOS-PAGING-PageWalk-DMA/Kconfig
```kconfig
menuconfig PK_PAGING_PAGEWALK_DMA
	bool "PageWalk with PCIe DMA"

if PK_PAGING_PAGEWALK_DMA

config PK_PAGING_PAGEWALK_DMA_VERSION
	default "default"
	string "verstion"

config PK_PAGING_PAGEWALK_DMA_TAR
	default "tar.gz"
	string "tar type"

config PK_PAGING_PAGEWALK_DMA_URL
	default "https://gitee.com/BiscuitOS_team/HardStack/raw/Gitee/Memory-Allocator/PAGING-MECH/BiscuitOS-PAGING-PageWalk-DMA"
	string "url"

config PK_PAGING_PAGEWALK_DMA_GITHUB
	string "GitHub"

config PK_PAGING_PAGEWALK_DMA_SRCFILE
	default "main.c Makefile Kconfig"
	string "Source code list"

config PK_PAGING_PAGEWALK_DMA_CSRCFILE
	string "Compile source code list"

config PK_PAGING_PAGEWALK_DMA_CONFIG
	string "CONFIG: Project Configure Options"

config PK_PAGING_PAGEWALK_DMA_LIBPATH
	string "LIBS: Libraries to pass to the linker, e.g. -l<library>"

config PK_PAGING_PAGEWALK_DMA_CPPFLAGS
	string "CPPFLAGS: C/C++ preprocessor flags, e.g. -I<include dir>"

config PK_PAGING_PAGEWALK_DMA_DPKCONFIG
	string "PKG_CONFIG_PATH: Directories to add to pkg-config's search path"

config PK_PAGING_PAGEWALK_DMA_CFLAGS
	string "CFLAGS: C compiler flags"

config PK_PAGING_PAGEWALK_DMA_LDFLAGS
	string "LDFLAGS: Linker flags"

config PK_PAGING_PAGEWALK_DMA_CXXFLAGS
	string "CXXFLAGS: C++ compiler flags"

config PK_PAGING_PAGEWALK_DMA_ASFLAGS
	string "CCASFLAGS: assembler compiler flags (defaults to CFLAGS)"

config PK_PAGING_PAGEWALK_DMA_BUILDARCH
	string "--host options on configure for Architecture"

endif # PK_PAGING_PAGEWALK_DMA
```

## package/PAGING/BiscuitOS-PAGING-PageWalk-File/Kconfig
```kconfig
menuconfig PK_PAGING_PAGEWALK_FILE
	bool "PageWalk with File mmap memory"

if PK_PAGING_PAGEWALK_FILE

config PK_PAGING_PAGEWALK_FILE_VERSION
	default "default"
	string "verstion"

config PK_PAGING_PAGEWALK_FILE_TAR
	default "tar.gz"
	string "tar type"

config PK_PAGING_PAGEWALK_FILE_URL
	default "https://gitee.com/BiscuitOS_team/HardStack/raw/Gitee/Memory-Allocator/PAGING-MECH/BiscuitOS-PAGING-PageWalk-File"
	string "url"

config PK_PAGING_PAGEWALK_FILE_GITHUB
	string "GitHub"

config PK_PAGING_PAGEWALK_FILE_SRCFILE
	default "main.c Makefile Kconfig Makefile.app RunBiscuitOS.sh app.c"
	string "Source code list"

config PK_PAGING_PAGEWALK_FILE_CSRCFILE
	string "Compile source code list"

config PK_PAGING_PAGEWALK_FILE_CONFIG
	string "CONFIG: Project Configure Options"

config PK_PAGING_PAGEWALK_FILE_LIBPATH
	string "LIBS: Libraries to pass to the linker, e.g. -l<library>"

config PK_PAGING_PAGEWALK_FILE_CPPFLAGS
	string "CPPFLAGS: C/C++ preprocessor flags, e.g. -I<include dir>"

config PK_PAGING_PAGEWALK_FILE_DPKCONFIG
	string "PKG_CONFIG_PATH: Directories to add to pkg-config's search path"

config PK_PAGING_PAGEWALK_FILE_CFLAGS
	string "CFLAGS: C compiler flags"

config PK_PAGING_PAGEWALK_FILE_LDFLAGS
	string "LDFLAGS: Linker flags"

config PK_PAGING_PAGEWALK_FILE_CXXFLAGS
	string "CXXFLAGS: C++ compiler flags"

config PK_PAGING_PAGEWALK_FILE_ASFLAGS
	string "CCASFLAGS: assembler compiler flags (defaults to CFLAGS)"

config PK_PAGING_PAGEWALK_FILE_BUILDARCH
	string "--host options on configure for Architecture"

endif # PK_PAGING_PAGEWALK_FILE
```

## package/PAGING/BiscuitOS-PAGING-PageWalk-IOREMAP/Kconfig
```kconfig
menuconfig PK_PAGING_PAGEWALK_IOREMAP
	bool "PageWalk with IOREMAP MMIO"

if PK_PAGING_PAGEWALK_IOREMAP

config PK_PAGING_PAGEWALK_IOREMAP_VERSION
	default "default"
	string "verstion"

config PK_PAGING_PAGEWALK_IOREMAP_TAR
	default "tar.gz"
	string "tar type"

config PK_PAGING_PAGEWALK_IOREMAP_URL
	default "https://gitee.com/BiscuitOS_team/HardStack/raw/Gitee/Memory-Allocator/PAGING-MECH/BiscuitOS-PAGING-PageWalk-IOREMAP"
	string "url"

config PK_PAGING_PAGEWALK_IOREMAP_GITHUB
	string "GitHub"

config PK_PAGING_PAGEWALK_IOREMAP_SRCFILE
	default "main.c Makefile Kconfig"
	string "Source code list"

config PK_PAGING_PAGEWALK_IOREMAP_CSRCFILE
	string "Compile source code list"

config PK_PAGING_PAGEWALK_IOREMAP_CONFIG
	string "CONFIG: Project Configure Options"

config PK_PAGING_PAGEWALK_IOREMAP_LIBPATH
	string "LIBS: Libraries to pass to the linker, e.g. -l<library>"

config PK_PAGING_PAGEWALK_IOREMAP_CPPFLAGS
	string "CPPFLAGS: C/C++ preprocessor flags, e.g. -I<include dir>"

config PK_PAGING_PAGEWALK_IOREMAP_DPKCONFIG
	string "PKG_CONFIG_PATH: Directories to add to pkg-config's search path"

config PK_PAGING_PAGEWALK_IOREMAP_CFLAGS
	string "CFLAGS: C compiler flags"

config PK_PAGING_PAGEWALK_IOREMAP_LDFLAGS
	string "LDFLAGS: Linker flags"

config PK_PAGING_PAGEWALK_IOREMAP_CXXFLAGS
	string "CXXFLAGS: C++ compiler flags"

config PK_PAGING_PAGEWALK_IOREMAP_ASFLAGS
	string "CCASFLAGS: assembler compiler flags (defaults to CFLAGS)"

config PK_PAGING_PAGEWALK_IOREMAP_BUILDARCH
	string "--host options on configure for Architecture"

endif # PK_PAGING_PAGEWALK_IOREMAP
```

## package/PAGING/BiscuitOS-PAGING-PageWalk-Kernel/Kconfig
```kconfig
menuconfig PK_PAGING_PAGEWALK_KERNEL
	bool "PageWalk with Kernel Space"

if PK_PAGING_PAGEWALK_KERNEL

config PK_PAGING_PAGEWALK_KERNEL_VERSION
	default "default"
	string "verstion"

config PK_PAGING_PAGEWALK_KERNEL_TAR
	default "tar.gz"
	string "tar type"

config PK_PAGING_PAGEWALK_KERNEL_URL
	default "https://gitee.com/BiscuitOS_team/HardStack/raw/Gitee/Memory-Allocator/PAGING-MECH/BiscuitOS-PAGING-PageWalk-Kernel"
	string "url"

config PK_PAGING_PAGEWALK_KERNEL_GITHUB
	string "GitHub"

config PK_PAGING_PAGEWALK_KERNEL_SRCFILE
	default "main.c Makefile Kconfig"
	string "Source code list"

config PK_PAGING_PAGEWALK_KERNEL_CSRCFILE
	string "Compile source code list"

config PK_PAGING_PAGEWALK_KERNEL_CONFIG
	string "CONFIG: Project Configure Options"

config PK_PAGING_PAGEWALK_KERNEL_LIBPATH
	string "LIBS: Libraries to pass to the linker, e.g. -l<library>"

config PK_PAGING_PAGEWALK_KERNEL_CPPFLAGS
	string "CPPFLAGS: C/C++ preprocessor flags, e.g. -I<include dir>"

config PK_PAGING_PAGEWALK_KERNEL_DPKCONFIG
	string "PKG_CONFIG_PATH: Directories to add to pkg-config's search path"

config PK_PAGING_PAGEWALK_KERNEL_CFLAGS
	string "CFLAGS: C compiler flags"

config PK_PAGING_PAGEWALK_KERNEL_LDFLAGS
	string "LDFLAGS: Linker flags"

config PK_PAGING_PAGEWALK_KERNEL_CXXFLAGS
	string "CXXFLAGS: C++ compiler flags"

config PK_PAGING_PAGEWALK_KERNEL_ASFLAGS
	string "CCASFLAGS: assembler compiler flags (defaults to CFLAGS)"

config PK_PAGING_PAGEWALK_KERNEL_BUILDARCH
	string "--host options on configure for Architecture"

endif # PK_PAGING_PAGEWALK_KERNEL
```

## package/PAGING/BiscuitOS-PAGING-PageWalk-Linear/Kconfig
```kconfig
menuconfig PK_PAGING_PAGEWALK_LINEAR
	bool "PageWalk with Linear Mapping"

if PK_PAGING_PAGEWALK_LINEAR

config PK_PAGING_PAGEWALK_LINEAR_VERSION
	default "default"
	string "verstion"

config PK_PAGING_PAGEWALK_LINEAR_TAR
	default "tar.gz"
	string "tar type"

config PK_PAGING_PAGEWALK_LINEAR_URL
	default "https://gitee.com/BiscuitOS_team/HardStack/raw/Gitee/Memory-Allocator/PAGING-MECH/BiscuitOS-PAGING-PageWalk-Linear"
	string "url"

config PK_PAGING_PAGEWALK_LINEAR_GITHUB
	string "GitHub"

config PK_PAGING_PAGEWALK_LINEAR_SRCFILE
	default "main.c Makefile Kconfig"
	string "Source code list"

config PK_PAGING_PAGEWALK_LINEAR_CSRCFILE
	string "Compile source code list"

config PK_PAGING_PAGEWALK_LINEAR_CONFIG
	string "CONFIG: Project Configure Options"

config PK_PAGING_PAGEWALK_LINEAR_LIBPATH
	string "LIBS: Libraries to pass to the linker, e.g. -l<library>"

config PK_PAGING_PAGEWALK_LINEAR_CPPFLAGS
	string "CPPFLAGS: C/C++ preprocessor flags, e.g. -I<include dir>"

config PK_PAGING_PAGEWALK_LINEAR_DPKCONFIG
	string "PKG_CONFIG_PATH: Directories to add to pkg-config's search path"

config PK_PAGING_PAGEWALK_LINEAR_CFLAGS
	string "CFLAGS: C compiler flags"

config PK_PAGING_PAGEWALK_LINEAR_LDFLAGS
	string "LDFLAGS: Linker flags"

config PK_PAGING_PAGEWALK_LINEAR_CXXFLAGS
	string "CXXFLAGS: C++ compiler flags"

config PK_PAGING_PAGEWALK_LINEAR_ASFLAGS
	string "CCASFLAGS: assembler compiler flags (defaults to CFLAGS)"

config PK_PAGING_PAGEWALK_LINEAR_BUILDARCH
	string "--host options on configure for Architecture"

endif # PK_PAGING_PAGEWALK_LINEAR
```

## package/PAGING/BiscuitOS-PAGING-PageWalk-MADV_COLD/Kconfig
```kconfig
menuconfig PK_PAGING_PAGEWALK_MADV_COLD
	bool "PageWalk Use-Case: MADV_COLD"

if PK_PAGING_PAGEWALK_MADV_COLD

config PK_PAGING_PAGEWALK_MADV_COLD_VERSION
	default "default"
	string "verstion"

config PK_PAGING_PAGEWALK_MADV_COLD_TAR
	default "tar.gz"
	string "tar type"

config PK_PAGING_PAGEWALK_MADV_COLD_URL
	default "https://gitee.com/BiscuitOS_team/HardStack/raw/Gitee/Memory-Allocator/PAGING-MECH/BiscuitOS-PAGING-PageWalk-MADV_COLD"
	string "url"

config PK_PAGING_PAGEWALK_MADV_COLD_GITHUB
	string "GitHub"

config PK_PAGING_PAGEWALK_MADV_COLD_SRCFILE
	default "main.c Makefile"
	string "Source code list"

config PK_PAGING_PAGEWALK_MADV_COLD_CSRCFILE
	string "Compile source code list"

config PK_PAGING_PAGEWALK_MADV_COLD_CONFIG
	string "CONFIG: Project Configure Options"

config PK_PAGING_PAGEWALK_MADV_COLD_LIBPATH
	string "LIBS: Libraries to pass to the linker, e.g. -l<library>"

config PK_PAGING_PAGEWALK_MADV_COLD_CPPFLAGS
	string "CPPFLAGS: C/C++ preprocessor flags, e.g. -I<include dir>"

config PK_PAGING_PAGEWALK_MADV_COLD_DPKCONFIG
	string "PKG_CONFIG_PATH: Directories to add to pkg-config's search path"

config PK_PAGING_PAGEWALK_MADV_COLD_CFLAGS
	string "CFLAGS: C compiler flags"

config PK_PAGING_PAGEWALK_MADV_COLD_LDFLAGS
	string "LDFLAGS: Linker flags"

config PK_PAGING_PAGEWALK_MADV_COLD_CXXFLAGS
	string "CXXFLAGS: C++ compiler flags"

config PK_PAGING_PAGEWALK_MADV_COLD_ASFLAGS
	string "CCASFLAGS: assembler compiler flags (defaults to CFLAGS)"

config PK_PAGING_PAGEWALK_MADV_COLD_BUILDARCH
	string "--host options on configure for Architecture"

endif # PK_PAGING_PAGEWALK_MADV_COLD
```

## package/PAGING/BiscuitOS-PAGING-PageWalk-MADV_PAGEOUT/Kconfig
```kconfig
menuconfig PK_PAGING_PAGEWALK_MADV_PAGEOUT
	bool "PageWalk Use-Case: MADV_PAGEOUT"

if PK_PAGING_PAGEWALK_MADV_PAGEOUT

config PK_PAGING_PAGEWALK_MADV_PAGEOUT_VERSION
	default "default"
	string "verstion"

config PK_PAGING_PAGEWALK_MADV_PAGEOUT_TAR
	default "tar.gz"
	string "tar type"

config PK_PAGING_PAGEWALK_MADV_PAGEOUT_URL
	default "https://gitee.com/BiscuitOS_team/HardStack/raw/Gitee/Memory-Allocator/PAGING-MECH/BiscuitOS-PAGING-PageWalk-MADV_PAGEOUT"
	string "url"

config PK_PAGING_PAGEWALK_MADV_PAGEOUT_GITHUB
	string "GitHub"

config PK_PAGING_PAGEWALK_MADV_PAGEOUT_SRCFILE
	default "main.c Makefile"
	string "Source code list"

config PK_PAGING_PAGEWALK_MADV_PAGEOUT_CSRCFILE
	string "Compile source code list"

config PK_PAGING_PAGEWALK_MADV_PAGEOUT_CONFIG
	string "CONFIG: Project Configure Options"

config PK_PAGING_PAGEWALK_MADV_PAGEOUT_LIBPATH
	string "LIBS: Libraries to pass to the linker, e.g. -l<library>"

config PK_PAGING_PAGEWALK_MADV_PAGEOUT_CPPFLAGS
	string "CPPFLAGS: C/C++ preprocessor flags, e.g. -I<include dir>"

config PK_PAGING_PAGEWALK_MADV_PAGEOUT_DPKCONFIG
	string "PKG_CONFIG_PATH: Directories to add to pkg-config's search path"

config PK_PAGING_PAGEWALK_MADV_PAGEOUT_CFLAGS
	string "CFLAGS: C compiler flags"

config PK_PAGING_PAGEWALK_MADV_PAGEOUT_LDFLAGS
	string "LDFLAGS: Linker flags"

config PK_PAGING_PAGEWALK_MADV_PAGEOUT_CXXFLAGS
	string "CXXFLAGS: C++ compiler flags"

config PK_PAGING_PAGEWALK_MADV_PAGEOUT_ASFLAGS
	string "CCASFLAGS: assembler compiler flags (defaults to CFLAGS)"

config PK_PAGING_PAGEWALK_MADV_PAGEOUT_BUILDARCH
	string "--host options on configure for Architecture"

endif # PK_PAGING_PAGEWALK_MADV_PAGEOUT
```
