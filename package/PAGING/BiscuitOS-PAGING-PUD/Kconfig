## package/PAGING/BiscuitOS-PAGING-PageWalk-MADV_WILLNEED/Kconfig
```kconfig
menuconfig PK_PAGING_PAGEWALK_MADV_WILLNEED
	bool "PageWalk Use-Case: MADV_WILLNEED"

if PK_PAGING_PAGEWALK_MADV_WILLNEED

config PK_PAGING_PAGEWALK_MADV_WILLNEED_VERSION
	default "default"
	string "verstion"

config PK_PAGING_PAGEWALK_MADV_WILLNEED_TAR
	default "tar.gz"
	string "tar type"

config PK_PAGING_PAGEWALK_MADV_WILLNEED_URL
	default "https://gitee.com/BiscuitOS_team/HardStack/raw/Gitee/Memory-Allocator/PAGING-MECH/BiscuitOS-PAGING-PageWalk-MADV_WILLNEED"
	string "url"

config PK_PAGING_PAGEWALK_MADV_WILLNEED_GITHUB
	string "GitHub"

config PK_PAGING_PAGEWALK_MADV_WILLNEED_SRCFILE
	default "main.c Makefile"
	string "Source code list"

config PK_PAGING_PAGEWALK_MADV_WILLNEED_CSRCFILE
	string "Compile source code list"

config PK_PAGING_PAGEWALK_MADV_WILLNEED_CONFIG
	string "CONFIG: Project Configure Options"

config PK_PAGING_PAGEWALK_MADV_WILLNEED_LIBPATH
	string "LIBS: Libraries to pass to the linker, e.g. -l<library>"

config PK_PAGING_PAGEWALK_MADV_WILLNEED_CPPFLAGS
	string "CPPFLAGS: C/C++ preprocessor flags, e.g. -I<include dir>"

config PK_PAGING_PAGEWALK_MADV_WILLNEED_DPKCONFIG
	string "PKG_CONFIG_PATH: Directories to add to pkg-config's search path"

config PK_PAGING_PAGEWALK_MADV_WILLNEED_CFLAGS
	string "CFLAGS: C compiler flags"

config PK_PAGING_PAGEWALK_MADV_WILLNEED_LDFLAGS
	string "LDFLAGS: Linker flags"

config PK_PAGING_PAGEWALK_MADV_WILLNEED_CXXFLAGS
	string "CXXFLAGS: C++ compiler flags"

config PK_PAGING_PAGEWALK_MADV_WILLNEED_ASFLAGS
	string "CCASFLAGS: assembler compiler flags (defaults to CFLAGS)"

config PK_PAGING_PAGEWALK_MADV_WILLNEED_BUILDARCH
	string "--host options on configure for Architecture"

endif # PK_PAGING_PAGEWALK_MADV_WILLNEED
```

## package/PAGING/BiscuitOS-PAGING-PageWalk-MLOCK/Kconfig
```kconfig
menuconfig PK_PAGING_PAGEWALK_MLOCK
	bool "PageWalk Use-Case: MLOCK"

if PK_PAGING_PAGEWALK_MLOCK

config PK_PAGING_PAGEWALK_MLOCK_VERSION
	default "default"
	string "verstion"

config PK_PAGING_PAGEWALK_MLOCK_TAR
	default "tar.gz"
	string "tar type"

config PK_PAGING_PAGEWALK_MLOCK_URL
	default "https://gitee.com/BiscuitOS_team/HardStack/raw/Gitee/Memory-Allocator/PAGING-MECH/BiscuitOS-PAGING-PageWalk-MLOCK"
	string "url"

config PK_PAGING_PAGEWALK_MLOCK_GITHUB
	string "GitHub"

config PK_PAGING_PAGEWALK_MLOCK_SRCFILE
	default "main.c Makefile"
	string "Source code list"

config PK_PAGING_PAGEWALK_MLOCK_CSRCFILE
	string "Compile source code list"

config PK_PAGING_PAGEWALK_MLOCK_CONFIG
	string "CONFIG: Project Configure Options"

config PK_PAGING_PAGEWALK_MLOCK_LIBPATH
	string "LIBS: Libraries to pass to the linker, e.g. -l<library>"

config PK_PAGING_PAGEWALK_MLOCK_CPPFLAGS
	string "CPPFLAGS: C/C++ preprocessor flags, e.g. -I<include dir>"

config PK_PAGING_PAGEWALK_MLOCK_DPKCONFIG
	string "PKG_CONFIG_PATH: Directories to add to pkg-config's search path"

config PK_PAGING_PAGEWALK_MLOCK_CFLAGS
	string "CFLAGS: C compiler flags"

config PK_PAGING_PAGEWALK_MLOCK_LDFLAGS
	string "LDFLAGS: Linker flags"

config PK_PAGING_PAGEWALK_MLOCK_CXXFLAGS
	string "CXXFLAGS: C++ compiler flags"

config PK_PAGING_PAGEWALK_MLOCK_ASFLAGS
	string "CCASFLAGS: assembler compiler flags (defaults to CFLAGS)"

config PK_PAGING_PAGEWALK_MLOCK_BUILDARCH
	string "--host options on configure for Architecture"

endif # PK_PAGING_PAGEWALK_MLOCK
```

## package/PAGING/BiscuitOS-PAGING-PageWalk-Modify/Kconfig
```kconfig
menuconfig PK_PAGING_PAGEWALK_MODIFY
	bool "PageWalk with Modify Pagetable"

if PK_PAGING_PAGEWALK_MODIFY

config PK_PAGING_PAGEWALK_MODIFY_VERSION
	default "default"
	string "verstion"

config PK_PAGING_PAGEWALK_MODIFY_TAR
	default "tar.gz"
	string "tar type"

config PK_PAGING_PAGEWALK_MODIFY_URL
	default "https://gitee.com/BiscuitOS_team/HardStack/raw/Gitee/Memory-Allocator/PAGING-MECH/BiscuitOS-PAGING-PageWalk-Modify"
	string "url"

config PK_PAGING_PAGEWALK_MODIFY_GITHUB
	string "GitHub"

config PK_PAGING_PAGEWALK_MODIFY_SRCFILE
	default "main.c Makefile Kconfig Mafile.app RunBiscuitOS.sh app.c"
	string "Source code list"

config PK_PAGING_PAGEWALK_MODIFY_CSRCFILE
	string "Compile source code list"

config PK_PAGING_PAGEWALK_MODIFY_CONFIG
	string "CONFIG: Project Configure Options"

config PK_PAGING_PAGEWALK_MODIFY_LIBPATH
	string "LIBS: Libraries to pass to the linker, e.g. -l<library>"

config PK_PAGING_PAGEWALK_MODIFY_CPPFLAGS
	string "CPPFLAGS: C/C++ preprocessor flags, e.g. -I<include dir>"

config PK_PAGING_PAGEWALK_MODIFY_DPKCONFIG
	string "PKG_CONFIG_PATH: Directories to add to pkg-config's search path"

config PK_PAGING_PAGEWALK_MODIFY_CFLAGS
	string "CFLAGS: C compiler flags"

config PK_PAGING_PAGEWALK_MODIFY_LDFLAGS
	string "LDFLAGS: Linker flags"

config PK_PAGING_PAGEWALK_MODIFY_CXXFLAGS
	string "CXXFLAGS: C++ compiler flags"

config PK_PAGING_PAGEWALK_MODIFY_ASFLAGS
	string "CCASFLAGS: assembler compiler flags (defaults to CFLAGS)"

config PK_PAGING_PAGEWALK_MODIFY_BUILDARCH
	string "--host options on configure for Architecture"

endif # PK_PAGING_PAGEWALK_MODIFY
```

## package/PAGING/BiscuitOS-PAGING-PageWalk-Permanent/Kconfig
```kconfig
menuconfig PK_PAGING_PAGEWALK_PERMANENT
	bool "PageWalk with Permanent Mapping"

if PK_PAGING_PAGEWALK_PERMANENT

config PK_PAGING_PAGEWALK_PERMANENT_VERSION
	default "default"
	string "verstion"

config PK_PAGING_PAGEWALK_PERMANENT_TAR
	default "tar.gz"
	string "tar type"

config PK_PAGING_PAGEWALK_PERMANENT_URL
	default "https://gitee.com/BiscuitOS_team/HardStack/raw/Gitee/Memory-Allocator/PAGING-MECH/BiscuitOS-PAGING-PageWalk-Permanent"
	string "url"

config PK_PAGING_PAGEWALK_PERMANENT_GITHUB
	string "GitHub"

config PK_PAGING_PAGEWALK_PERMANENT_SRCFILE
	default "main.c Makefile Kconfig"
	string "Source code list"

config PK_PAGING_PAGEWALK_PERMANENT_CSRCFILE
	string "Compile source code list"

config PK_PAGING_PAGEWALK_PERMANENT_CONFIG
	string "CONFIG: Project Configure Options"

config PK_PAGING_PAGEWALK_PERMANENT_LIBPATH
	string "LIBS: Libraries to pass to the linker, e.g. -l<library>"

config PK_PAGING_PAGEWALK_PERMANENT_CPPFLAGS
	string "CPPFLAGS: C/C++ preprocessor flags, e.g. -I<include dir>"

config PK_PAGING_PAGEWALK_PERMANENT_DPKCONFIG
	string "PKG_CONFIG_PATH: Directories to add to pkg-config's search path"

config PK_PAGING_PAGEWALK_PERMANENT_CFLAGS
	string "CFLAGS: C compiler flags"

config PK_PAGING_PAGEWALK_PERMANENT_LDFLAGS
	string "LDFLAGS: Linker flags"

config PK_PAGING_PAGEWALK_PERMANENT_CXXFLAGS
	string "CXXFLAGS: C++ compiler flags"

config PK_PAGING_PAGEWALK_PERMANENT_ASFLAGS
	string "CCASFLAGS: assembler compiler flags (defaults to CFLAGS)"

config PK_PAGING_PAGEWALK_PERMANENT_BUILDARCH
	string "--host options on configure for Architecture"

endif # PK_PAGING_PAGEWALK_PERMANENT
```

## package/PAGING/BiscuitOS-PAGING-PageWalk-RSVDMEM/Kconfig
```kconfig
menuconfig PK_PAGING_PAGEWALK_RSVDMEM
	bool "PageWalk with RSVD-MEM"

if PK_PAGING_PAGEWALK_RSVDMEM

config PK_PAGING_PAGEWALK_RSVDMEM_VERSION
	default "default"
	string "verstion"

config PK_PAGING_PAGEWALK_RSVDMEM_TAR
	default "tar.gz"
	string "tar type"

config PK_PAGING_PAGEWALK_RSVDMEM_URL
	default "https://gitee.com/BiscuitOS_team/HardStack/raw/Gitee/Memory-Allocator/PAGING-MECH/BiscuitOS-PAGING-PageWalk-RSVDMEM"
	string "url"

config PK_PAGING_PAGEWALK_RSVDMEM_GITHUB
	string "GitHub"

config PK_PAGING_PAGEWALK_RSVDMEM_SRCFILE
	default "main.c Makefile Kconfig Mafile.app RunBiscuitOS.sh app.c"
	string "Source code list"

config PK_PAGING_PAGEWALK_RSVDMEM_CSRCFILE
	string "Compile source code list"

config PK_PAGING_PAGEWALK_RSVDMEM_CONFIG
	string "CONFIG: Project Configure Options"

config PK_PAGING_PAGEWALK_RSVDMEM_LIBPATH
	string "LIBS: Libraries to pass to the linker, e.g. -l<library>"

config PK_PAGING_PAGEWALK_RSVDMEM_CPPFLAGS
	string "CPPFLAGS: C/C++ preprocessor flags, e.g. -I<include dir>"

config PK_PAGING_PAGEWALK_RSVDMEM_DPKCONFIG
	string "PKG_CONFIG_PATH: Directories to add to pkg-config's search path"

config PK_PAGING_PAGEWALK_RSVDMEM_CFLAGS
	string "CFLAGS: C compiler flags"

config PK_PAGING_PAGEWALK_RSVDMEM_LDFLAGS
	string "LDFLAGS: Linker flags"

config PK_PAGING_PAGEWALK_RSVDMEM_CXXFLAGS
	string "CXXFLAGS: C++ compiler flags"

config PK_PAGING_PAGEWALK_RSVDMEM_ASFLAGS
	string "CCASFLAGS: assembler compiler flags (defaults to CFLAGS)"

config PK_PAGING_PAGEWALK_RSVDMEM_BUILDARCH
	string "--host options on configure for Architecture"

endif # PK_PAGING_PAGEWALK_RSVDMEM
```

## package/PAGING/BiscuitOS-PAGING-PageWalk-SMAPS/Kconfig
```kconfig
menuconfig PK_PAGING_PAGEWALK_SMAPS
	bool "PageWalk Use-Case: SMAPs"

if PK_PAGING_PAGEWALK_SMAPS

config PK_PAGING_PAGEWALK_SMAPS_VERSION
	default "default"
	string "verstion"

config PK_PAGING_PAGEWALK_SMAPS_TAR
	default "tar.gz"
	string "tar type"

config PK_PAGING_PAGEWALK_SMAPS_URL
	default "https://gitee.com/BiscuitOS_team/HardStack/raw/Gitee/Memory-Allocator/PAGING-MECH/BiscuitOS-PAGING-PageWalk-SMAPS"
	string "url"

config PK_PAGING_PAGEWALK_SMAPS_GITHUB
	string "GitHub"

config PK_PAGING_PAGEWALK_SMAPS_SRCFILE
	default "main.c Makefile Kconfig Makefile.app RunBiscuitOS.sh app.c"
	string "Source code list"

config PK_PAGING_PAGEWALK_SMAPS_CSRCFILE
	string "Compile source code list"

config PK_PAGING_PAGEWALK_SMAPS_CONFIG
	string "CONFIG: Project Configure Options"

config PK_PAGING_PAGEWALK_SMAPS_LIBPATH
	string "LIBS: Libraries to pass to the linker, e.g. -l<library>"

config PK_PAGING_PAGEWALK_SMAPS_CPPFLAGS
	string "CPPFLAGS: C/C++ preprocessor flags, e.g. -I<include dir>"

config PK_PAGING_PAGEWALK_SMAPS_DPKCONFIG
	string "PKG_CONFIG_PATH: Directories to add to pkg-config's search path"

config PK_PAGING_PAGEWALK_SMAPS_CFLAGS
	string "CFLAGS: C compiler flags"

config PK_PAGING_PAGEWALK_SMAPS_LDFLAGS
	string "LDFLAGS: Linker flags"

config PK_PAGING_PAGEWALK_SMAPS_CXXFLAGS
	string "CXXFLAGS: C++ compiler flags"

config PK_PAGING_PAGEWALK_SMAPS_ASFLAGS
	string "CCASFLAGS: assembler compiler flags (defaults to CFLAGS)"

config PK_PAGING_PAGEWALK_SMAPS_BUILDARCH
	string "--host options on configure for Architecture"

endif # PK_PAGING_PAGEWALK_SMAPS
```

## package/PAGING/BiscuitOS-PAGING-PageWalk-Temporary/Kconfig
```kconfig
menuconfig PK_PAGING_PAGEWALK_TEMPORARY
	bool "PageWalk with Temporary Mapping"

if PK_PAGING_PAGEWALK_TEMPORARY

config PK_PAGING_PAGEWALK_TEMPORARY_VERSION
	default "default"
	string "verstion"

config PK_PAGING_PAGEWALK_TEMPORARY_TAR
	default "tar.gz"
	string "tar type"

config PK_PAGING_PAGEWALK_TEMPORARY_URL
	default "https://gitee.com/BiscuitOS_team/HardStack/raw/Gitee/Memory-Allocator/PAGING-MECH/BiscuitOS-PAGING-PageWalk-Temporary"
	string "url"

config PK_PAGING_PAGEWALK_TEMPORARY_GITHUB
	string "GitHub"

config PK_PAGING_PAGEWALK_TEMPORARY_SRCFILE
	default "main.c Makefile Kconfig"
	string "Source code list"

config PK_PAGING_PAGEWALK_TEMPORARY_CSRCFILE
	string "Compile source code list"

config PK_PAGING_PAGEWALK_TEMPORARY_CONFIG
	string "CONFIG: Project Configure Options"

config PK_PAGING_PAGEWALK_TEMPORARY_LIBPATH
	string "LIBS: Libraries to pass to the linker, e.g. -l<library>"

config PK_PAGING_PAGEWALK_TEMPORARY_CPPFLAGS
	string "CPPFLAGS: C/C++ preprocessor flags, e.g. -I<include dir>"

config PK_PAGING_PAGEWALK_TEMPORARY_DPKCONFIG
	string "PKG_CONFIG_PATH: Directories to add to pkg-config's search path"

config PK_PAGING_PAGEWALK_TEMPORARY_CFLAGS
	string "CFLAGS: C compiler flags"

config PK_PAGING_PAGEWALK_TEMPORARY_LDFLAGS
	string "LDFLAGS: Linker flags"

config PK_PAGING_PAGEWALK_TEMPORARY_CXXFLAGS
	string "CXXFLAGS: C++ compiler flags"

config PK_PAGING_PAGEWALK_TEMPORARY_ASFLAGS
	string "CCASFLAGS: assembler compiler flags (defaults to CFLAGS)"

config PK_PAGING_PAGEWALK_TEMPORARY_BUILDARCH
	string "--host options on configure for Architecture"

endif # PK_PAGING_PAGEWALK_TEMPORARY
```
