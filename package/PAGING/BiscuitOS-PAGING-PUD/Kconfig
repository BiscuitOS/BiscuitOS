## package/PAGING/BiscuitOS-PAGING-PUD/Kconfig
```kconfig
menuconfig PK_PAGING_PUD
	bool "PUD(Page Upper/3th Directory)"

if PK_PAGING_PUD

config PK_PAGING_PUD_VERSION
	default "default"
	string "verstion"

config PK_PAGING_PUD_TAR
	default "tar.gz"
	string "tar type"

config PK_PAGING_PUD_URL
	default "https://gitee.com/BiscuitOS_team/HardStack/raw/Gitee/Memory-Allocator/PAGING-MECH/BiscuitOS-PAGING-PUD"
	string "url"

config PK_PAGING_PUD_GITHUB
	string "GitHub"

config PK_PAGING_PUD_SRCFILE
	default "main.c Makefile Kconfig Mafile.app RunBiscuitOS.sh app.c"
	string "Source code list"

config PK_PAGING_PUD_CSRCFILE
	string "Compile source code list"

config PK_PAGING_PUD_CONFIG
	string "CONFIG: Project Configure Options"

config PK_PAGING_PUD_LIBPATH
	string "LIBS: Libraries to pass to the linker, e.g. -l<library>"

config PK_PAGING_PUD_CPPFLAGS
	string "CPPFLAGS: C/C++ preprocessor flags, e.g. -I<include dir>"

config PK_PAGING_PUD_DPKCONFIG
	string "PKG_CONFIG_PATH: Directories to add to pkg-config's search path"

config PK_PAGING_PUD_CFLAGS
	string "CFLAGS: C compiler flags"

config PK_PAGING_PUD_LDFLAGS
	string "LDFLAGS: Linker flags"

config PK_PAGING_PUD_CXXFLAGS
	string "CXXFLAGS: C++ compiler flags"

config PK_PAGING_PUD_ASFLAGS
	string "CCASFLAGS: assembler compiler flags (defaults to CFLAGS)"

config PK_PAGING_PUD_BUILDARCH
	string "--host options on configure for Architecture"

endif # PK_PAGING_PUD
```

## package/PAGING/BiscuitOS-PAGING-PageWalk-ADD/Kconfig
```kconfig
menuconfig PK_PAGING_PAGEWALK_ADD
	bool "PageWalk with ADD Pagetable"

if PK_PAGING_PAGEWALK_ADD

config PK_PAGING_PAGEWALK_ADD_VERSION
	default "default"
	string "verstion"

config PK_PAGING_PAGEWALK_ADD_TAR
	default "tar.gz"
	string "tar type"

config PK_PAGING_PAGEWALK_ADD_URL
	default "https://gitee.com/BiscuitOS_team/HardStack/raw/Gitee/Memory-Allocator/PAGING-MECH/BiscuitOS-PAGING-PageWalk-ADD"
	string "url"

config PK_PAGING_PAGEWALK_ADD_GITHUB
	string "GitHub"

config PK_PAGING_PAGEWALK_ADD_SRCFILE
	default "main.c Makefile Kconfig Makefile.app RunBiscuitOS.sh app.c"
	string "Source code list"

config PK_PAGING_PAGEWALK_ADD_CSRCFILE
	string "Compile source code list"

config PK_PAGING_PAGEWALK_ADD_CONFIG
	string "CONFIG: Project Configure Options"

config PK_PAGING_PAGEWALK_ADD_LIBPATH
	string "LIBS: Libraries to pass to the linker, e.g. -l<library>"

config PK_PAGING_PAGEWALK_ADD_CPPFLAGS
	string "CPPFLAGS: C/C++ preprocessor flags, e.g. -I<include dir>"

config PK_PAGING_PAGEWALK_ADD_DPKCONFIG
	string "PKG_CONFIG_PATH: Directories to add to pkg-config's search path"

config PK_PAGING_PAGEWALK_ADD_CFLAGS
	string "CFLAGS: C compiler flags"

config PK_PAGING_PAGEWALK_ADD_LDFLAGS
	string "LDFLAGS: Linker flags"

config PK_PAGING_PAGEWALK_ADD_CXXFLAGS
	string "CXXFLAGS: C++ compiler flags"

config PK_PAGING_PAGEWALK_ADD_ASFLAGS
	string "CCASFLAGS: assembler compiler flags (defaults to CFLAGS)"

config PK_PAGING_PAGEWALK_ADD_BUILDARCH
	string "--host options on configure for Architecture"

endif # PK_PAGING_PAGEWALK_ADD
```

## package/PAGING/BiscuitOS-PAGING-PageWalk-Anonymous/Kconfig
```kconfig
menuconfig PK_PAGING_PAGEWALK_ANON
	bool "PageWalk with Anonymous mmap memory"

if PK_PAGING_PAGEWALK_ANON

config PK_PAGING_PAGEWALK_ANON_VERSION
	default "default"
	string "verstion"

config PK_PAGING_PAGEWALK_ANON_TAR
	default "tar.gz"
	string "tar type"

config PK_PAGING_PAGEWALK_ANON_URL
	default "https://gitee.com/BiscuitOS_team/HardStack/raw/Gitee/Memory-Allocator/PAGING-MECH/BiscuitOS-PAGING-PageWalk-Anonymous"
	string "url"

config PK_PAGING_PAGEWALK_ANON_GITHUB
	string "GitHub"

config PK_PAGING_PAGEWALK_ANON_SRCFILE
	default "main.c Makefile Kconfig Mafile.app RunBiscuitOS.sh app.c"
	string "Source code list"

config PK_PAGING_PAGEWALK_ANON_CSRCFILE
	string "Compile source code list"

config PK_PAGING_PAGEWALK_ANON_CONFIG
	string "CONFIG: Project Configure Options"

config PK_PAGING_PAGEWALK_ANON_LIBPATH
	string "LIBS: Libraries to pass to the linker, e.g. -l<library>"

config PK_PAGING_PAGEWALK_ANON_CPPFLAGS
	string "CPPFLAGS: C/C++ preprocessor flags, e.g. -I<include dir>"

config PK_PAGING_PAGEWALK_ANON_DPKCONFIG
	string "PKG_CONFIG_PATH: Directories to add to pkg-config's search path"

config PK_PAGING_PAGEWALK_ANON_CFLAGS
	string "CFLAGS: C compiler flags"

config PK_PAGING_PAGEWALK_ANON_LDFLAGS
	string "LDFLAGS: Linker flags"

config PK_PAGING_PAGEWALK_ANON_CXXFLAGS
	string "CXXFLAGS: C++ compiler flags"

config PK_PAGING_PAGEWALK_ANON_ASFLAGS
	string "CCASFLAGS: assembler compiler flags (defaults to CFLAGS)"

config PK_PAGING_PAGEWALK_ANON_BUILDARCH
	string "--host options on configure for Architecture"

endif # PK_PAGING_PAGEWALK_ANON
```

## package/PAGING/BiscuitOS-PAGING-PageWalk-CBC-walk_page_test-65/Kconfig
```kconfig
menuconfig PK_PAGING_PAGEWALK_CBC_PAGETEST_65
	bool "PageWalk Case-by-Case: walk_page_tast 65#"

if PK_PAGING_PAGEWALK_CBC_PAGETEST_65

config PK_PAGING_PAGEWALK_CBC_PAGETEST_65_VERSION
	default "default"
	string "verstion"

config PK_PAGING_PAGEWALK_CBC_PAGETEST_65_TAR
	default "tar.gz"
	string "tar type"

config PK_PAGING_PAGEWALK_CBC_PAGETEST_65_URL
	default "https://gitee.com/BiscuitOS_team/HardStack/raw/Gitee/Memory-Allocator/PAGING-MECH/BiscuitOS-PAGING-PageWalk-CBC-walk_page_test-65"
	string "url"

config PK_PAGING_PAGEWALK_CBC_PAGETEST_65_GITHUB
	string "GitHub"

config PK_PAGING_PAGEWALK_CBC_PAGETEST_65_SRCFILE
	default "main.c Makefile Kconfig Makefile.app RunBiscuitOS.sh app.c"
	string "Source code list"

config PK_PAGING_PAGEWALK_CBC_PAGETEST_65_CSRCFILE
	string "Compile source code list"

config PK_PAGING_PAGEWALK_CBC_PAGETEST_65_CONFIG
	string "CONFIG: Project Configure Options"

config PK_PAGING_PAGEWALK_CBC_PAGETEST_65_LIBPATH
	string "LIBS: Libraries to pass to the linker, e.g. -l<library>"

config PK_PAGING_PAGEWALK_CBC_PAGETEST_65_CPPFLAGS
	string "CPPFLAGS: C/C++ preprocessor flags, e.g. -I<include dir>"

config PK_PAGING_PAGEWALK_CBC_PAGETEST_65_DPKCONFIG
	string "PKG_CONFIG_PATH: Directories to add to pkg-config's search path"

config PK_PAGING_PAGEWALK_CBC_PAGETEST_65_CFLAGS
	string "CFLAGS: C compiler flags"

config PK_PAGING_PAGEWALK_CBC_PAGETEST_65_LDFLAGS
	string "LDFLAGS: Linker flags"

config PK_PAGING_PAGEWALK_CBC_PAGETEST_65_CXXFLAGS
	string "CXXFLAGS: C++ compiler flags"

config PK_PAGING_PAGEWALK_CBC_PAGETEST_65_ASFLAGS
	string "CCASFLAGS: assembler compiler flags (defaults to CFLAGS)"

config PK_PAGING_PAGEWALK_CBC_PAGETEST_65_BUILDARCH
	string "--host options on configure for Architecture"

endif # PK_PAGING_PAGEWALK_CBC_PAGETEST_65
```

## package/PAGING/BiscuitOS-PAGING-PageWalk-CBC-walk_page_test-76/Kconfig
```kconfig
menuconfig PK_PAGING_PAGEWALK_CBC_PAGETEST_76
	bool "PageWalk Case-by-Case: walk_page_tast 76#"

if PK_PAGING_PAGEWALK_CBC_PAGETEST_76

config PK_PAGING_PAGEWALK_CBC_PAGETEST_76_VERSION
	default "default"
	string "verstion"

config PK_PAGING_PAGEWALK_CBC_PAGETEST_76_TAR
	default "tar.gz"
	string "tar type"

config PK_PAGING_PAGEWALK_CBC_PAGETEST_76_URL
	default "https://gitee.com/BiscuitOS_team/HardStack/raw/Gitee/Memory-Allocator/PAGING-MECH/BiscuitOS-PAGING-PageWalk-CBC-walk_page_test-76"
	string "url"

config PK_PAGING_PAGEWALK_CBC_PAGETEST_76_GITHUB
	string "GitHub"

config PK_PAGING_PAGEWALK_CBC_PAGETEST_76_SRCFILE
	default "main.c Makefile Kconfig Mafile.app RunBiscuitOS.sh app.c"
	string "Source code list"

config PK_PAGING_PAGEWALK_CBC_PAGETEST_76_CSRCFILE
	string "Compile source code list"

config PK_PAGING_PAGEWALK_CBC_PAGETEST_76_CONFIG
	string "CONFIG: Project Configure Options"

config PK_PAGING_PAGEWALK_CBC_PAGETEST_76_LIBPATH
	string "LIBS: Libraries to pass to the linker, e.g. -l<library>"

config PK_PAGING_PAGEWALK_CBC_PAGETEST_76_CPPFLAGS
	string "CPPFLAGS: C/C++ preprocessor flags, e.g. -I<include dir>"

config PK_PAGING_PAGEWALK_CBC_PAGETEST_76_DPKCONFIG
	string "PKG_CONFIG_PATH: Directories to add to pkg-config's search path"

config PK_PAGING_PAGEWALK_CBC_PAGETEST_76_CFLAGS
	string "CFLAGS: C compiler flags"

config PK_PAGING_PAGEWALK_CBC_PAGETEST_76_LDFLAGS
	string "LDFLAGS: Linker flags"

config PK_PAGING_PAGEWALK_CBC_PAGETEST_76_CXXFLAGS
	string "CXXFLAGS: C++ compiler flags"

config PK_PAGING_PAGEWALK_CBC_PAGETEST_76_ASFLAGS
	string "CCASFLAGS: assembler compiler flags (defaults to CFLAGS)"

config PK_PAGING_PAGEWALK_CBC_PAGETEST_76_BUILDARCH
	string "--host options on configure for Architecture"

endif # PK_PAGING_PAGEWALK_CBC_PAGETEST_76
```

## package/PAGING/BiscuitOS-PAGING-PageWalk-CBC-walk_pmd_range-18/Kconfig
```kconfig
menuconfig PK_PAGING_PAGEWALK_CBC_PMDRANGE_18
	bool "PageWalk Case-by-Case: walk_pmd_range 18#"

if PK_PAGING_PAGEWALK_CBC_PMDRANGE_18

config PK_PAGING_PAGEWALK_CBC_PMDRANGE_18_VERSION
	default "default"
	string "verstion"

config PK_PAGING_PAGEWALK_CBC_PMDRANGE_18_TAR
	default "tar.gz"
	string "tar type"

config PK_PAGING_PAGEWALK_CBC_PMDRANGE_18_URL
	default "https://gitee.com/BiscuitOS_team/HardStack/raw/Gitee/Memory-Allocator/PAGING-MECH/BiscuitOS-PAGING-PageWalk-CBC-walk_pmd_range-18"
	string "url"

config PK_PAGING_PAGEWALK_CBC_PMDRANGE_18_GITHUB
	string "GitHub"

config PK_PAGING_PAGEWALK_CBC_PMDRANGE_18_SRCFILE
	default "main.c Makefile Kconfig Mafile.app RunBiscuitOS.sh app.c"
	string "Source code list"

config PK_PAGING_PAGEWALK_CBC_PMDRANGE_18_CSRCFILE
	string "Compile source code list"

config PK_PAGING_PAGEWALK_CBC_PMDRANGE_18_CONFIG
	string "CONFIG: Project Configure Options"

config PK_PAGING_PAGEWALK_CBC_PMDRANGE_18_LIBPATH
	string "LIBS: Libraries to pass to the linker, e.g. -l<library>"

config PK_PAGING_PAGEWALK_CBC_PMDRANGE_18_CPPFLAGS
	string "CPPFLAGS: C/C++ preprocessor flags, e.g. -I<include dir>"

config PK_PAGING_PAGEWALK_CBC_PMDRANGE_18_DPKCONFIG
	string "PKG_CONFIG_PATH: Directories to add to pkg-config's search path"

config PK_PAGING_PAGEWALK_CBC_PMDRANGE_18_CFLAGS
	string "CFLAGS: C compiler flags"

config PK_PAGING_PAGEWALK_CBC_PMDRANGE_18_LDFLAGS
	string "LDFLAGS: Linker flags"

config PK_PAGING_PAGEWALK_CBC_PMDRANGE_18_CXXFLAGS
	string "CXXFLAGS: C++ compiler flags"

config PK_PAGING_PAGEWALK_CBC_PMDRANGE_18_ASFLAGS
	string "CCASFLAGS: assembler compiler flags (defaults to CFLAGS)"

config PK_PAGING_PAGEWALK_CBC_PMDRANGE_18_BUILDARCH
	string "--host options on configure for Architecture"

endif # PK_PAGING_PAGEWALK_CBC_PMDRANGE_18
```

## package/PAGING/BiscuitOS-PAGING-PageWalk-CBC-walk_pmd_range-49/Kconfig
```kconfig
menuconfig PK_PAGING_PAGEWALK_CBC_PMDRANGE_49
	bool "PageWalk Case-by-Case: walk_pmd_range 49#"

if PK_PAGING_PAGEWALK_CBC_PMDRANGE_49

config PK_PAGING_PAGEWALK_CBC_PMDRANGE_49_VERSION
	default "default"
	string "verstion"

config PK_PAGING_PAGEWALK_CBC_PMDRANGE_49_TAR
	default "tar.gz"
	string "tar type"

config PK_PAGING_PAGEWALK_CBC_PMDRANGE_49_URL
	default "https://gitee.com/BiscuitOS_team/HardStack/raw/Gitee/Memory-Allocator/PAGING-MECH/BiscuitOS-PAGING-PageWalk-CBC-walk_pmd_range-49"
	string "url"

config PK_PAGING_PAGEWALK_CBC_PMDRANGE_49_GITHUB
	string "GitHub"

config PK_PAGING_PAGEWALK_CBC_PMDRANGE_49_SRCFILE
	default "main.c Makefile Kconfig Mafile.app RunBiscuitOS.sh app.c"
	string "Source code list"

config PK_PAGING_PAGEWALK_CBC_PMDRANGE_49_CSRCFILE
	string "Compile source code list"

config PK_PAGING_PAGEWALK_CBC_PMDRANGE_49_CONFIG
	string "CONFIG: Project Configure Options"

config PK_PAGING_PAGEWALK_CBC_PMDRANGE_49_LIBPATH
	string "LIBS: Libraries to pass to the linker, e.g. -l<library>"

config PK_PAGING_PAGEWALK_CBC_PMDRANGE_49_CPPFLAGS
	string "CPPFLAGS: C/C++ preprocessor flags, e.g. -I<include dir>"

config PK_PAGING_PAGEWALK_CBC_PMDRANGE_49_DPKCONFIG
	string "PKG_CONFIG_PATH: Directories to add to pkg-config's search path"

config PK_PAGING_PAGEWALK_CBC_PMDRANGE_49_CFLAGS
	string "CFLAGS: C compiler flags"

config PK_PAGING_PAGEWALK_CBC_PMDRANGE_49_LDFLAGS
	string "LDFLAGS: Linker flags"

config PK_PAGING_PAGEWALK_CBC_PMDRANGE_49_CXXFLAGS
	string "CXXFLAGS: C++ compiler flags"

config PK_PAGING_PAGEWALK_CBC_PMDRANGE_49_ASFLAGS
	string "CCASFLAGS: assembler compiler flags (defaults to CFLAGS)"

config PK_PAGING_PAGEWALK_CBC_PMDRANGE_49_BUILDARCH
	string "--host options on configure for Architecture"

endif # PK_PAGING_PAGEWALK_CBC_PMDRANGE_49
```

## package/PAGING/BiscuitOS-PAGING-PageWalk-CLEAR-Reference/Kconfig
```kconfig
menuconfig PK_PAGING_PAGEWALK_CLEANREFS
	bool "PageWalk Use-Case: Clear Reference"

if PK_PAGING_PAGEWALK_CLEANREFS

config PK_PAGING_PAGEWALK_CLEANREFS_VERSION
	default "default"
	string "verstion"

config PK_PAGING_PAGEWALK_CLEANREFS_TAR
	default "tar.gz"
	string "tar type"

config PK_PAGING_PAGEWALK_CLEANREFS_URL
	default "https://gitee.com/BiscuitOS_team/HardStack/raw/Gitee/Memory-Allocator/PAGING-MECH/BiscuitOS-PAGING-PageWalk-CLEAR-Reference"
	string "url"

config PK_PAGING_PAGEWALK_CLEANREFS_GITHUB
	string "GitHub"

config PK_PAGING_PAGEWALK_CLEANREFS_SRCFILE
	default "main.c Makefile Kconfig Mafile.app RunBiscuitOS.sh app.c"
	string "Source code list"

config PK_PAGING_PAGEWALK_CLEANREFS_CSRCFILE
	string "Compile source code list"

config PK_PAGING_PAGEWALK_CLEANREFS_CONFIG
	string "CONFIG: Project Configure Options"

config PK_PAGING_PAGEWALK_CLEANREFS_LIBPATH
	string "LIBS: Libraries to pass to the linker, e.g. -l<library>"

config PK_PAGING_PAGEWALK_CLEANREFS_CPPFLAGS
	string "CPPFLAGS: C/C++ preprocessor flags, e.g. -I<include dir>"

config PK_PAGING_PAGEWALK_CLEANREFS_DPKCONFIG
	string "PKG_CONFIG_PATH: Directories to add to pkg-config's search path"

config PK_PAGING_PAGEWALK_CLEANREFS_CFLAGS
	string "CFLAGS: C compiler flags"

config PK_PAGING_PAGEWALK_CLEANREFS_LDFLAGS
	string "LDFLAGS: Linker flags"

config PK_PAGING_PAGEWALK_CLEANREFS_CXXFLAGS
	string "CXXFLAGS: C++ compiler flags"

config PK_PAGING_PAGEWALK_CLEANREFS_ASFLAGS
	string "CCASFLAGS: assembler compiler flags (defaults to CFLAGS)"

config PK_PAGING_PAGEWALK_CLEANREFS_BUILDARCH
	string "--host options on configure for Architecture"

endif # PK_PAGING_PAGEWALK_CLEANREFS
```

## package/PAGING/BiscuitOS-PAGING-PageWalk-CMA/Kconfig
```kconfig
menuconfig PK_PAGING_PAGEWALK_CMA
	bool "PageWalk with CMA"

if PK_PAGING_PAGEWALK_CMA

config PK_PAGING_PAGEWALK_CMA_VERSION
	default "default"
	string "verstion"

config PK_PAGING_PAGEWALK_CMA_TAR
	default "tar.gz"
	string "tar type"

config PK_PAGING_PAGEWALK_CMA_URL
	default "https://gitee.com/BiscuitOS_team/HardStack/raw/Gitee/Memory-Allocator/PAGING-MECH/BiscuitOS-PAGING-PageWalk-CMA"
	string "url"

config PK_PAGING_PAGEWALK_CMA_GITHUB
	string "GitHub"

config PK_PAGING_PAGEWALK_CMA_SRCFILE
	default "main.c Makefile Kconfig Makefile.app RunBiscuitOS.sh app.c"
	string "Source code list"

config PK_PAGING_PAGEWALK_CMA_CSRCFILE
	string "Compile source code list"

config PK_PAGING_PAGEWALK_CMA_CONFIG
	string "CONFIG: Project Configure Options"

config PK_PAGING_PAGEWALK_CMA_LIBPATH
	string "LIBS: Libraries to pass to the linker, e.g. -l<library>"

config PK_PAGING_PAGEWALK_CMA_CPPFLAGS
	string "CPPFLAGS: C/C++ preprocessor flags, e.g. -I<include dir>"

config PK_PAGING_PAGEWALK_CMA_DPKCONFIG
	string "PKG_CONFIG_PATH: Directories to add to pkg-config's search path"

config PK_PAGING_PAGEWALK_CMA_CFLAGS
	string "CFLAGS: C compiler flags"

config PK_PAGING_PAGEWALK_CMA_LDFLAGS
	string "LDFLAGS: Linker flags"

config PK_PAGING_PAGEWALK_CMA_CXXFLAGS
	string "CXXFLAGS: C++ compiler flags"

config PK_PAGING_PAGEWALK_CMA_ASFLAGS
	string "CCASFLAGS: assembler compiler flags (defaults to CFLAGS)"

config PK_PAGING_PAGEWALK_CMA_BUILDARCH
	string "--host options on configure for Architecture"

endif # PK_PAGING_PAGEWALK_CMA
```
