## package/PAGING/BiscuitOS-PAGING-ATPR-ONDEMAND/Kconfig
```kconfig
menuconfig PK_PAGING_ATPR_ONDEMAND
	bool "ATPR(Apply to page range): OnDemand"

if PK_PAGING_ATPR_ONDEMAND

config PK_PAGING_ATPR_ONDEMAND_VERSION
	default "default"
	string "verstion"

config PK_PAGING_ATPR_ONDEMAND_TAR
	default "tar.gz"
	string "tar type"

config PK_PAGING_ATPR_ONDEMAND_URL
	default "https://gitee.com/BiscuitOS_team/HardStack/raw/Gitee/Memory-Allocator/PAGING-MECH/BiscuitOS-PAGING-ATPR-ONDEMAND"
	string "url"

config PK_PAGING_ATPR_ONDEMAND_GITHUB
	string "GitHub"

config PK_PAGING_ATPR_ONDEMAND_SRCFILE
	default "app.c Kconfig main.c Makefile Makefile.host RunBiscuitOS.sh"
	string "Source code list"

config PK_PAGING_ATPR_ONDEMAND_CSRCFILE
	string "Compile source code list"

config PK_PAGING_ATPR_ONDEMAND_CONFIG
	string "CONFIG: Project Configure Options"

config PK_PAGING_ATPR_ONDEMAND_LIBPATH
	string "LIBS: Libraries to pass to the linker, e.g. -l<library>"

config PK_PAGING_ATPR_ONDEMAND_CPPFLAGS
	string "CPPFLAGS: C/C++ preprocessor flags, e.g. -I<include dir>"

config PK_PAGING_ATPR_ONDEMAND_DPKCONFIG
	string "PKG_CONFIG_PATH: Directories to add to pkg-config's search path"

config PK_PAGING_ATPR_ONDEMAND_CFLAGS
	string "CFLAGS: C compiler flags"

config PK_PAGING_ATPR_ONDEMAND_LDFLAGS
	string "LDFLAGS: Linker flags"

config PK_PAGING_ATPR_ONDEMAND_CXXFLAGS
	string "CXXFLAGS: C++ compiler flags"

config PK_PAGING_ATPR_ONDEMAND_ASFLAGS
	string "CCASFLAGS: assembler compiler flags (defaults to CFLAGS)"

config PK_PAGING_ATPR_ONDEMAND_BUILDARCH
	string "--host options on configure for Architecture"

endif # PK_PAGING_ATPR_ONDEMAND
```

## package/PAGING/BiscuitOS-PAGING-ATPR-PREALLOC/Kconfig
```kconfig
menuconfig PK_PAGING_ATPR_PREALLOC
	bool "ATPR(Apply to page range): PreAlloc"

if PK_PAGING_ATPR_PREALLOC

config PK_PAGING_ATPR_PREALLOC_VERSION
	default "default"
	string "verstion"

config PK_PAGING_ATPR_PREALLOC_TAR
	default "tar.gz"
	string "tar type"

config PK_PAGING_ATPR_PREALLOC_URL
	default "https://gitee.com/BiscuitOS_team/HardStack/raw/Gitee/Memory-Allocator/PAGING-MECH/BiscuitOS-PAGING-ATPR-PREALLOC"
	string "url"

config PK_PAGING_ATPR_PREALLOC_GITHUB
	string "GitHub"

config PK_PAGING_ATPR_PREALLOC_SRCFILE
	default "app.c Kconfig main.c Makefile Makefile.host RunBiscuitOS.sh"
	string "Source code list"

config PK_PAGING_ATPR_PREALLOC_CSRCFILE
	string "Compile source code list"

config PK_PAGING_ATPR_PREALLOC_CONFIG
	string "CONFIG: Project Configure Options"

config PK_PAGING_ATPR_PREALLOC_LIBPATH
	string "LIBS: Libraries to pass to the linker, e.g. -l<library>"

config PK_PAGING_ATPR_PREALLOC_CPPFLAGS
	string "CPPFLAGS: C/C++ preprocessor flags, e.g. -I<include dir>"

config PK_PAGING_ATPR_PREALLOC_DPKCONFIG
	string "PKG_CONFIG_PATH: Directories to add to pkg-config's search path"

config PK_PAGING_ATPR_PREALLOC_CFLAGS
	string "CFLAGS: C compiler flags"

config PK_PAGING_ATPR_PREALLOC_LDFLAGS
	string "LDFLAGS: Linker flags"

config PK_PAGING_ATPR_PREALLOC_CXXFLAGS
	string "CXXFLAGS: C++ compiler flags"

config PK_PAGING_ATPR_PREALLOC_ASFLAGS
	string "CCASFLAGS: assembler compiler flags (defaults to CFLAGS)"

config PK_PAGING_ATPR_PREALLOC_BUILDARCH
	string "--host options on configure for Architecture"

endif # PK_PAGING_ATPR_PREALLOC
```

## package/PAGING/BiscuitOS-PAGING-EA-CENTRALIZED-MAPPING/Kconfig
```kconfig
menuconfig PK_PAGING_EA_CENTRALIZED_MAPPING
	bool "ENGINEERING APPLICATION: CENTRALIZED MAPPING"

if PK_PAGING_EA_CENTRALIZED_MAPPING

config PK_PAGING_EA_CENTRALIZED_MAPPING_VERSION
	default "default"
	string "verstion"

config PK_PAGING_EA_CENTRALIZED_MAPPING_TAR
	default "tar.gz"
	string "tar type"

config PK_PAGING_EA_CENTRALIZED_MAPPING_URL
	default "https://gitee.com/BiscuitOS_team/HardStack/raw/Gitee/Memory-Allocator/PAGING-MECH/BiscuitOS-PAGING-EA-CENTRALIZED-MAPPING"
	string "url"

config PK_PAGING_EA_CENTRALIZED_MAPPING_GITHUB
	string "GitHub"

config PK_PAGING_EA_CENTRALIZED_MAPPING_SRCFILE
	default "main.c Makefile Kconfig Makefile.host RunBiscuitOS.sh app.c"
	string "Source code list"

config PK_PAGING_EA_CENTRALIZED_MAPPING_CSRCFILE
	string "Compile source code list"

config PK_PAGING_EA_CENTRALIZED_MAPPING_CONFIG
	string "CONFIG: Project Configure Options"

config PK_PAGING_EA_CENTRALIZED_MAPPING_LIBPATH
	string "LIBS: Libraries to pass to the linker, e.g. -l<library>"

config PK_PAGING_EA_CENTRALIZED_MAPPING_CPPFLAGS
	string "CPPFLAGS: C/C++ preprocessor flags, e.g. -I<include dir>"

config PK_PAGING_EA_CENTRALIZED_MAPPING_DPKCONFIG
	string "PKG_CONFIG_PATH: Directories to add to pkg-config's search path"

config PK_PAGING_EA_CENTRALIZED_MAPPING_CFLAGS
	string "CFLAGS: C compiler flags"

config PK_PAGING_EA_CENTRALIZED_MAPPING_LDFLAGS
	string "LDFLAGS: Linker flags"

config PK_PAGING_EA_CENTRALIZED_MAPPING_CXXFLAGS
	string "CXXFLAGS: C++ compiler flags"

config PK_PAGING_EA_CENTRALIZED_MAPPING_ASFLAGS
	string "CCASFLAGS: assembler compiler flags (defaults to CFLAGS)"

config PK_PAGING_EA_CENTRALIZED_MAPPING_BUILDARCH
	string "--host options on configure for Architecture"

endif # PK_PAGING_EA_CENTRALIZED_MAPPING
```

## package/PAGING/BiscuitOS-PAGING-EA-KMM/Kconfig
```kconfig
menuconfig PK_PAGING_EA_KMM
	bool "Paging Project: KMM BASE"

if PK_PAGING_EA_KMM

config PK_PAGING_EA_KMM_VERSION
	default "default"
	string "verstion"

config PK_PAGING_EA_KMM_TAR
	default "tar.gz"
	string "tar type"

config PK_PAGING_EA_KMM_URL
	default "https://gitee.com/BiscuitOS_team/HardStack/raw/Gitee/Memory-Allocator/PAGING-MECH/BiscuitOS-PAGING-EA-KMM"
	string "url"

config PK_PAGING_EA_KMM_GITHUB
	string "GitHub"

config PK_PAGING_EA_KMM_SRCFILE
	default "Kconfig  main.c  Makefile"
	string "Source code list"

config PK_PAGING_EA_KMM_CSRCFILE
	string "Compile source code list"

config PK_PAGING_EA_KMM_CONFIG
	string "CONFIG: Project Configure Options"

config PK_PAGING_EA_KMM_LIBPATH
	string "LIBS: Libraries to pass to the linker, e.g. -l<library>"

config PK_PAGING_EA_KMM_CPPFLAGS
	string "CPPFLAGS: C/C++ preprocessor flags, e.g. -I<include dir>"

config PK_PAGING_EA_KMM_DPKCONFIG
	string "PKG_CONFIG_PATH: Directories to add to pkg-config's search path"

config PK_PAGING_EA_KMM_CFLAGS
	string "CFLAGS: C compiler flags"

config PK_PAGING_EA_KMM_LDFLAGS
	string "LDFLAGS: Linker flags"

config PK_PAGING_EA_KMM_CXXFLAGS
	string "CXXFLAGS: C++ compiler flags"

config PK_PAGING_EA_KMM_ASFLAGS
	string "CCASFLAGS: assembler compiler flags (defaults to CFLAGS)"

config PK_PAGING_EA_KMM_BUILDARCH
	string "--host options on configure for Architecture"

endif # PK_PAGING_EA_KMM
```

## package/PAGING/BiscuitOS-PAGING-EA-MM/Kconfig
```kconfig
menuconfig PK_PAGING_EA_MM
	bool "Paging Project: MM BASE"

if PK_PAGING_EA_MM

config PK_PAGING_EA_MM_VERSION
	default "default"
	string "verstion"

config PK_PAGING_EA_MM_TAR
	default "tar.gz"
	string "tar type"

config PK_PAGING_EA_MM_URL
	default "https://gitee.com/BiscuitOS_team/HardStack/raw/Gitee/Memory-Allocator/PAGING-MECH/BiscuitOS-PAGING-EA-MM"
	string "url"

config PK_PAGING_EA_MM_GITHUB
	string "GitHub"

config PK_PAGING_EA_MM_SRCFILE
	default "app.c  Kconfig  main.c  Makefile  Makefile.host  RunBiscuitOS.sh"
	string "Source code list"

config PK_PAGING_EA_MM_CSRCFILE
	string "Compile source code list"

config PK_PAGING_EA_MM_CONFIG
	string "CONFIG: Project Configure Options"

config PK_PAGING_EA_MM_LIBPATH
	string "LIBS: Libraries to pass to the linker, e.g. -l<library>"

config PK_PAGING_EA_MM_CPPFLAGS
	string "CPPFLAGS: C/C++ preprocessor flags, e.g. -I<include dir>"

config PK_PAGING_EA_MM_DPKCONFIG
	string "PKG_CONFIG_PATH: Directories to add to pkg-config's search path"

config PK_PAGING_EA_MM_CFLAGS
	string "CFLAGS: C compiler flags"

config PK_PAGING_EA_MM_LDFLAGS
	string "LDFLAGS: Linker flags"

config PK_PAGING_EA_MM_CXXFLAGS
	string "CXXFLAGS: C++ compiler flags"

config PK_PAGING_EA_MM_ASFLAGS
	string "CCASFLAGS: assembler compiler flags (defaults to CFLAGS)"

config PK_PAGING_EA_MM_BUILDARCH
	string "--host options on configure for Architecture"

endif # PK_PAGING_EA_MM
```

## package/PAGING/BiscuitOS-PAGING-EA-SIMPLE-KERNEL-ALLOCATOR/Kconfig
```kconfig
menuconfig PK_PAGING_EA_SIMPLE_KALLOCATOR
	bool "ENGINEERING APPLICATION: Simple Kernel ALLOCATOR"

if PK_PAGING_EA_SIMPLE_KALLOCATOR

config PK_PAGING_EA_SIMPLE_KALLOCATOR_VERSION
	default "default"
	string "verstion"

config PK_PAGING_EA_SIMPLE_KALLOCATOR_TAR
	default "tar.gz"
	string "tar type"

config PK_PAGING_EA_SIMPLE_KALLOCATOR_URL
	default "https://gitee.com/BiscuitOS_team/HardStack/raw/Gitee/Memory-Allocator/PAGING-MECH/BiscuitOS-PAGING-EA-SIMPLE-KERNEL-ALLOCATOR"
	string "url"

config PK_PAGING_EA_SIMPLE_KALLOCATOR_GITHUB
	string "GitHub"

config PK_PAGING_EA_SIMPLE_KALLOCATOR_SRCFILE
	default "main.c Makefile Kconfig"
	string "Source code list"

config PK_PAGING_EA_SIMPLE_KALLOCATOR_CSRCFILE
	string "Compile source code list"

config PK_PAGING_EA_SIMPLE_KALLOCATOR_CONFIG
	string "CONFIG: Project Configure Options"

config PK_PAGING_EA_SIMPLE_KALLOCATOR_LIBPATH
	string "LIBS: Libraries to pass to the linker, e.g. -l<library>"

config PK_PAGING_EA_SIMPLE_KALLOCATOR_CPPFLAGS
	string "CPPFLAGS: C/C++ preprocessor flags, e.g. -I<include dir>"

config PK_PAGING_EA_SIMPLE_KALLOCATOR_DPKCONFIG
	string "PKG_CONFIG_PATH: Directories to add to pkg-config's search path"

config PK_PAGING_EA_SIMPLE_KALLOCATOR_CFLAGS
	string "CFLAGS: C compiler flags"

config PK_PAGING_EA_SIMPLE_KALLOCATOR_LDFLAGS
	string "LDFLAGS: Linker flags"

config PK_PAGING_EA_SIMPLE_KALLOCATOR_CXXFLAGS
	string "CXXFLAGS: C++ compiler flags"

config PK_PAGING_EA_SIMPLE_KALLOCATOR_ASFLAGS
	string "CCASFLAGS: assembler compiler flags (defaults to CFLAGS)"

config PK_PAGING_EA_SIMPLE_KALLOCATOR_BUILDARCH
	string "--host options on configure for Architecture"

endif # PK_PAGING_EA_SIMPLE_KALLOCATOR
```

## package/PAGING/BiscuitOS-PAGING-HUGE-PF-KSM-ANON-THP/Kconfig
```kconfig
menuconfig PK_PAGING_HUGE_PF_KSM_ANON_THP
	bool "Huge PageFault with KSM Anonymous THP"

if PK_PAGING_HUGE_PF_KSM_ANON_THP

config PK_PAGING_HUGE_PF_KSM_ANON_THP_VERSION
	default "default"
	string "verstion"

config PK_PAGING_HUGE_PF_KSM_ANON_THP_TAR
	default "tar.gz"
	string "tar type"

config PK_PAGING_HUGE_PF_KSM_ANON_THP_URL
	default "https://gitee.com/BiscuitOS_team/HardStack/raw/Gitee/Memory-Allocator/PAGING-MECH/BiscuitOS-PAGING-HUGE-PF-KSM-ANON-THP"
	string "url"

config PK_PAGING_HUGE_PF_KSM_ANON_THP_GITHUB
	string "GitHub"

config PK_PAGING_HUGE_PF_KSM_ANON_THP_SRCFILE
	default "main.c Makefile RunBiscuitOS.sh"
	string "Source code list"

config PK_PAGING_HUGE_PF_KSM_ANON_THP_CSRCFILE
	string "Compile source code list"

config PK_PAGING_HUGE_PF_KSM_ANON_THP_CONFIG
	string "CONFIG: Project Configure Options"

config PK_PAGING_HUGE_PF_KSM_ANON_THP_LIBPATH
	string "LIBS: Libraries to pass to the linker, e.g. -l<library>"

config PK_PAGING_HUGE_PF_KSM_ANON_THP_CPPFLAGS
	string "CPPFLAGS: C/C++ preprocessor flags, e.g. -I<include dir>"

config PK_PAGING_HUGE_PF_KSM_ANON_THP_DPKCONFIG
	string "PKG_CONFIG_PATH: Directories to add to pkg-config's search path"

config PK_PAGING_HUGE_PF_KSM_ANON_THP_CFLAGS
	string "CFLAGS: C compiler flags"

config PK_PAGING_HUGE_PF_KSM_ANON_THP_LDFLAGS
	string "LDFLAGS: Linker flags"

config PK_PAGING_HUGE_PF_KSM_ANON_THP_CXXFLAGS
	string "CXXFLAGS: C++ compiler flags"

config PK_PAGING_HUGE_PF_KSM_ANON_THP_ASFLAGS
	string "CCASFLAGS: assembler compiler flags (defaults to CFLAGS)"

config PK_PAGING_HUGE_PF_KSM_ANON_THP_BUILDARCH
	string "--host options on configure for Architecture"

endif # PK_PAGING_HUGE_PF_KSM_ANON_THP
```

## package/PAGING/BiscuitOS-PAGING-HUGE-PF-PUDMAPPED/Kconfig
```kconfig
menuconfig PK_PAGING_HUGE_PF_PUDMAPPED
	bool "Huge PageFault with PUDMAPPED(1G)"

if PK_PAGING_HUGE_PF_PUDMAPPED

config PK_PAGING_HUGE_PF_PUDMAPPED_VERSION
	default "default"
	string "verstion"

config PK_PAGING_HUGE_PF_PUDMAPPED_TAR
	default "tar.gz"
	string "tar type"

config PK_PAGING_HUGE_PF_PUDMAPPED_URL
	default "https://gitee.com/BiscuitOS_team/HardStack/raw/Gitee/Memory-Allocator/PAGING-MECH/BiscuitOS-PAGING-HUGE-PF-PUDMAPPED"
	string "url"

config PK_PAGING_HUGE_PF_PUDMAPPED_GITHUB
	string "GitHub"

config PK_PAGING_HUGE_PF_PUDMAPPED_SRCFILE
	default "main.c Makefile Kconfig Mafile.host RunBiscuitOS.sh app.c"
	string "Source code list"

config PK_PAGING_HUGE_PF_PUDMAPPED_CSRCFILE
	string "Compile source code list"

config PK_PAGING_HUGE_PF_PUDMAPPED_CONFIG
	string "CONFIG: Project Configure Options"

config PK_PAGING_HUGE_PF_PUDMAPPED_LIBPATH
	string "LIBS: Libraries to pass to the linker, e.g. -l<library>"

config PK_PAGING_HUGE_PF_PUDMAPPED_CPPFLAGS
	string "CPPFLAGS: C/C++ preprocessor flags, e.g. -I<include dir>"

config PK_PAGING_HUGE_PF_PUDMAPPED_DPKCONFIG
	string "PKG_CONFIG_PATH: Directories to add to pkg-config's search path"

config PK_PAGING_HUGE_PF_PUDMAPPED_CFLAGS
	string "CFLAGS: C compiler flags"

config PK_PAGING_HUGE_PF_PUDMAPPED_LDFLAGS
	string "LDFLAGS: Linker flags"

config PK_PAGING_HUGE_PF_PUDMAPPED_CXXFLAGS
	string "CXXFLAGS: C++ compiler flags"

config PK_PAGING_HUGE_PF_PUDMAPPED_ASFLAGS
	string "CCASFLAGS: assembler compiler flags (defaults to CFLAGS)"

config PK_PAGING_HUGE_PF_PUDMAPPED_BUILDARCH
	string "--host options on configure for Architecture"

endif # PK_PAGING_HUGE_PF_PUDMAPPED
```

## package/PAGING/BiscuitOS-PAGING-INTEL-MTRRS-IOCTL2/Kconfig
```kconfig
menuconfig PK_PAGING_INTEL_MTRRS_IOCTL2
	bool "Intel MTRRS: Read MTRRs via IOCTL Type2"

if PK_PAGING_INTEL_MTRRS_IOCTL2

config PK_PAGING_INTEL_MTRRS_IOCTL2_VERSION
	default "default"
	string "verstion"

config PK_PAGING_INTEL_MTRRS_IOCTL2_TAR
	default "tar.gz"
	string "tar type"

config PK_PAGING_INTEL_MTRRS_IOCTL2_URL
	default "https://gitee.com/BiscuitOS_team/HardStack/raw/Gitee/Memory-Allocator/PAGING-MECH/BiscuitOS-PAGING-INTEL-MTRRS-IOCTL2"
	string "url"

config PK_PAGING_INTEL_MTRRS_IOCTL2_GITHUB
	string "GitHub"

config PK_PAGING_INTEL_MTRRS_IOCTL2_SRCFILE
	default "main.c Makefile RunBiscuitOS.sh"
	string "Source code list"

config PK_PAGING_INTEL_MTRRS_IOCTL2_CSRCFILE
	string "Compile source code list"

config PK_PAGING_INTEL_MTRRS_IOCTL2_CONFIG
	string "CONFIG: Project Configure Options"

config PK_PAGING_INTEL_MTRRS_IOCTL2_LIBPATH
	string "LIBS: Libraries to pass to the linker, e.g. -l<library>"

config PK_PAGING_INTEL_MTRRS_IOCTL2_CPPFLAGS
	string "CPPFLAGS: C/C++ preprocessor flags, e.g. -I<include dir>"

config PK_PAGING_INTEL_MTRRS_IOCTL2_DPKCONFIG
	string "PKG_CONFIG_PATH: Directories to add to pkg-config's search path"

config PK_PAGING_INTEL_MTRRS_IOCTL2_CFLAGS
	string "CFLAGS: C compiler flags"

config PK_PAGING_INTEL_MTRRS_IOCTL2_LDFLAGS
	string "LDFLAGS: Linker flags"

config PK_PAGING_INTEL_MTRRS_IOCTL2_CXXFLAGS
	string "CXXFLAGS: C++ compiler flags"

config PK_PAGING_INTEL_MTRRS_IOCTL2_ASFLAGS
	string "CCASFLAGS: assembler compiler flags (defaults to CFLAGS)"

config PK_PAGING_INTEL_MTRRS_IOCTL2_BUILDARCH
	string "--host options on configure for Architecture"

endif # PK_PAGING_INTEL_MTRRS_IOCTL2
```
