## package/PAGING/BiscuitOS-PAGING-LOOKUP-ADDR-RSVDMEM/Kconfig
```kconfig
menuconfig PK_PAGING_LOOKUP_ADDR_RSVDMEM
	bool "LOOKUP Address: Consult RSVDMEM"

if PK_PAGING_LOOKUP_ADDR_RSVDMEM

config PK_PAGING_LOOKUP_ADDR_RSVDMEM_VERSION
	default "default"
	string "verstion"

config PK_PAGING_LOOKUP_ADDR_RSVDMEM_TAR
	default "tar.gz"
	string "tar type"

config PK_PAGING_LOOKUP_ADDR_RSVDMEM_URL
	default "https://gitee.com/BiscuitOS_team/HardStack/raw/Gitee/Memory-Allocator/PAGING-MECH/BiscuitOS-PAGING-LOOKUP-ADDR-RSVDMEM"
	string "url"

config PK_PAGING_LOOKUP_ADDR_RSVDMEM_GITHUB
	string "GitHub"

config PK_PAGING_LOOKUP_ADDR_RSVDMEM_SRCFILE
	default "Kconfig main.c Makefile Makefile.host RunBiscuitOS.sh"
	string "Source code list"

config PK_PAGING_LOOKUP_ADDR_RSVDMEM_CSRCFILE
	string "Compile source code list"

config PK_PAGING_LOOKUP_ADDR_RSVDMEM_CONFIG
	string "CONFIG: Project Configure Options"

config PK_PAGING_LOOKUP_ADDR_RSVDMEM_LIBPATH
	string "LIBS: Libraries to pass to the linker, e.g. -l<library>"

config PK_PAGING_LOOKUP_ADDR_RSVDMEM_CPPFLAGS
	string "CPPFLAGS: C/C++ preprocessor flags, e.g. -I<include dir>"

config PK_PAGING_LOOKUP_ADDR_RSVDMEM_DPKCONFIG
	string "PKG_CONFIG_PATH: Directories to add to pkg-config's search path"

config PK_PAGING_LOOKUP_ADDR_RSVDMEM_CFLAGS
	string "CFLAGS: C compiler flags"

config PK_PAGING_LOOKUP_ADDR_RSVDMEM_LDFLAGS
	string "LDFLAGS: Linker flags"

config PK_PAGING_LOOKUP_ADDR_RSVDMEM_CXXFLAGS
	string "CXXFLAGS: C++ compiler flags"

config PK_PAGING_LOOKUP_ADDR_RSVDMEM_ASFLAGS
	string "CCASFLAGS: assembler compiler flags (defaults to CFLAGS)"

config PK_PAGING_LOOKUP_ADDR_RSVDMEM_BUILDARCH
	string "--host options on configure for Architecture"

endif # PK_PAGING_LOOKUP_ADDR_RSVDMEM
```

## package/PAGING/BiscuitOS-PAGING-LOOKUP-ADDR/Kconfig
```kconfig
menuconfig PK_PAGING_LOOKUP_ADDR
	bool "LOOKUP Address"

if PK_PAGING_LOOKUP_ADDR

config PK_PAGING_LOOKUP_ADDR_VERSION
	default "default"
	string "verstion"

config PK_PAGING_LOOKUP_ADDR_TAR
	default "tar.gz"
	string "tar type"

config PK_PAGING_LOOKUP_ADDR_URL
	default "https://gitee.com/BiscuitOS_team/HardStack/raw/Gitee/Memory-Allocator/PAGING-MECH/BiscuitOS-PAGING-LOOKUP-ADDR"
	string "url"

config PK_PAGING_LOOKUP_ADDR_GITHUB
	string "GitHub"

config PK_PAGING_LOOKUP_ADDR_SRCFILE
	default "Kconfig main.c Makefile Makefile.host RunBiscuitOS.sh"
	string "Source code list"

config PK_PAGING_LOOKUP_ADDR_CSRCFILE
	string "Compile source code list"

config PK_PAGING_LOOKUP_ADDR_CONFIG
	string "CONFIG: Project Configure Options"

config PK_PAGING_LOOKUP_ADDR_LIBPATH
	string "LIBS: Libraries to pass to the linker, e.g. -l<library>"

config PK_PAGING_LOOKUP_ADDR_CPPFLAGS
	string "CPPFLAGS: C/C++ preprocessor flags, e.g. -I<include dir>"

config PK_PAGING_LOOKUP_ADDR_DPKCONFIG
	string "PKG_CONFIG_PATH: Directories to add to pkg-config's search path"

config PK_PAGING_LOOKUP_ADDR_CFLAGS
	string "CFLAGS: C compiler flags"

config PK_PAGING_LOOKUP_ADDR_LDFLAGS
	string "LDFLAGS: Linker flags"

config PK_PAGING_LOOKUP_ADDR_CXXFLAGS
	string "CXXFLAGS: C++ compiler flags"

config PK_PAGING_LOOKUP_ADDR_ASFLAGS
	string "CCASFLAGS: assembler compiler flags (defaults to CFLAGS)"

config PK_PAGING_LOOKUP_ADDR_BUILDARCH
	string "--host options on configure for Architecture"

endif # PK_PAGING_LOOKUP_ADDR
```

## package/PAGING/BiscuitOS-PAGING-MISC/Kconfig
```kconfig
menuconfig PK_PAGING_MISC
	bool "MISC"

if PK_PAGING_MISC

config PK_PAGING_MISC_VERSION
	default "default"
	string "verstion"

config PK_PAGING_MISC_TAR
	default "tar.gz"
	string "tar type"

config PK_PAGING_MISC_URL
	default "https://gitee.com/BiscuitOS_team/HardStack/raw/Gitee/Memory-Allocator/PAGING-MECH/BiscuitOS-PAGING-MISC"
	string "url"

config PK_PAGING_MISC_GITHUB
	string "GitHub"

config PK_PAGING_MISC_SRCFILE
	default "main.c Makefile RunBiscuitOS.sh app.c Makefile.host Kconfig"
	string "Source code list"

config PK_PAGING_MISC_CSRCFILE
	string "Compile source code list"

config PK_PAGING_MISC_CONFIG
	string "CONFIG: Project Configure Options"

config PK_PAGING_MISC_LIBPATH
	string "LIBS: Libraries to pass to the linker, e.g. -l<library>"

config PK_PAGING_MISC_CPPFLAGS
	string "CPPFLAGS: C/C++ preprocessor flags, e.g. -I<include dir>"

config PK_PAGING_MISC_DPKCONFIG
	string "PKG_CONFIG_PATH: Directories to add to pkg-config's search path"

config PK_PAGING_MISC_CFLAGS
	string "CFLAGS: C compiler flags"

config PK_PAGING_MISC_LDFLAGS
	string "LDFLAGS: Linker flags"

config PK_PAGING_MISC_CXXFLAGS
	string "CXXFLAGS: C++ compiler flags"

config PK_PAGING_MISC_ASFLAGS
	string "CCASFLAGS: assembler compiler flags (defaults to CFLAGS)"

config PK_PAGING_MISC_BUILDARCH
	string "--host options on configure for Architecture"

endif # PK_PAGING_MISC
```

## package/PAGING/BiscuitOS-PAGING-MMIO-MAPPING/Kconfig
```kconfig
menuconfig PK_PAGING_MMIO_MAPPING
	bool "MMIO Mapping"

if PK_PAGING_MMIO_MAPPING

config PK_PAGING_MMIO_MAPPING_VERSION
	default "default"
	string "verstion"

config PK_PAGING_MMIO_MAPPING_TAR
	default "tar.gz"
	string "tar type"

config PK_PAGING_MMIO_MAPPING_URL
	default "https://gitee.com/BiscuitOS_team/HardStack/raw/Gitee/Memory-Allocator/PAGING-MECH/BiscuitOS-PAGING-MMIO-MAPPING"
	string "url"

config PK_PAGING_MMIO_MAPPING_GITHUB
	string "GitHub"

config PK_PAGING_MMIO_MAPPING_SRCFILE
	default "main.c Makefile Kconfig Makefile.host RunBiscuitOS.sh"
	string "Source code list"

config PK_PAGING_MMIO_MAPPING_CSRCFILE
	string "Compile source code list"

config PK_PAGING_MMIO_MAPPING_CONFIG
	string "CONFIG: Project Configure Options"

config PK_PAGING_MMIO_MAPPING_LIBPATH
	string "LIBS: Libraries to pass to the linker, e.g. -l<library>"

config PK_PAGING_MMIO_MAPPING_CPPFLAGS
	string "CPPFLAGS: C/C++ preprocessor flags, e.g. -I<include dir>"

config PK_PAGING_MMIO_MAPPING_DPKCONFIG
	string "PKG_CONFIG_PATH: Directories to add to pkg-config's search path"

config PK_PAGING_MMIO_MAPPING_CFLAGS
	string "CFLAGS: C compiler flags"

config PK_PAGING_MMIO_MAPPING_LDFLAGS
	string "LDFLAGS: Linker flags"

config PK_PAGING_MMIO_MAPPING_CXXFLAGS
	string "CXXFLAGS: C++ compiler flags"

config PK_PAGING_MMIO_MAPPING_ASFLAGS
	string "CCASFLAGS: assembler compiler flags (defaults to CFLAGS)"

config PK_PAGING_MMIO_MAPPING_BUILDARCH
	string "--host options on configure for Architecture"

endif # PK_PAGING_MMIO_MAPPING
```

## package/PAGING/BiscuitOS-PAGING-PF-ANON-COW/Kconfig
```kconfig
menuconfig PK_PAGING_PF_ANON_COW
	bool "Page Fault with Anonymous on COW(Copy-On-Write)"

if PK_PAGING_PF_ANON_COW

config PK_PAGING_PF_ANON_COW_VERSION
	default "default"
	string "verstion"

config PK_PAGING_PF_ANON_COW_TAR
	default "tar.gz"
	string "tar type"

config PK_PAGING_PF_ANON_COW_URL
	default "https://gitee.com/BiscuitOS_team/HardStack/raw/Gitee/Memory-Allocator/PAGING-MECH/BiscuitOS-PAGING-PF-ANON-COW"
	string "url"

config PK_PAGING_PF_ANON_COW_GITHUB
	string "GitHub"

config PK_PAGING_PF_ANON_COW_SRCFILE
	default "main.c Makefile RunBiscuitOS.sh"
	string "Source code list"

config PK_PAGING_PF_ANON_COW_CSRCFILE
	string "Compile source code list"

config PK_PAGING_PF_ANON_COW_CONFIG
	string "CONFIG: Project Configure Options"

config PK_PAGING_PF_ANON_COW_LIBPATH
	string "LIBS: Libraries to pass to the linker, e.g. -l<library>"

config PK_PAGING_PF_ANON_COW_CPPFLAGS
	string "CPPFLAGS: C/C++ preprocessor flags, e.g. -I<include dir>"

config PK_PAGING_PF_ANON_COW_DPKCONFIG
	string "PKG_CONFIG_PATH: Directories to add to pkg-config's search path"

config PK_PAGING_PF_ANON_COW_CFLAGS
	string "CFLAGS: C compiler flags"

config PK_PAGING_PF_ANON_COW_LDFLAGS
	string "LDFLAGS: Linker flags"

config PK_PAGING_PF_ANON_COW_CXXFLAGS
	string "CXXFLAGS: C++ compiler flags"

config PK_PAGING_PF_ANON_COW_ASFLAGS
	string "CCASFLAGS: assembler compiler flags (defaults to CFLAGS)"

config PK_PAGING_PF_ANON_COW_BUILDARCH
	string "--host options on configure for Architecture"

endif # PK_PAGING_PF_ANON_COW
```

## package/PAGING/BiscuitOS-PAGING-PF-ANON-HEAP/Kconfig
```kconfig
menuconfig PK_PAGING_PF_ANON_HEAP
	bool "Page Fault with Anonymous on Heap"

if PK_PAGING_PF_ANON_HEAP

config PK_PAGING_PF_ANON_HEAP_VERSION
	default "default"
	string "verstion"

config PK_PAGING_PF_ANON_HEAP_TAR
	default "tar.gz"
	string "tar type"

config PK_PAGING_PF_ANON_HEAP_URL
	default "https://gitee.com/BiscuitOS_team/HardStack/raw/Gitee/Memory-Allocator/PAGING-MECH/BiscuitOS-PAGING-PF-ANON-HEAP"
	string "url"

config PK_PAGING_PF_ANON_HEAP_GITHUB
	string "GitHub"

config PK_PAGING_PF_ANON_HEAP_SRCFILE
	default "main.c Makefile RunBiscuitOS.sh"
	string "Source code list"

config PK_PAGING_PF_ANON_HEAP_CSRCFILE
	string "Compile source code list"

config PK_PAGING_PF_ANON_HEAP_CONFIG
	string "CONFIG: Project Configure Options"

config PK_PAGING_PF_ANON_HEAP_LIBPATH
	string "LIBS: Libraries to pass to the linker, e.g. -l<library>"

config PK_PAGING_PF_ANON_HEAP_CPPFLAGS
	string "CPPFLAGS: C/C++ preprocessor flags, e.g. -I<include dir>"

config PK_PAGING_PF_ANON_HEAP_DPKCONFIG
	string "PKG_CONFIG_PATH: Directories to add to pkg-config's search path"

config PK_PAGING_PF_ANON_HEAP_CFLAGS
	string "CFLAGS: C compiler flags"

config PK_PAGING_PF_ANON_HEAP_LDFLAGS
	string "LDFLAGS: Linker flags"

config PK_PAGING_PF_ANON_HEAP_CXXFLAGS
	string "CXXFLAGS: C++ compiler flags"

config PK_PAGING_PF_ANON_HEAP_ASFLAGS
	string "CCASFLAGS: assembler compiler flags (defaults to CFLAGS)"

config PK_PAGING_PF_ANON_HEAP_BUILDARCH
	string "--host options on configure for Architecture"

endif # PK_PAGING_PF_ANON_HEAP
```

## package/PAGING/BiscuitOS-PAGING-PF-ANON-KSM/Kconfig
```kconfig
menuconfig PK_PAGING_PF_ANON_KSM
	bool "Page Fault with Anonymous on KSM"

if PK_PAGING_PF_ANON_KSM

config PK_PAGING_PF_ANON_KSM_VERSION
	default "default"
	string "verstion"

config PK_PAGING_PF_ANON_KSM_TAR
	default "tar.gz"
	string "tar type"

config PK_PAGING_PF_ANON_KSM_URL
	default "https://gitee.com/BiscuitOS_team/HardStack/raw/Gitee/Memory-Allocator/PAGING-MECH/BiscuitOS-PAGING-PF-ANON-KSM"
	string "url"

config PK_PAGING_PF_ANON_KSM_GITHUB
	string "GitHub"

config PK_PAGING_PF_ANON_KSM_SRCFILE
	default "main.c Makefile RunBiscuitOS.sh"
	string "Source code list"

config PK_PAGING_PF_ANON_KSM_CSRCFILE
	string "Compile source code list"

config PK_PAGING_PF_ANON_KSM_CONFIG
	string "CONFIG: Project Configure Options"

config PK_PAGING_PF_ANON_KSM_LIBPATH
	string "LIBS: Libraries to pass to the linker, e.g. -l<library>"

config PK_PAGING_PF_ANON_KSM_CPPFLAGS
	string "CPPFLAGS: C/C++ preprocessor flags, e.g. -I<include dir>"

config PK_PAGING_PF_ANON_KSM_DPKCONFIG
	string "PKG_CONFIG_PATH: Directories to add to pkg-config's search path"

config PK_PAGING_PF_ANON_KSM_CFLAGS
	string "CFLAGS: C compiler flags"

config PK_PAGING_PF_ANON_KSM_LDFLAGS
	string "LDFLAGS: Linker flags"

config PK_PAGING_PF_ANON_KSM_CXXFLAGS
	string "CXXFLAGS: C++ compiler flags"

config PK_PAGING_PF_ANON_KSM_ASFLAGS
	string "CCASFLAGS: assembler compiler flags (defaults to CFLAGS)"

config PK_PAGING_PF_ANON_KSM_BUILDARCH
	string "--host options on configure for Architecture"

endif # PK_PAGING_PF_ANON_KSM
```
