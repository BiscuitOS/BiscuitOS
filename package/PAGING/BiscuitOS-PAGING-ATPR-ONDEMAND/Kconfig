## package/PAGING/BiscuitOS-PAGING-INTEL-MTRRS/Kconfig
```kconfig
menuconfig PK_PAGING_INTEL_MTRRS
	bool "Intel MTRRS"

if PK_PAGING_INTEL_MTRRS

config PK_PAGING_INTEL_MTRRS_VERSION
	default "default"
	string "verstion"

config PK_PAGING_INTEL_MTRRS_TAR
	default "tar.gz"
	string "tar type"

config PK_PAGING_INTEL_MTRRS_URL
	default "https://gitee.com/BiscuitOS_team/HardStack/raw/Gitee/Memory-Allocator/PAGING-MECH/BiscuitOS-PAGING-INTEL-MTRRS"
	string "url"

config PK_PAGING_INTEL_MTRRS_GITHUB
	string "GitHub"

config PK_PAGING_INTEL_MTRRS_SRCFILE
	default "main.c Makefile RunBiscuitOS.sh app.c Makefile.app Kconfig"
	string "Source code list"

config PK_PAGING_INTEL_MTRRS_CSRCFILE
	string "Compile source code list"

config PK_PAGING_INTEL_MTRRS_CONFIG
	string "CONFIG: Project Configure Options"

config PK_PAGING_INTEL_MTRRS_LIBMTRRSH
	string "LIBS: Libraries to pass to the linker, e.g. -l<library>"

config PK_PAGING_INTEL_MTRRS_CPPFLAGS
	string "CPPFLAGS: C/C++ preprocessor flags, e.g. -I<include dir>"

config PK_PAGING_INTEL_MTRRS_DPKCONFIG
	string "PKG_CONFIG_MTRRSH: Directories to add to pkg-config's search path"

config PK_PAGING_INTEL_MTRRS_CFLAGS
	string "CFLAGS: C compiler flags"

config PK_PAGING_INTEL_MTRRS_LDFLAGS
	string "LDFLAGS: Linker flags"

config PK_PAGING_INTEL_MTRRS_CXXFLAGS
	string "CXXFLAGS: C++ compiler flags"

config PK_PAGING_INTEL_MTRRS_ASFLAGS
	string "CCASFLAGS: assembler compiler flags (defaults to CFLAGS)"

config PK_PAGING_INTEL_MTRRS_BUILDARCH
	string "--host options on configure for Architecture"

endif # PK_PAGING_INTEL_MTRRS
```

## package/PAGING/BiscuitOS-PAGING-INTEL-PAT/Kconfig
```kconfig
menuconfig PK_PAGING_INTEL_PAT
	bool "Intel PAT"

if PK_PAGING_INTEL_PAT

config PK_PAGING_INTEL_PAT_VERSION
	default "default"
	string "verstion"

config PK_PAGING_INTEL_PAT_TAR
	default "tar.gz"
	string "tar type"

config PK_PAGING_INTEL_PAT_URL
	default "https://gitee.com/BiscuitOS_team/HardStack/raw/Gitee/Memory-Allocator/PAGING-MECH/BiscuitOS-PAGING-INTEL-PAT"
	string "url"

config PK_PAGING_INTEL_PAT_GITHUB
	string "GitHub"

config PK_PAGING_INTEL_PAT_SRCFILE
	default "main.c Makefile RunBiscuitOS.sh app.c Makefile.app Kconfig"
	string "Source code list"

config PK_PAGING_INTEL_PAT_CSRCFILE
	string "Compile source code list"

config PK_PAGING_INTEL_PAT_CONFIG
	string "CONFIG: Project Configure Options"

config PK_PAGING_INTEL_PAT_LIBPATH
	string "LIBS: Libraries to pass to the linker, e.g. -l<library>"

config PK_PAGING_INTEL_PAT_CPPFLAGS
	string "CPPFLAGS: C/C++ preprocessor flags, e.g. -I<include dir>"

config PK_PAGING_INTEL_PAT_DPKCONFIG
	string "PKG_CONFIG_PATH: Directories to add to pkg-config's search path"

config PK_PAGING_INTEL_PAT_CFLAGS
	string "CFLAGS: C compiler flags"

config PK_PAGING_INTEL_PAT_LDFLAGS
	string "LDFLAGS: Linker flags"

config PK_PAGING_INTEL_PAT_CXXFLAGS
	string "CXXFLAGS: C++ compiler flags"

config PK_PAGING_INTEL_PAT_ASFLAGS
	string "CCASFLAGS: assembler compiler flags (defaults to CFLAGS)"

config PK_PAGING_INTEL_PAT_BUILDARCH
	string "--host options on configure for Architecture"

endif # PK_PAGING_INTEL_PAT
```

## package/PAGING/BiscuitOS-PAGING-LM-BUDDY/Kconfig
```kconfig
menuconfig PK_PAGING_LM_BUDDY
	bool "Linear Mapping: Buddy Allocator"

if PK_PAGING_LM_BUDDY

config PK_PAGING_LM_BUDDY_VERSION
	default "default"
	string "verstion"

config PK_PAGING_LM_BUDDY_TAR
	default "tar.gz"
	string "tar type"

config PK_PAGING_LM_BUDDY_URL
	default "https://gitee.com/BiscuitOS_team/HardStack/raw/Gitee/Memory-Allocator/PAGING-MECH/BiscuitOS-PAGING-LM-BUDDY"
	string "url"

config PK_PAGING_LM_BUDDY_GITHUB
	string "GitHub"

config PK_PAGING_LM_BUDDY_SRCFILE
	default "main.c Makefile Kconfig Makefile.host RunBiscuitOS.sh"
	string "Source code list"

config PK_PAGING_LM_BUDDY_CSRCFILE
	string "Compile source code list"

config PK_PAGING_LM_BUDDY_CONFIG
	string "CONFIG: Project Configure Options"

config PK_PAGING_LM_BUDDY_LIBPATH
	string "LIBS: Libraries to pass to the linker, e.g. -l<library>"

config PK_PAGING_LM_BUDDY_CPPFLAGS
	string "CPPFLAGS: C/C++ preprocessor flags, e.g. -I<include dir>"

config PK_PAGING_LM_BUDDY_DPKCONFIG
	string "PKG_CONFIG_PATH: Directories to add to pkg-config's search path"

config PK_PAGING_LM_BUDDY_CFLAGS
	string "CFLAGS: C compiler flags"

config PK_PAGING_LM_BUDDY_LDFLAGS
	string "LDFLAGS: Linker flags"

config PK_PAGING_LM_BUDDY_CXXFLAGS
	string "CXXFLAGS: C++ compiler flags"

config PK_PAGING_LM_BUDDY_ASFLAGS
	string "CCASFLAGS: assembler compiler flags (defaults to CFLAGS)"

config PK_PAGING_LM_BUDDY_BUILDARCH
	string "--host options on configure for Architecture"

endif # PK_PAGING_LM_BUDDY
```

## package/PAGING/BiscuitOS-PAGING-LM-SLAB/Kconfig
```kconfig
menuconfig PK_PAGING_LM_SLAB
	bool "Linear Mapping: SLAB Allocator"

if PK_PAGING_LM_SLAB

config PK_PAGING_LM_SLAB_VERSION
	default "default"
	string "verstion"

config PK_PAGING_LM_SLAB_TAR
	default "tar.gz"
	string "tar type"

config PK_PAGING_LM_SLAB_URL
	default "https://gitee.com/BiscuitOS_team/HardStack/raw/Gitee/Memory-Allocator/PAGING-MECH/BiscuitOS-PAGING-LM-SLAB"
	string "url"

config PK_PAGING_LM_SLAB_GITHUB
	string "GitHub"

config PK_PAGING_LM_SLAB_SRCFILE
	default "main.c Makefile Kconfig Makefile.host RunBiscuitOS.sh"
	string "Source code list"

config PK_PAGING_LM_SLAB_CSRCFILE
	string "Compile source code list"

config PK_PAGING_LM_SLAB_CONFIG
	string "CONFIG: Project Configure Options"

config PK_PAGING_LM_SLAB_LIBPATH
	string "LIBS: Libraries to pass to the linker, e.g. -l<library>"

config PK_PAGING_LM_SLAB_CPPFLAGS
	string "CPPFLAGS: C/C++ preprocessor flags, e.g. -I<include dir>"

config PK_PAGING_LM_SLAB_DPKCONFIG
	string "PKG_CONFIG_PATH: Directories to add to pkg-config's search path"

config PK_PAGING_LM_SLAB_CFLAGS
	string "CFLAGS: C compiler flags"

config PK_PAGING_LM_SLAB_LDFLAGS
	string "LDFLAGS: Linker flags"

config PK_PAGING_LM_SLAB_CXXFLAGS
	string "CXXFLAGS: C++ compiler flags"

config PK_PAGING_LM_SLAB_ASFLAGS
	string "CCASFLAGS: assembler compiler flags (defaults to CFLAGS)"

config PK_PAGING_LM_SLAB_BUILDARCH
	string "--host options on configure for Architecture"

endif # PK_PAGING_LM_SLAB
```

## package/PAGING/BiscuitOS-PAGING-LM/Kconfig
```kconfig
menuconfig PK_PAGING_LM
	bool "Linear Mapping"

if PK_PAGING_LM

config PK_PAGING_LM_VERSION
	default "default"
	string "verstion"

config PK_PAGING_LM_TAR
	default "tar.gz"
	string "tar type"

config PK_PAGING_LM_URL
	default "https://gitee.com/BiscuitOS_team/HardStack/raw/Gitee/Memory-Allocator/PAGING-MECH/BiscuitOS-PAGING-LM"
	string "url"

config PK_PAGING_LM_GITHUB
	string "GitHub"

config PK_PAGING_LM_SRCFILE
	default "main.c Makefile Kconfig Makefile.host RunBiscuitOS.sh"
	string "Source code list"

config PK_PAGING_LM_CSRCFILE
	string "Compile source code list"

config PK_PAGING_LM_CONFIG
	string "CONFIG: Project Configure Options"

config PK_PAGING_LM_LIBPATH
	string "LIBS: Libraries to pass to the linker, e.g. -l<library>"

config PK_PAGING_LM_CPPFLAGS
	string "CPPFLAGS: C/C++ preprocessor flags, e.g. -I<include dir>"

config PK_PAGING_LM_DPKCONFIG
	string "PKG_CONFIG_PATH: Directories to add to pkg-config's search path"

config PK_PAGING_LM_CFLAGS
	string "CFLAGS: C compiler flags"

config PK_PAGING_LM_LDFLAGS
	string "LDFLAGS: Linker flags"

config PK_PAGING_LM_CXXFLAGS
	string "CXXFLAGS: C++ compiler flags"

config PK_PAGING_LM_ASFLAGS
	string "CCASFLAGS: assembler compiler flags (defaults to CFLAGS)"

config PK_PAGING_LM_BUILDARCH
	string "--host options on configure for Architecture"

endif # PK_PAGING_LM
```

## package/PAGING/BiscuitOS-PAGING-LOOKUP-ADDR-EARLY/Kconfig
```kconfig
menuconfig PK_PAGING_LOOKUP_ADDR_EARLY
	bool "LOOKUP-Address: Consult EARLY IO/MEM"

if PK_PAGING_LOOKUP_ADDR_EARLY

config PK_PAGING_LOOKUP_ADDR_EARLY_VERSION
	default "default"
	string "verstion"

config PK_PAGING_LOOKUP_ADDR_EARLY_TAR
	default "tar.gz"
	string "tar type"

config PK_PAGING_LOOKUP_ADDR_EARLY_URL
	default "https://gitee.com/BiscuitOS_team/HardStack/raw/Gitee/Memory-Allocator/PAGING-MECH/BiscuitOS-PAGING-LOOKUP-ADDR-EARLY"
	string "url"

config PK_PAGING_LOOKUP_ADDR_EARLY_GITHUB
	string "GitHub"

config PK_PAGING_LOOKUP_ADDR_EARLY_SRCFILE
	default "main.c Makefile Kconfig BiscuitOS_Insert.bs"
	string "Source code list"

config PK_PAGING_LOOKUP_ADDR_EARLY_CSRCFILE
	string "Compile source code list"

config PK_PAGING_LOOKUP_ADDR_EARLY_CONFIG
	string "CONFIG: Project Configure Options"

config PK_PAGING_LOOKUP_ADDR_EARLY_LIBPATH
	string "LIBS: Libraries to pass to the linker, e.g. -l<library>"

config PK_PAGING_LOOKUP_ADDR_EARLY_CPPFLAGS
	string "CPPFLAGS: C/C++ preprocessor flags, e.g. -I<include dir>"

config PK_PAGING_LOOKUP_ADDR_EARLY_DPKCONFIG
	string "PKG_CONFIG_PATH: Directories to add to pkg-config's search path"

config PK_PAGING_LOOKUP_ADDR_EARLY_CFLAGS
	string "CFLAGS: C compiler flags"

config PK_PAGING_LOOKUP_ADDR_EARLY_LDFLAGS
	string "LDFLAGS: Linker flags"

config PK_PAGING_LOOKUP_ADDR_EARLY_CXXFLAGS
	string "CXXFLAGS: C++ compiler flags"

config PK_PAGING_LOOKUP_ADDR_EARLY_ASFLAGS
	string "CCASFLAGS: assembler compiler flags (defaults to CFLAGS)"

config PK_PAGING_LOOKUP_ADDR_EARLY_BUILDARCH
	string "--host options on configure for Architecture"

endif # PK_PAGING_LOOKUP_ADDR_EARLY
```

## package/PAGING/BiscuitOS-PAGING-LOOKUP-ADDR-FIXMAP/Kconfig
```kconfig
menuconfig PK_PAGING_LOOKUP_ADDR_FIXMAP
	bool "LOOKUP Address: Consult FIXMAP/Permanent MAPPING"

if PK_PAGING_LOOKUP_ADDR_FIXMAP

config PK_PAGING_LOOKUP_ADDR_FIXMAP_VERSION
	default "default"
	string "verstion"

config PK_PAGING_LOOKUP_ADDR_FIXMAP_TAR
	default "tar.gz"
	string "tar type"

config PK_PAGING_LOOKUP_ADDR_FIXMAP_URL
	default "https://gitee.com/BiscuitOS_team/HardStack/raw/Gitee/Memory-Allocator/PAGING-MECH/BiscuitOS-PAGING-LOOKUP-ADDR-FIXMAP"
	string "url"

config PK_PAGING_LOOKUP_ADDR_FIXMAP_GITHUB
	string "GitHub"

config PK_PAGING_LOOKUP_ADDR_FIXMAP_SRCFILE
	default "Kconfig main.c Makefile"
	string "Source code list"

config PK_PAGING_LOOKUP_ADDR_FIXMAP_CSRCFILE
	string "Compile source code list"

config PK_PAGING_LOOKUP_ADDR_FIXMAP_CONFIG
	string "CONFIG: Project Configure Options"

config PK_PAGING_LOOKUP_ADDR_FIXMAP_LIBPATH
	string "LIBS: Libraries to pass to the linker, e.g. -l<library>"

config PK_PAGING_LOOKUP_ADDR_FIXMAP_CPPFLAGS
	string "CPPFLAGS: C/C++ preprocessor flags, e.g. -I<include dir>"

config PK_PAGING_LOOKUP_ADDR_FIXMAP_DPKCONFIG
	string "PKG_CONFIG_PATH: Directories to add to pkg-config's search path"

config PK_PAGING_LOOKUP_ADDR_FIXMAP_CFLAGS
	string "CFLAGS: C compiler flags"

config PK_PAGING_LOOKUP_ADDR_FIXMAP_LDFLAGS
	string "LDFLAGS: Linker flags"

config PK_PAGING_LOOKUP_ADDR_FIXMAP_CXXFLAGS
	string "CXXFLAGS: C++ compiler flags"

config PK_PAGING_LOOKUP_ADDR_FIXMAP_ASFLAGS
	string "CCASFLAGS: assembler compiler flags (defaults to CFLAGS)"

config PK_PAGING_LOOKUP_ADDR_FIXMAP_BUILDARCH
	string "--host options on configure for Architecture"

endif # PK_PAGING_LOOKUP_ADDR_FIXMAP
```

## package/PAGING/BiscuitOS-PAGING-LOOKUP-ADDR-MEMBLOCK/Kconfig
```kconfig
menuconfig PK_PAGING_LOOKUP_ADDR_MEMBLOCK
	bool "LOOKUP-Address: Consult MEMBLOCK"

if PK_PAGING_LOOKUP_ADDR_MEMBLOCK

config PK_PAGING_LOOKUP_ADDR_MEMBLOCK_VERSION
	default "default"
	string "verstion"

config PK_PAGING_LOOKUP_ADDR_MEMBLOCK_TAR
	default "tar.gz"
	string "tar type"

config PK_PAGING_LOOKUP_ADDR_MEMBLOCK_URL
	default "https://gitee.com/BiscuitOS_team/HardStack/raw/Gitee/Memory-Allocator/PAGING-MECH/BiscuitOS-PAGING-LOOKUP-ADDR-MEMBLOCK"
	string "url"

config PK_PAGING_LOOKUP_ADDR_MEMBLOCK_GITHUB
	string "GitHub"

config PK_PAGING_LOOKUP_ADDR_MEMBLOCK_SRCFILE
	default "main.c Makefile Kconfig BiscuitOS_Insert.bs"
	string "Source code list"

config PK_PAGING_LOOKUP_ADDR_MEMBLOCK_CSRCFILE
	string "Compile source code list"

config PK_PAGING_LOOKUP_ADDR_MEMBLOCK_CONFIG
	string "CONFIG: Project Configure Options"

config PK_PAGING_LOOKUP_ADDR_MEMBLOCK_LIBPATH
	string "LIBS: Libraries to pass to the linker, e.g. -l<library>"

config PK_PAGING_LOOKUP_ADDR_MEMBLOCK_CPPFLAGS
	string "CPPFLAGS: C/C++ preprocessor flags, e.g. -I<include dir>"

config PK_PAGING_LOOKUP_ADDR_MEMBLOCK_DPKCONFIG
	string "PKG_CONFIG_PATH: Directories to add to pkg-config's search path"

config PK_PAGING_LOOKUP_ADDR_MEMBLOCK_CFLAGS
	string "CFLAGS: C compiler flags"

config PK_PAGING_LOOKUP_ADDR_MEMBLOCK_LDFLAGS
	string "LDFLAGS: Linker flags"

config PK_PAGING_LOOKUP_ADDR_MEMBLOCK_CXXFLAGS
	string "CXXFLAGS: C++ compiler flags"

config PK_PAGING_LOOKUP_ADDR_MEMBLOCK_ASFLAGS
	string "CCASFLAGS: assembler compiler flags (defaults to CFLAGS)"

config PK_PAGING_LOOKUP_ADDR_MEMBLOCK_BUILDARCH
	string "--host options on configure for Architecture"

endif # PK_PAGING_LOOKUP_ADDR_MEMBLOCK
```

## package/PAGING/BiscuitOS-PAGING-LOOKUP-ADDR-MMIO/Kconfig
```kconfig
menuconfig PK_PAGING_LOOKUP_ADDR_MMIO
	bool "LOOKUP Address: Consult MMIO"

if PK_PAGING_LOOKUP_ADDR_MMIO

config PK_PAGING_LOOKUP_ADDR_MMIO_VERSION
	default "default"
	string "verstion"

config PK_PAGING_LOOKUP_ADDR_MMIO_TAR
	default "tar.gz"
	string "tar type"

config PK_PAGING_LOOKUP_ADDR_MMIO_URL
	default "https://gitee.com/BiscuitOS_team/HardStack/raw/Gitee/Memory-Allocator/PAGING-MECH/BiscuitOS-PAGING-LOOKUP-ADDR-MMIO"
	string "url"

config PK_PAGING_LOOKUP_ADDR_MMIO_GITHUB
	string "GitHub"

config PK_PAGING_LOOKUP_ADDR_MMIO_SRCFILE
	default "Kconfig main.c Makefile Makefile.host RunBiscuitOS.sh"
	string "Source code list"

config PK_PAGING_LOOKUP_ADDR_MMIO_CSRCFILE
	string "Compile source code list"

config PK_PAGING_LOOKUP_ADDR_MMIO_CONFIG
	string "CONFIG: Project Configure Options"

config PK_PAGING_LOOKUP_ADDR_MMIO_LIBPATH
	string "LIBS: Libraries to pass to the linker, e.g. -l<library>"

config PK_PAGING_LOOKUP_ADDR_MMIO_CPPFLAGS
	string "CPPFLAGS: C/C++ preprocessor flags, e.g. -I<include dir>"

config PK_PAGING_LOOKUP_ADDR_MMIO_DPKCONFIG
	string "PKG_CONFIG_PATH: Directories to add to pkg-config's search path"

config PK_PAGING_LOOKUP_ADDR_MMIO_CFLAGS
	string "CFLAGS: C compiler flags"

config PK_PAGING_LOOKUP_ADDR_MMIO_LDFLAGS
	string "LDFLAGS: Linker flags"

config PK_PAGING_LOOKUP_ADDR_MMIO_CXXFLAGS
	string "CXXFLAGS: C++ compiler flags"

config PK_PAGING_LOOKUP_ADDR_MMIO_ASFLAGS
	string "CCASFLAGS: assembler compiler flags (defaults to CFLAGS)"

config PK_PAGING_LOOKUP_ADDR_MMIO_BUILDARCH
	string "--host options on configure for Architecture"

endif # PK_PAGING_LOOKUP_ADDR_MMIO
```
