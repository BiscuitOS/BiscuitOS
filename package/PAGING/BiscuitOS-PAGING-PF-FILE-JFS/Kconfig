## package/PAGING/BiscuitOS-PAGING-PF-FILE-JFS/Kconfig
```kconfig
menuconfig PK_PAGING_PF_FILE_JFS
	bool "Page Fault with File-Mapped JFS"

if PK_PAGING_PF_FILE_JFS

config PK_PAGING_PF_FILE_JFS_VERSION
	default "default"
	string "verstion"

config PK_PAGING_PF_FILE_JFS_TAR
	default "tar.gz"
	string "tar type"

config PK_PAGING_PF_FILE_JFS_URL
	default "https://gitee.com/BiscuitOS_team/HardStack/raw/Gitee/Memory-Allocator/PAGING-MECH/BiscuitOS-PAGING-PF-FILE-JFS"
	string "url"

config PK_PAGING_PF_FILE_JFS_GITHUB
	string "GitHub"

config PK_PAGING_PF_FILE_JFS_SRCFILE
	default "main.c Makefile RunBiscuitOS.sh"
	string "Source code list"

config PK_PAGING_PF_FILE_JFS_CSRCFILE
	string "Compile source code list"

config PK_PAGING_PF_FILE_JFS_CONFIG
	string "CONFIG: Project Configure Options"

config PK_PAGING_PF_FILE_JFS_LIBPATH
	string "LIBS: Libraries to pass to the linker, e.g. -l<library>"

config PK_PAGING_PF_FILE_JFS_CPPFLAGS
	string "CPPFLAGS: C/C++ preprocessor flags, e.g. -I<include dir>"

config PK_PAGING_PF_FILE_JFS_DPKCONFIG
	string "PKG_CONFIG_PATH: Directories to add to pkg-config's search path"

config PK_PAGING_PF_FILE_JFS_CFLAGS
	string "CFLAGS: C compiler flags"

config PK_PAGING_PF_FILE_JFS_LDFLAGS
	string "LDFLAGS: Linker flags"

config PK_PAGING_PF_FILE_JFS_CXXFLAGS
	string "CXXFLAGS: C++ compiler flags"

config PK_PAGING_PF_FILE_JFS_ASFLAGS
	string "CCASFLAGS: assembler compiler flags (defaults to CFLAGS)"

config PK_PAGING_PF_FILE_JFS_BUILDARCH
	string "--host options on configure for Architecture"

endif # PK_PAGING_PF_FILE_JFS
```

## package/PAGING/BiscuitOS-PAGING-PF-FILE-MINIXFS/Kconfig
```kconfig
menuconfig PK_PAGING_PF_FILE_MINIXFS
	bool "Page Fault with File-Mapped MINIXFS"

if PK_PAGING_PF_FILE_MINIXFS

config PK_PAGING_PF_FILE_MINIXFS_VERSION
	default "default"
	string "verstion"

config PK_PAGING_PF_FILE_MINIXFS_TAR
	default "tar.gz"
	string "tar type"

config PK_PAGING_PF_FILE_MINIXFS_URL
	default "https://gitee.com/BiscuitOS_team/HardStack/raw/Gitee/Memory-Allocator/PAGING-MECH/BiscuitOS-PAGING-PF-FILE-MINIXFS"
	string "url"

config PK_PAGING_PF_FILE_MINIXFS_GITHUB
	string "GitHub"

config PK_PAGING_PF_FILE_MINIXFS_SRCFILE
	default "main.c Makefile RunBiscuitOS.sh"
	string "Source code list"

config PK_PAGING_PF_FILE_MINIXFS_CSRCFILE
	string "Compile source code list"

config PK_PAGING_PF_FILE_MINIXFS_CONFIG
	string "CONFIG: Project Configure Options"

config PK_PAGING_PF_FILE_MINIXFS_LIBPATH
	string "LIBS: Libraries to pass to the linker, e.g. -l<library>"

config PK_PAGING_PF_FILE_MINIXFS_CPPFLAGS
	string "CPPFLAGS: C/C++ preprocessor flags, e.g. -I<include dir>"

config PK_PAGING_PF_FILE_MINIXFS_DPKCONFIG
	string "PKG_CONFIG_PATH: Directories to add to pkg-config's search path"

config PK_PAGING_PF_FILE_MINIXFS_CFLAGS
	string "CFLAGS: C compiler flags"

config PK_PAGING_PF_FILE_MINIXFS_LDFLAGS
	string "LDFLAGS: Linker flags"

config PK_PAGING_PF_FILE_MINIXFS_CXXFLAGS
	string "CXXFLAGS: C++ compiler flags"

config PK_PAGING_PF_FILE_MINIXFS_ASFLAGS
	string "CCASFLAGS: assembler compiler flags (defaults to CFLAGS)"

config PK_PAGING_PF_FILE_MINIXFS_BUILDARCH
	string "--host options on configure for Architecture"

endif # PK_PAGING_PF_FILE_MINIXFS
```

## package/PAGING/BiscuitOS-PAGING-PF-FILE-MSDOS/Kconfig
```kconfig
menuconfig PK_PAGING_PF_FILE_MSDOS
	bool "Page Fault with File-Mapped MSDOS FS"

if PK_PAGING_PF_FILE_MSDOS

config PK_PAGING_PF_FILE_MSDOS_VERSION
	default "default"
	string "verstion"

config PK_PAGING_PF_FILE_MSDOS_TAR
	default "tar.gz"
	string "tar type"

config PK_PAGING_PF_FILE_MSDOS_URL
	default "https://gitee.com/BiscuitOS_team/HardStack/raw/Gitee/Memory-Allocator/PAGING-MECH/BiscuitOS-PAGING-PF-FILE-MSDOS"
	string "url"

config PK_PAGING_PF_FILE_MSDOS_GITHUB
	string "GitHub"

config PK_PAGING_PF_FILE_MSDOS_SRCFILE
	default "main.c Makefile RunBiscuitOS.sh"
	string "Source code list"

config PK_PAGING_PF_FILE_MSDOS_CSRCFILE
	string "Compile source code list"

config PK_PAGING_PF_FILE_MSDOS_CONFIG
	string "CONFIG: Project Configure Options"

config PK_PAGING_PF_FILE_MSDOS_LIBPATH
	string "LIBS: Libraries to pass to the linker, e.g. -l<library>"

config PK_PAGING_PF_FILE_MSDOS_CPPFLAGS
	string "CPPFLAGS: C/C++ preprocessor flags, e.g. -I<include dir>"

config PK_PAGING_PF_FILE_MSDOS_DPKCONFIG
	string "PKG_CONFIG_PATH: Directories to add to pkg-config's search path"

config PK_PAGING_PF_FILE_MSDOS_CFLAGS
	string "CFLAGS: C compiler flags"

config PK_PAGING_PF_FILE_MSDOS_LDFLAGS
	string "LDFLAGS: Linker flags"

config PK_PAGING_PF_FILE_MSDOS_CXXFLAGS
	string "CXXFLAGS: C++ compiler flags"

config PK_PAGING_PF_FILE_MSDOS_ASFLAGS
	string "CCASFLAGS: assembler compiler flags (defaults to CFLAGS)"

config PK_PAGING_PF_FILE_MSDOS_BUILDARCH
	string "--host options on configure for Architecture"

endif # PK_PAGING_PF_FILE_MSDOS
```

## package/PAGING/BiscuitOS-PAGING-PF-FILE-REISERFS/Kconfig
```kconfig
menuconfig PK_PAGING_PF_FILE_REISERFS
	bool "Page Fault with File-Mapped REISERFS"

if PK_PAGING_PF_FILE_REISERFS

config PK_PAGING_PF_FILE_REISERFS_VERSION
	default "default"
	string "verstion"

config PK_PAGING_PF_FILE_REISERFS_TAR
	default "tar.gz"
	string "tar type"

config PK_PAGING_PF_FILE_REISERFS_URL
	default "https://gitee.com/BiscuitOS_team/HardStack/raw/Gitee/Memory-Allocator/PAGING-MECH/BiscuitOS-PAGING-PF-FILE-REISERFS"
	string "url"

config PK_PAGING_PF_FILE_REISERFS_GITHUB
	string "GitHub"

config PK_PAGING_PF_FILE_REISERFS_SRCFILE
	default "main.c Makefile RunBiscuitOS.sh"
	string "Source code list"

config PK_PAGING_PF_FILE_REISERFS_CSRCFILE
	string "Compile source code list"

config PK_PAGING_PF_FILE_REISERFS_CONFIG
	string "CONFIG: Project Configure Options"

config PK_PAGING_PF_FILE_REISERFS_LIBPATH
	string "LIBS: Libraries to pass to the linker, e.g. -l<library>"

config PK_PAGING_PF_FILE_REISERFS_CPPFLAGS
	string "CPPFLAGS: C/C++ preprocessor flags, e.g. -I<include dir>"

config PK_PAGING_PF_FILE_REISERFS_DPKCONFIG
	string "PKG_CONFIG_PATH: Directories to add to pkg-config's search path"

config PK_PAGING_PF_FILE_REISERFS_CFLAGS
	string "CFLAGS: C compiler flags"

config PK_PAGING_PF_FILE_REISERFS_LDFLAGS
	string "LDFLAGS: Linker flags"

config PK_PAGING_PF_FILE_REISERFS_CXXFLAGS
	string "CXXFLAGS: C++ compiler flags"

config PK_PAGING_PF_FILE_REISERFS_ASFLAGS
	string "CCASFLAGS: assembler compiler flags (defaults to CFLAGS)"

config PK_PAGING_PF_FILE_REISERFS_BUILDARCH
	string "--host options on configure for Architecture"

endif # PK_PAGING_PF_FILE_REISERFS
```

## package/PAGING/BiscuitOS-PAGING-PF-FILE-SQUASHFS/Kconfig
```kconfig
menuconfig PK_PAGING_PF_FILE_SQUASHFS
	bool "Page Fault with File-Mapped SQUASHFS"

if PK_PAGING_PF_FILE_SQUASHFS

config PK_PAGING_PF_FILE_SQUASHFS_VERSION
	default "default"
	string "verstion"

config PK_PAGING_PF_FILE_SQUASHFS_TAR
	default "tar.gz"
	string "tar type"

config PK_PAGING_PF_FILE_SQUASHFS_URL
	default "https://gitee.com/BiscuitOS_team/HardStack/raw/Gitee/Memory-Allocator/PAGING-MECH/BiscuitOS-PAGING-PF-FILE-SQUASHFS"
	string "url"

config PK_PAGING_PF_FILE_SQUASHFS_GITHUB
	string "GitHub"

config PK_PAGING_PF_FILE_SQUASHFS_SRCFILE
	default "main.c Makefile RunBiscuitOS.sh"
	string "Source code list"

config PK_PAGING_PF_FILE_SQUASHFS_CSRCFILE
	string "Compile source code list"

config PK_PAGING_PF_FILE_SQUASHFS_CONFIG
	string "CONFIG: Project Configure Options"

config PK_PAGING_PF_FILE_SQUASHFS_LIBPATH
	string "LIBS: Libraries to pass to the linker, e.g. -l<library>"

config PK_PAGING_PF_FILE_SQUASHFS_CPPFLAGS
	string "CPPFLAGS: C/C++ preprocessor flags, e.g. -I<include dir>"

config PK_PAGING_PF_FILE_SQUASHFS_DPKCONFIG
	string "PKG_CONFIG_PATH: Directories to add to pkg-config's search path"

config PK_PAGING_PF_FILE_SQUASHFS_CFLAGS
	string "CFLAGS: C compiler flags"

config PK_PAGING_PF_FILE_SQUASHFS_LDFLAGS
	string "LDFLAGS: Linker flags"

config PK_PAGING_PF_FILE_SQUASHFS_CXXFLAGS
	string "CXXFLAGS: C++ compiler flags"

config PK_PAGING_PF_FILE_SQUASHFS_ASFLAGS
	string "CCASFLAGS: assembler compiler flags (defaults to CFLAGS)"

config PK_PAGING_PF_FILE_SQUASHFS_BUILDARCH
	string "--host options on configure for Architecture"

endif # PK_PAGING_PF_FILE_SQUASHFS
```

## package/PAGING/BiscuitOS-PAGING-PF-FILE-TMPFS/Kconfig
```kconfig
menuconfig PK_PAGING_PF_FILE_TMPFS
	bool "Page Fault with File-Mapped TMPFS"

if PK_PAGING_PF_FILE_TMPFS

config PK_PAGING_PF_FILE_TMPFS_VERSION
	default "default"
	string "verstion"

config PK_PAGING_PF_FILE_TMPFS_TAR
	default "tar.gz"
	string "tar type"

config PK_PAGING_PF_FILE_TMPFS_URL
	default "https://gitee.com/BiscuitOS_team/HardStack/raw/Gitee/Memory-Allocator/PAGING-MECH/BiscuitOS-PAGING-PF-FILE-TMPFS"
	string "url"

config PK_PAGING_PF_FILE_TMPFS_GITHUB
	string "GitHub"

config PK_PAGING_PF_FILE_TMPFS_SRCFILE
	default "main.c Makefile RunBiscuitOS.sh"
	string "Source code list"

config PK_PAGING_PF_FILE_TMPFS_CSRCFILE
	string "Compile source code list"

config PK_PAGING_PF_FILE_TMPFS_CONFIG
	string "CONFIG: Project Configure Options"

config PK_PAGING_PF_FILE_TMPFS_LIBPATH
	string "LIBS: Libraries to pass to the linker, e.g. -l<library>"

config PK_PAGING_PF_FILE_TMPFS_CPPFLAGS
	string "CPPFLAGS: C/C++ preprocessor flags, e.g. -I<include dir>"

config PK_PAGING_PF_FILE_TMPFS_DPKCONFIG
	string "PKG_CONFIG_PATH: Directories to add to pkg-config's search path"

config PK_PAGING_PF_FILE_TMPFS_CFLAGS
	string "CFLAGS: C compiler flags"

config PK_PAGING_PF_FILE_TMPFS_LDFLAGS
	string "LDFLAGS: Linker flags"

config PK_PAGING_PF_FILE_TMPFS_CXXFLAGS
	string "CXXFLAGS: C++ compiler flags"

config PK_PAGING_PF_FILE_TMPFS_ASFLAGS
	string "CCASFLAGS: assembler compiler flags (defaults to CFLAGS)"

config PK_PAGING_PF_FILE_TMPFS_BUILDARCH
	string "--host options on configure for Architecture"

endif # PK_PAGING_PF_FILE_TMPFS
```

## package/PAGING/BiscuitOS-PAGING-PF-FILE-XFS/Kconfig
```kconfig
menuconfig PK_PAGING_PF_FILE_XFS
	bool "Page Fault with File-Mapped XFS"

if PK_PAGING_PF_FILE_XFS

config PK_PAGING_PF_FILE_XFS_VERSION
	default "default"
	string "verstion"

config PK_PAGING_PF_FILE_XFS_TAR
	default "tar.gz"
	string "tar type"

config PK_PAGING_PF_FILE_XFS_URL
	default "https://gitee.com/BiscuitOS_team/HardStack/raw/Gitee/Memory-Allocator/PAGING-MECH/BiscuitOS-PAGING-PF-FILE-XFS"
	string "url"

config PK_PAGING_PF_FILE_XFS_GITHUB
	string "GitHub"

config PK_PAGING_PF_FILE_XFS_SRCFILE
	default "main.c Makefile RunBiscuitOS.sh"
	string "Source code list"

config PK_PAGING_PF_FILE_XFS_CSRCFILE
	string "Compile source code list"

config PK_PAGING_PF_FILE_XFS_CONFIG
	string "CONFIG: Project Configure Options"

config PK_PAGING_PF_FILE_XFS_LIBPATH
	string "LIBS: Libraries to pass to the linker, e.g. -l<library>"

config PK_PAGING_PF_FILE_XFS_CPPFLAGS
	string "CPPFLAGS: C/C++ preprocessor flags, e.g. -I<include dir>"

config PK_PAGING_PF_FILE_XFS_DPKCONFIG
	string "PKG_CONFIG_PATH: Directories to add to pkg-config's search path"

config PK_PAGING_PF_FILE_XFS_CFLAGS
	string "CFLAGS: C compiler flags"

config PK_PAGING_PF_FILE_XFS_LDFLAGS
	string "LDFLAGS: Linker flags"

config PK_PAGING_PF_FILE_XFS_CXXFLAGS
	string "CXXFLAGS: C++ compiler flags"

config PK_PAGING_PF_FILE_XFS_ASFLAGS
	string "CCASFLAGS: assembler compiler flags (defaults to CFLAGS)"

config PK_PAGING_PF_FILE_XFS_BUILDARCH
	string "--host options on configure for Architecture"

endif # PK_PAGING_PF_FILE_XFS
```

## package/PAGING/BiscuitOS-PAGING-PF-HUGEPF-PAGEMAP/Kconfig
```kconfig
menuconfig PK_PAGING_PF_HUGEPF_PAGEMAP
	bool "Page Fault with Hugefault (PAGEMAP)"

if PK_PAGING_PF_HUGEPF_PAGEMAP

config PK_PAGING_PF_HUGEPF_PAGEMAP_VERSION
	default "default"
	string "verstion"

config PK_PAGING_PF_HUGEPF_PAGEMAP_TAR
	default "tar.gz"
	string "tar type"

config PK_PAGING_PF_HUGEPF_PAGEMAP_URL
	default "https://gitee.com/BiscuitOS_team/HardStack/raw/Gitee/Memory-Allocator/PAGING-MECH/BiscuitOS-PAGING-PF-HUGEPF-PAGEMAP"
	string "url"

config PK_PAGING_PF_HUGEPF_PAGEMAP_GITHUB
	string "GitHub"

config PK_PAGING_PF_HUGEPF_PAGEMAP_SRCFILE
	default "main.c Makefile Kconfig Makefile.app RunBiscuitOS.sh app.c"
	string "Source code list"

config PK_PAGING_PF_HUGEPF_PAGEMAP_CSRCFILE
	string "Compile source code list"

config PK_PAGING_PF_HUGEPF_PAGEMAP_CONFIG
	string "CONFIG: Project Configure Options"

config PK_PAGING_PF_HUGEPF_PAGEMAP_LIBPATH
	string "LIBS: Libraries to pass to the linker, e.g. -l<library>"

config PK_PAGING_PF_HUGEPF_PAGEMAP_CPPFLAGS
	string "CPPFLAGS: C/C++ preprocessor flags, e.g. -I<include dir>"

config PK_PAGING_PF_HUGEPF_PAGEMAP_DPKCONFIG
	string "PKG_CONFIG_PATH: Directories to add to pkg-config's search path"

config PK_PAGING_PF_HUGEPF_PAGEMAP_CFLAGS
	string "CFLAGS: C compiler flags"

config PK_PAGING_PF_HUGEPF_PAGEMAP_LDFLAGS
	string "LDFLAGS: Linker flags"

config PK_PAGING_PF_HUGEPF_PAGEMAP_CXXFLAGS
	string "CXXFLAGS: C++ compiler flags"

config PK_PAGING_PF_HUGEPF_PAGEMAP_ASFLAGS
	string "CCASFLAGS: assembler compiler flags (defaults to CFLAGS)"

config PK_PAGING_PF_HUGEPF_PAGEMAP_BUILDARCH
	string "--host options on configure for Architecture"

endif # PK_PAGING_PF_HUGEPF_PAGEMAP
```

## package/PAGING/BiscuitOS-PAGING-PF-HUGEPF-PFNMAP/Kconfig
```kconfig
menuconfig PK_PAGING_PF_HUGEPF_PFNMAP
	bool "Page Fault with Hugefault (PFNMAP)"

if PK_PAGING_PF_HUGEPF_PFNMAP

config PK_PAGING_PF_HUGEPF_PFNMAP_VERSION
	default "default"
	string "verstion"

config PK_PAGING_PF_HUGEPF_PFNMAP_TAR
	default "tar.gz"
	string "tar type"

config PK_PAGING_PF_HUGEPF_PFNMAP_URL
	default "https://gitee.com/BiscuitOS_team/HardStack/raw/Gitee/Memory-Allocator/PAGING-MECH/BiscuitOS-PAGING-PF-HUGEPF-PFNMAP"
	string "url"

config PK_PAGING_PF_HUGEPF_PFNMAP_GITHUB
	string "GitHub"

config PK_PAGING_PF_HUGEPF_PFNMAP_SRCFILE
	default "main.c Makefile Kconfig Mafile.host RunBiscuitOS.sh app.c"
	string "Source code list"

config PK_PAGING_PF_HUGEPF_PFNMAP_CSRCFILE
	string "Compile source code list"

config PK_PAGING_PF_HUGEPF_PFNMAP_CONFIG
	string "CONFIG: Project Configure Options"

config PK_PAGING_PF_HUGEPF_PFNMAP_LIBPATH
	string "LIBS: Libraries to pass to the linker, e.g. -l<library>"

config PK_PAGING_PF_HUGEPF_PFNMAP_CPPFLAGS
	string "CPPFLAGS: C/C++ preprocessor flags, e.g. -I<include dir>"

config PK_PAGING_PF_HUGEPF_PFNMAP_DPKCONFIG
	string "PKG_CONFIG_PATH: Directories to add to pkg-config's search path"

config PK_PAGING_PF_HUGEPF_PFNMAP_CFLAGS
	string "CFLAGS: C compiler flags"

config PK_PAGING_PF_HUGEPF_PFNMAP_LDFLAGS
	string "LDFLAGS: Linker flags"

config PK_PAGING_PF_HUGEPF_PFNMAP_CXXFLAGS
	string "CXXFLAGS: C++ compiler flags"

config PK_PAGING_PF_HUGEPF_PFNMAP_ASFLAGS
	string "CCASFLAGS: assembler compiler flags (defaults to CFLAGS)"

config PK_PAGING_PF_HUGEPF_PFNMAP_BUILDARCH
	string "--host options on configure for Architecture"

endif # PK_PAGING_PF_HUGEPF_PFNMAP
```
