## package/PAGING/BiscuitOS-PAGING-PF-PAGEMAP/Kconfig
```kconfig
menuconfig PK_PAGING_PF_PAGEMAP
	bool "Page Fault with PAGEMAP"

if PK_PAGING_PF_PAGEMAP

config PK_PAGING_PF_PAGEMAP_VERSION
	default "default"
	string "verstion"

config PK_PAGING_PF_PAGEMAP_TAR
	default "tar.gz"
	string "tar type"

config PK_PAGING_PF_PAGEMAP_URL
	default "https://gitee.com/BiscuitOS_team/HardStack/raw/Gitee/Memory-Allocator/PAGING-MECH/BiscuitOS-PAGING-PF-PAGEMAP"
	string "url"

config PK_PAGING_PF_PAGEMAP_GITHUB
	string "GitHub"

config PK_PAGING_PF_PAGEMAP_SRCFILE
	default "app.c Kconfig main.c Makefile Makefile.host RunBiscuitOS.sh"
	string "Source code list"

config PK_PAGING_PF_PAGEMAP_CSRCFILE
	string "Compile source code list"

config PK_PAGING_PF_PAGEMAP_CONFIG
	string "CONFIG: Project Configure Options"

config PK_PAGING_PF_PAGEMAP_LIBPATH
	string "LIBS: Libraries to pass to the linker, e.g. -l<library>"

config PK_PAGING_PF_PAGEMAP_CPPFLAGS
	string "CPPFLAGS: C/C++ preprocessor flags, e.g. -I<include dir>"

config PK_PAGING_PF_PAGEMAP_DPKCONFIG
	string "PKG_CONFIG_PATH: Directories to add to pkg-config's search path"

config PK_PAGING_PF_PAGEMAP_CFLAGS
	string "CFLAGS: C compiler flags"

config PK_PAGING_PF_PAGEMAP_LDFLAGS
	string "LDFLAGS: Linker flags"

config PK_PAGING_PF_PAGEMAP_CXXFLAGS
	string "CXXFLAGS: C++ compiler flags"

config PK_PAGING_PF_PAGEMAP_ASFLAGS
	string "CCASFLAGS: assembler compiler flags (defaults to CFLAGS)"

config PK_PAGING_PF_PAGEMAP_BUILDARCH
	string "--host options on configure for Architecture"

endif # PK_PAGING_PF_PAGEMAP
```

## package/PAGING/BiscuitOS-PAGING-PF-PFNMAP-COW/Kconfig
```kconfig
menuconfig PK_PAGING_PF_PFNMAP_COW
	bool "Page Fault with PFNMAP(RSVDMEM) COW(Copy on Write)"

if PK_PAGING_PF_PFNMAP_COW

config PK_PAGING_PF_PFNMAP_COW_VERSION
	default "default"
	string "verstion"

config PK_PAGING_PF_PFNMAP_COW_TAR
	default "tar.gz"
	string "tar type"

config PK_PAGING_PF_PFNMAP_COW_URL
	default "https://gitee.com/BiscuitOS_team/HardStack/raw/Gitee/Memory-Allocator/PAGING-MECH/BiscuitOS-PAGING-PF-PFNMAP-COW"
	string "url"

config PK_PAGING_PF_PFNMAP_COW_GITHUB
	string "GitHub"

config PK_PAGING_PF_PFNMAP_COW_SRCFILE
	default "app.c Kconfig main.c Makefile Makefile.host RunBiscuitOS.sh"
	string "Source code list"

config PK_PAGING_PF_PFNMAP_COW_CSRCFILE
	string "Compile source code list"

config PK_PAGING_PF_PFNMAP_COW_CONFIG
	string "CONFIG: Project Configure Options"

config PK_PAGING_PF_PFNMAP_COW_LIBPATH
	string "LIBS: Libraries to pass to the linker, e.g. -l<library>"

config PK_PAGING_PF_PFNMAP_COW_CPPFLAGS
	string "CPPFLAGS: C/C++ preprocessor flags, e.g. -I<include dir>"

config PK_PAGING_PF_PFNMAP_COW_DPKCONFIG
	string "PKG_CONFIG_PATH: Directories to add to pkg-config's search path"

config PK_PAGING_PF_PFNMAP_COW_CFLAGS
	string "CFLAGS: C compiler flags"

config PK_PAGING_PF_PFNMAP_COW_LDFLAGS
	string "LDFLAGS: Linker flags"

config PK_PAGING_PF_PFNMAP_COW_CXXFLAGS
	string "CXXFLAGS: C++ compiler flags"

config PK_PAGING_PF_PFNMAP_COW_ASFLAGS
	string "CCASFLAGS: assembler compiler flags (defaults to CFLAGS)"

config PK_PAGING_PF_PFNMAP_COW_BUILDARCH
	string "--host options on configure for Architecture"

endif # PK_PAGING_PF_PFNMAP_COW
```

## package/PAGING/BiscuitOS-PAGING-PF-PFNMAP-PMDMAPPED/Kconfig
```kconfig
menuconfig PK_PAGING_PF_PFNMAP_PMDMAPPED
	bool "Page Fault with PFNMAP(RSVDMEM) on PmdMapped"

if PK_PAGING_PF_PFNMAP_PMDMAPPED

config PK_PAGING_PF_PFNMAP_PMDMAPPED_VERSION
	default "default"
	string "verstion"

config PK_PAGING_PF_PFNMAP_PMDMAPPED_TAR
	default "tar.gz"
	string "tar type"

config PK_PAGING_PF_PFNMAP_PMDMAPPED_URL
	default "https://gitee.com/BiscuitOS_team/HardStack/raw/Gitee/Memory-Allocator/PAGING-MECH/BiscuitOS-PAGING-PF-PFNMAP-PMDMAPPED"
	string "url"

config PK_PAGING_PF_PFNMAP_PMDMAPPED_GITHUB
	string "GitHub"

config PK_PAGING_PF_PFNMAP_PMDMAPPED_SRCFILE
	default "app.c Kconfig main.c Makefile Makefile.host RunBiscuitOS.sh"
	string "Source code list"

config PK_PAGING_PF_PFNMAP_PMDMAPPED_CSRCFILE
	string "Compile source code list"

config PK_PAGING_PF_PFNMAP_PMDMAPPED_CONFIG
	string "CONFIG: Project Configure Options"

config PK_PAGING_PF_PFNMAP_PMDMAPPED_LIBPATH
	string "LIBS: Libraries to pass to the linker, e.g. -l<library>"

config PK_PAGING_PF_PFNMAP_PMDMAPPED_CPPFLAGS
	string "CPPFLAGS: C/C++ preprocessor flags, e.g. -I<include dir>"

config PK_PAGING_PF_PFNMAP_PMDMAPPED_DPKCONFIG
	string "PKG_CONFIG_PATH: Directories to add to pkg-config's search path"

config PK_PAGING_PF_PFNMAP_PMDMAPPED_CFLAGS
	string "CFLAGS: C compiler flags"

config PK_PAGING_PF_PFNMAP_PMDMAPPED_LDFLAGS
	string "LDFLAGS: Linker flags"

config PK_PAGING_PF_PFNMAP_PMDMAPPED_CXXFLAGS
	string "CXXFLAGS: C++ compiler flags"

config PK_PAGING_PF_PFNMAP_PMDMAPPED_ASFLAGS
	string "CCASFLAGS: assembler compiler flags (defaults to CFLAGS)"

config PK_PAGING_PF_PFNMAP_PMDMAPPED_BUILDARCH
	string "--host options on configure for Architecture"

endif # PK_PAGING_PF_PFNMAP_PMDMAPPED
```

## package/PAGING/BiscuitOS-PAGING-PF-PFNMAP-PUDMAPPED/Kconfig
```kconfig
menuconfig PK_PAGING_PF_PFNMAP_PUDMAPPED
	bool "Page Fault with PFNMAP(RSVDMEM) on PudMapped"

if PK_PAGING_PF_PFNMAP_PUDMAPPED

config PK_PAGING_PF_PFNMAP_PUDMAPPED_VERSION
	default "default"
	string "verstion"

config PK_PAGING_PF_PFNMAP_PUDMAPPED_TAR
	default "tar.gz"
	string "tar type"

config PK_PAGING_PF_PFNMAP_PUDMAPPED_URL
	default "https://gitee.com/BiscuitOS_team/HardStack/raw/Gitee/Memory-Allocator/PAGING-MECH/BiscuitOS-PAGING-PF-PFNMAP-PUDMAPPED"
	string "url"

config PK_PAGING_PF_PFNMAP_PUDMAPPED_GITHUB
	string "GitHub"

config PK_PAGING_PF_PFNMAP_PUDMAPPED_SRCFILE
	default "app.c Kconfig main.c Makefile Makefile.host RunBiscuitOS.sh"
	string "Source code list"

config PK_PAGING_PF_PFNMAP_PUDMAPPED_CSRCFILE
	string "Compile source code list"

config PK_PAGING_PF_PFNMAP_PUDMAPPED_CONFIG
	string "CONFIG: Project Configure Options"

config PK_PAGING_PF_PFNMAP_PUDMAPPED_LIBPATH
	string "LIBS: Libraries to pass to the linker, e.g. -l<library>"

config PK_PAGING_PF_PFNMAP_PUDMAPPED_CPPFLAGS
	string "CPPFLAGS: C/C++ preprocessor flags, e.g. -I<include dir>"

config PK_PAGING_PF_PFNMAP_PUDMAPPED_DPKCONFIG
	string "PKG_CONFIG_PATH: Directories to add to pkg-config's search path"

config PK_PAGING_PF_PFNMAP_PUDMAPPED_CFLAGS
	string "CFLAGS: C compiler flags"

config PK_PAGING_PF_PFNMAP_PUDMAPPED_LDFLAGS
	string "LDFLAGS: Linker flags"

config PK_PAGING_PF_PFNMAP_PUDMAPPED_CXXFLAGS
	string "CXXFLAGS: C++ compiler flags"

config PK_PAGING_PF_PFNMAP_PUDMAPPED_ASFLAGS
	string "CCASFLAGS: assembler compiler flags (defaults to CFLAGS)"

config PK_PAGING_PF_PFNMAP_PUDMAPPED_BUILDARCH
	string "--host options on configure for Architecture"

endif # PK_PAGING_PF_PFNMAP_PUDMAPPED
```

## package/PAGING/BiscuitOS-PAGING-PF-PFNMAP-RO/Kconfig
```kconfig
menuconfig PK_PAGING_PF_PFNMAP_RO
	bool "Page Fault with PFNMAP(RSVDMEM) Read-Only"

if PK_PAGING_PF_PFNMAP_RO

config PK_PAGING_PF_PFNMAP_RO_VERSION
	default "default"
	string "verstion"

config PK_PAGING_PF_PFNMAP_RO_TAR
	default "tar.gz"
	string "tar type"

config PK_PAGING_PF_PFNMAP_RO_URL
	default "https://gitee.com/BiscuitOS_team/HardStack/raw/Gitee/Memory-Allocator/PAGING-MECH/BiscuitOS-PAGING-PF-PFNMAP-RO"
	string "url"

config PK_PAGING_PF_PFNMAP_RO_GITHUB
	string "GitHub"

config PK_PAGING_PF_PFNMAP_RO_SRCFILE
	default "app.c Kconfig main.c Makefile Makefile.host RunBiscuitOS.sh"
	string "Source code list"

config PK_PAGING_PF_PFNMAP_RO_CSRCFILE
	string "Compile source code list"

config PK_PAGING_PF_PFNMAP_RO_CONFIG
	string "CONFIG: Project Configure Options"

config PK_PAGING_PF_PFNMAP_RO_LIBPATH
	string "LIBS: Libraries to pass to the linker, e.g. -l<library>"

config PK_PAGING_PF_PFNMAP_RO_CPPFLAGS
	string "CPPFLAGS: C/C++ preprocessor flags, e.g. -I<include dir>"

config PK_PAGING_PF_PFNMAP_RO_DPKCONFIG
	string "PKG_CONFIG_PATH: Directories to add to pkg-config's search path"

config PK_PAGING_PF_PFNMAP_RO_CFLAGS
	string "CFLAGS: C compiler flags"

config PK_PAGING_PF_PFNMAP_RO_LDFLAGS
	string "LDFLAGS: Linker flags"

config PK_PAGING_PF_PFNMAP_RO_CXXFLAGS
	string "CXXFLAGS: C++ compiler flags"

config PK_PAGING_PF_PFNMAP_RO_ASFLAGS
	string "CCASFLAGS: assembler compiler flags (defaults to CFLAGS)"

config PK_PAGING_PF_PFNMAP_RO_BUILDARCH
	string "--host options on configure for Architecture"

endif # PK_PAGING_PF_PFNMAP_RO
```

## package/PAGING/BiscuitOS-PAGING-PF-PFNMAP-WP/Kconfig
```kconfig
menuconfig PK_PAGING_PF_PFNMAP_WP
	bool "Page Fault with PFNMAP(RSVDMEM) Write-Protection"

if PK_PAGING_PF_PFNMAP_WP

config PK_PAGING_PF_PFNMAP_WP_VERSION
	default "default"
	string "verstion"

config PK_PAGING_PF_PFNMAP_WP_TAR
	default "tar.gz"
	string "tar type"

config PK_PAGING_PF_PFNMAP_WP_URL
	default "https://gitee.com/BiscuitOS_team/HardStack/raw/Gitee/Memory-Allocator/PAGING-MECH/BiscuitOS-PAGING-PF-PFNMAP-WP"
	string "url"

config PK_PAGING_PF_PFNMAP_WP_GITHUB
	string "GitHub"

config PK_PAGING_PF_PFNMAP_WP_SRCFILE
	default "app.c Kconfig main.c Makefile Makefile.host RunBiscuitOS.sh"
	string "Source code list"

config PK_PAGING_PF_PFNMAP_WP_CSRCFILE
	string "Compile source code list"

config PK_PAGING_PF_PFNMAP_WP_CONFIG
	string "CONFIG: Project Configure Options"

config PK_PAGING_PF_PFNMAP_WP_LIBPATH
	string "LIBS: Libraries to pass to the linker, e.g. -l<library>"

config PK_PAGING_PF_PFNMAP_WP_CPPFLAGS
	string "CPPFLAGS: C/C++ preprocessor flags, e.g. -I<include dir>"

config PK_PAGING_PF_PFNMAP_WP_DPKCONFIG
	string "PKG_CONFIG_PATH: Directories to add to pkg-config's search path"

config PK_PAGING_PF_PFNMAP_WP_CFLAGS
	string "CFLAGS: C compiler flags"

config PK_PAGING_PF_PFNMAP_WP_LDFLAGS
	string "LDFLAGS: Linker flags"

config PK_PAGING_PF_PFNMAP_WP_CXXFLAGS
	string "CXXFLAGS: C++ compiler flags"

config PK_PAGING_PF_PFNMAP_WP_ASFLAGS
	string "CCASFLAGS: assembler compiler flags (defaults to CFLAGS)"

config PK_PAGING_PF_PFNMAP_WP_BUILDARCH
	string "--host options on configure for Architecture"

endif # PK_PAGING_PF_PFNMAP_WP
```

## package/PAGING/BiscuitOS-PAGING-PF-PFNMAP/Kconfig
```kconfig
menuconfig PK_PAGING_PF_PFNMAP
	bool "Page Fault with PFNMAP(RSVDMEM)"

if PK_PAGING_PF_PFNMAP

config PK_PAGING_PF_PFNMAP_VERSION
	default "default"
	string "verstion"

config PK_PAGING_PF_PFNMAP_TAR
	default "tar.gz"
	string "tar type"

config PK_PAGING_PF_PFNMAP_URL
	default "https://gitee.com/BiscuitOS_team/HardStack/raw/Gitee/Memory-Allocator/PAGING-MECH/BiscuitOS-PAGING-PF-PFNMAP"
	string "url"

config PK_PAGING_PF_PFNMAP_GITHUB
	string "GitHub"

config PK_PAGING_PF_PFNMAP_SRCFILE
	default "app.c Kconfig main.c Makefile Makefile.host RunBiscuitOS.sh"
	string "Source code list"

config PK_PAGING_PF_PFNMAP_CSRCFILE
	string "Compile source code list"

config PK_PAGING_PF_PFNMAP_CONFIG
	string "CONFIG: Project Configure Options"

config PK_PAGING_PF_PFNMAP_LIBPATH
	string "LIBS: Libraries to pass to the linker, e.g. -l<library>"

config PK_PAGING_PF_PFNMAP_CPPFLAGS
	string "CPPFLAGS: C/C++ preprocessor flags, e.g. -I<include dir>"

config PK_PAGING_PF_PFNMAP_DPKCONFIG
	string "PKG_CONFIG_PATH: Directories to add to pkg-config's search path"

config PK_PAGING_PF_PFNMAP_CFLAGS
	string "CFLAGS: C compiler flags"

config PK_PAGING_PF_PFNMAP_LDFLAGS
	string "LDFLAGS: Linker flags"

config PK_PAGING_PF_PFNMAP_CXXFLAGS
	string "CXXFLAGS: C++ compiler flags"

config PK_PAGING_PF_PFNMAP_ASFLAGS
	string "CCASFLAGS: assembler compiler flags (defaults to CFLAGS)"

config PK_PAGING_PF_PFNMAP_BUILDARCH
	string "--host options on configure for Architecture"

endif # PK_PAGING_PF_PFNMAP
```
