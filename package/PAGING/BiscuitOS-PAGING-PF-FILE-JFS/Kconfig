## package/PAGING/BiscuitOS-PAGING-PF-HUGEPF/Kconfig
```kconfig
menuconfig PK_PAGING_PF_HUGEPF
	bool "Page Fault with Hugefault"

if PK_PAGING_PF_HUGEPF

config PK_PAGING_PF_HUGEPF_VERSION
	default "default"
	string "verstion"

config PK_PAGING_PF_HUGEPF_TAR
	default "tar.gz"
	string "tar type"

config PK_PAGING_PF_HUGEPF_URL
	default "https://gitee.com/BiscuitOS_team/HardStack/raw/Gitee/Memory-Allocator/PAGING-MECH/BiscuitOS-PAGING-PF-HUGEPF"
	string "url"

config PK_PAGING_PF_HUGEPF_GITHUB
	string "GitHub"

config PK_PAGING_PF_HUGEPF_SRCFILE
	default "main.c Makefile Kconfig Makefile.app RunBiscuitOS.sh app.c"
	string "Source code list"

config PK_PAGING_PF_HUGEPF_CSRCFILE
	string "Compile source code list"

config PK_PAGING_PF_HUGEPF_CONFIG
	string "CONFIG: Project Configure Options"

config PK_PAGING_PF_HUGEPF_LIBPATH
	string "LIBS: Libraries to pass to the linker, e.g. -l<library>"

config PK_PAGING_PF_HUGEPF_CPPFLAGS
	string "CPPFLAGS: C/C++ preprocessor flags, e.g. -I<include dir>"

config PK_PAGING_PF_HUGEPF_DPKCONFIG
	string "PKG_CONFIG_PATH: Directories to add to pkg-config's search path"

config PK_PAGING_PF_HUGEPF_CFLAGS
	string "CFLAGS: C compiler flags"

config PK_PAGING_PF_HUGEPF_LDFLAGS
	string "LDFLAGS: Linker flags"

config PK_PAGING_PF_HUGEPF_CXXFLAGS
	string "CXXFLAGS: C++ compiler flags"

config PK_PAGING_PF_HUGEPF_ASFLAGS
	string "CCASFLAGS: assembler compiler flags (defaults to CFLAGS)"

config PK_PAGING_PF_HUGEPF_BUILDARCH
	string "--host options on configure for Architecture"

endif # PK_PAGING_PF_HUGEPF
```

## package/PAGING/BiscuitOS-PAGING-PF-HUGETLB-COW-FAULT/Kconfig
```kconfig
menuconfig PK_PAGING_PF_HUGETLB_COW_FAULT
	bool "Page Fault with HUGETLB Memory on COW SegmentFault"

if PK_PAGING_PF_HUGETLB_COW_FAULT

config PK_PAGING_PF_HUGETLB_COW_FAULT_VERSION
	default "default"
	string "verstion"

config PK_PAGING_PF_HUGETLB_COW_FAULT_TAR
	default "tar.gz"
	string "tar type"

config PK_PAGING_PF_HUGETLB_COW_FAULT_URL
	default "https://gitee.com/BiscuitOS_team/HardStack/raw/Gitee/Memory-Allocator/PAGING-MECH/BiscuitOS-PAGING-PF-HUGETLB-COW-FAULT"
	string "url"

config PK_PAGING_PF_HUGETLB_COW_FAULT_GITHUB
	string "GitHub"

config PK_PAGING_PF_HUGETLB_COW_FAULT_SRCFILE
	default "main.c Makefile RunBiscuitOS.sh"
	string "Source code list"

config PK_PAGING_PF_HUGETLB_COW_FAULT_CSRCFILE
	string "Compile source code list"

config PK_PAGING_PF_HUGETLB_COW_FAULT_CONFIG
	string "CONFIG: Project Configure Options"

config PK_PAGING_PF_HUGETLB_COW_FAULT_LIBPATH
	string "LIBS: Libraries to pass to the linker, e.g. -l<library>"

config PK_PAGING_PF_HUGETLB_COW_FAULT_CPPFLAGS
	string "CPPFLAGS: C/C++ preprocessor flags, e.g. -I<include dir>"

config PK_PAGING_PF_HUGETLB_COW_FAULT_DPKCONFIG
	string "PKG_CONFIG_PATH: Directories to add to pkg-config's search path"

config PK_PAGING_PF_HUGETLB_COW_FAULT_CFLAGS
	string "CFLAGS: C compiler flags"

config PK_PAGING_PF_HUGETLB_COW_FAULT_LDFLAGS
	string "LDFLAGS: Linker flags"

config PK_PAGING_PF_HUGETLB_COW_FAULT_CXXFLAGS
	string "CXXFLAGS: C++ compiler flags"

config PK_PAGING_PF_HUGETLB_COW_FAULT_ASFLAGS
	string "CCASFLAGS: assembler compiler flags (defaults to CFLAGS)"

config PK_PAGING_PF_HUGETLB_COW_FAULT_BUILDARCH
	string "--host options on configure for Architecture"

endif # PK_PAGING_PF_HUGETLB_COW_FAULT
```

## package/PAGING/BiscuitOS-PAGING-PF-HUGETLB-POSIX/Kconfig
```kconfig
menuconfig PK_PAGING_PF_HUGETLB_POSIX
	bool "Page Fault with HUGETLB Memory on POSIX"

if PK_PAGING_PF_HUGETLB_POSIX

config PK_PAGING_PF_HUGETLB_POSIX_VERSION
	default "default"
	string "verstion"

config PK_PAGING_PF_HUGETLB_POSIX_TAR
	default "tar.gz"
	string "tar type"

config PK_PAGING_PF_HUGETLB_POSIX_URL
	default "https://gitee.com/BiscuitOS_team/HardStack/raw/Gitee/Memory-Allocator/PAGING-MECH/BiscuitOS-PAGING-PF-HUGETLB-POSIX"
	string "url"

config PK_PAGING_PF_HUGETLB_POSIX_GITHUB
	string "GitHub"

config PK_PAGING_PF_HUGETLB_POSIX_SRCFILE
	default "client.c server.c Makefile RunBiscuitOS.sh"
	string "Source code list"

config PK_PAGING_PF_HUGETLB_POSIX_CSRCFILE
	string "Compile source code list"

config PK_PAGING_PF_HUGETLB_POSIX_CONFIG
	string "CONFIG: Project Configure Options"

config PK_PAGING_PF_HUGETLB_POSIX_LIBPATH
	string "LIBS: Libraries to pass to the linker, e.g. -l<library>"

config PK_PAGING_PF_HUGETLB_POSIX_CPPFLAGS
	string "CPPFLAGS: C/C++ preprocessor flags, e.g. -I<include dir>"

config PK_PAGING_PF_HUGETLB_POSIX_DPKCONFIG
	string "PKG_CONFIG_PATH: Directories to add to pkg-config's search path"

config PK_PAGING_PF_HUGETLB_POSIX_CFLAGS
	string "CFLAGS: C compiler flags"

config PK_PAGING_PF_HUGETLB_POSIX_LDFLAGS
	string "LDFLAGS: Linker flags"

config PK_PAGING_PF_HUGETLB_POSIX_CXXFLAGS
	string "CXXFLAGS: C++ compiler flags"

config PK_PAGING_PF_HUGETLB_POSIX_ASFLAGS
	string "CCASFLAGS: assembler compiler flags (defaults to CFLAGS)"

config PK_PAGING_PF_HUGETLB_POSIX_BUILDARCH
	string "--host options on configure for Architecture"

endif # PK_PAGING_PF_HUGETLB_POSIX
```

## package/PAGING/BiscuitOS-PAGING-PF-HUGETLB-SURPLUS/Kconfig
```kconfig
menuconfig PK_PAGING_PF_HUGETLB_SURPLUS
	bool "Page Fault with HUGETLB Memory on Surplus"

if PK_PAGING_PF_HUGETLB_SURPLUS

config PK_PAGING_PF_HUGETLB_SURPLUS_VERSION
	default "default"
	string "verstion"

config PK_PAGING_PF_HUGETLB_SURPLUS_TAR
	default "tar.gz"
	string "tar type"

config PK_PAGING_PF_HUGETLB_SURPLUS_URL
	default "https://gitee.com/BiscuitOS_team/HardStack/raw/Gitee/Memory-Allocator/PAGING-MECH/BiscuitOS-PAGING-PF-HUGETLB-SURPLUS"
	string "url"

config PK_PAGING_PF_HUGETLB_SURPLUS_GITHUB
	string "GitHub"

config PK_PAGING_PF_HUGETLB_SURPLUS_SRCFILE
	default "main.c Makefile RunBiscuitOS.sh"
	string "Source code list"

config PK_PAGING_PF_HUGETLB_SURPLUS_CSRCFILE
	string "Compile source code list"

config PK_PAGING_PF_HUGETLB_SURPLUS_CONFIG
	string "CONFIG: Project Configure Options"

config PK_PAGING_PF_HUGETLB_SURPLUS_LIBPATH
	string "LIBS: Libraries to pass to the linker, e.g. -l<library>"

config PK_PAGING_PF_HUGETLB_SURPLUS_CPPFLAGS
	string "CPPFLAGS: C/C++ preprocessor flags, e.g. -I<include dir>"

config PK_PAGING_PF_HUGETLB_SURPLUS_DPKCONFIG
	string "PKG_CONFIG_PATH: Directories to add to pkg-config's search path"

config PK_PAGING_PF_HUGETLB_SURPLUS_CFLAGS
	string "CFLAGS: C compiler flags"

config PK_PAGING_PF_HUGETLB_SURPLUS_LDFLAGS
	string "LDFLAGS: Linker flags"

config PK_PAGING_PF_HUGETLB_SURPLUS_CXXFLAGS
	string "CXXFLAGS: C++ compiler flags"

config PK_PAGING_PF_HUGETLB_SURPLUS_ASFLAGS
	string "CCASFLAGS: assembler compiler flags (defaults to CFLAGS)"

config PK_PAGING_PF_HUGETLB_SURPLUS_BUILDARCH
	string "--host options on configure for Architecture"

endif # PK_PAGING_PF_HUGETLB_SURPLUS
```

## package/PAGING/BiscuitOS-PAGING-PF-HUGETLB-SYSV/Kconfig
```kconfig
menuconfig PK_PAGING_PF_HUGETLB_SYSV
	bool "Page Fault with HUGETLB Memory on SYSV"

if PK_PAGING_PF_HUGETLB_SYSV

config PK_PAGING_PF_HUGETLB_SYSV_VERSION
	default "default"
	string "verstion"

config PK_PAGING_PF_HUGETLB_SYSV_TAR
	default "tar.gz"
	string "tar type"

config PK_PAGING_PF_HUGETLB_SYSV_URL
	default "https://gitee.com/BiscuitOS_team/HardStack/raw/Gitee/Memory-Allocator/PAGING-MECH/BiscuitOS-PAGING-PF-HUGETLB-SYSV"
	string "url"

config PK_PAGING_PF_HUGETLB_SYSV_GITHUB
	string "GitHub"

config PK_PAGING_PF_HUGETLB_SYSV_SRCFILE
	default "client.c server.c Makefile RunBiscuitOS.sh"
	string "Source code list"

config PK_PAGING_PF_HUGETLB_SYSV_CSRCFILE
	string "Compile source code list"

config PK_PAGING_PF_HUGETLB_SYSV_CONFIG
	string "CONFIG: Project Configure Options"

config PK_PAGING_PF_HUGETLB_SYSV_LIBPATH
	string "LIBS: Libraries to pass to the linker, e.g. -l<library>"

config PK_PAGING_PF_HUGETLB_SYSV_CPPFLAGS
	string "CPPFLAGS: C/C++ preprocessor flags, e.g. -I<include dir>"

config PK_PAGING_PF_HUGETLB_SYSV_DPKCONFIG
	string "PKG_CONFIG_PATH: Directories to add to pkg-config's search path"

config PK_PAGING_PF_HUGETLB_SYSV_CFLAGS
	string "CFLAGS: C compiler flags"

config PK_PAGING_PF_HUGETLB_SYSV_LDFLAGS
	string "LDFLAGS: Linker flags"

config PK_PAGING_PF_HUGETLB_SYSV_CXXFLAGS
	string "CXXFLAGS: C++ compiler flags"

config PK_PAGING_PF_HUGETLB_SYSV_ASFLAGS
	string "CCASFLAGS: assembler compiler flags (defaults to CFLAGS)"

config PK_PAGING_PF_HUGETLB_SYSV_BUILDARCH
	string "--host options on configure for Architecture"

endif # PK_PAGING_PF_HUGETLB_SYSV
```

## package/PAGING/BiscuitOS-PAGING-PF-KERNEL-KPROBE/Kconfig
```kconfig
menuconfig PK_PAGING_PF_KERNEL_KPROBE
	bool "Page Fault: KPROBE-PF"

if PK_PAGING_PF_KERNEL_KPROBE

config PK_PAGING_PF_KERNEL_KPROBE_VERSION
	default "default"
	string "verstion"

config PK_PAGING_PF_KERNEL_KPROBE_TAR
	default "tar.gz"
	string "tar type"

config PK_PAGING_PF_KERNEL_KPROBE_URL
	default "https://gitee.com/BiscuitOS_team/HardStack/raw/Gitee/Memory-Allocator/PAGING-MECH/BiscuitOS-PAGING-PF-KERNEL-KPROBE"
	string "url"

config PK_PAGING_PF_KERNEL_KPROBE_GITHUB
	string "GitHub"

config PK_PAGING_PF_KERNEL_KPROBE_SRCFILE
	default "app.c main.c Makefile RunBiscuitOS.sh Kconfig Makefile.host"
	string "Source code list"

config PK_PAGING_PF_KERNEL_KPROBE_CSRCFILE
	string "Compile source code list"

config PK_PAGING_PF_KERNEL_KPROBE_CONFIG
	string "CONFIG: Project Configure Options"

config PK_PAGING_PF_KERNEL_KPROBE_LIBPATH
	string "LIBS: Libraries to pass to the linker, e.g. -l<library>"

config PK_PAGING_PF_KERNEL_KPROBE_CPPFLAGS
	string "CPPFLAGS: C/C++ preprocessor flags, e.g. -I<include dir>"

config PK_PAGING_PF_KERNEL_KPROBE_DPKCONFIG
	string "PKG_CONFIG_PATH: Directories to add to pkg-config's search path"

config PK_PAGING_PF_KERNEL_KPROBE_CFLAGS
	string "CFLAGS: C compiler flags"

config PK_PAGING_PF_KERNEL_KPROBE_LDFLAGS
	string "LDFLAGS: Linker flags"

config PK_PAGING_PF_KERNEL_KPROBE_CXXFLAGS
	string "CXXFLAGS: C++ compiler flags"

config PK_PAGING_PF_KERNEL_KPROBE_ASFLAGS
	string "CCASFLAGS: assembler compiler flags (defaults to CFLAGS)"

config PK_PAGING_PF_KERNEL_KPROBE_BUILDARCH
	string "--host options on configure for Architecture"

endif # PK_PAGING_PF_KERNEL_KPROBE
```

## package/PAGING/BiscuitOS-PAGING-PF-KERNEL-SPUR-NX/Kconfig
```kconfig
menuconfig PK_PAGING_PF_KERNEL_SPUR_NX
	bool "Page Fault: Spurious #PF with NX"

if PK_PAGING_PF_KERNEL_SPUR_NX

config PK_PAGING_PF_KERNEL_SPUR_NX_VERSION
	default "default"
	string "verstion"

config PK_PAGING_PF_KERNEL_SPUR_NX_TAR
	default "tar.gz"
	string "tar type"

config PK_PAGING_PF_KERNEL_SPUR_NX_URL
	default "https://gitee.com/BiscuitOS_team/HardStack/raw/Gitee/Memory-Allocator/PAGING-MECH/BiscuitOS-PAGING-PF-KERNEL-SPUR-NX"
	string "url"

config PK_PAGING_PF_KERNEL_SPUR_NX_GITHUB
	string "GitHub"

config PK_PAGING_PF_KERNEL_SPUR_NX_SRCFILE
	default "main.c Makefile Kconfig"
	string "Source code list"

config PK_PAGING_PF_KERNEL_SPUR_NX_CSRCFILE
	string "Compile source code list"

config PK_PAGING_PF_KERNEL_SPUR_NX_CONFIG
	string "CONFIG: Project Configure Options"

config PK_PAGING_PF_KERNEL_SPUR_NX_LIBPATH
	string "LIBS: Libraries to pass to the linker, e.g. -l<library>"

config PK_PAGING_PF_KERNEL_SPUR_NX_CPPFLAGS
	string "CPPFLAGS: C/C++ preprocessor flags, e.g. -I<include dir>"

config PK_PAGING_PF_KERNEL_SPUR_NX_DPKCONFIG
	string "PKG_CONFIG_PATH: Directories to add to pkg-config's search path"

config PK_PAGING_PF_KERNEL_SPUR_NX_CFLAGS
	string "CFLAGS: C compiler flags"

config PK_PAGING_PF_KERNEL_SPUR_NX_LDFLAGS
	string "LDFLAGS: Linker flags"

config PK_PAGING_PF_KERNEL_SPUR_NX_CXXFLAGS
	string "CXXFLAGS: C++ compiler flags"

config PK_PAGING_PF_KERNEL_SPUR_NX_ASFLAGS
	string "CCASFLAGS: assembler compiler flags (defaults to CFLAGS)"

config PK_PAGING_PF_KERNEL_SPUR_NX_BUILDARCH
	string "--host options on configure for Architecture"

endif # PK_PAGING_PF_KERNEL_SPUR_NX
```

## package/PAGING/BiscuitOS-PAGING-PF-KERNEL-SPUR-RW/Kconfig
```kconfig
menuconfig PK_PAGING_PF_KERNEL_SPUR_RW
	bool "Page Fault: Spurious #PF with RW"

if PK_PAGING_PF_KERNEL_SPUR_RW

config PK_PAGING_PF_KERNEL_SPUR_RW_VERSION
	default "default"
	string "verstion"

config PK_PAGING_PF_KERNEL_SPUR_RW_TAR
	default "tar.gz"
	string "tar type"

config PK_PAGING_PF_KERNEL_SPUR_RW_URL
	default "https://gitee.com/BiscuitOS_team/HardStack/raw/Gitee/Memory-Allocator/PAGING-MECH/BiscuitOS-PAGING-PF-KERNEL-SPUR-RW"
	string "url"

config PK_PAGING_PF_KERNEL_SPUR_RW_GITHUB
	string "GitHub"

config PK_PAGING_PF_KERNEL_SPUR_RW_SRCFILE
	default "main.c Makefile Kconfig"
	string "Source code list"

config PK_PAGING_PF_KERNEL_SPUR_RW_CSRCFILE
	string "Compile source code list"

config PK_PAGING_PF_KERNEL_SPUR_RW_CONFIG
	string "CONFIG: Project Configure Options"

config PK_PAGING_PF_KERNEL_SPUR_RW_LIBPATH
	string "LIBS: Libraries to pass to the linker, e.g. -l<library>"

config PK_PAGING_PF_KERNEL_SPUR_RW_CPPFLAGS
	string "CPPFLAGS: C/C++ preprocessor flags, e.g. -I<include dir>"

config PK_PAGING_PF_KERNEL_SPUR_RW_DPKCONFIG
	string "PKG_CONFIG_PATH: Directories to add to pkg-config's search path"

config PK_PAGING_PF_KERNEL_SPUR_RW_CFLAGS
	string "CFLAGS: C compiler flags"

config PK_PAGING_PF_KERNEL_SPUR_RW_LDFLAGS
	string "LDFLAGS: Linker flags"

config PK_PAGING_PF_KERNEL_SPUR_RW_CXXFLAGS
	string "CXXFLAGS: C++ compiler flags"

config PK_PAGING_PF_KERNEL_SPUR_RW_ASFLAGS
	string "CCASFLAGS: assembler compiler flags (defaults to CFLAGS)"

config PK_PAGING_PF_KERNEL_SPUR_RW_BUILDARCH
	string "--host options on configure for Architecture"

endif # PK_PAGING_PF_KERNEL_SPUR_RW
```

## package/PAGING/BiscuitOS-PAGING-PF-KERNEL/Kconfig
```kconfig
menuconfig PK_PAGING_PF_KERNEL
	bool "Page Fault: Kernel Address Fault"

if PK_PAGING_PF_KERNEL

config PK_PAGING_PF_KERNEL_VERSION
	default "default"
	string "verstion"

config PK_PAGING_PF_KERNEL_TAR
	default "tar.gz"
	string "tar type"

config PK_PAGING_PF_KERNEL_URL
	default "https://gitee.com/BiscuitOS_team/HardStack/raw/Gitee/Memory-Allocator/PAGING-MECH/BiscuitOS-PAGING-PF-KERNEL"
	string "url"

config PK_PAGING_PF_KERNEL_GITHUB
	string "GitHub"

config PK_PAGING_PF_KERNEL_SRCFILE
	default "main.c Makefile RunBiscuitOS.sh Kconfig Makefile.host"
	string "Source code list"

config PK_PAGING_PF_KERNEL_CSRCFILE
	string "Compile source code list"

config PK_PAGING_PF_KERNEL_CONFIG
	string "CONFIG: Project Configure Options"

config PK_PAGING_PF_KERNEL_LIBPATH
	string "LIBS: Libraries to pass to the linker, e.g. -l<library>"

config PK_PAGING_PF_KERNEL_CPPFLAGS
	string "CPPFLAGS: C/C++ preprocessor flags, e.g. -I<include dir>"

config PK_PAGING_PF_KERNEL_DPKCONFIG
	string "PKG_CONFIG_PATH: Directories to add to pkg-config's search path"

config PK_PAGING_PF_KERNEL_CFLAGS
	string "CFLAGS: C compiler flags"

config PK_PAGING_PF_KERNEL_LDFLAGS
	string "LDFLAGS: Linker flags"

config PK_PAGING_PF_KERNEL_CXXFLAGS
	string "CXXFLAGS: C++ compiler flags"

config PK_PAGING_PF_KERNEL_ASFLAGS
	string "CCASFLAGS: assembler compiler flags (defaults to CFLAGS)"

config PK_PAGING_PF_KERNEL_BUILDARCH
	string "--host options on configure for Architecture"

endif # PK_PAGING_PF_KERNEL
```
