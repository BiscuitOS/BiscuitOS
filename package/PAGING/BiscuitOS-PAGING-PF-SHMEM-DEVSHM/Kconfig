## package/PAGING/BiscuitOS-PAGING-PFNMAP-PFNREMAP/Kconfig
```kconfig
menuconfig PK_PAGING_PFNMAP_PFNREMAP
	bool "PFNMAP: PFNREMAP"

if PK_PAGING_PFNMAP_PFNREMAP

config PK_PAGING_PFNMAP_PFNREMAP_VERSION
	default "default"
	string "verstion"

config PK_PAGING_PFNMAP_PFNREMAP_TAR
	default "tar.gz"
	string "tar type"

config PK_PAGING_PFNMAP_PFNREMAP_URL
	default "https://gitee.com/BiscuitOS_team/HardStack/raw/Gitee/Memory-Allocator/PAGING-MECH/BiscuitOS-PAGING-PFNMAP-PFNREMAP"
	string "url"

config PK_PAGING_PFNMAP_PFNREMAP_GITHUB
	string "GitHub"

config PK_PAGING_PFNMAP_PFNREMAP_SRCFILE
	default "main.c Makefile Kconfig Makefile.host RunBiscuitOS.sh"
	string "Source code list"

config PK_PAGING_PFNMAP_PFNREMAP_CSRCFILE
	string "Compile source code list"

config PK_PAGING_PFNMAP_PFNREMAP_CONFIG
	string "CONFIG: Project Configure Options"

config PK_PAGING_PFNMAP_PFNREMAP_LIBPATH
	string "LIBS: Libraries to pass to the linker, e.g. -l<library>"

config PK_PAGING_PFNMAP_PFNREMAP_CPPFLAGS
	string "CPPFLAGS: C/C++ preprocessor flags, e.g. -I<include dir>"

config PK_PAGING_PFNMAP_PFNREMAP_DPKCONFIG
	string "PKG_CONFIG_PATH: Directories to add to pkg-config's search path"

config PK_PAGING_PFNMAP_PFNREMAP_CFLAGS
	string "CFLAGS: C compiler flags"

config PK_PAGING_PFNMAP_PFNREMAP_LDFLAGS
	string "LDFLAGS: Linker flags"

config PK_PAGING_PFNMAP_PFNREMAP_CXXFLAGS
	string "CXXFLAGS: C++ compiler flags"

config PK_PAGING_PFNMAP_PFNREMAP_ASFLAGS
	string "CCASFLAGS: assembler compiler flags (defaults to CFLAGS)"

config PK_PAGING_PFNMAP_PFNREMAP_BUILDARCH
	string "--host options on configure for Architecture"

endif # PK_PAGING_PFNMAP_PFNREMAP
```

## package/PAGING/BiscuitOS-PAGING-PGD/Kconfig
```kconfig
menuconfig PK_PAGING_PGD
	bool "PGD(Page Global Directory)"

if PK_PAGING_PGD

config PK_PAGING_PGD_VERSION
	default "default"
	string "verstion"

config PK_PAGING_PGD_TAR
	default "tar.gz"
	string "tar type"

config PK_PAGING_PGD_URL
	default "https://gitee.com/BiscuitOS_team/HardStack/raw/Gitee/Memory-Allocator/PAGING-MECH/BiscuitOS-PAGING-PGD"
	string "url"

config PK_PAGING_PGD_GITHUB
	string "GitHub"

config PK_PAGING_PGD_SRCFILE
	default "main.c Makefile Kconfig Mafile.app RunBiscuitOS.sh app.c"
	string "Source code list"

config PK_PAGING_PGD_CSRCFILE
	string "Compile source code list"

config PK_PAGING_PGD_CONFIG
	string "CONFIG: Project Configure Options"

config PK_PAGING_PGD_LIBPATH
	string "LIBS: Libraries to pass to the linker, e.g. -l<library>"

config PK_PAGING_PGD_CPPFLAGS
	string "CPPFLAGS: C/C++ preprocessor flags, e.g. -I<include dir>"

config PK_PAGING_PGD_DPKCONFIG
	string "PKG_CONFIG_PATH: Directories to add to pkg-config's search path"

config PK_PAGING_PGD_CFLAGS
	string "CFLAGS: C compiler flags"

config PK_PAGING_PGD_LDFLAGS
	string "LDFLAGS: Linker flags"

config PK_PAGING_PGD_CXXFLAGS
	string "CXXFLAGS: C++ compiler flags"

config PK_PAGING_PGD_ASFLAGS
	string "CCASFLAGS: assembler compiler flags (defaults to CFLAGS)"

config PK_PAGING_PGD_BUILDARCH
	string "--host options on configure for Architecture"

endif # PK_PAGING_PGD
```

## package/PAGING/BiscuitOS-PAGING-PGPROT/Kconfig
```kconfig
menuconfig PK_PAGING_PGPROT
	bool "PGPROT(PageTable Attribute)"

if PK_PAGING_PGPROT

config PK_PAGING_PGPROT_VERSION
	default "default"
	string "verstion"

config PK_PAGING_PGPROT_TAR
	default "tar.gz"
	string "tar type"

config PK_PAGING_PGPROT_URL
	default "https://gitee.com/BiscuitOS_team/HardStack/raw/Gitee/Memory-Allocator/PAGING-MECH/BiscuitOS-PAGING-PGPROT"
	string "url"

config PK_PAGING_PGPROT_GITHUB
	string "GitHub"

config PK_PAGING_PGPROT_SRCFILE
	default "main.c Makefile Kconfig Mafile.host RunBiscuitOS.sh app.c"
	string "Source code list"

config PK_PAGING_PGPROT_CSRCFILE
	string "Compile source code list"

config PK_PAGING_PGPROT_CONFIG
	string "CONFIG: Project Configure Options"

config PK_PAGING_PGPROT_LIBPATH
	string "LIBS: Libraries to pass to the linker, e.g. -l<library>"

config PK_PAGING_PGPROT_CPPFLAGS
	string "CPPFLAGS: C/C++ preprocessor flags, e.g. -I<include dir>"

config PK_PAGING_PGPROT_DPKCONFIG
	string "PKG_CONFIG_PATH: Directories to add to pkg-config's search path"

config PK_PAGING_PGPROT_CFLAGS
	string "CFLAGS: C compiler flags"

config PK_PAGING_PGPROT_LDFLAGS
	string "LDFLAGS: Linker flags"

config PK_PAGING_PGPROT_CXXFLAGS
	string "CXXFLAGS: C++ compiler flags"

config PK_PAGING_PGPROT_ASFLAGS
	string "CCASFLAGS: assembler compiler flags (defaults to CFLAGS)"

config PK_PAGING_PGPROT_BUILDARCH
	string "--host options on configure for Architecture"

endif # PK_PAGING_PGPROT
```

## package/PAGING/BiscuitOS-PAGING-PKEY/Kconfig
```kconfig
menuconfig PK_PAGING_PKEY
	bool "Protection Key"

if PK_PAGING_PKEY

config PK_PAGING_PKEY_VERSION
	default "default"
	string "verstion"

config PK_PAGING_PKEY_TAR
	default "tar.gz"
	string "tar type"

config PK_PAGING_PKEY_URL
	default "https://gitee.com/BiscuitOS_team/HardStack/raw/Gitee/Memory-Allocator/PAGING-MECH/BiscuitOS-PAGING-PKEY"
	string "url"

config PK_PAGING_PKEY_GITHUB
	string "GitHub"

config PK_PAGING_PKEY_SRCFILE
	default "main.c Makefile RunBiscuitOS.sh"
	string "Source code list"

config PK_PAGING_PKEY_CSRCFILE
	string "Compile source code list"

config PK_PAGING_PKEY_CONFIG
	string "CONFIG: Project Configure Options"

config PK_PAGING_PKEY_LIBPATH
	string "LIBS: Libraries to pass to the linker, e.g. -l<library>"

config PK_PAGING_PKEY_CPPKEYLAGS
	string "CPPKEYLAGS: C/C++ preprocessor flags, e.g. -I<include dir>"

config PK_PAGING_PKEY_DPKCONFIG
	string "PKG_CONFIG_PATH: Directories to add to pkg-config's search path"

config PK_PAGING_PKEY_CFLAGS
	string "CFLAGS: C compiler flags"

config PK_PAGING_PKEY_LDFLAGS
	string "LDFLAGS: Linker flags"

config PK_PAGING_PKEY_CXXFLAGS
	string "CXXFLAGS: C++ compiler flags"

config PK_PAGING_PKEY_ASFLAGS
	string "CCASFLAGS: assembler compiler flags (defaults to CFLAGS)"

config PK_PAGING_PKEY_BUILDARCH
	string "--host options on configure for Architecture"

endif # PK_PAGING_PKEY
```

## package/PAGING/BiscuitOS-PAGING-PMD/Kconfig
```kconfig
menuconfig PK_PAGING_PMD
	bool "PMD(Page Middle Directory)"

if PK_PAGING_PMD

config PK_PAGING_PMD_VERSION
	default "default"
	string "verstion"

config PK_PAGING_PMD_TAR
	default "tar.gz"
	string "tar type"

config PK_PAGING_PMD_URL
	default "https://gitee.com/BiscuitOS_team/HardStack/raw/Gitee/Memory-Allocator/PAGING-MECH/BiscuitOS-PAGING-PMD"
	string "url"

config PK_PAGING_PMD_GITHUB
	string "GitHub"

config PK_PAGING_PMD_SRCFILE
	default "main.c Makefile Kconfig Mafile.app RunBiscuitOS.sh app.c"
	string "Source code list"

config PK_PAGING_PMD_CSRCFILE
	string "Compile source code list"

config PK_PAGING_PMD_CONFIG
	string "CONFIG: Project Configure Options"

config PK_PAGING_PMD_LIBPATH
	string "LIBS: Libraries to pass to the linker, e.g. -l<library>"

config PK_PAGING_PMD_CPPFLAGS
	string "CPPFLAGS: C/C++ preprocessor flags, e.g. -I<include dir>"

config PK_PAGING_PMD_DPKCONFIG
	string "PKG_CONFIG_PATH: Directories to add to pkg-config's search path"

config PK_PAGING_PMD_CFLAGS
	string "CFLAGS: C compiler flags"

config PK_PAGING_PMD_LDFLAGS
	string "LDFLAGS: Linker flags"

config PK_PAGING_PMD_CXXFLAGS
	string "CXXFLAGS: C++ compiler flags"

config PK_PAGING_PMD_ASFLAGS
	string "CCASFLAGS: assembler compiler flags (defaults to CFLAGS)"

config PK_PAGING_PMD_BUILDARCH
	string "--host options on configure for Architecture"

endif # PK_PAGING_PMD
```

## package/PAGING/BiscuitOS-PAGING-PROC-CLEAR-REFS-FILE-HUGETLB/Kconfig
```kconfig
menuconfig PK_PAGING_PROC_CLEAR_REFS_FILE_HUGETLB
	bool "PROC Clear Referenced with File-Mapped HugeTLB Memory"

if PK_PAGING_PROC_CLEAR_REFS_FILE_HUGETLB

config PK_PAGING_PROC_CLEAR_REFS_FILE_HUGETLB_VERSION
	default "default"
	string "verstion"

config PK_PAGING_PROC_CLEAR_REFS_FILE_HUGETLB_TAR
	default "tar.gz"
	string "tar type"

config PK_PAGING_PROC_CLEAR_REFS_FILE_HUGETLB_URL
	default "https://gitee.com/BiscuitOS_team/HardStack/raw/Gitee/Memory-Allocator/PAGING-MECH/BiscuitOS-PAGING-PROC-CLEAR-REFS-FILE-HUGETLB"
	string "url"

config PK_PAGING_PROC_CLEAR_REFS_FILE_HUGETLB_GITHUB
	string "GitHub"

config PK_PAGING_PROC_CLEAR_REFS_FILE_HUGETLB_SRCFILE
	default "main.c Makefile RunBiscuitOS.sh"
	string "Source code list"

config PK_PAGING_PROC_CLEAR_REFS_FILE_HUGETLB_CSRCFILE
	string "Compile source code list"

config PK_PAGING_PROC_CLEAR_REFS_FILE_HUGETLB_CONFIG
	string "CONFIG: Project Configure Options"

config PK_PAGING_PROC_CLEAR_REFS_FILE_HUGETLB_LIBPATH
	string "LIBS: Libraries to pass to the linker, e.g. -l<library>"

config PK_PAGING_PROC_CLEAR_REFS_FILE_HUGETLB_CPPFLAGS
	string "CPPFLAGS: C/C++ preprocessor flags, e.g. -I<include dir>"

config PK_PAGING_PROC_CLEAR_REFS_FILE_HUGETLB_DPKCONFIG
	string "PKG_CONFIG_PATH: Directories to add to pkg-config's search path"

config PK_PAGING_PROC_CLEAR_REFS_FILE_HUGETLB_CFLAGS
	string "CFLAGS: C compiler flags"

config PK_PAGING_PROC_CLEAR_REFS_FILE_HUGETLB_LDFLAGS
	string "LDFLAGS: Linker flags"

config PK_PAGING_PROC_CLEAR_REFS_FILE_HUGETLB_CXXFLAGS
	string "CXXFLAGS: C++ compiler flags"

config PK_PAGING_PROC_CLEAR_REFS_FILE_HUGETLB_ASFLAGS
	string "CCASFLAGS: assembler compiler flags (defaults to CFLAGS)"

config PK_PAGING_PROC_CLEAR_REFS_FILE_HUGETLB_BUILDARCH
	string "--host options on configure for Architecture"

endif # PK_PAGING_PROC_CLEAR_REFS_FILE_HUGETLB
```

## package/PAGING/BiscuitOS-PAGING-PROC-CLEAR-REFS-FILE/Kconfig
```kconfig
menuconfig PK_PAGING_PROC_CLEAR_REFS_FILE
	bool "PROC Clear Referenced with File-Mapped Memory"

if PK_PAGING_PROC_CLEAR_REFS_FILE

config PK_PAGING_PROC_CLEAR_REFS_FILE_VERSION
	default "default"
	string "verstion"

config PK_PAGING_PROC_CLEAR_REFS_FILE_TAR
	default "tar.gz"
	string "tar type"

config PK_PAGING_PROC_CLEAR_REFS_FILE_URL
	default "https://gitee.com/BiscuitOS_team/HardStack/raw/Gitee/Memory-Allocator/PAGING-MECH/BiscuitOS-PAGING-PROC-CLEAR-REFS-FILE"
	string "url"

config PK_PAGING_PROC_CLEAR_REFS_FILE_GITHUB
	string "GitHub"

config PK_PAGING_PROC_CLEAR_REFS_FILE_SRCFILE
	default "main.c Makefile RunBiscuitOS.sh"
	string "Source code list"

config PK_PAGING_PROC_CLEAR_REFS_FILE_CSRCFILE
	string "Compile source code list"

config PK_PAGING_PROC_CLEAR_REFS_FILE_CONFIG
	string "CONFIG: Project Configure Options"

config PK_PAGING_PROC_CLEAR_REFS_FILE_LIBPATH
	string "LIBS: Libraries to pass to the linker, e.g. -l<library>"

config PK_PAGING_PROC_CLEAR_REFS_FILE_CPPFLAGS
	string "CPPFLAGS: C/C++ preprocessor flags, e.g. -I<include dir>"

config PK_PAGING_PROC_CLEAR_REFS_FILE_DPKCONFIG
	string "PKG_CONFIG_PATH: Directories to add to pkg-config's search path"

config PK_PAGING_PROC_CLEAR_REFS_FILE_CFLAGS
	string "CFLAGS: C compiler flags"

config PK_PAGING_PROC_CLEAR_REFS_FILE_LDFLAGS
	string "LDFLAGS: Linker flags"

config PK_PAGING_PROC_CLEAR_REFS_FILE_CXXFLAGS
	string "CXXFLAGS: C++ compiler flags"

config PK_PAGING_PROC_CLEAR_REFS_FILE_ASFLAGS
	string "CCASFLAGS: assembler compiler flags (defaults to CFLAGS)"

config PK_PAGING_PROC_CLEAR_REFS_FILE_BUILDARCH
	string "--host options on configure for Architecture"

endif # PK_PAGING_PROC_CLEAR_REFS_FILE
```
