## package/PAGING/BiscuitOS-PAGING-PF-UFFD-FORK/Kconfig
```kconfig
menuconfig PK_PAGING_PF_UFFD_FORK
	bool "Page Fault with userfaultfd on FORK"

if PK_PAGING_PF_UFFD_FORK

config PK_PAGING_PF_UFFD_FORK_VERSION
	default "default"
	string "verstion"

config PK_PAGING_PF_UFFD_FORK_TAR
	default "tar.gz"
	string "tar type"

config PK_PAGING_PF_UFFD_FORK_URL
	default "https://gitee.com/BiscuitOS_team/HardStack/raw/Gitee/Memory-Allocator/PAGING-MECH/BiscuitOS-PAGING-PF-UFFD-FORK"
	string "url"

config PK_PAGING_PF_UFFD_FORK_GITHUB
	string "GitHub"

config PK_PAGING_PF_UFFD_FORK_SRCFILE
	default "main.c Makefile RunBiscuitOS.sh"
	string "Source code list"

config PK_PAGING_PF_UFFD_FORK_CSRCFILE
	string "Compile source code list"

config PK_PAGING_PF_UFFD_FORK_CONFIG
	string "CONFIG: Project Configure Options"

config PK_PAGING_PF_UFFD_FORK_LIBPATH
	string "LIBS: Libraries to pass to the linker, e.g. -l<library>"

config PK_PAGING_PF_UFFD_FORK_CPPFLAGS
	string "CPPFLAGS: C/C++ preprocessor flags, e.g. -I<include dir>"

config PK_PAGING_PF_UFFD_FORK_DPKCONFIG
	string "PKG_CONFIG_PATH: Directories to add to pkg-config's search path"

config PK_PAGING_PF_UFFD_FORK_CFLAGS
	string "CFLAGS: C compiler flags"

config PK_PAGING_PF_UFFD_FORK_LDFLAGS
	string "LDFLAGS: Linker flags"

config PK_PAGING_PF_UFFD_FORK_CXXFLAGS
	string "CXXFLAGS: C++ compiler flags"

config PK_PAGING_PF_UFFD_FORK_ASFLAGS
	string "CCASFLAGS: assembler compiler flags (defaults to CFLAGS)"

config PK_PAGING_PF_UFFD_FORK_BUILDARCH
	string "--host options on configure for Architecture"

endif # PK_PAGING_PF_UFFD_FORK
```

## package/PAGING/BiscuitOS-PAGING-PF-UFFD-REMAP/Kconfig
```kconfig
menuconfig PK_PAGING_PF_UFFD_REMAP
	bool "Page Fault with userfaultfd on REMAP"

if PK_PAGING_PF_UFFD_REMAP

config PK_PAGING_PF_UFFD_REMAP_VERSION
	default "default"
	string "verstion"

config PK_PAGING_PF_UFFD_REMAP_TAR
	default "tar.gz"
	string "tar type"

config PK_PAGING_PF_UFFD_REMAP_URL
	default "https://gitee.com/BiscuitOS_team/HardStack/raw/Gitee/Memory-Allocator/PAGING-MECH/BiscuitOS-PAGING-PF-UFFD-REMAP"
	string "url"

config PK_PAGING_PF_UFFD_REMAP_GITHUB
	string "GitHub"

config PK_PAGING_PF_UFFD_REMAP_SRCFILE
	default "main.c Makefile RunBiscuitOS.sh"
	string "Source code list"

config PK_PAGING_PF_UFFD_REMAP_CSRCFILE
	string "Compile source code list"

config PK_PAGING_PF_UFFD_REMAP_CONFIG
	string "CONFIG: Project Configure Options"

config PK_PAGING_PF_UFFD_REMAP_LIBPATH
	string "LIBS: Libraries to pass to the linker, e.g. -l<library>"

config PK_PAGING_PF_UFFD_REMAP_CPPFLAGS
	string "CPPFLAGS: C/C++ preprocessor flags, e.g. -I<include dir>"

config PK_PAGING_PF_UFFD_REMAP_DPKCONFIG
	string "PKG_CONFIG_PATH: Directories to add to pkg-config's search path"

config PK_PAGING_PF_UFFD_REMAP_CFLAGS
	string "CFLAGS: C compiler flags"

config PK_PAGING_PF_UFFD_REMAP_LDFLAGS
	string "LDFLAGS: Linker flags"

config PK_PAGING_PF_UFFD_REMAP_CXXFLAGS
	string "CXXFLAGS: C++ compiler flags"

config PK_PAGING_PF_UFFD_REMAP_ASFLAGS
	string "CCASFLAGS: assembler compiler flags (defaults to CFLAGS)"

config PK_PAGING_PF_UFFD_REMAP_BUILDARCH
	string "--host options on configure for Architecture"

endif # PK_PAGING_PF_UFFD_REMAP
```

## package/PAGING/BiscuitOS-PAGING-PF-UFFD-REMOVE/Kconfig
```kconfig
menuconfig PK_PAGING_PF_UFFD_REMOVE
	bool "Page Fault with userfaultfd on REMOVE"

if PK_PAGING_PF_UFFD_REMOVE

config PK_PAGING_PF_UFFD_REMOVE_VERSION
	default "default"
	string "verstion"

config PK_PAGING_PF_UFFD_REMOVE_TAR
	default "tar.gz"
	string "tar type"

config PK_PAGING_PF_UFFD_REMOVE_URL
	default "https://gitee.com/BiscuitOS_team/HardStack/raw/Gitee/Memory-Allocator/PAGING-MECH/BiscuitOS-PAGING-PF-UFFD-REMOVE"
	string "url"

config PK_PAGING_PF_UFFD_REMOVE_GITHUB
	string "GitHub"

config PK_PAGING_PF_UFFD_REMOVE_SRCFILE
	default "main.c Makefile RunBiscuitOS.sh"
	string "Source code list"

config PK_PAGING_PF_UFFD_REMOVE_CSRCFILE
	string "Compile source code list"

config PK_PAGING_PF_UFFD_REMOVE_CONFIG
	string "CONFIG: Project Configure Options"

config PK_PAGING_PF_UFFD_REMOVE_LIBPATH
	string "LIBS: Libraries to pass to the linker, e.g. -l<library>"

config PK_PAGING_PF_UFFD_REMOVE_CPPFLAGS
	string "CPPFLAGS: C/C++ preprocessor flags, e.g. -I<include dir>"

config PK_PAGING_PF_UFFD_REMOVE_DPKCONFIG
	string "PKG_CONFIG_PATH: Directories to add to pkg-config's search path"

config PK_PAGING_PF_UFFD_REMOVE_CFLAGS
	string "CFLAGS: C compiler flags"

config PK_PAGING_PF_UFFD_REMOVE_LDFLAGS
	string "LDFLAGS: Linker flags"

config PK_PAGING_PF_UFFD_REMOVE_CXXFLAGS
	string "CXXFLAGS: C++ compiler flags"

config PK_PAGING_PF_UFFD_REMOVE_ASFLAGS
	string "CCASFLAGS: assembler compiler flags (defaults to CFLAGS)"

config PK_PAGING_PF_UFFD_REMOVE_BUILDARCH
	string "--host options on configure for Architecture"

endif # PK_PAGING_PF_UFFD_REMOVE
```

## package/PAGING/BiscuitOS-PAGING-PF-VMALLOC32/Kconfig
```kconfig
menuconfig PK_PAGING_PF_VMALLOC32
	bool "Page Fault with VMALLOC32"

if PK_PAGING_PF_VMALLOC32

config PK_PAGING_PF_VMALLOC32_VERSION
	default "default"
	string "verstion"

config PK_PAGING_PF_VMALLOC32_TAR
	default "tar.gz"
	string "tar type"

config PK_PAGING_PF_VMALLOC32_URL
	default "https://gitee.com/BiscuitOS_team/HardStack/raw/Gitee/Memory-Allocator/PAGING-MECH/BiscuitOS-PAGING-PF-VMALLOC32"
	string "url"

config PK_PAGING_PF_VMALLOC32_GITHUB
	string "GitHub"

config PK_PAGING_PF_VMALLOC32_SRCFILE
	default "app.c Kconfig main.c Makefile Makefile.host RunBiscuitOS.sh"
	string "Source code list"

config PK_PAGING_PF_VMALLOC32_CSRCFILE
	string "Compile source code list"

config PK_PAGING_PF_VMALLOC32_CONFIG
	string "CONFIG: Project Configure Options"

config PK_PAGING_PF_VMALLOC32_LIBPATH
	string "LIBS: Libraries to pass to the linker, e.g. -l<library>"

config PK_PAGING_PF_VMALLOC32_CPPFLAGS
	string "CPPFLAGS: C/C++ preprocessor flags, e.g. -I<include dir>"

config PK_PAGING_PF_VMALLOC32_DPKCONFIG
	string "PKG_CONFIG_PATH: Directories to add to pkg-config's search path"

config PK_PAGING_PF_VMALLOC32_CFLAGS
	string "CFLAGS: C compiler flags"

config PK_PAGING_PF_VMALLOC32_LDFLAGS
	string "LDFLAGS: Linker flags"

config PK_PAGING_PF_VMALLOC32_CXXFLAGS
	string "CXXFLAGS: C++ compiler flags"

config PK_PAGING_PF_VMALLOC32_ASFLAGS
	string "CCASFLAGS: assembler compiler flags (defaults to CFLAGS)"

config PK_PAGING_PF_VMALLOC32_BUILDARCH
	string "--host options on configure for Architecture"

endif # PK_PAGING_PF_VMALLOC32
```

## package/PAGING/BiscuitOS-PAGING-PF-ZERO-PAGE/Kconfig
```kconfig
menuconfig PK_PAGING_PF_ZERO_PAGE
	bool "Page Fault with Zero Page"

if PK_PAGING_PF_ZERO_PAGE

config PK_PAGING_PF_ZERO_PAGE_VERSION
	default "default"
	string "verstion"

config PK_PAGING_PF_ZERO_PAGE_TAR
	default "tar.gz"
	string "tar type"

config PK_PAGING_PF_ZERO_PAGE_URL
	default "https://gitee.com/BiscuitOS_team/HardStack/raw/Gitee/Memory-Allocator/PAGING-MECH/BiscuitOS-PAGING-PF-ZERO-PAGE"
	string "url"

config PK_PAGING_PF_ZERO_PAGE_GITHUB
	string "GitHub"

config PK_PAGING_PF_ZERO_PAGE_SRCFILE
	default "main.c Makefile RunBiscuitOS.sh"
	string "Source code list"

config PK_PAGING_PF_ZERO_PAGE_CSRCFILE
	string "Compile source code list"

config PK_PAGING_PF_ZERO_PAGE_CONFIG
	string "CONFIG: Project Configure Options"

config PK_PAGING_PF_ZERO_PAGE_LIBPATH
	string "LIBS: Libraries to pass to the linker, e.g. -l<library>"

config PK_PAGING_PF_ZERO_PAGE_CPPFLAGS
	string "CPPFLAGS: C/C++ preprocessor flags, e.g. -I<include dir>"

config PK_PAGING_PF_ZERO_PAGE_DPKCONFIG
	string "PKG_CONFIG_PATH: Directories to add to pkg-config's search path"

config PK_PAGING_PF_ZERO_PAGE_CFLAGS
	string "CFLAGS: C compiler flags"

config PK_PAGING_PF_ZERO_PAGE_LDFLAGS
	string "LDFLAGS: Linker flags"

config PK_PAGING_PF_ZERO_PAGE_CXXFLAGS
	string "CXXFLAGS: C++ compiler flags"

config PK_PAGING_PF_ZERO_PAGE_ASFLAGS
	string "CCASFLAGS: assembler compiler flags (defaults to CFLAGS)"

config PK_PAGING_PF_ZERO_PAGE_BUILDARCH
	string "--host options on configure for Architecture"

endif # PK_PAGING_PF_ZERO_PAGE
```

## package/PAGING/BiscuitOS-PAGING-PF/Kconfig
```kconfig
menuconfig PK_PAGING_PF
	bool "Page Fault"

if PK_PAGING_PF

config PK_PAGING_PF_VERSION
	default "default"
	string "verstion"

config PK_PAGING_PF_TAR
	default "tar.gz"
	string "tar type"

config PK_PAGING_PF_URL
	default "https://gitee.com/BiscuitOS_team/HardStack/raw/Gitee/Memory-Allocator/PAGING-MECH/BiscuitOS-PAGING-PF"
	string "url"

config PK_PAGING_PF_GITHUB
	string "GitHub"

config PK_PAGING_PF_SRCFILE
	default "main.c Makefile RunBiscuitOS.sh"
	string "Source code list"

config PK_PAGING_PF_CSRCFILE
	string "Compile source code list"

config PK_PAGING_PF_CONFIG
	string "CONFIG: Project Configure Options"

config PK_PAGING_PF_LIBPATH
	string "LIBS: Libraries to pass to the linker, e.g. -l<library>"

config PK_PAGING_PF_CPPFLAGS
	string "CPPFLAGS: C/C++ preprocessor flags, e.g. -I<include dir>"

config PK_PAGING_PF_DPKCONFIG
	string "PKG_CONFIG_PATH: Directories to add to pkg-config's search path"

config PK_PAGING_PF_CFLAGS
	string "CFLAGS: C compiler flags"

config PK_PAGING_PF_LDFLAGS
	string "LDFLAGS: Linker flags"

config PK_PAGING_PF_CXXFLAGS
	string "CXXFLAGS: C++ compiler flags"

config PK_PAGING_PF_ASFLAGS
	string "CCASFLAGS: assembler compiler flags (defaults to CFLAGS)"

config PK_PAGING_PF_BUILDARCH
	string "--host options on configure for Architecture"

endif # PK_PAGING_PF
```

## package/PAGING/BiscuitOS-PAGING-PFNMAP-CUSTOMIZE-1G/Kconfig
```kconfig
menuconfig PK_PAGING_PFNMAP_CUSTOMIZE_1G
	bool "PFNMAP: CUSTOMIZE Mapping 1G"

if PK_PAGING_PFNMAP_CUSTOMIZE_1G

config PK_PAGING_PFNMAP_CUSTOMIZE_1G_VERSION
	default "default"
	string "verstion"

config PK_PAGING_PFNMAP_CUSTOMIZE_1G_TAR
	default "tar.gz"
	string "tar type"

config PK_PAGING_PFNMAP_CUSTOMIZE_1G_URL
	default "https://gitee.com/BiscuitOS_team/HardStack/raw/Gitee/Memory-Allocator/PAGING-MECH/BiscuitOS-PAGING-PFNMAP-CUSTOMIZE-1G"
	string "url"

config PK_PAGING_PFNMAP_CUSTOMIZE_1G_GITHUB
	string "GitHub"

config PK_PAGING_PFNMAP_CUSTOMIZE_1G_SRCFILE
	default "main.c Makefile Kconfig Makefile.host RunBiscuitOS.sh"
	string "Source code list"

config PK_PAGING_PFNMAP_CUSTOMIZE_1G_CSRCFILE
	string "Compile source code list"

config PK_PAGING_PFNMAP_CUSTOMIZE_1G_CONFIG
	string "CONFIG: Project Configure Options"

config PK_PAGING_PFNMAP_CUSTOMIZE_1G_LIBPATH
	string "LIBS: Libraries to pass to the linker, e.g. -l<library>"

config PK_PAGING_PFNMAP_CUSTOMIZE_1G_CPPFLAGS
	string "CPPFLAGS: C/C++ preprocessor flags, e.g. -I<include dir>"

config PK_PAGING_PFNMAP_CUSTOMIZE_1G_DPKCONFIG
	string "PKG_CONFIG_PATH: Directories to add to pkg-config's search path"

config PK_PAGING_PFNMAP_CUSTOMIZE_1G_CFLAGS
	string "CFLAGS: C compiler flags"

config PK_PAGING_PFNMAP_CUSTOMIZE_1G_LDFLAGS
	string "LDFLAGS: Linker flags"

config PK_PAGING_PFNMAP_CUSTOMIZE_1G_CXXFLAGS
	string "CXXFLAGS: C++ compiler flags"

config PK_PAGING_PFNMAP_CUSTOMIZE_1G_ASFLAGS
	string "CCASFLAGS: assembler compiler flags (defaults to CFLAGS)"

config PK_PAGING_PFNMAP_CUSTOMIZE_1G_BUILDARCH
	string "--host options on configure for Architecture"

endif # PK_PAGING_PFNMAP_CUSTOMIZE_1G
```

## package/PAGING/BiscuitOS-PAGING-PFNMAP-CUSTOMIZE-LAZYALLOC/Kconfig
```kconfig
menuconfig PK_PAGING_PFNMAP_CUSTOMIZE_LAZYALLOC
	bool "PFNMAP: CUSTOMIZE LAZYALLOC"

if PK_PAGING_PFNMAP_CUSTOMIZE_LAZYALLOC

config PK_PAGING_PFNMAP_CUSTOMIZE_LAZYALLOC_VERSION
	default "default"
	string "verstion"

config PK_PAGING_PFNMAP_CUSTOMIZE_LAZYALLOC_TAR
	default "tar.gz"
	string "tar type"

config PK_PAGING_PFNMAP_CUSTOMIZE_LAZYALLOC_URL
	default "https://gitee.com/BiscuitOS_team/HardStack/raw/Gitee/Memory-Allocator/PAGING-MECH/BiscuitOS-PAGING-PFNMAP-CUSTOMIZE-LAZYALLOC"
	string "url"

config PK_PAGING_PFNMAP_CUSTOMIZE_LAZYALLOC_GITHUB
	string "GitHub"

config PK_PAGING_PFNMAP_CUSTOMIZE_LAZYALLOC_SRCFILE
	default "main.c Makefile Kconfig Makefile.host RunBiscuitOS.sh"
	string "Source code list"

config PK_PAGING_PFNMAP_CUSTOMIZE_LAZYALLOC_CSRCFILE
	string "Compile source code list"

config PK_PAGING_PFNMAP_CUSTOMIZE_LAZYALLOC_CONFIG
	string "CONFIG: Project Configure Options"

config PK_PAGING_PFNMAP_CUSTOMIZE_LAZYALLOC_LIBPATH
	string "LIBS: Libraries to pass to the linker, e.g. -l<library>"

config PK_PAGING_PFNMAP_CUSTOMIZE_LAZYALLOC_CPPFLAGS
	string "CPPFLAGS: C/C++ preprocessor flags, e.g. -I<include dir>"

config PK_PAGING_PFNMAP_CUSTOMIZE_LAZYALLOC_DPKCONFIG
	string "PKG_CONFIG_PATH: Directories to add to pkg-config's search path"

config PK_PAGING_PFNMAP_CUSTOMIZE_LAZYALLOC_CFLAGS
	string "CFLAGS: C compiler flags"

config PK_PAGING_PFNMAP_CUSTOMIZE_LAZYALLOC_LDFLAGS
	string "LDFLAGS: Linker flags"

config PK_PAGING_PFNMAP_CUSTOMIZE_LAZYALLOC_CXXFLAGS
	string "CXXFLAGS: C++ compiler flags"

config PK_PAGING_PFNMAP_CUSTOMIZE_LAZYALLOC_ASFLAGS
	string "CCASFLAGS: assembler compiler flags (defaults to CFLAGS)"

config PK_PAGING_PFNMAP_CUSTOMIZE_LAZYALLOC_BUILDARCH
	string "--host options on configure for Architecture"

endif # PK_PAGING_PFNMAP_CUSTOMIZE_LAZYALLOC
```

## package/PAGING/BiscuitOS-PAGING-PFNMAP-MEMREMAP/Kconfig
```kconfig
menuconfig PK_PAGING_PFNMAP_MEMREMAP
	bool "PFNMAP: MEMREMAP"

if PK_PAGING_PFNMAP_MEMREMAP

config PK_PAGING_PFNMAP_MEMREMAP_VERSION
	default "default"
	string "verstion"

config PK_PAGING_PFNMAP_MEMREMAP_TAR
	default "tar.gz"
	string "tar type"

config PK_PAGING_PFNMAP_MEMREMAP_URL
	default "https://gitee.com/BiscuitOS_team/HardStack/raw/Gitee/Memory-Allocator/PAGING-MECH/BiscuitOS-PAGING-PFNMAP-MEMREMAP"
	string "url"

config PK_PAGING_PFNMAP_MEMREMAP_GITHUB
	string "GitHub"

config PK_PAGING_PFNMAP_MEMREMAP_SRCFILE
	default "main.c Makefile Kconfig Makefile.host RunBiscuitOS.sh"
	string "Source code list"

config PK_PAGING_PFNMAP_MEMREMAP_CSRCFILE
	string "Compile source code list"

config PK_PAGING_PFNMAP_MEMREMAP_CONFIG
	string "CONFIG: Project Configure Options"

config PK_PAGING_PFNMAP_MEMREMAP_LIBPATH
	string "LIBS: Libraries to pass to the linker, e.g. -l<library>"

config PK_PAGING_PFNMAP_MEMREMAP_CPPFLAGS
	string "CPPFLAGS: C/C++ preprocessor flags, e.g. -I<include dir>"

config PK_PAGING_PFNMAP_MEMREMAP_DPKCONFIG
	string "PKG_CONFIG_PATH: Directories to add to pkg-config's search path"

config PK_PAGING_PFNMAP_MEMREMAP_CFLAGS
	string "CFLAGS: C compiler flags"

config PK_PAGING_PFNMAP_MEMREMAP_LDFLAGS
	string "LDFLAGS: Linker flags"

config PK_PAGING_PFNMAP_MEMREMAP_CXXFLAGS
	string "CXXFLAGS: C++ compiler flags"

config PK_PAGING_PFNMAP_MEMREMAP_ASFLAGS
	string "CCASFLAGS: assembler compiler flags (defaults to CFLAGS)"

config PK_PAGING_PFNMAP_MEMREMAP_BUILDARCH
	string "--host options on configure for Architecture"

endif # PK_PAGING_PFNMAP_MEMREMAP
```
