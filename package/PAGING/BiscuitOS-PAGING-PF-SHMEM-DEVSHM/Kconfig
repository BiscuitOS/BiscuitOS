## package/PAGING/BiscuitOS-PAGING-PF-SHMEM-DEVSHM/Kconfig
```kconfig
menuconfig PK_PAGING_PF_SHMEM_DEVSHM
	bool "Page Fault with SHMEM Memory on /dev/shm"

if PK_PAGING_PF_SHMEM_DEVSHM

config PK_PAGING_PF_SHMEM_DEVSHM_VERSION
	default "default"
	string "verstion"

config PK_PAGING_PF_SHMEM_DEVSHM_TAR
	default "tar.gz"
	string "tar type"

config PK_PAGING_PF_SHMEM_DEVSHM_URL
	default "https://gitee.com/BiscuitOS_team/HardStack/raw/Gitee/Memory-Allocator/PAGING-MECH/BiscuitOS-PAGING-PF-SHMEM-DEVSHM"
	string "url"

config PK_PAGING_PF_SHMEM_DEVSHM_GITHUB
	string "GitHub"

config PK_PAGING_PF_SHMEM_DEVSHM_SRCFILE
	default "main.c Makefile RunBiscuitOS.sh"
	string "Source code list"

config PK_PAGING_PF_SHMEM_DEVSHM_CSRCFILE
	string "Compile source code list"

config PK_PAGING_PF_SHMEM_DEVSHM_CONFIG
	string "CONFIG: Project Configure Options"

config PK_PAGING_PF_SHMEM_DEVSHM_LIBPATH
	string "LIBS: Libraries to pass to the linker, e.g. -l<library>"

config PK_PAGING_PF_SHMEM_DEVSHM_CPPFLAGS
	string "CPPFLAGS: C/C++ preprocessor flags, e.g. -I<include dir>"

config PK_PAGING_PF_SHMEM_DEVSHM_DPKCONFIG
	string "PKG_CONFIG_PATH: Directories to add to pkg-config's search path"

config PK_PAGING_PF_SHMEM_DEVSHM_CFLAGS
	string "CFLAGS: C compiler flags"

config PK_PAGING_PF_SHMEM_DEVSHM_LDFLAGS
	string "LDFLAGS: Linker flags"

config PK_PAGING_PF_SHMEM_DEVSHM_CXXFLAGS
	string "CXXFLAGS: C++ compiler flags"

config PK_PAGING_PF_SHMEM_DEVSHM_ASFLAGS
	string "CCASFLAGS: assembler compiler flags (defaults to CFLAGS)"

config PK_PAGING_PF_SHMEM_DEVSHM_BUILDARCH
	string "--host options on configure for Architecture"

endif # PK_PAGING_PF_SHMEM_DEVSHM
```

## package/PAGING/BiscuitOS-PAGING-PF-SHMEM-MEMFD/Kconfig
```kconfig
menuconfig PK_PAGING_PF_SHMEM_MEMFD
	bool "Page Fault with SHMEM Memory on MEMFD"

if PK_PAGING_PF_SHMEM_MEMFD

config PK_PAGING_PF_SHMEM_MEMFD_VERSION
	default "default"
	string "verstion"

config PK_PAGING_PF_SHMEM_MEMFD_TAR
	default "tar.gz"
	string "tar type"

config PK_PAGING_PF_SHMEM_MEMFD_URL
	default "https://gitee.com/BiscuitOS_team/HardStack/raw/Gitee/Memory-Allocator/PAGING-MECH/BiscuitOS-PAGING-PF-SHMEM-MEMFD"
	string "url"

config PK_PAGING_PF_SHMEM_MEMFD_GITHUB
	string "GitHub"

config PK_PAGING_PF_SHMEM_MEMFD_SRCFILE
	default "main.c Makefile RunBiscuitOS.sh"
	string "Source code list"

config PK_PAGING_PF_SHMEM_MEMFD_CSRCFILE
	string "Compile source code list"

config PK_PAGING_PF_SHMEM_MEMFD_CONFIG
	string "CONFIG: Project Configure Options"

config PK_PAGING_PF_SHMEM_MEMFD_LIBPATH
	string "LIBS: Libraries to pass to the linker, e.g. -l<library>"

config PK_PAGING_PF_SHMEM_MEMFD_CPPFLAGS
	string "CPPFLAGS: C/C++ preprocessor flags, e.g. -I<include dir>"

config PK_PAGING_PF_SHMEM_MEMFD_DPKCONFIG
	string "PKG_CONFIG_PATH: Directories to add to pkg-config's search path"

config PK_PAGING_PF_SHMEM_MEMFD_CFLAGS
	string "CFLAGS: C compiler flags"

config PK_PAGING_PF_SHMEM_MEMFD_LDFLAGS
	string "LDFLAGS: Linker flags"

config PK_PAGING_PF_SHMEM_MEMFD_CXXFLAGS
	string "CXXFLAGS: C++ compiler flags"

config PK_PAGING_PF_SHMEM_MEMFD_ASFLAGS
	string "CCASFLAGS: assembler compiler flags (defaults to CFLAGS)"

config PK_PAGING_PF_SHMEM_MEMFD_BUILDARCH
	string "--host options on configure for Architecture"

endif # PK_PAGING_PF_SHMEM_MEMFD
```

## package/PAGING/BiscuitOS-PAGING-PF-SHMEM-SYSV/Kconfig
```kconfig
menuconfig PK_PAGING_PF_SHMEM_SYSV
	bool "Page Fault with SHMEM Memory on SYSV"

if PK_PAGING_PF_SHMEM_SYSV

config PK_PAGING_PF_SHMEM_SYSV_VERSION
	default "default"
	string "verstion"

config PK_PAGING_PF_SHMEM_SYSV_TAR
	default "tar.gz"
	string "tar type"

config PK_PAGING_PF_SHMEM_SYSV_URL
	default "https://gitee.com/BiscuitOS_team/HardStack/raw/Gitee/Memory-Allocator/PAGING-MECH/BiscuitOS-PAGING-PF-SHMEM-SYSV"
	string "url"

config PK_PAGING_PF_SHMEM_SYSV_GITHUB
	string "GitHub"

config PK_PAGING_PF_SHMEM_SYSV_SRCFILE
	default "main.c Makefile RunBiscuitOS.sh"
	string "Source code list"

config PK_PAGING_PF_SHMEM_SYSV_CSRCFILE
	string "Compile source code list"

config PK_PAGING_PF_SHMEM_SYSV_CONFIG
	string "CONFIG: Project Configure Options"

config PK_PAGING_PF_SHMEM_SYSV_LIBPATH
	string "LIBS: Libraries to pass to the linker, e.g. -l<library>"

config PK_PAGING_PF_SHMEM_SYSV_CPPFLAGS
	string "CPPFLAGS: C/C++ preprocessor flags, e.g. -I<include dir>"

config PK_PAGING_PF_SHMEM_SYSV_DPKCONFIG
	string "PKG_CONFIG_PATH: Directories to add to pkg-config's search path"

config PK_PAGING_PF_SHMEM_SYSV_CFLAGS
	string "CFLAGS: C compiler flags"

config PK_PAGING_PF_SHMEM_SYSV_LDFLAGS
	string "LDFLAGS: Linker flags"

config PK_PAGING_PF_SHMEM_SYSV_CXXFLAGS
	string "CXXFLAGS: C++ compiler flags"

config PK_PAGING_PF_SHMEM_SYSV_ASFLAGS
	string "CCASFLAGS: assembler compiler flags (defaults to CFLAGS)"

config PK_PAGING_PF_SHMEM_SYSV_BUILDARCH
	string "--host options on configure for Architecture"

endif # PK_PAGING_PF_SHMEM_SYSV
```

## package/PAGING/BiscuitOS-PAGING-PF-SHMEM-USOCK/Kconfig
```kconfig
menuconfig PK_PAGING_PF_SHMEM_USOCK
	bool "Page Fault with SHMEM Memory on UNIX-SOCK"

if PK_PAGING_PF_SHMEM_USOCK

config PK_PAGING_PF_SHMEM_USOCK_VERSION
	default "default"
	string "verstion"

config PK_PAGING_PF_SHMEM_USOCK_TAR
	default "tar.gz"
	string "tar type"

config PK_PAGING_PF_SHMEM_USOCK_URL
	default "https://gitee.com/BiscuitOS_team/HardStack/raw/Gitee/Memory-Allocator/PAGING-MECH/BiscuitOS-PAGING-PF-SHMEM-USOCK"
	string "url"

config PK_PAGING_PF_SHMEM_USOCK_GITHUB
	string "GitHub"

config PK_PAGING_PF_SHMEM_USOCK_SRCFILE
	default "main.c Makefile RunBiscuitOS.sh"
	string "Source code list"

config PK_PAGING_PF_SHMEM_USOCK_CSRCFILE
	string "Compile source code list"

config PK_PAGING_PF_SHMEM_USOCK_CONFIG
	string "CONFIG: Project Configure Options"

config PK_PAGING_PF_SHMEM_USOCK_LIBPATH
	string "LIBS: Libraries to pass to the linker, e.g. -l<library>"

config PK_PAGING_PF_SHMEM_USOCK_CPPFLAGS
	string "CPPFLAGS: C/C++ preprocessor flags, e.g. -I<include dir>"

config PK_PAGING_PF_SHMEM_USOCK_DPKCONFIG
	string "PKG_CONFIG_PATH: Directories to add to pkg-config's search path"

config PK_PAGING_PF_SHMEM_USOCK_CFLAGS
	string "CFLAGS: C compiler flags"

config PK_PAGING_PF_SHMEM_USOCK_LDFLAGS
	string "LDFLAGS: Linker flags"

config PK_PAGING_PF_SHMEM_USOCK_CXXFLAGS
	string "CXXFLAGS: C++ compiler flags"

config PK_PAGING_PF_SHMEM_USOCK_ASFLAGS
	string "CCASFLAGS: assembler compiler flags (defaults to CFLAGS)"

config PK_PAGING_PF_SHMEM_USOCK_BUILDARCH
	string "--host options on configure for Architecture"

endif # PK_PAGING_PF_SHMEM_USOCK
```

## package/PAGING/BiscuitOS-PAGING-PF-SIGBUS/Kconfig
```kconfig
menuconfig PK_PAGING_PF_SIGBUS
	bool "Page Fault with SIGBUS"

if PK_PAGING_PF_SIGBUS

config PK_PAGING_PF_SIGBUS_VERSION
	default "default"
	string "verstion"

config PK_PAGING_PF_SIGBUS_TAR
	default "tar.gz"
	string "tar type"

config PK_PAGING_PF_SIGBUS_URL
	default "https://gitee.com/BiscuitOS_team/HardStack/raw/Gitee/Memory-Allocator/PAGING-MECH/BiscuitOS-PAGING-PF-SIGBUS"
	string "url"

config PK_PAGING_PF_SIGBUS_GITHUB
	string "GitHub"

config PK_PAGING_PF_SIGBUS_SRCFILE
	default "main.c Makefile RunBiscuitOS.sh"
	string "Source code list"

config PK_PAGING_PF_SIGBUS_CSRCFILE
	string "Compile source code list"

config PK_PAGING_PF_SIGBUS_CONFIG
	string "CONFIG: Project Configure Options"

config PK_PAGING_PF_SIGBUS_LIBPATH
	string "LIBS: Libraries to pass to the linker, e.g. -l<library>"

config PK_PAGING_PF_SIGBUS_CPPFLAGS
	string "CPPFLAGS: C/C++ preprocessor flags, e.g. -I<include dir>"

config PK_PAGING_PF_SIGBUS_DPKCONFIG
	string "PKG_CONFIG_PATH: Directories to add to pkg-config's search path"

config PK_PAGING_PF_SIGBUS_CFLAGS
	string "CFLAGS: C compiler flags"

config PK_PAGING_PF_SIGBUS_LDFLAGS
	string "LDFLAGS: Linker flags"

config PK_PAGING_PF_SIGBUS_CXXFLAGS
	string "CXXFLAGS: C++ compiler flags"

config PK_PAGING_PF_SIGBUS_ASFLAGS
	string "CCASFLAGS: assembler compiler flags (defaults to CFLAGS)"

config PK_PAGING_PF_SIGBUS_BUILDARCH
	string "--host options on configure for Architecture"

endif # PK_PAGING_PF_SIGBUS
```

## package/PAGING/BiscuitOS-PAGING-PF-SIGEGV/Kconfig
```kconfig
menuconfig PK_PAGING_PF_SIGEGV
	bool "Page Fault with SIGEGV(SegmentFault)"

if PK_PAGING_PF_SIGEGV

config PK_PAGING_PF_SIGEGV_VERSION
	default "default"
	string "verstion"

config PK_PAGING_PF_SIGEGV_TAR
	default "tar.gz"
	string "tar type"

config PK_PAGING_PF_SIGEGV_URL
	default "https://gitee.com/BiscuitOS_team/HardStack/raw/Gitee/Memory-Allocator/PAGING-MECH/BiscuitOS-PAGING-PF-SIGEGV"
	string "url"

config PK_PAGING_PF_SIGEGV_GITHUB
	string "GitHub"

config PK_PAGING_PF_SIGEGV_SRCFILE
	default "main.c Makefile RunBiscuitOS.sh"
	string "Source code list"

config PK_PAGING_PF_SIGEGV_CSRCFILE
	string "Compile source code list"

config PK_PAGING_PF_SIGEGV_CONFIG
	string "CONFIG: Project Configure Options"

config PK_PAGING_PF_SIGEGV_LIBPATH
	string "LIBS: Libraries to pass to the linker, e.g. -l<library>"

config PK_PAGING_PF_SIGEGV_CPPFLAGS
	string "CPPFLAGS: C/C++ preprocessor flags, e.g. -I<include dir>"

config PK_PAGING_PF_SIGEGV_DPKCONFIG
	string "PKG_CONFIG_PATH: Directories to add to pkg-config's search path"

config PK_PAGING_PF_SIGEGV_CFLAGS
	string "CFLAGS: C compiler flags"

config PK_PAGING_PF_SIGEGV_LDFLAGS
	string "LDFLAGS: Linker flags"

config PK_PAGING_PF_SIGEGV_CXXFLAGS
	string "CXXFLAGS: C++ compiler flags"

config PK_PAGING_PF_SIGEGV_ASFLAGS
	string "CCASFLAGS: assembler compiler flags (defaults to CFLAGS)"

config PK_PAGING_PF_SIGEGV_BUILDARCH
	string "--host options on configure for Architecture"

endif # PK_PAGING_PF_SIGEGV
```

## package/PAGING/BiscuitOS-PAGING-PF-THP-ANON-WP/Kconfig
```kconfig
menuconfig PK_PAGING_PF_THP_ANON_WP
	bool "Page Fault with THP - Anonymous WP Pages"

if PK_PAGING_PF_THP_ANON_WP

config PK_PAGING_PF_THP_ANON_WP_VERSION
	default "default"
	string "verstion"

config PK_PAGING_PF_THP_ANON_WP_TAR
	default "tar.gz"
	string "tar type"

config PK_PAGING_PF_THP_ANON_WP_URL
	default "https://gitee.com/BiscuitOS_team/HardStack/raw/Gitee/Memory-Allocator/PAGING-MECH/BiscuitOS-PAGING-PF-THP-ANON-WP"
	string "url"

config PK_PAGING_PF_THP_ANON_WP_GITHUB
	string "GitHub"

config PK_PAGING_PF_THP_ANON_WP_SRCFILE
	default "main.c Makefile RunBiscuitOS.sh"
	string "Source code list"

config PK_PAGING_PF_THP_ANON_WP_CSRCFILE
	string "Compile source code list"

config PK_PAGING_PF_THP_ANON_WP_CONFIG
	string "CONFIG: Project Configure Options"

config PK_PAGING_PF_THP_ANON_WP_LIBPATH
	string "LIBS: Libraries to pass to the linker, e.g. -l<library>"

config PK_PAGING_PF_THP_ANON_WP_CPPFLAGS
	string "CPPFLAGS: C/C++ preprocessor flags, e.g. -I<include dir>"

config PK_PAGING_PF_THP_ANON_WP_DPKCONFIG
	string "PKG_CONFIG_PATH: Directories to add to pkg-config's search path"

config PK_PAGING_PF_THP_ANON_WP_CFLAGS
	string "CFLAGS: C compiler flags"

config PK_PAGING_PF_THP_ANON_WP_LDFLAGS
	string "LDFLAGS: Linker flags"

config PK_PAGING_PF_THP_ANON_WP_CXXFLAGS
	string "CXXFLAGS: C++ compiler flags"

config PK_PAGING_PF_THP_ANON_WP_ASFLAGS
	string "CCASFLAGS: assembler compiler flags (defaults to CFLAGS)"

config PK_PAGING_PF_THP_ANON_WP_BUILDARCH
	string "--host options on configure for Architecture"

endif # PK_PAGING_PF_THP_ANON_WP
```

## package/PAGING/BiscuitOS-PAGING-PF-THP-ANON-ZSWAP/Kconfig
```kconfig
menuconfig PK_PAGING_PF_THP_ANON_ZSWAP
	bool "Page Fault with THP - Anonymous ZSWAP Pages"

if PK_PAGING_PF_THP_ANON_ZSWAP

config PK_PAGING_PF_THP_ANON_ZSWAP_VERSION
	default "default"
	string "verstion"

config PK_PAGING_PF_THP_ANON_ZSWAP_TAR
	default "tar.gz"
	string "tar type"

config PK_PAGING_PF_THP_ANON_ZSWAP_URL
	default "https://gitee.com/BiscuitOS_team/HardStack/raw/Gitee/Memory-Allocator/PAGING-MECH/BiscuitOS-PAGING-PF-THP-ANON-ZSWAP"
	string "url"

config PK_PAGING_PF_THP_ANON_ZSWAP_GITHUB
	string "GitHub"

config PK_PAGING_PF_THP_ANON_ZSWAP_SRCFILE
	default "main.c Makefile RunBiscuitOS.sh"
	string "Source code list"

config PK_PAGING_PF_THP_ANON_ZSWAP_CSRCFILE
	string "Compile source code list"

config PK_PAGING_PF_THP_ANON_ZSWAP_CONFIG
	string "CONFIG: Project Configure Options"

config PK_PAGING_PF_THP_ANON_ZSWAP_LIBPATH
	string "LIBS: Libraries to pass to the linker, e.g. -l<library>"

config PK_PAGING_PF_THP_ANON_ZSWAP_CPPFLAGS
	string "CPPFLAGS: C/C++ preprocessor flags, e.g. -I<include dir>"

config PK_PAGING_PF_THP_ANON_ZSWAP_DPKCONFIG
	string "PKG_CONFIG_PATH: Directories to add to pkg-config's search path"

config PK_PAGING_PF_THP_ANON_ZSWAP_CFLAGS
	string "CFLAGS: C compiler flags"

config PK_PAGING_PF_THP_ANON_ZSWAP_LDFLAGS
	string "LDFLAGS: Linker flags"

config PK_PAGING_PF_THP_ANON_ZSWAP_CXXFLAGS
	string "CXXFLAGS: C++ compiler flags"

config PK_PAGING_PF_THP_ANON_ZSWAP_ASFLAGS
	string "CCASFLAGS: assembler compiler flags (defaults to CFLAGS)"

config PK_PAGING_PF_THP_ANON_ZSWAP_BUILDARCH
	string "--host options on configure for Architecture"

endif # PK_PAGING_PF_THP_ANON_ZSWAP
```

## package/PAGING/BiscuitOS-PAGING-PF-THP-ANON/Kconfig
```kconfig
menuconfig PK_PAGING_PF_THP_ANON
	bool "Page Fault with THP - Anonymous HugePages"

if PK_PAGING_PF_THP_ANON

config PK_PAGING_PF_THP_ANON_VERSION
	default "default"
	string "verstion"

config PK_PAGING_PF_THP_ANON_TAR
	default "tar.gz"
	string "tar type"

config PK_PAGING_PF_THP_ANON_URL
	default "https://gitee.com/BiscuitOS_team/HardStack/raw/Gitee/Memory-Allocator/PAGING-MECH/BiscuitOS-PAGING-PF-THP-ANON"
	string "url"

config PK_PAGING_PF_THP_ANON_GITHUB
	string "GitHub"

config PK_PAGING_PF_THP_ANON_SRCFILE
	default "main.c Makefile RunBiscuitOS.sh"
	string "Source code list"

config PK_PAGING_PF_THP_ANON_CSRCFILE
	string "Compile source code list"

config PK_PAGING_PF_THP_ANON_CONFIG
	string "CONFIG: Project Configure Options"

config PK_PAGING_PF_THP_ANON_LIBPATH
	string "LIBS: Libraries to pass to the linker, e.g. -l<library>"

config PK_PAGING_PF_THP_ANON_CPPFLAGS
	string "CPPFLAGS: C/C++ preprocessor flags, e.g. -I<include dir>"

config PK_PAGING_PF_THP_ANON_DPKCONFIG
	string "PKG_CONFIG_PATH: Directories to add to pkg-config's search path"

config PK_PAGING_PF_THP_ANON_CFLAGS
	string "CFLAGS: C compiler flags"

config PK_PAGING_PF_THP_ANON_LDFLAGS
	string "LDFLAGS: Linker flags"

config PK_PAGING_PF_THP_ANON_CXXFLAGS
	string "CXXFLAGS: C++ compiler flags"

config PK_PAGING_PF_THP_ANON_ASFLAGS
	string "CCASFLAGS: assembler compiler flags (defaults to CFLAGS)"

config PK_PAGING_PF_THP_ANON_BUILDARCH
	string "--host options on configure for Architecture"

endif # PK_PAGING_PF_THP_ANON
```
