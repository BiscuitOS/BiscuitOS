## package/kvm/BiscuitOS-seaBIOS-host/Kconfig
```kconfig
menuconfig PK_BISCUITOS_SEABIOS_HOST
	bool "Host seaBIOS for BiscuitOS"

if PK_BISCUITOS_SEABIOS_HOST

config PK_BISCUITOS_SEABIOS_HOST_VERSION
	default "default"
	string "verstion"

config PK_BISCUITOS_SEABIOS_HOST_TAR
	default "tar.xz"
	string "tar type"

config PK_BISCUITOS_SEABIOS_HOST_URL
	default "https://download.qemu.org/"
	string "url"

config PK_BISCUITOS_SEABIOS_HOST_GITHUB
	string "GitHub"

config PK_BISCUITOS_SEABIOS_HOST_SRCFILE
	string "Source code list"

config PK_BISCUITOS_SEABIOS_HOST_CONFIG
	default "none"
	string "CONFIG: Project Configure Options"

config PK_BISCUITOS_SEABIOS_HOST_LIBPATH
	string "LIBS: Libraries to pass to the linker, e.g. -l<library>"

config PK_BISCUITOS_SEABIOS_HOST_CPPFLAGS
	string "CPPFLAGS: C/C++ preprocessor flags, e.g. -I<include dir>"

config PK_BISCUITOS_SEABIOS_HOST_DPKCONFIG
	string "PKG_CONFIG_PATH: Directories to add to pkg-config's search path"

config PK_BISCUITOS_SEABIOS_HOST_CFLAGS
	string "CFLAGS: C compiler flags"

config PK_BISCUITOS_SEABIOS_HOST_LDFLAGS
	string "LDFLAGS: Linker flags"

config PK_BISCUITOS_SEABIOS_HOST_CXXFLAGS
	string "CXXFLAGS: C++ compiler flags"

config PK_BISCUITOS_SEABIOS_HOST_ASFLAGS
	string "CCASFLAGS: assembler compiler flags (defaults to CFLAGS)"

config PK_BISCUITOS_SEABIOS_HOST_BUILDARCH
	default "x86_64-unknown-linux-gnu"
	string "--host options on configure for Architecture"

endif # PK_BISCUITOS_SEABIOS_HOST
```

## package/kvm/Broiler-vIOAPIC-interrupt/Kconfig
```kconfig
menuconfig PK_VINTR_VIOAPIC
	bool "vInterrupt: Broiler vIOAPIC interrupt"

if PK_VINTR_VIOAPIC

config PK_VINTR_VIOAPIC_VERSION
	default "default"
	string "verstion"

config PK_VINTR_VIOAPIC_TAR
	default "tar.gz"
	string "tar type"

config PK_VINTR_VIOAPIC_URL
	default "https://gitee.com/BiscuitOS_team/HardStack/raw/Gitee/Virtualization/vInterrupt/Broiler-vIOAPIC-interrupt"
	string "url"

config PK_VINTR_VIOAPIC_GITHUB
	string "GitHub"

config PK_VINTR_VIOAPIC_SRCFILE
	default "main.c Kconfig Makefile README.md RunBiscuitOS.sh Makefile.host"
	string "Source code list"

config PK_VINTR_VIOAPIC_CSRCFILE
	string "Compile source code list"

config PK_VINTR_VIOAPIC_CONFIG
	string "CONFIG: Project Configure Options"

config PK_VINTR_VIOAPIC_LIBPATH
	string "LIBS: Libraries to pass to the linker, e.g. -l<library>"

config PK_VINTR_VIOAPIC_CPPFLAGS
	string "CPPFLAGS: C/C++ preprocessor flags, e.g. -I<include dir>"

config PK_VINTR_VIOAPIC_DPKCONFIG
	string "PKG_CONFIG_PATH: Directories to add to pkg-config's search path"

config PK_VINTR_VIOAPIC_CFLAGS
	string "CFLAGS: C compiler flags"

config PK_VINTR_VIOAPIC_LDFLAGS
	string "LDFLAGS: Linker flags"

config PK_VINTR_VIOAPIC_CXXFLAGS
	string "CXXFLAGS: C++ compiler flags"

config PK_VINTR_VIOAPIC_ASFLAGS
	string "CCASFLAGS: assembler compiler flags (defaults to CFLAGS)"

config PK_VINTR_VIOAPIC_BUILDARCH
	string "--host options on configure for Architecture"

endif # PK_VINTR_VIOAPIC
```

## package/kvm/Broiler-vPIC-interrupt/Kconfig
```kconfig
menuconfig PK_VINTR_VPIC
	bool "vInterrupt: Broiler vPIC interrupt"

if PK_VINTR_VPIC

config PK_VINTR_VPIC_VERSION
	default "default"
	string "verstion"

config PK_VINTR_VPIC_TAR
	default "tar.gz"
	string "tar type"

config PK_VINTR_VPIC_URL
	default "https://gitee.com/BiscuitOS_team/HardStack/raw/Gitee/Virtualization/vInterrupt/Broiler-vPIC-interrupt"
	string "url"

config PK_VINTR_VPIC_GITHUB
	string "GitHub"

config PK_VINTR_VPIC_SRCFILE
	default "main.c Kconfig Makefile README.md RunBiscuitOS.sh Makefile.host"
	string "Source code list"

config PK_VINTR_VPIC_CSRCFILE
	string "Compile source code list"

config PK_VINTR_VPIC_CONFIG
	string "CONFIG: Project Configure Options"

config PK_VINTR_VPIC_LIBPATH
	string "LIBS: Libraries to pass to the linker, e.g. -l<library>"

config PK_VINTR_VPIC_CPPFLAGS
	string "CPPFLAGS: C/C++ preprocessor flags, e.g. -I<include dir>"

config PK_VINTR_VPIC_DPKCONFIG
	string "PKG_CONFIG_PATH: Directories to add to pkg-config's search path"

config PK_VINTR_VPIC_CFLAGS
	string "CFLAGS: C compiler flags"

config PK_VINTR_VPIC_LDFLAGS
	string "LDFLAGS: Linker flags"

config PK_VINTR_VPIC_CXXFLAGS
	string "CXXFLAGS: C++ compiler flags"

config PK_VINTR_VPIC_ASFLAGS
	string "CCASFLAGS: assembler compiler flags (defaults to CFLAGS)"

config PK_VINTR_VPIC_BUILDARCH
	string "--host options on configure for Architecture"

endif # PK_VINTR_VPIC
```

## package/kvm/CPUID-Tools/Kconfig
```kconfig
menuconfig PK_CPUID_TOOLS
	bool "CPUID tools"

if PK_CPUID_TOOLS

config PK_CPUID_TOOLS_VERSION
	default "default"
	string "verstion"

config PK_CPUID_TOOLS_TAR
	default "tar.gz"
	string "tar type"

config PK_CPUID_TOOLS_URL
	default "https://gitee.com/BiscuitOS_team/HardStack/raw/Gitee/Virtualization/tools/cpuid"
	string "url"

config PK_CPUID_TOOLS_GITHUB
	string "GitHub"

config PK_CPUID_TOOLS_SRCFILE
	default "main.c Makefile"
	string "Source code list"

config PK_CPUID_TOOLS_CSRCFILE
	string "Compile source code list"

config PK_CPUID_TOOLS_CONFIG
	string "CONFIG: Project Configure Options"

config PK_CPUID_TOOLS_LIBPATH
	string "LIBS: Libraries to pass to the linker, e.g. -l<library>"

config PK_CPUID_TOOLS_CPPFLAGS
	string "CPPFLAGS: C/C++ preprocessor flags, e.g. -I<include dir>"

config PK_CPUID_TOOLS_DPKCONFIG
	string "PKG_CONFIG_PATH: Directories to add to pkg-config's search path"

config PK_CPUID_TOOLS_CFLAGS
	string "CFLAGS: C compiler flags"

config PK_CPUID_TOOLS_LDFLAGS
	string "LDFLAGS: Linker flags"

config PK_CPUID_TOOLS_CXXFLAGS
	string "CXXFLAGS: C++ compiler flags"

config PK_CPUID_TOOLS_ASFLAGS
	string "CCASFLAGS: assembler compiler flags (defaults to CFLAGS)"

config PK_CPUID_TOOLS_BUILDARCH
	string "--host options on configure for Architecture"

endif # PK_CPUID_TOOLS
```

## package/kvm/Kconfig
```kconfig
menuconfig PK_KVM
	bool "KVM"

if PK_KVM

# kvm_module
source package/kvm/kvm_module/Kconfig

# kvm_userspace
source package/kvm/kvm_userspace/Kconfig

# kvm_hisotry
source package/kvm/kvm_history/Kconfig

# BiscuitOS KVM Application (4KiB)
source package/kvm/BiscuitOS-UKVM/Kconfig

# BiscuitOS KVM Application (2MiB)
source package/kvm/BiscuitOS-UKVM-2M/Kconfig

# BiscuitOS KVM Application (1Gig)
source package/kvm/BiscuitOS-UKVM-1G/Kconfig

# BiscuitOS KVM Application (SMP/Kernel+)
source package/kvm/BiscuitOS-UKVM-SMAP-kernel/Kconfig

# BiscuitOS KVM Application (SMP/Userspace+)
source package/kvm/BiscuitOS-UKVM-SMAP-userspace/Kconfig

# BiscuitOS qemu-kvm
source package/kvm/BiscuitOS-qemu-kvm/Kconfig

# BiscuitOS qemu-kvm 2M HugePage
source package/kvm/BiscuitOS-qemu-kvm-2M/Kconfig

# BiscuitOS qemu-kvm 1G HugePage
source package/kvm/BiscuitOS-qemu-kvm-1G/Kconfig

# BiscuitOS QEMU PCI Device Driver
source package/kvm/BiscuitOS-QEMU-PCI-module/Kconfig

# BiscuitOS QEMU PCI Application
source package/kvm/BiscuitOS-QEMU-PCI-Application/Kconfig

# Native Linux KVM tool
source package/kvm/BiscuitOS-kvmtools/Kconfig

# Native Linux KVM tool 2M
source package/kvm/BiscuitOS-kvmtools-2M/Kconfig

# Native Linux KVM tool 1G
source package/kvm/BiscuitOS-kvmtools-1G/Kconfig

endif # PK_KVM
```

## package/kvm/MSR-Tools/Kconfig
```kconfig
menuconfig PK_MSR_TOOLS
	bool "MSR tools (rdmsr and wrmsr)"

if PK_MSR_TOOLS

config PK_MSR_TOOLS_VERSION
	default "default"
	string "verstion"

config PK_MSR_TOOLS_TAR
	default "tar.gz"
	string "tar type"

config PK_MSR_TOOLS_URL
	default "https://gitee.com/BiscuitOS_team/HardStack/raw/Gitee/Virtualization/tools/msr"
	string "url"

config PK_MSR_TOOLS_GITHUB
	string "GitHub"

config PK_MSR_TOOLS_SRCFILE
	default "rdmsr.c wrmsr.c Makefile"
	string "Source code list"

config PK_MSR_TOOLS_CSRCFILE
	string "Compile source code list"

config PK_MSR_TOOLS_CONFIG
	string "CONFIG: Project Configure Options"

config PK_MSR_TOOLS_LIBPATH
	string "LIBS: Libraries to pass to the linker, e.g. -l<library>"

config PK_MSR_TOOLS_CPPFLAGS
	string "CPPFLAGS: C/C++ preprocessor flags, e.g. -I<include dir>"

config PK_MSR_TOOLS_DPKCONFIG
	string "PKG_CONFIG_PATH: Directories to add to pkg-config's search path"

config PK_MSR_TOOLS_CFLAGS
	string "CFLAGS: C compiler flags"

config PK_MSR_TOOLS_LDFLAGS
	string "LDFLAGS: Linker flags"

config PK_MSR_TOOLS_CXXFLAGS
	string "CXXFLAGS: C++ compiler flags"

config PK_MSR_TOOLS_ASFLAGS
	string "CCASFLAGS: assembler compiler flags (defaults to CFLAGS)"

config PK_MSR_TOOLS_BUILDARCH
	string "--host options on configure for Architecture"

endif # PK_MSR_TOOLS
```

## package/kvm/kvm_history/Kconfig
```kconfig
menuconfig PK_KVM_HISTORY
	bool "KVM Development History"

if PK_KVM_HISTORY

# linux-2.6.20 
source "package/kvm/kvm_history/linux-2.6.20/Kconfig"

# Userspace linux-2.6.20 
source "package/kvm/kvm_history/userspace-2.6.20/Kconfig"

# linux-2.6.32 
source "package/kvm/kvm_history/linux-2.6.32/Kconfig"

# Userspace linux-2.6.32 
source "package/kvm/kvm_history/userspace-2.6.32/Kconfig"

endif # PK_KVM_HISTORY
```

## package/kvm/kvm_history/linux-2.6.20/Kconfig
```kconfig
menuconfig PK_KVM_2_6_20
	bool "KVM on linux 2.6.20"

if PK_KVM_2_6_20

config PK_KVM_2_6_20_VERSION
	default "2.6.20"
	string "verstion"

config PK_KVM_2_6_20_TAR
	default "tar.gz"
	string "tar type"

config PK_KVM_2_6_20_URL
	default "https://gitee.com/BiscuitOS_team/HardStack/raw/Gitee/Memory-Allocator/History/mm/mm_bs"
	string "url"

config PK_KVM_2_6_20_GITHUB
	string "GitHub"
	default "https://gitee.com/BiscuitOS_team/BiscuitOS_KVM.git"

config PK_KVM_2_6_20_SRCFILE
	default "README.md"
	string "Source code list"

config PK_KVM_2_6_20_CSRCFILE
	string "Compile source code list"

config PK_KVM_2_6_20_CONFIG
	string "CONFIG: Project Configure Options"

config PK_KVM_2_6_20_LIBPATH
	string "LIBS: Libraries to pass to the linker, e.g. -l<library>"

config PK_KVM_2_6_20_CPPFLAGS
	string "CPPFLAGS: C/C++ preprocessor flags, e.g. -I<include dir>"

config PK_KVM_2_6_20_DPKCONFIG
	string "PKG_CONFIG_PATH: Directories to add to pkg-config's search path"

config PK_KVM_2_6_20_CFLAGS
	string "CFLAGS: C compiler flags"

config PK_KVM_2_6_20_LDFLAGS
	string "LDFLAGS: Linker flags"

config PK_KVM_2_6_20_CXXFLAGS
	string "CXXFLAGS: C++ compiler flags"

config PK_KVM_2_6_20_ASFLAGS
	string "CCASFLAGS: assembler compiler flags (defaults to CFLAGS)"

config PK_KVM_2_6_20_BUILDARCH
	string "--host options on configure for Architecture"

endif # PK_KVM_2_6_20
```

## package/kvm/kvm_history/linux-2.6.32/Kconfig
```kconfig
menuconfig PK_KVM_2_6_32
	bool "KVM on linux 2.6.32"

if PK_KVM_2_6_32

config PK_KVM_2_6_32_VERSION
	default "2.6.32"
	string "verstion"

config PK_KVM_2_6_32_TAR
	default "tar.gz"
	string "tar type"

config PK_KVM_2_6_32_URL
	default "https://gitee.com/BiscuitOS_team/HardStack/raw/Gitee/Memory-Allocator/History/mm/mm_bs"
	string "url"

config PK_KVM_2_6_32_GITHUB
	string "GitHub"
	default "https://gitee.com/BiscuitOS_team/BiscuitOS_KVM.git"

config PK_KVM_2_6_32_SRCFILE
	default "README.md"
	string "Source code list"

config PK_KVM_2_6_32_CSRCFILE
	string "Compile source code list"

config PK_KVM_2_6_32_CONFIG
	string "CONFIG: Project Configure Options"

config PK_KVM_2_6_32_LIBPATH
	string "LIBS: Libraries to pass to the linker, e.g. -l<library>"

config PK_KVM_2_6_32_CPPFLAGS
	string "CPPFLAGS: C/C++ preprocessor flags, e.g. -I<include dir>"

config PK_KVM_2_6_32_DPKCONFIG
	string "PKG_CONFIG_PATH: Directories to add to pkg-config's search path"

config PK_KVM_2_6_32_CFLAGS
	string "CFLAGS: C compiler flags"

config PK_KVM_2_6_32_LDFLAGS
	string "LDFLAGS: Linker flags"

config PK_KVM_2_6_32_CXXFLAGS
	string "CXXFLAGS: C++ compiler flags"

config PK_KVM_2_6_32_ASFLAGS
	string "CCASFLAGS: assembler compiler flags (defaults to CFLAGS)"

config PK_KVM_2_6_32_BUILDARCH
	string "--host options on configure for Architecture"

endif # PK_KVM_2_6_32
```

## package/kvm/kvm_module/Kconfig
```kconfig
menuconfig PK_KVM_MODULE
	bool "KVM on Module"

if PK_KVM_MODULE

config PK_KVM_MODULE_VERSION
	default "0.0.1"
	string "verstion"

config PK_KVM_MODULE_TAR
	default "tar.gz"
	string "tar type"

config PK_KVM_MODULE_URL
	default "https://gitee.com/BiscuitOS_team/HardStack/raw/Gitee/Virtualization/KVM/kvm_module"
	string "url"

config PK_KVM_MODULE_GITHUB
	string "GitHub"

config PK_KVM_MODULE_SRCFILE
	default "Kconfig Makefile README.md RunBiscuitOS_kvm.sh kvm/cpuid.c kvm/hyperv.c kvm/lapic.c kvm/mmu.c kvm/page_track.c kvm/x86.c virt/coalesced_mmio.c virt/eventfd.c virt/kvm_main.c virt/vfio.c vmx/evmcs.c vmx/nested.c vmx/vmx.c include/kvm/async_pf.h include/kvm/capabilities.h include/kvm/evmcs.h include/kvm/internal.h include/kvm/mmu.h include/kvm/ops.h include/kvm/virtext.h include/kvm/vmcs12.h include/kvm/vmcs.h include/kvm/vmcs_shadow_fields.h include/kvm/vmx.h include/kvm/x86.h"
	string "Source code list"

config PK_KVM_MODULE_CSRCFILE
	string "Compile source code list"

config PK_KVM_MODULE_CONFIG
	string "CONFIG: Project Configure Options"

config PK_KVM_MODULE_LIBPATH
	string "LIBS: Libraries to pass to the linker, e.g. -l<library>"

config PK_KVM_MODULE_CPPFLAGS
	string "CPPFLAGS: C/C++ preprocessor flags, e.g. -I<include dir>"

config PK_KVM_MODULE_DPKCONFIG
	string "PKG_CONFIG_PATH: Directories to add to pkg-config's search path"

config PK_KVM_MODULE_CFLAGS
	string "CFLAGS: C compiler flags"

config PK_KVM_MODULE_LDFLAGS
	string "LDFLAGS: Linker flags"

config PK_KVM_MODULE_CXXFLAGS
	string "CXXFLAGS: C++ compiler flags"

config PK_KVM_MODULE_ASFLAGS
	string "CCASFLAGS: assembler compiler flags (defaults to CFLAGS)"

config PK_KVM_MODULE_BUILDARCH
	string "--host options on configure for Architecture"

endif # PK_KVM_MODULE
```

## package/kvm/kvm_userspace/Kconfig
```kconfig
menuconfig PK_KVM_USERSPACE
	bool "KVM on Userspace"
	select PK_KVM_MODULE

if PK_KVM_USERSPACE

config PK_KVM_USERSPACE_VERSION
	default "0.0.1"
	string "verstion"

config PK_KVM_USERSPACE_TAR
	default "tar.gz"
	string "tar type"

config PK_KVM_USERSPACE_URL
	default "https://gitee.com/BiscuitOS_team/HardStack/raw/Gitee/Virtualization/KVM/kvm_userspace"
	string "url"

config PK_KVM_USERSPACE_GITHUB
	string "GitHub"

config PK_KVM_USERSPACE_SRCFILE
	default "README.md Makefile main.c"
	string "Source code list"

config PK_KVM_USERSPACE_CSRCFILE
	string "Compile source code list"

config PK_KVM_USERSPACE_CONFIG
	string "CONFIG: Project Configure Options"

config PK_KVM_USERSPACE_LIBPATH
	string "LIBS: Libraries to pass to the linker, e.g. -l<library>"

config PK_KVM_USERSPACE_CPPFLAGS
	string "CPPFLAGS: C/C++ preprocessor flags, e.g. -I<include dir>"

config PK_KVM_USERSPACE_DPKCONFIG
	string "PKG_CONFIG_PATH: Directories to add to pkg-config's search path"

config PK_KVM_USERSPACE_CFLAGS
	string "CFLAGS: C compiler flags"

config PK_KVM_USERSPACE_LDFLAGS
	string "LDFLAGS: Linker flags"

config PK_KVM_USERSPACE_CXXFLAGS
	string "CXXFLAGS: C++ compiler flags"

config PK_KVM_USERSPACE_ASFLAGS
	string "CCASFLAGS: assembler compiler flags (defaults to CFLAGS)"

config PK_KVM_USERSPACE_BUILDARCH
	string "--host options on configure for Architecture"

endif # PK_KVM_USERSPACE
```

## package/language/C/Kconfig
```kconfig
menuconfig PK_LANGUAGE_C
	bool "C language: GNU C/C99/C89"

if PK_LANGUAGE_C

# C on BiscuitOS
source "package/language/C/BiscuitOS-C/Kconfig"

endif # PK_LANGUAGE_C
```
