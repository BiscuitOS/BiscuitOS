## package/language/CPP/BiscuitOS-CPP/Kconfig
```kconfig
menuconfig PK_CPP_BISCUITOS
	bool "C++/CPP language on BiscuitOS"

if PK_CPP_BISCUITOS

config PK_CPP_BISCUITOS_VERSION
	default "default"
	string "verstion"

config PK_CPP_BISCUITOS_TAR
	default "tar.gz"
	string "tar type"

config PK_CPP_BISCUITOS_URL
	default "https://gitee.com/BiscuitOS_team/HardStack/raw/Gitee/Language/CPP/BiscuitOS-CPP"
	string "url"

config PK_CPP_BISCUITOS_GITHUB
	string "GitHub"

config PK_CPP_BISCUITOS_SRCFILE
	default "main.c Makefile"
	string "Source code list"

config PK_CPP_BISCUITOS_CSRCFILE
	string "Compile source code list"

config PK_CPP_BISCUITOS_CONFIG
	string "CONFIG: Project Configure Options"

config PK_CPP_BISCUITOS_LIBPATH
	string "LIBS: Libraries to pass to the linker, e.g. -l<library>"

config PK_CPP_BISCUITOS_CPPFLAGS
	string "CPPFLAGS: C/C++ preprocessor flags, e.g. -I<include dir>"

config PK_CPP_BISCUITOS_DPKCONFIG
	string "PKG_CONFIG_PATH: Directories to add to pkg-config's search path"

config PK_CPP_BISCUITOS_CFLAGS
	string "CFLAGS: C compiler flags"

config PK_CPP_BISCUITOS_LDFLAGS
	string "LDFLAGS: Linker flags"

config PK_CPP_BISCUITOS_CXXFLAGS
	string "CXXFLAGS: C++ compiler flags"

config PK_CPP_BISCUITOS_ASFLAGS
	string "CCASFLAGS: assembler compiler flags (defaults to CFLAGS)"

config PK_CPP_BISCUITOS_BUILDARCH
	string "--host options on configure for Architecture"

endif # PK_CPP_BISCUITOS
```

## package/language/CPP/Kconfig
```kconfig
menuconfig PK_LANGUAGE_CPP
	bool "C++ language: GNU C++/cpp"

if PK_LANGUAGE_CPP

# CPP on BiscuitOS
source "package/language/CPP/BiscuitOS-CPP/Kconfig"

endif # PK_LANGUAGE_CPP
```

## package/language/Kconfig
```kconfig
menuconfig PK_LANGUAGE
	bool "Language: C/C++/Phython/Assembly etc"

if PK_LANGUAGE

# C
source package/language/C/Kconfig

# CPP/C++
source package/language/CPP/Kconfig

# Python
source package/language/Python/Kconfig

# Shell
source package/language/Shell/Kconfig

endif # PK_LANGUAGE
```

## package/language/Python/BiscuitOS-Python/Kconfig
```kconfig
menuconfig PK_PYTHON_BISCUITOS
	bool "Python language on BiscuitOS"

if PK_PYTHON_BISCUITOS

config PK_PYTHON_BISCUITOS_VERSION
	default "default"
	string "verstion"

config PK_PYTHON_BISCUITOS_TAR
	default "tar.gz"
	string "tar type"

config PK_PYTHON_BISCUITOS_URL
	default "https://gitee.com/BiscuitOS_team/HardStack/raw/Gitee/Language/Python/BiscuitOS-Python"
	string "url"

config PK_PYTHON_BISCUITOS_GITHUB
	string "GitHub"

config PK_PYTHON_BISCUITOS_SRCFILE
	default "main.py Makefile"
	string "Source code list"

config PK_PYTHON_BISCUITOS_CSRCFILE
	string "Compile source code list"

config PK_PYTHON_BISCUITOS_CONFIG
	string "CONFIG: Project Configure Options"

config PK_PYTHON_BISCUITOS_LIBPATH
	string "LIBS: Libraries to pass to the linker, e.g. -l<library>"

config PK_PYTHON_BISCUITOS_CPPFLAGS
	string "CPPFLAGS: C/C++ preprocessor flags, e.g. -I<include dir>"

config PK_PYTHON_BISCUITOS_DPKCONFIG
	string "PKG_CONFIG_PATH: Directories to add to pkg-config's search path"

config PK_PYTHON_BISCUITOS_CFLAGS
	string "CFLAGS: C compiler flags"

config PK_PYTHON_BISCUITOS_LDFLAGS
	string "LDFLAGS: Linker flags"

config PK_PYTHON_BISCUITOS_CXXFLAGS
	string "CXXFLAGS: C++ compiler flags"

config PK_PYTHON_BISCUITOS_ASFLAGS
	string "CCASFLAGS: assembler compiler flags (defaults to CFLAGS)"

config PK_PYTHON_BISCUITOS_BUILDARCH
	string "--host options on configure for Architecture"

endif # PK_PYTHON_BISCUITOS
```

## package/language/Python/Kconfig
```kconfig
menuconfig PK_LANGUAGE_PYTHON
	select PK_PYTHON
	bool "Python: python 2.7"

if PK_LANGUAGE_PYTHON

# Python on BiscuitOS
source "package/language/Python/BiscuitOS-Python/Kconfig"

endif # PK_LANGUAGE_PYTHON
```

## package/language/Shell/BiscuitOS-Shell/Kconfig
```kconfig
menuconfig PK_SHELL_BISCUITOS
	bool "Shell language on BiscuitOS"

if PK_SHELL_BISCUITOS

config PK_SHELL_BISCUITOS_VERSION
	default "default"
	string "verstion"

config PK_SHELL_BISCUITOS_TAR
	default "tar.gz"
	string "tar type"

config PK_SHELL_BISCUITOS_URL
	default "https://gitee.com/BiscuitOS_team/HardStack/raw/Gitee/Language/Shell/BiscuitOS-Shell"
	string "url"

config PK_SHELL_BISCUITOS_GITHUB
	string "GitHub"

config PK_SHELL_BISCUITOS_SRCFILE
	default "main.sh Makefile"
	string "Source code list"

config PK_SHELL_BISCUITOS_CSRCFILE
	string "Compile source code list"

config PK_SHELL_BISCUITOS_CONFIG
	string "CONFIG: Project Configure Options"

config PK_SHELL_BISCUITOS_LIBPATH
	string "LIBS: Libraries to pass to the linker, e.g. -l<library>"

config PK_SHELL_BISCUITOS_CPPFLAGS
	string "CPPFLAGS: C/C++ preprocessor flags, e.g. -I<include dir>"

config PK_SHELL_BISCUITOS_DPKCONFIG
	string "PKG_CONFIG_PATH: Directories to add to pkg-config's search path"

config PK_SHELL_BISCUITOS_CFLAGS
	string "CFLAGS: C compiler flags"

config PK_SHELL_BISCUITOS_LDFLAGS
	string "LDFLAGS: Linker flags"

config PK_SHELL_BISCUITOS_CXXFLAGS
	string "CXXFLAGS: C++ compiler flags"

config PK_SHELL_BISCUITOS_ASFLAGS
	string "CCASFLAGS: assembler compiler flags (defaults to CFLAGS)"

config PK_SHELL_BISCUITOS_BUILDARCH
	string "--host options on configure for Architecture"

endif # PK_SHELL_BISCUITOS
```

## package/language/Shell/Kconfig
```kconfig
menuconfig PK_LANGUAGE_SHELL
	bool "Shell language and scripts"

if PK_LANGUAGE_SHELL

# Shell on BiscuitOS
source "package/language/Shell/BiscuitOS-Shell/Kconfig"

endif # PK_LANGUAGE_SHELL
```

## package/libX11/Kconfig
```kconfig
menuconfig PK_LIBX11
	select PK_LIBXCB
	select PK_XTRANS
	select PK_KBPROTO
	select PK_INPUTPROTO
	bool "libX11"

if PK_LIBX11

config PK_LIBX11_VERSION
	default "1.6.5"
	string "verstion"

config PK_LIBX11_TAR
	default "tar.gz"
	string "tar type"

config PK_LIBX11_URL
	default "https://www.x.org/releases/individual/lib/"
	string "url"

config PK_LIBX11_GITHUB
	string "GitHub"

config PK_LIBX11_SRCFILE
	string "Source code list"

config PK_LIBX11_CONFIG
	default "--enable-malloc0returnsnull --disable-selective-werror --enable-silent-rules --disable-static"
	string "CONFIG: Project Configure Options"

config PK_LIBX11_LIBPATH
	string "LIBS: Libraries to pass to the linker, e.g. -l<library>"

config PK_LIBX11_CPPFLAGS
	string "CPPFLAGS: C/C++ preprocessor flags, e.g. -I<include dir>"

config PK_LIBX11_DPKCONFIG
	string "PKG_CONFIG_PATH: Directories to add to pkg-config's search path"

config PK_LIBX11_CFLAGS
	string "CFLAGS: C compiler flags"

config PK_LIBX11_LDFLAGS
	string "LDFLAGS: Linker flags"

config PK_LIBX11_CXXFLAGS
	string "CXXFLAGS: C++ compiler flags"

config PK_LIBX11_ASFLAGS
	string "CCASFLAGS: assembler compiler flags (defaults to CFLAGS)"

config PK_LIBX11_BUILDARCH
	default "x86_64-unknown-linux-gnu"
	string "--host options on configure for Architecture"

endif # PK_LIBX11
```

## package/libXau/Kconfig
```kconfig
menuconfig PK_LIBXAU
	select PK_XPROTO
	bool "libXau"

if PK_LIBXAU

config PK_LIBXAU_VERSION
	default "1.0.8"
	string "verstion"

config PK_LIBXAU_TAR
	default "tar.gz"
	string "tar type"

config PK_LIBXAU_URL
	default "https://www.x.org/releases/individual/lib/"
	string "url"

config PK_LIBXAU_GITHUB
	string "GitHub"

config PK_LIBXAU_SRCFILE
	string "Source code list"

config PK_LIBXAU_CONFIG
	default "--enable-silent-rules --disable-static"
	string "CONFIG: Project Configure Options"

config PK_LIBXAU_LIBPATH
	string "LIBS: Libraries to pass to the linker, e.g. -l<library>"

config PK_LIBXAU_CPPFLAGS
	string "CPPFLAGS: C/C++ preprocessor flags, e.g. -I<include dir>"

config PK_LIBXAU_DPKCONFIG
	string "PKG_CONFIG_PATH: Directories to add to pkg-config's search path"

config PK_LIBXAU_CFLAGS
	string "CFLAGS: C compiler flags"

config PK_LIBXAU_LDFLAGS
	string "LDFLAGS: Linker flags"

config PK_LIBXAU_CXXFLAGS
	string "CXXFLAGS: C++ compiler flags"

config PK_LIBXAU_ASFLAGS
	string "CCASFLAGS: assembler compiler flags (defaults to CFLAGS)"

config PK_LIBXAU_BUILDARCH
	default "x86_64-unknown-linux-gnu"
	string "--host options on configure for Architecture"

endif # PK_LIBXAU
```

## package/libXdamage/Kconfig
```kconfig
menuconfig PK_LIBXDAMAGE
	select PK_DAMAGEPROTO
	select PK_LIBXFIXES
	bool "libXdamage"

if PK_LIBXDAMAGE

config PK_LIBXDAMAGE_VERSION
	default "1.1"
	string "verstion"

config PK_LIBXDAMAGE_TAR
	default "tar.gz"
	string "tar type"

config PK_LIBXDAMAGE_URL
	default "https://www.x.org/releases/individual/lib/"
	string "url"

config PK_LIBXDAMAGE_GITHUB
	string "GitHub"

config PK_LIBXDAMAGE_SRCFILE
	string "Source code list"

config PK_LIBXDAMAGE_CONFIG
	default "--enable-silent-rules --disable-static"
	string "CONFIG: Project Configure Options"

config PK_LIBXDAMAGE_LIBPATH
	string "LIBS: Libraries to pass to the linker, e.g. -l<library>"

config PK_LIBXDAMAGE_CPPFLAGS
	string "CPPFLAGS: C/C++ preprocessor flags, e.g. -I<include dir>"

config PK_LIBXDAMAGE_DPKCONFIG
	string "PKG_CONFIG_PATH: Directories to add to pkg-config's search path"

config PK_LIBXDAMAGE_CFLAGS
	string "CFLAGS: C compiler flags"

config PK_LIBXDAMAGE_LDFLAGS
	string "LDFLAGS: Linker flags"

config PK_LIBXDAMAGE_CXXFLAGS
	string "CXXFLAGS: C++ compiler flags"

config PK_LIBXDAMAGE_ASFLAGS
	string "CCASFLAGS: assembler compiler flags (defaults to CFLAGS)"

config PK_LIBXDAMAGE_BUILDARCH
	default "x86_64-unknown-linux-gnu"
	string "--host options on configure for Architecture"

endif # PK_LIBXDAMAGE
```

## package/libXdmcp/Kconfig
```kconfig
menuconfig PK_LIBXDMCP
	select PK_LIBXSHMFENCE
	bool "libXdmcp"

if PK_LIBXDMCP

config PK_LIBXDMCP_VERSION
	default "1.1.3"
	string "verstion"

config PK_LIBXDMCP_TAR
	default "tar.gz"
	string "tar type"

config PK_LIBXDMCP_URL
	default "https://www.x.org/releases/individual/lib/"
	string "url"

config PK_LIBXDMCP_GITHUB
	string "GitHub"

config PK_LIBXDMCP_SRCFILE
	string "Source code list"

config PK_LIBXDMCP_CONFIG
	default "--enable-silent-rules --disable-static"
	string "CONFIG: Project Configure Options"

config PK_LIBXDMCP_LIBPATH
	string "LIBS: Libraries to pass to the linker, e.g. -l<library>"

config PK_LIBXDMCP_CPPFLAGS
	string "CPPFLAGS: C/C++ preprocessor flags, e.g. -I<include dir>"

config PK_LIBXDMCP_DPKCONFIG
	string "PKG_CONFIG_PATH: Directories to add to pkg-config's search path"

config PK_LIBXDMCP_CFLAGS
	string "CFLAGS: C compiler flags"

config PK_LIBXDMCP_LDFLAGS
	string "LDFLAGS: Linker flags"

config PK_LIBXDMCP_CXXFLAGS
	string "CXXFLAGS: C++ compiler flags"

config PK_LIBXDMCP_ASFLAGS
	string "CCASFLAGS: assembler compiler flags (defaults to CFLAGS)"

config PK_LIBXDMCP_BUILDARCH
	default "x86_64-unknown-linux-gnu"
	string "--host options on configure for Architecture"

endif # PK_LIBXDMCP
```

## package/libXext/Kconfig
```kconfig
menuconfig PK_LIBXEXT
	select PK_XEXTPROTO
	select PK_LIBXDMCP
	bool "libXext"

if PK_LIBXEXT

config PK_LIBXEXT_VERSION
	default "1.3.1"
	string "verstion"

config PK_LIBXEXT_TAR
	default "tar.gz"
	string "tar type"

config PK_LIBXEXT_URL
	default "https://www.x.org/releases/individual/lib/"
	string "url"

config PK_LIBXEXT_GITHUB
	string "GitHub"

config PK_LIBXEXT_SRCFILE
	string "Source code list"

config PK_LIBXEXT_CONFIG
	default "--enable-silent-rules --disable-static"
	string "CONFIG: Project Configure Options"

config PK_LIBXEXT_LIBPATH
	string "LIBS: Libraries to pass to the linker, e.g. -l<library>"

config PK_LIBXEXT_CPPFLAGS
	string "CPPFLAGS: C/C++ preprocessor flags, e.g. -I<include dir>"

config PK_LIBXEXT_DPKCONFIG
	string "PKG_CONFIG_PATH: Directories to add to pkg-config's search path"

config PK_LIBXEXT_CFLAGS
	string "CFLAGS: C compiler flags"

config PK_LIBXEXT_LDFLAGS
	string "LDFLAGS: Linker flags"

config PK_LIBXEXT_CXXFLAGS
	string "CXXFLAGS: C++ compiler flags"

config PK_LIBXEXT_ASFLAGS
	string "CCASFLAGS: assembler compiler flags (defaults to CFLAGS)"

config PK_LIBXEXT_BUILDARCH
	default "x86_64-unknown-linux-gnu"
	string "--host options on configure for Architecture"

endif # PK_LIBXEXT
```
