## package/MOTION-MEMORY/BiscuitOS-MOTION-MEMORY-ALLOCATOR-UDEMO/Kconfig
```kconfig
menuconfig PK_MOTION_MEMORY_ALLOCATOR_UDEMO
	bool "USERSPACE ALLOCATOR DEMO"

if PK_MOTION_MEMORY_ALLOCATOR_UDEMO

config PK_MOTION_MEMORY_ALLOCATOR_UDEMO_VERSION
	default "default"
	string "verstion"

config PK_MOTION_MEMORY_ALLOCATOR_UDEMO_TAR
	default "tar.gz"
	string "tar type"

config PK_MOTION_MEMORY_ALLOCATOR_UDEMO_URL
	default "https://gitee.com/BiscuitOS_team/HardStack/raw/Gitee/MOTION/MEMORY/BiscuitOS-MOTION-MEMORY-ALLOCATOR-UDEMO"
	string "url"

config PK_MOTION_MEMORY_ALLOCATOR_UDEMO_GITHUB
	string "GitHub"

config PK_MOTION_MEMORY_ALLOCATOR_UDEMO_SRCFILE
	default "app.c  Kconfig  main.c  Makefile  Makefile.host  RunBiscuitOS.sh  userlib.c"
	string "Source code list"

config PK_MOTION_MEMORY_ALLOCATOR_UDEMO_CSRCFILE
	string "Compile source code list"

config PK_MOTION_MEMORY_ALLOCATOR_UDEMO_CONFIG
	string "CONFIG: Project Configure Options"

config PK_MOTION_MEMORY_ALLOCATOR_UDEMO_LIBPATH
	string "LIBS: Libraries to pass to the linker, e.g. -l<library>"

config PK_MOTION_MEMORY_ALLOCATOR_UDEMO_CPPFLAGS
	string "CPPFLAGS: C/C++ preprocessor flags, e.g. -I<include dir>"

config PK_MOTION_MEMORY_ALLOCATOR_UDEMO_DPKCONFIG
	string "PKG_CONFIG_PATH: Directories to add to pkg-config's search path"

config PK_MOTION_MEMORY_ALLOCATOR_UDEMO_CFLAGS
	string "CFLAGS: C compiler flags"

config PK_MOTION_MEMORY_ALLOCATOR_UDEMO_LDFLAGS
	string "LDFLAGS: Linker flags"

config PK_MOTION_MEMORY_ALLOCATOR_UDEMO_CXXFLAGS
	string "CXXFLAGS: C++ compiler flags"

config PK_MOTION_MEMORY_ALLOCATOR_UDEMO_ASFLAGS
	string "CCASFLAGS: assembler compiler flags (defaults to CFLAGS)"

config PK_MOTION_MEMORY_ALLOCATOR_UDEMO_BUILDARCH
	string "--host options on configure for Architecture"

endif # PK_MOTION_MEMORY_ALLOCATOR_UDEMO
```

## package/MOTION-MEMORY/BiscuitOS-MOTION-MEMORY-ASAN/Kconfig
```kconfig
menuconfig PK_MOTION_MEMORY_ASAN
	bool "ASAN"

if PK_MOTION_MEMORY_ASAN

config PK_MOTION_MEMORY_ASAN_VERSION
	default "default"
	string "verstion"

config PK_MOTION_MEMORY_ASAN_TAR
	default "tar.gz"
	string "tar type"

config PK_MOTION_MEMORY_ASAN_URL
	default "https://gitee.com/BiscuitOS_team/HardStack/raw/Gitee/MOTION/MEMORY/BiscuitOS-MOTION-MEMORY-ASAN"
	string "url"

config PK_MOTION_MEMORY_ASAN_GITHUB
	string "GitHub"

config PK_MOTION_MEMORY_ASAN_SRCFILE
	default "main.c Makefile"
	string "Source code list"

config PK_MOTION_MEMORY_ASAN_CSRCFILE
	string "Compile source code list"

config PK_MOTION_MEMORY_ASAN_CONFIG
	string "CONFIG: Project Configure Options"

config PK_MOTION_MEMORY_ASAN_LIBPATH
	string "LIBS: Libraries to pass to the linker, e.g. -l<library>"

config PK_MOTION_MEMORY_ASAN_CPPFLAGS
	string "CPPFLAGS: C/C++ preprocessor flags, e.g. -I<include dir>"

config PK_MOTION_MEMORY_ASAN_DPKCONFIG
	string "PKG_CONFIG_PATH: Directories to add to pkg-config's search path"

config PK_MOTION_MEMORY_ASAN_CFLAGS
	string "CFLAGS: C compiler flags"

config PK_MOTION_MEMORY_ASAN_LDFLAGS
	string "LDFLAGS: Linker flags"

config PK_MOTION_MEMORY_ASAN_CXXFLAGS
	string "CXXFLAGS: C++ compiler flags"

config PK_MOTION_MEMORY_ASAN_ASFLAGS
	string "CCASFLAGS: assembler compiler flags (defaults to CFLAGS)"

config PK_MOTION_MEMORY_ASAN_BUILDARCH
	string "--host options on configure for Architecture"

endif # PK_MOTION_MEMORY_ASAN
```

## package/MOTION-MEMORY/BiscuitOS-MOTION-MEMORY-BUDDY/Kconfig
```kconfig
menuconfig PK_MOTION_MEMORY_BUDDY
	bool "BUDDY ALLOCATOR"

if PK_MOTION_MEMORY_BUDDY

config PK_MOTION_MEMORY_BUDDY_VERSION
	default "default"
	string "verstion"

config PK_MOTION_MEMORY_BUDDY_TAR
	default "tar.gz"
	string "tar type"

config PK_MOTION_MEMORY_BUDDY_URL
	default "https://gitee.com/BiscuitOS_team/HardStack/raw/Gitee/MOTION/MEMORY/BiscuitOS-MOTION-MEMORY-BUDDY"
	string "url"

config PK_MOTION_MEMORY_BUDDY_GITHUB
	string "GitHub"

config PK_MOTION_MEMORY_BUDDY_SRCFILE
	default "Kconfig  main.c  Makefile  Makefile.host  RunBiscuitOS.sh"
	string "Source code list"

config PK_MOTION_MEMORY_BUDDY_CSRCFILE
	string "Compile source code list"

config PK_MOTION_MEMORY_BUDDY_CONFIG
	string "CONFIG: Project Configure Options"

config PK_MOTION_MEMORY_BUDDY_LIBPATH
	string "LIBS: Libraries to pass to the linker, e.g. -l<library>"

config PK_MOTION_MEMORY_BUDDY_CPPFLAGS
	string "CPPFLAGS: C/C++ preprocessor flags, e.g. -I<include dir>"

config PK_MOTION_MEMORY_BUDDY_DPKCONFIG
	string "PKG_CONFIG_PATH: Directories to add to pkg-config's search path"

config PK_MOTION_MEMORY_BUDDY_CFLAGS
	string "CFLAGS: C compiler flags"

config PK_MOTION_MEMORY_BUDDY_LDFLAGS
	string "LDFLAGS: Linker flags"

config PK_MOTION_MEMORY_BUDDY_CXXFLAGS
	string "CXXFLAGS: C++ compiler flags"

config PK_MOTION_MEMORY_BUDDY_ASFLAGS
	string "CCASFLAGS: assembler compiler flags (defaults to CFLAGS)"

config PK_MOTION_MEMORY_BUDDY_BUILDARCH
	string "--host options on configure for Architecture"

endif # PK_MOTION_MEMORY_BUDDY
```

## package/MOTION-MEMORY/BiscuitOS-MOTION-MEMORY-CMA/Kconfig
```kconfig
menuconfig PK_MOTION_MEMORY_CMA
	bool "CMA MEMORY"

if PK_MOTION_MEMORY_CMA

config PK_MOTION_MEMORY_CMA_VERSION
	default "default"
	string "verstion"

config PK_MOTION_MEMORY_CMA_TAR
	default "tar.gz"
	string "tar type"

config PK_MOTION_MEMORY_CMA_URL
	default "https://gitee.com/BiscuitOS_team/HardStack/raw/Gitee/MOTION/MEMORY/BiscuitOS-MOTION-MEMORY-CMA"
	string "url"

config PK_MOTION_MEMORY_CMA_GITHUB
	string "GitHub"

config PK_MOTION_MEMORY_CMA_SRCFILE
	default "Kconfig  main.c  Makefile  Makefile.host  RunBiscuitOS.sh"
	string "Source code list"

config PK_MOTION_MEMORY_CMA_CSRCFILE
	string "Compile source code list"

config PK_MOTION_MEMORY_CMA_CONFIG
	string "CONFIG: Project Configure Options"

config PK_MOTION_MEMORY_CMA_LIBPATH
	string "LIBS: Libraries to pass to the linker, e.g. -l<library>"

config PK_MOTION_MEMORY_CMA_CPPFLAGS
	string "CPPFLAGS: C/C++ preprocessor flags, e.g. -I<include dir>"

config PK_MOTION_MEMORY_CMA_DPKCONFIG
	string "PKG_CONFIG_PATH: Directories to add to pkg-config's search path"

config PK_MOTION_MEMORY_CMA_CFLAGS
	string "CFLAGS: C compiler flags"

config PK_MOTION_MEMORY_CMA_LDFLAGS
	string "LDFLAGS: Linker flags"

config PK_MOTION_MEMORY_CMA_CXXFLAGS
	string "CXXFLAGS: C++ compiler flags"

config PK_MOTION_MEMORY_CMA_ASFLAGS
	string "CCASFLAGS: assembler compiler flags (defaults to CFLAGS)"

config PK_MOTION_MEMORY_CMA_BUILDARCH
	string "--host options on configure for Architecture"

endif # PK_MOTION_MEMORY_CMA
```

## package/MOTION-MEMORY/BiscuitOS-MOTION-MEMORY-COW/Kconfig
```kconfig
menuconfig PK_MOTION_MEMORY_COW
	bool "COW"

if PK_MOTION_MEMORY_COW

config PK_MOTION_MEMORY_COW_VERSION
	default "default"
	string "verstion"

config PK_MOTION_MEMORY_COW_TAR
	default "tar.gz"
	string "tar type"

config PK_MOTION_MEMORY_COW_URL
	default "https://gitee.com/BiscuitOS_team/HardStack/raw/Gitee/MOTION/MEMORY/BiscuitOS-MOTION-MEMORY-COW"
	string "url"

config PK_MOTION_MEMORY_COW_GITHUB
	string "GitHub"

config PK_MOTION_MEMORY_COW_SRCFILE
	default "main.c Makefile RunBiscuitOS.sh"
	string "Source code list"

config PK_MOTION_MEMORY_COW_CSRCFILE
	string "Compile source code list"

config PK_MOTION_MEMORY_COW_CONFIG
	string "CONFIG: Project Configure Options"

config PK_MOTION_MEMORY_COW_LIBPATH
	string "LIBS: Libraries to pass to the linker, e.g. -l<library>"

config PK_MOTION_MEMORY_COW_CPPFLAGS
	string "CPPFLAGS: C/C++ preprocessor flags, e.g. -I<include dir>"

config PK_MOTION_MEMORY_COW_DPKCONFIG
	string "PKG_CONFIG_PATH: Directories to add to pkg-config's search path"

config PK_MOTION_MEMORY_COW_CFLAGS
	string "CFLAGS: C compiler flags"

config PK_MOTION_MEMORY_COW_LDFLAGS
	string "LDFLAGS: Linker flags"

config PK_MOTION_MEMORY_COW_CXXFLAGS
	string "CXXFLAGS: C++ compiler flags"

config PK_MOTION_MEMORY_COW_ASFLAGS
	string "CCASFLAGS: assembler compiler flags (defaults to CFLAGS)"

config PK_MOTION_MEMORY_COW_BUILDARCH
	string "--host options on configure for Architecture"

endif # PK_MOTION_MEMORY_COW
```

## package/MOTION-MEMORY/BiscuitOS-MOTION-MEMORY-CRASH/Kconfig
```kconfig
menuconfig PK_MOTION_MEMORY_CRASH
	bool "CRASH"

if PK_MOTION_MEMORY_CRASH

config PK_MOTION_MEMORY_CRASH_VERSION
	default "default"
	string "verstion"

config PK_MOTION_MEMORY_CRASH_TAR
	default "tar.gz"
	string "tar type"

config PK_MOTION_MEMORY_CRASH_URL
	default "https://gitee.com/BiscuitOS_team/HardStack/raw/Gitee/MOTION/MEMORY/BiscuitOS-MOTION-MEMORY-CRASH"
	string "url"

config PK_MOTION_MEMORY_CRASH_GITHUB
	string "GitHub"

config PK_MOTION_MEMORY_CRASH_SRCFILE
	default "Kconfig  main.c  Makefile  Makefile.host  RunBiscuitOS.sh"
	string "Source code list"

config PK_MOTION_MEMORY_CRASH_CSRCFILE
	string "Compile source code list"

config PK_MOTION_MEMORY_CRASH_CONFIG
	string "CONFIG: Project Configure Options"

config PK_MOTION_MEMORY_CRASH_LIBPATH
	string "LIBS: Libraries to pass to the linker, e.g. -l<library>"

config PK_MOTION_MEMORY_CRASH_CPPFLAGS
	string "CPPFLAGS: C/C++ preprocessor flags, e.g. -I<include dir>"

config PK_MOTION_MEMORY_CRASH_DPKCONFIG
	string "PKG_CONFIG_PATH: Directories to add to pkg-config's search path"

config PK_MOTION_MEMORY_CRASH_CFLAGS
	string "CFLAGS: C compiler flags"

config PK_MOTION_MEMORY_CRASH_LDFLAGS
	string "LDFLAGS: Linker flags"

config PK_MOTION_MEMORY_CRASH_CXXFLAGS
	string "CXXFLAGS: C++ compiler flags"

config PK_MOTION_MEMORY_CRASH_ASFLAGS
	string "CCASFLAGS: assembler compiler flags (defaults to CFLAGS)"

config PK_MOTION_MEMORY_CRASH_BUILDARCH
	string "--host options on configure for Architecture"

endif # PK_MOTION_MEMORY_CRASH
```
