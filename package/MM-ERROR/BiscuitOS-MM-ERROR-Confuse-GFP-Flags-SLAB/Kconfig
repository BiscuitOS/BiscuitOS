## package/MM-ERROR/BiscuitOS-MM-ERROR-EARLY-IO-RSVDMEM-MT-ZEROLEN/Kconfig
```kconfig
menuconfig PK_MM_ERR_EARLYIOMEM_ZEROLEN
	bool "EARLY-IOREMAP BUG: Zero Length"

if PK_MM_ERR_EARLYIOMEM_ZEROLEN

config PK_MM_ERR_EARLYIOMEM_ZEROLEN_VERSION
	default "default"
	string "verstion"

config PK_MM_ERR_EARLYIOMEM_ZEROLEN_TAR
	default "tar.gz"
	string "tar type"

config PK_MM_ERR_EARLYIOMEM_ZEROLEN_URL
	default "https://gitee.com/BiscuitOS_team/HardStack/raw/Gitee/Memory-Allocator/MM-ERROR/BiscuitOS-MM-ERROR-EARLY-IO-RSVDMEM-MT-ZEROLEN"
	string "url"

config PK_MM_ERR_EARLYIOMEM_ZEROLEN_GITHUB
	string "GitHub"

config PK_MM_ERR_EARLYIOMEM_ZEROLEN_SRCFILE
	default "main.c Kconfig Makefile BiscuitOS_Insert.bs"
	string "Source code list"

config PK_MM_ERR_EARLYIOMEM_ZEROLEN_CSRCFILE
	string "Compile source code list"

config PK_MM_ERR_EARLYIOMEM_ZEROLEN_CONFIG
	string "CONFIG: Project Configure Options"

config PK_MM_ERR_EARLYIOMEM_ZEROLEN_LIBPATH
	string "LIBS: Libraries to pass to the linker, e.g. -l<library>"

config PK_MM_ERR_EARLYIOMEM_ZEROLEN_CPPFLAGS
	string "CPPFLAGS: C/C++ preprocessor flags, e.g. -I<include dir>"

config PK_MM_ERR_EARLYIOMEM_ZEROLEN_DPKCONFIG
	string "PKG_CONFIG_PATH: Directories to add to pkg-config's search path"

config PK_MM_ERR_EARLYIOMEM_ZEROLEN_CFLAGS
	string "CFLAGS: C compiler flags"

config PK_MM_ERR_EARLYIOMEM_ZEROLEN_LDFLAGS
	string "LDFLAGS: Linker flags"

config PK_MM_ERR_EARLYIOMEM_ZEROLEN_CXXFLAGS
	string "CXXFLAGS: C++ compiler flags"

config PK_MM_ERR_EARLYIOMEM_ZEROLEN_ASFLAGS
	string "CCASFLAGS: assembler compiler flags (defaults to CFLAGS)"

config PK_MM_ERR_EARLYIOMEM_ZEROLEN_BUILDARCH
	string "--host options on configure for Architecture"

endif # PK_MM_ERR_EARLYIOMEM_ZEROLEN
```

## package/MM-ERROR/BiscuitOS-MM-ERROR-Permanent-Overflow/Kconfig
```kconfig
menuconfig PK_MM_ERR_PERMANENT_OVERFLOW
	bool "Permanent Mapping BUG: Overflow Range"

if PK_MM_ERR_PERMANENT_OVERFLOW

config PK_MM_ERR_PERMANENT_OVERFLOW_VERSION
	default "default"
	string "verstion"

config PK_MM_ERR_PERMANENT_OVERFLOW_TAR
	default "tar.gz"
	string "tar type"

config PK_MM_ERR_PERMANENT_OVERFLOW_URL
	default "https://gitee.com/BiscuitOS_team/HardStack/raw/Gitee/Memory-Allocator/FIXMAP/BiscuitOS-Permanent"
	string "url"

config PK_MM_ERR_PERMANENT_OVERFLOW_GITHUB
	string "GitHub"

config PK_MM_ERR_PERMANENT_OVERFLOW_SRCFILE
	default "main.c Kconfig Makefile"
	string "Source code list"

config PK_MM_ERR_PERMANENT_OVERFLOW_CSRCFILE
	string "Compile source code list"

config PK_MM_ERR_PERMANENT_OVERFLOW_CONFIG
	string "CONFIG: Project Configure Options"

config PK_MM_ERR_PERMANENT_OVERFLOW_LIBPATH
	string "LIBS: Libraries to pass to the linker, e.g. -l<library>"

config PK_MM_ERR_PERMANENT_OVERFLOW_CPPFLAGS
	string "CPPFLAGS: C/C++ preprocessor flags, e.g. -I<include dir>"

config PK_MM_ERR_PERMANENT_OVERFLOW_DPKCONFIG
	string "PKG_CONFIG_PATH: Directories to add to pkg-config's search path"

config PK_MM_ERR_PERMANENT_OVERFLOW_CFLAGS
	string "CFLAGS: C compiler flags"

config PK_MM_ERR_PERMANENT_OVERFLOW_LDFLAGS
	string "LDFLAGS: Linker flags"

config PK_MM_ERR_PERMANENT_OVERFLOW_CXXFLAGS
	string "CXXFLAGS: C++ compiler flags"

config PK_MM_ERR_PERMANENT_OVERFLOW_ASFLAGS
	string "CCASFLAGS: assembler compiler flags (defaults to CFLAGS)"

config PK_MM_ERR_PERMANENT_OVERFLOW_BUILDARCH
	string "--host options on configure for Architecture"

endif # PK_MM_ERR_PERMANENT_OVERFLOW
```

## package/MM-ERROR/Kconfig
```kconfig
menuconfig PK_MM_ERROR
	bool "Memory Error Collect (Kernel/Userspace)"

if PK_MM_ERROR

# Confuse GFP flags
source package/MM-ERROR/BiscuitOS-MM-ERROR-Confuse-GFP-Flags/Kconfig

# Confuse GFP flags on PCP
source package/MM-ERROR/BiscuitOS-MM-ERROR-Confuse-GFP-Flags-PCP/Kconfig

# Confuse GFP flags on Buddy
source package/MM-ERROR/BiscuitOS-MM-ERROR-Confuse-GFP-Flags-Buddy/Kconfig

# Confuse GFP flags on SLAB/SLUB/SLOB
source package/MM-ERROR/BiscuitOS-MM-ERROR-Confuse-GFP-Flags-SLAB/Kconfig

# Confuse GFP flags on VMALLOC
source package/MM-ERROR/BiscuitOS-MM-ERROR-Confuse-GFP-Flags-VMALLOC/Kconfig

# Permanent Mapping Overflow
source package/MM-ERROR/BiscuitOS-MM-ERROR-Permanent-Overflow/Kconfig

# Early IO/RSVD-MEM Memory Allocator
source package/MM-ERROR/BiscuitOS-MM-ERROR-WP-ON-EARLY-IO-RSVDMEM-MT/Kconfig

# Early IO/RSVD-MEM Memory Allocator: OverLife
source package/MM-ERROR/BiscuitOS-MM-ERROR-EARLY-IO-RSVDMEM-MT-OVERLIFE/Kconfig

# Early IO/RSVD-MEM Memory Allocator: Over slot
source package/MM-ERROR/BiscuitOS-MM-ERROR-EARLY-IO-RSVDMEM-MT-OVER-SLOT/Kconfig

# Early IO/RSVD-MEM Memory Allocator: Unfree
source package/MM-ERROR/BiscuitOS-MM-ERROR-EARLY-IO-RSVDMEM-MT-UNFREE/Kconfig

# Early IO/RSVD-MEM Memory Allocator: Zero Length
source package/MM-ERROR/BiscuitOS-MM-ERROR-EARLY-IO-RSVDMEM-MT-ZEROLEN/Kconfig

# Early IO/RSVD-MEM Memory Allocator: Overflow MaxPhysAddr
source package/MM-ERROR/BiscuitOS-MM-ERROR-EARLY-IO-RSVDMEM-MT-OVER-MAXPHYS/Kconfig

# Early IO/RSVD-MEM Memory Allocator: Overflow MaxPhysAddr Range
source package/MM-ERROR/BiscuitOS-MM-ERROR-EARLY-IO-RSVDMEM-MT-OVER-MAXPHYS-RANGE/Kconfig

# Early IO/RSVD-MEM Memory Allocator: Re-Free Range
source package/MM-ERROR/BiscuitOS-MM-ERROR-EARLY-IO-RSVDMEM-MT-REFREE/Kconfig

# Early IO/RSVD-MEM Memory Allocator: Free Uncorrect Size
source package/MM-ERROR/BiscuitOS-MM-ERROR-EARLY-IO-RSVDMEM-MT-UESIZE/Kconfig

endif # PK_MM_ERROR
```

## package/MMU/Kconfig
```kconfig
menuconfig PK_BISCUITOS_MMU
	bool "MMU (BiscuitOS+)"

if PK_BISCUITOS_MMU

# Memory Hotplug in C
source package/MMU/Memory-Hotplug-in-C/Kconfig

# Memory Hotplug auto
source package/MMU/Memory-Hotplug-auto/Kconfig

endif # PK_BISCUITOS_MMU
```

## package/MMU/Memory-Hotplug-auto/Kconfig
```kconfig
menuconfig PK_MMU_MEMORY_HOTPLUG_AUTO
	bool "Memory Hotplug in C"

if PK_MMU_MEMORY_HOTPLUG_AUTO

config PK_MMU_MEMORY_HOTPLUG_AUTO_VERSION
	default "0.0.1"
	string "verstion"

config PK_MMU_MEMORY_HOTPLUG_AUTO_TAR
	default "tar.gz"
	string "tar type"

config PK_MMU_MEMORY_HOTPLUG_AUTO_URL
	default "https://gitee.com/BiscuitOS_team/HardStack/raw/Gitee/Memory-Allocator/Memory-Hotplug/memory-hotplug"
	string "url"

config PK_MMU_MEMORY_HOTPLUG_AUTO_GITHUB
	string "GitHub"

config PK_MMU_MEMORY_HOTPLUG_AUTO_SRCFILE
	default "main.c Kconfig Makefile"
	string "Source code list"

config PK_MMU_MEMORY_HOTPLUG_AUTO_CSRCFILE
	string "Compile source code list"

config PK_MMU_MEMORY_HOTPLUG_AUTO_CONFIG
	string "CONFIG: Project Configure Options"

config PK_MMU_MEMORY_HOTPLUG_AUTO_LIBPATH
	string "LIBS: Libraries to pass to the linker, e.g. -l<library>"

config PK_MMU_MEMORY_HOTPLUG_AUTO_CPPFLAGS
	string "CPPFLAGS: C/C++ preprocessor flags, e.g. -I<include dir>"

config PK_MMU_MEMORY_HOTPLUG_AUTO_DPKCONFIG
	string "PKG_CONFIG_PATH: Directories to add to pkg-config's search path"

config PK_MMU_MEMORY_HOTPLUG_AUTO_CFLAGS
	string "CFLAGS: C compiler flags"

config PK_MMU_MEMORY_HOTPLUG_AUTO_LDFLAGS
	string "LDFLAGS: Linker flags"

config PK_MMU_MEMORY_HOTPLUG_AUTO_CXXFLAGS
	string "CXXFLAGS: C++ compiler flags"

config PK_MMU_MEMORY_HOTPLUG_AUTO_ASFLAGS
	string "CCASFLAGS: assembler compiler flags (defaults to CFLAGS)"

config PK_MMU_MEMORY_HOTPLUG_AUTO_BUILDARCH
	string "--host options on configure for Architecture"

endif # PK_MMU_MEMORY_HOTPLUG_AUTO
```

## package/MMU/Memory-Hotplug-in-C/Kconfig
```kconfig
menuconfig PK_MMU_MEMORY_HOTPLUG_IN_C
	bool "Memory Hotplug in C"

if PK_MMU_MEMORY_HOTPLUG_IN_C

config PK_MMU_MEMORY_HOTPLUG_IN_C_VERSION
	default "0.0.1"
	string "verstion"

config PK_MMU_MEMORY_HOTPLUG_IN_C_TAR
	default "tar.gz"
	string "tar type"

config PK_MMU_MEMORY_HOTPLUG_IN_C_URL
	default "https://gitee.com/BiscuitOS_team/HardStack/raw/Gitee/Memory-Allocator/Memory-Hotplug/add_memory"
	string "url"

config PK_MMU_MEMORY_HOTPLUG_IN_C_GITHUB
	string "GitHub"

config PK_MMU_MEMORY_HOTPLUG_IN_C_SRCFILE
	default "main.c Kconfig Makefile"
	string "Source code list"

config PK_MMU_MEMORY_HOTPLUG_IN_C_CSRCFILE
	string "Compile source code list"

config PK_MMU_MEMORY_HOTPLUG_IN_C_CONFIG
	string "CONFIG: Project Configure Options"

config PK_MMU_MEMORY_HOTPLUG_IN_C_LIBPATH
	string "LIBS: Libraries to pass to the linker, e.g. -l<library>"

config PK_MMU_MEMORY_HOTPLUG_IN_C_CPPFLAGS
	string "CPPFLAGS: C/C++ preprocessor flags, e.g. -I<include dir>"

config PK_MMU_MEMORY_HOTPLUG_IN_C_DPKCONFIG
	string "PKG_CONFIG_PATH: Directories to add to pkg-config's search path"

config PK_MMU_MEMORY_HOTPLUG_IN_C_CFLAGS
	string "CFLAGS: C compiler flags"

config PK_MMU_MEMORY_HOTPLUG_IN_C_LDFLAGS
	string "LDFLAGS: Linker flags"

config PK_MMU_MEMORY_HOTPLUG_IN_C_CXXFLAGS
	string "CXXFLAGS: C++ compiler flags"

config PK_MMU_MEMORY_HOTPLUG_IN_C_ASFLAGS
	string "CCASFLAGS: assembler compiler flags (defaults to CFLAGS)"

config PK_MMU_MEMORY_HOTPLUG_IN_C_BUILDARCH
	string "--host options on configure for Architecture"

endif # PK_MMU_MEMORY_HOTPLUG_IN_C
```

## package/MMU_shrink/Kconfig
```kconfig
menuconfig PK_MMU_SHRINK
	bool "MMU Shrink"

if PK_MMU_SHRINK

# kernel-slab-shrink-base
source package/MMU_shrink/kernel-slab-shrink-base/Kconfig

endif # PK_MMU_SHRINK
```

## package/MMU_shrink/kernel-slab-shrink-base/Kconfig
```kconfig
menuconfig PK_SLAB_SHRINK_DEMO
	bool "kernel slab shrink Demo"

if PK_SLAB_SHRINK_DEMO

config PK_SLAB_SHRINK_DEMO_VERSION
	default "0.0.1"
	string "verstion"

config PK_SLAB_SHRINK_DEMO_TAR
	default "tar.gz"
	string "tar type"

config PK_SLAB_SHRINK_DEMO_URL
	default "https://gitee.com/BiscuitOS_team/HardStack/raw/Gitee/Memory-Allocator/Shrink/kernel-slab-shrink-base"
	string "url"

config PK_SLAB_SHRINK_DEMO_GITHUB
	string "GitHub"

config PK_SLAB_SHRINK_DEMO_SRCFILE
	default "main.c Kconfig Makefile"
	string "Source code list"

config PK_SLAB_SHRINK_DEMO_CSRCFILE
	string "Compile source code list"

config PK_SLAB_SHRINK_DEMO_CONFIG
	string "CONFIG: Project Configure Options"

config PK_SLAB_SHRINK_DEMO_LIBPATH
	string "LIBS: Libraries to pass to the linker, e.g. -l<library>"

config PK_SLAB_SHRINK_DEMO_CPPFLAGS
	string "CPPFLAGS: C/C++ preprocessor flags, e.g. -I<include dir>"

config PK_SLAB_SHRINK_DEMO_DPKCONFIG
	string "PKG_CONFIG_PATH: Directories to add to pkg-config's search path"

config PK_SLAB_SHRINK_DEMO_CFLAGS
	string "CFLAGS: C compiler flags"

config PK_SLAB_SHRINK_DEMO_LDFLAGS
	string "LDFLAGS: Linker flags"

config PK_SLAB_SHRINK_DEMO_CXXFLAGS
	string "CXXFLAGS: C++ compiler flags"

config PK_SLAB_SHRINK_DEMO_ASFLAGS
	string "CCASFLAGS: assembler compiler flags (defaults to CFLAGS)"

config PK_SLAB_SHRINK_DEMO_BUILDARCH
	string "--host options on configure for Architecture"

endif # PK_SLAB_SHRINK_DEMO
```

## package/MMU_shrink/register_shrink/Kconfig
```kconfig
menuconfig PK_REGISTER_SHRINK
	bool "register_shrink/unregister_shrink"

if PK_REGISTER_SHRINK

config PK_REGISTER_SHRINK_VERSION
	default "0.0.1"
	string "verstion"

config PK_REGISTER_SHRINK_TAR
	default "tar.gz"
	string "tar type"

config PK_REGISTER_SHRINK_URL
	default "https://gitee.com/BiscuitOS_team/HardStack/raw/Gitee/Memory-Allocator/Shrink/register_shrink"
	string "url"

config PK_REGISTER_SHRINK_GITHUB
	string "GitHub"

config PK_REGISTER_SHRINK_SRCFILE
	default "main.c Kconfig Makefile"
	string "Source code list"

config PK_REGISTER_SHRINK_CSRCFILE
	string "Compile source code list"

config PK_REGISTER_SHRINK_CONFIG
	string "CONFIG: Project Configure Options"

config PK_REGISTER_SHRINK_LIBPATH
	string "LIBS: Libraries to pass to the linker, e.g. -l<library>"

config PK_REGISTER_SHRINK_CPPFLAGS
	string "CPPFLAGS: C/C++ preprocessor flags, e.g. -I<include dir>"

config PK_REGISTER_SHRINK_DPKCONFIG
	string "PKG_CONFIG_PATH: Directories to add to pkg-config's search path"

config PK_REGISTER_SHRINK_CFLAGS
	string "CFLAGS: C compiler flags"

config PK_REGISTER_SHRINK_LDFLAGS
	string "LDFLAGS: Linker flags"

config PK_REGISTER_SHRINK_CXXFLAGS
	string "CXXFLAGS: C++ compiler flags"

config PK_REGISTER_SHRINK_ASFLAGS
	string "CCASFLAGS: assembler compiler flags (defaults to CFLAGS)"

config PK_REGISTER_SHRINK_BUILDARCH
	string "--host options on configure for Architecture"

endif # PK_REGISTER_SHRINK
```

## package/MOTION-MEMORY/BiscuitOS-MOTION-MEMORY-ALLOCATOR-KDEMO/Kconfig
```kconfig
menuconfig PK_MOTION_MEMORY_ALLOCATOR_KDEMO
	bool "KERNEL ALLOCATOR DEMO"

if PK_MOTION_MEMORY_ALLOCATOR_KDEMO

config PK_MOTION_MEMORY_ALLOCATOR_KDEMO_VERSION
	default "default"
	string "verstion"

config PK_MOTION_MEMORY_ALLOCATOR_KDEMO_TAR
	default "tar.gz"
	string "tar type"

config PK_MOTION_MEMORY_ALLOCATOR_KDEMO_URL
	default "https://gitee.com/BiscuitOS_team/HardStack/raw/Gitee/MOTION/MEMORY/BiscuitOS-MOTION-MEMORY-ALLOCATOR-KDEMO"
	string "url"

config PK_MOTION_MEMORY_ALLOCATOR_KDEMO_GITHUB
	string "GitHub"

config PK_MOTION_MEMORY_ALLOCATOR_KDEMO_SRCFILE
	default "Kconfig  main.c  Makefile"
	string "Source code list"

config PK_MOTION_MEMORY_ALLOCATOR_KDEMO_CSRCFILE
	string "Compile source code list"

config PK_MOTION_MEMORY_ALLOCATOR_KDEMO_CONFIG
	string "CONFIG: Project Configure Options"

config PK_MOTION_MEMORY_ALLOCATOR_KDEMO_LIBPATH
	string "LIBS: Libraries to pass to the linker, e.g. -l<library>"

config PK_MOTION_MEMORY_ALLOCATOR_KDEMO_CPPFLAGS
	string "CPPFLAGS: C/C++ preprocessor flags, e.g. -I<include dir>"

config PK_MOTION_MEMORY_ALLOCATOR_KDEMO_DPKCONFIG
	string "PKG_CONFIG_PATH: Directories to add to pkg-config's search path"

config PK_MOTION_MEMORY_ALLOCATOR_KDEMO_CFLAGS
	string "CFLAGS: C compiler flags"

config PK_MOTION_MEMORY_ALLOCATOR_KDEMO_LDFLAGS
	string "LDFLAGS: Linker flags"

config PK_MOTION_MEMORY_ALLOCATOR_KDEMO_CXXFLAGS
	string "CXXFLAGS: C++ compiler flags"

config PK_MOTION_MEMORY_ALLOCATOR_KDEMO_ASFLAGS
	string "CCASFLAGS: assembler compiler flags (defaults to CFLAGS)"

config PK_MOTION_MEMORY_ALLOCATOR_KDEMO_BUILDARCH
	string "--host options on configure for Architecture"

endif # PK_MOTION_MEMORY_ALLOCATOR_KDEMO
```

## package/MOTION-MEMORY/BiscuitOS-MOTION-MEMORY-ALLOCATOR-KERNEL/Kconfig
```kconfig
menuconfig PK_MOTION_MEMORY_ALLOCATOR_KERNEL
	bool "KERNEL ALLOCATOR"

if PK_MOTION_MEMORY_ALLOCATOR_KERNEL

config PK_MOTION_MEMORY_ALLOCATOR_KERNEL_VERSION
	default "default"
	string "verstion"

config PK_MOTION_MEMORY_ALLOCATOR_KERNEL_TAR
	default "tar.gz"
	string "tar type"

config PK_MOTION_MEMORY_ALLOCATOR_KERNEL_URL
	default "https://gitee.com/BiscuitOS_team/HardStack/raw/Gitee/MOTION/MEMORY/BiscuitOS-MOTION-MEMORY-ALLOCATOR-KERNEL"
	string "url"

config PK_MOTION_MEMORY_ALLOCATOR_KERNEL_GITHUB
	string "GitHub"

config PK_MOTION_MEMORY_ALLOCATOR_KERNEL_SRCFILE
	default "Kconfig  main.c  Makefile"
	string "Source code list"

config PK_MOTION_MEMORY_ALLOCATOR_KERNEL_CSRCFILE
	string "Compile source code list"

config PK_MOTION_MEMORY_ALLOCATOR_KERNEL_CONFIG
	string "CONFIG: Project Configure Options"

config PK_MOTION_MEMORY_ALLOCATOR_KERNEL_LIBPATH
	string "LIBS: Libraries to pass to the linker, e.g. -l<library>"

config PK_MOTION_MEMORY_ALLOCATOR_KERNEL_CPPFLAGS
	string "CPPFLAGS: C/C++ preprocessor flags, e.g. -I<include dir>"

config PK_MOTION_MEMORY_ALLOCATOR_KERNEL_DPKCONFIG
	string "PKG_CONFIG_PATH: Directories to add to pkg-config's search path"

config PK_MOTION_MEMORY_ALLOCATOR_KERNEL_CFLAGS
	string "CFLAGS: C compiler flags"

config PK_MOTION_MEMORY_ALLOCATOR_KERNEL_LDFLAGS
	string "LDFLAGS: Linker flags"

config PK_MOTION_MEMORY_ALLOCATOR_KERNEL_CXXFLAGS
	string "CXXFLAGS: C++ compiler flags"

config PK_MOTION_MEMORY_ALLOCATOR_KERNEL_ASFLAGS
	string "CCASFLAGS: assembler compiler flags (defaults to CFLAGS)"

config PK_MOTION_MEMORY_ALLOCATOR_KERNEL_BUILDARCH
	string "--host options on configure for Architecture"

endif # PK_MOTION_MEMORY_ALLOCATOR_KERNEL
```
