## package/MM-ERROR/BiscuitOS-MM-ERROR-Confuse-GFP-Flags-SLAB/Kconfig
```kconfig
menuconfig PK_MM_ERR_CONFUSE_GFP_FLAGS_SLAB
	bool ".... [SLAB/SLUB/SLOB] Confuse GFP Flags trigger Kernel BUG"

if PK_MM_ERR_CONFUSE_GFP_FLAGS_SLAB

config PK_MM_ERR_CONFUSE_GFP_FLAGS_SLAB_VERSION
	default "default"
	string "verstion"

config PK_MM_ERR_CONFUSE_GFP_FLAGS_SLAB_TAR
	default "tar.gz"
	string "tar type"

config PK_MM_ERR_CONFUSE_GFP_FLAGS_SLAB_URL
	default "https://gitee.com/BiscuitOS_team/HardStack/raw/Gitee/Memory-Allocator/MM-ERROR/BiscuitOS-MM-ERROR-Confuse-GFP-Flags-SLAB"
	string "url"

config PK_MM_ERR_CONFUSE_GFP_FLAGS_SLAB_GITHUB
	string "GitHub"

config PK_MM_ERR_CONFUSE_GFP_FLAGS_SLAB_SRCFILE
	default "main.c Kconfig Makefile"
	string "Source code list"

config PK_MM_ERR_CONFUSE_GFP_FLAGS_SLAB_CSRCFILE
	string "Compile source code list"

config PK_MM_ERR_CONFUSE_GFP_FLAGS_SLAB_CONFIG
	string "CONFIG: Project Configure Options"

config PK_MM_ERR_CONFUSE_GFP_FLAGS_SLAB_LIBPATH
	string "LIBS: Libraries to pass to the linker, e.g. -l<library>"

config PK_MM_ERR_CONFUSE_GFP_FLAGS_SLAB_CPPFLAGS
	string "CPPFLAGS: C/C++ preprocessor flags, e.g. -I<include dir>"

config PK_MM_ERR_CONFUSE_GFP_FLAGS_SLAB_DPKCONFIG
	string "PKG_CONFIG_PATH: Directories to add to pkg-config's search path"

config PK_MM_ERR_CONFUSE_GFP_FLAGS_SLAB_CFLAGS
	string "CFLAGS: C compiler flags"

config PK_MM_ERR_CONFUSE_GFP_FLAGS_SLAB_LDFLAGS
	string "LDFLAGS: Linker flags"

config PK_MM_ERR_CONFUSE_GFP_FLAGS_SLAB_CXXFLAGS
	string "CXXFLAGS: C++ compiler flags"

config PK_MM_ERR_CONFUSE_GFP_FLAGS_SLAB_ASFLAGS
	string "CCASFLAGS: assembler compiler flags (defaults to CFLAGS)"

config PK_MM_ERR_CONFUSE_GFP_FLAGS_SLAB_BUILDARCH
	string "--host options on configure for Architecture"

endif # PK_MM_ERR_CONFUSE_GFP_FLAGS_SLAB
```

## package/MM-ERROR/BiscuitOS-MM-ERROR-Confuse-GFP-Flags-VMALLOC/Kconfig
```kconfig
menuconfig PK_MM_ERR_CONFUSE_GFP_FLAGS_VMALLOC
	bool ".... [VMALLOC] Confuse GFP Flags trigger Kernel BUG"

if PK_MM_ERR_CONFUSE_GFP_FLAGS_VMALLOC

config PK_MM_ERR_CONFUSE_GFP_FLAGS_VMALLOC_VERSION
	default "default"
	string "verstion"

config PK_MM_ERR_CONFUSE_GFP_FLAGS_VMALLOC_TAR
	default "tar.gz"
	string "tar type"

config PK_MM_ERR_CONFUSE_GFP_FLAGS_VMALLOC_URL
	default "https://gitee.com/BiscuitOS_team/HardStack/raw/Gitee/Memory-Allocator/MM-ERROR/BiscuitOS-MM-ERROR-Confuse-GFP-Flags-VMALLOC"
	string "url"

config PK_MM_ERR_CONFUSE_GFP_FLAGS_VMALLOC_GITHUB
	string "GitHub"

config PK_MM_ERR_CONFUSE_GFP_FLAGS_VMALLOC_SRCFILE
	default "main.c Kconfig Makefile"
	string "Source code list"

config PK_MM_ERR_CONFUSE_GFP_FLAGS_VMALLOC_CSRCFILE
	string "Compile source code list"

config PK_MM_ERR_CONFUSE_GFP_FLAGS_VMALLOC_CONFIG
	string "CONFIG: Project Configure Options"

config PK_MM_ERR_CONFUSE_GFP_FLAGS_VMALLOC_LIBPATH
	string "LIBS: Libraries to pass to the linker, e.g. -l<library>"

config PK_MM_ERR_CONFUSE_GFP_FLAGS_VMALLOC_CPPFLAGS
	string "CPPFLAGS: C/C++ preprocessor flags, e.g. -I<include dir>"

config PK_MM_ERR_CONFUSE_GFP_FLAGS_VMALLOC_DPKCONFIG
	string "PKG_CONFIG_PATH: Directories to add to pkg-config's search path"

config PK_MM_ERR_CONFUSE_GFP_FLAGS_VMALLOC_CFLAGS
	string "CFLAGS: C compiler flags"

config PK_MM_ERR_CONFUSE_GFP_FLAGS_VMALLOC_LDFLAGS
	string "LDFLAGS: Linker flags"

config PK_MM_ERR_CONFUSE_GFP_FLAGS_VMALLOC_CXXFLAGS
	string "CXXFLAGS: C++ compiler flags"

config PK_MM_ERR_CONFUSE_GFP_FLAGS_VMALLOC_ASFLAGS
	string "CCASFLAGS: assembler compiler flags (defaults to CFLAGS)"

config PK_MM_ERR_CONFUSE_GFP_FLAGS_VMALLOC_BUILDARCH
	string "--host options on configure for Architecture"

endif # PK_MM_ERR_CONFUSE_GFP_FLAGS_VMALLOC
```

## package/MM-ERROR/BiscuitOS-MM-ERROR-Confuse-GFP-Flags/Kconfig
```kconfig
menuconfig PK_MM_ERR_CONFUSE_GFP_FLAGS
	bool "Confuse GFP Flags trigger Kernel BUG"

if PK_MM_ERR_CONFUSE_GFP_FLAGS

config PK_MM_ERR_CONFUSE_GFP_FLAGS_VERSION
	default "default"
	string "verstion"

config PK_MM_ERR_CONFUSE_GFP_FLAGS_TAR
	default "tar.gz"
	string "tar type"

config PK_MM_ERR_CONFUSE_GFP_FLAGS_URL
	default "https://gitee.com/BiscuitOS_team/HardStack/raw/Gitee/Memory-Allocator/MM-ERROR/BiscuitOS-MM-ERROR-Confuse-GFP-Flags"
	string "url"

config PK_MM_ERR_CONFUSE_GFP_FLAGS_GITHUB
	string "GitHub"

config PK_MM_ERR_CONFUSE_GFP_FLAGS_SRCFILE
	default "main.c Kconfig Makefile"
	string "Source code list"

config PK_MM_ERR_CONFUSE_GFP_FLAGS_CSRCFILE
	string "Compile source code list"

config PK_MM_ERR_CONFUSE_GFP_FLAGS_CONFIG
	string "CONFIG: Project Configure Options"

config PK_MM_ERR_CONFUSE_GFP_FLAGS_LIBPATH
	string "LIBS: Libraries to pass to the linker, e.g. -l<library>"

config PK_MM_ERR_CONFUSE_GFP_FLAGS_CPPFLAGS
	string "CPPFLAGS: C/C++ preprocessor flags, e.g. -I<include dir>"

config PK_MM_ERR_CONFUSE_GFP_FLAGS_DPKCONFIG
	string "PKG_CONFIG_PATH: Directories to add to pkg-config's search path"

config PK_MM_ERR_CONFUSE_GFP_FLAGS_CFLAGS
	string "CFLAGS: C compiler flags"

config PK_MM_ERR_CONFUSE_GFP_FLAGS_LDFLAGS
	string "LDFLAGS: Linker flags"

config PK_MM_ERR_CONFUSE_GFP_FLAGS_CXXFLAGS
	string "CXXFLAGS: C++ compiler flags"

config PK_MM_ERR_CONFUSE_GFP_FLAGS_ASFLAGS
	string "CCASFLAGS: assembler compiler flags (defaults to CFLAGS)"

config PK_MM_ERR_CONFUSE_GFP_FLAGS_BUILDARCH
	string "--host options on configure for Architecture"

endif # PK_MM_ERR_CONFUSE_GFP_FLAGS
```

## package/MM-ERROR/BiscuitOS-MM-ERROR-EARLY-IO-RSVDMEM-MT-OVER-MAXPHYS-RANGE/Kconfig
```kconfig
menuconfig PK_MM_ERR_EARLYIOMEM_OVERMAXPHYS_RANGE
	bool "EARLY-IOREMAP BUG: Overflow Max Physical Range"

if PK_MM_ERR_EARLYIOMEM_OVERMAXPHYS_RANGE

config PK_MM_ERR_EARLYIOMEM_OVERMAXPHYS_RANGE_VERSION
	default "default"
	string "verstion"

config PK_MM_ERR_EARLYIOMEM_OVERMAXPHYS_RANGE_TAR
	default "tar.gz"
	string "tar type"

config PK_MM_ERR_EARLYIOMEM_OVERMAXPHYS_RANGE_URL
	default "https://gitee.com/BiscuitOS_team/HardStack/raw/Gitee/Memory-Allocator/MM-ERROR/BiscuitOS-MM-ERROR-EARLY-IO-RSVDMEM-MT-OVER-MAXPHYS-RANGE"
	string "url"

config PK_MM_ERR_EARLYIOMEM_OVERMAXPHYS_RANGE_GITHUB
	string "GitHub"

config PK_MM_ERR_EARLYIOMEM_OVERMAXPHYS_RANGE_SRCFILE
	default "main.c Kconfig Makefile BiscuitOS_Insert.bs"
	string "Source code list"

config PK_MM_ERR_EARLYIOMEM_OVERMAXPHYS_RANGE_CSRCFILE
	string "Compile source code list"

config PK_MM_ERR_EARLYIOMEM_OVERMAXPHYS_RANGE_CONFIG
	string "CONFIG: Project Configure Options"

config PK_MM_ERR_EARLYIOMEM_OVERMAXPHYS_RANGE_LIBPATH
	string "LIBS: Libraries to pass to the linker, e.g. -l<library>"

config PK_MM_ERR_EARLYIOMEM_OVERMAXPHYS_RANGE_CPPFLAGS
	string "CPPFLAGS: C/C++ preprocessor flags, e.g. -I<include dir>"

config PK_MM_ERR_EARLYIOMEM_OVERMAXPHYS_RANGE_DPKCONFIG
	string "PKG_CONFIG_PATH: Directories to add to pkg-config's search path"

config PK_MM_ERR_EARLYIOMEM_OVERMAXPHYS_RANGE_CFLAGS
	string "CFLAGS: C compiler flags"

config PK_MM_ERR_EARLYIOMEM_OVERMAXPHYS_RANGE_LDFLAGS
	string "LDFLAGS: Linker flags"

config PK_MM_ERR_EARLYIOMEM_OVERMAXPHYS_RANGE_CXXFLAGS
	string "CXXFLAGS: C++ compiler flags"

config PK_MM_ERR_EARLYIOMEM_OVERMAXPHYS_RANGE_ASFLAGS
	string "CCASFLAGS: assembler compiler flags (defaults to CFLAGS)"

config PK_MM_ERR_EARLYIOMEM_OVERMAXPHYS_RANGE_BUILDARCH
	string "--host options on configure for Architecture"

endif # PK_MM_ERR_EARLYIOMEM_OVERMAXPHYS_RANGE
```

## package/MM-ERROR/BiscuitOS-MM-ERROR-EARLY-IO-RSVDMEM-MT-OVER-SLOT/Kconfig
```kconfig
menuconfig PK_MM_ERR_EARLYIOMEM_OVERSLOT
	bool "EARLY-IOREMAP BUG: No Free Slot"

if PK_MM_ERR_EARLYIOMEM_OVERSLOT

config PK_MM_ERR_EARLYIOMEM_OVERSLOT_VERSION
	default "default"
	string "verstion"

config PK_MM_ERR_EARLYIOMEM_OVERSLOT_TAR
	default "tar.gz"
	string "tar type"

config PK_MM_ERR_EARLYIOMEM_OVERSLOT_URL
	default "https://gitee.com/BiscuitOS_team/HardStack/raw/Gitee/Memory-Allocator/MM-ERROR/BiscuitOS-MM-ERROR-EARLY-IO-RSVDMEM-MT-OVER-SLOT"
	string "url"

config PK_MM_ERR_EARLYIOMEM_OVERSLOT_GITHUB
	string "GitHub"

config PK_MM_ERR_EARLYIOMEM_OVERSLOT_SRCFILE
	default "main.c Kconfig Makefile BiscuitOS_Insert.bs"
	string "Source code list"

config PK_MM_ERR_EARLYIOMEM_OVERSLOT_CSRCFILE
	string "Compile source code list"

config PK_MM_ERR_EARLYIOMEM_OVERSLOT_CONFIG
	string "CONFIG: Project Configure Options"

config PK_MM_ERR_EARLYIOMEM_OVERSLOT_LIBPATH
	string "LIBS: Libraries to pass to the linker, e.g. -l<library>"

config PK_MM_ERR_EARLYIOMEM_OVERSLOT_CPPFLAGS
	string "CPPFLAGS: C/C++ preprocessor flags, e.g. -I<include dir>"

config PK_MM_ERR_EARLYIOMEM_OVERSLOT_DPKCONFIG
	string "PKG_CONFIG_PATH: Directories to add to pkg-config's search path"

config PK_MM_ERR_EARLYIOMEM_OVERSLOT_CFLAGS
	string "CFLAGS: C compiler flags"

config PK_MM_ERR_EARLYIOMEM_OVERSLOT_LDFLAGS
	string "LDFLAGS: Linker flags"

config PK_MM_ERR_EARLYIOMEM_OVERSLOT_CXXFLAGS
	string "CXXFLAGS: C++ compiler flags"

config PK_MM_ERR_EARLYIOMEM_OVERSLOT_ASFLAGS
	string "CCASFLAGS: assembler compiler flags (defaults to CFLAGS)"

config PK_MM_ERR_EARLYIOMEM_OVERSLOT_BUILDARCH
	string "--host options on configure for Architecture"

endif # PK_MM_ERR_EARLYIOMEM_OVERSLOT
```

## package/MM-ERROR/BiscuitOS-MM-ERROR-EARLY-IO-RSVDMEM-MT-OVERLIFE/Kconfig
```kconfig
menuconfig PK_MM_ERR_EARLYIOMEM_OVERLIFE
	bool "Early-IOREMAP BUG: Invoke over-life"

if PK_MM_ERR_EARLYIOMEM_OVERLIFE

config PK_MM_ERR_EARLYIOMEM_OVERLIFE_VERSION
	default "default"
	string "verstion"

config PK_MM_ERR_EARLYIOMEM_OVERLIFE_TAR
	default "tar.gz"
	string "tar type"

config PK_MM_ERR_EARLYIOMEM_OVERLIFE_URL
	default "https://gitee.com/BiscuitOS_team/HardStack/raw/Gitee/Memory-Allocator/MM-ERROR/BiscuitOS-MM-ERROR-EARLY-IO-RSVDMEM-MT-OVERLIFE"
	string "url"

config PK_MM_ERR_EARLYIOMEM_OVERLIFE_GITHUB
	string "GitHub"

config PK_MM_ERR_EARLYIOMEM_OVERLIFE_SRCFILE
	default "main.c Kconfig Makefile"
	string "Source code list"

config PK_MM_ERR_EARLYIOMEM_OVERLIFE_CSRCFILE
	string "Compile source code list"

config PK_MM_ERR_EARLYIOMEM_OVERLIFE_CONFIG
	string "CONFIG: Project Configure Options"

config PK_MM_ERR_EARLYIOMEM_OVERLIFE_LIBPATH
	string "LIBS: Libraries to pass to the linker, e.g. -l<library>"

config PK_MM_ERR_EARLYIOMEM_OVERLIFE_CPPFLAGS
	string "CPPFLAGS: C/C++ preprocessor flags, e.g. -I<include dir>"

config PK_MM_ERR_EARLYIOMEM_OVERLIFE_DPKCONFIG
	string "PKG_CONFIG_PATH: Directories to add to pkg-config's search path"

config PK_MM_ERR_EARLYIOMEM_OVERLIFE_CFLAGS
	string "CFLAGS: C compiler flags"

config PK_MM_ERR_EARLYIOMEM_OVERLIFE_LDFLAGS
	string "LDFLAGS: Linker flags"

config PK_MM_ERR_EARLYIOMEM_OVERLIFE_CXXFLAGS
	string "CXXFLAGS: C++ compiler flags"

config PK_MM_ERR_EARLYIOMEM_OVERLIFE_ASFLAGS
	string "CCASFLAGS: assembler compiler flags (defaults to CFLAGS)"

config PK_MM_ERR_EARLYIOMEM_OVERLIFE_BUILDARCH
	string "--host options on configure for Architecture"

endif # PK_MM_ERR_EARLYIOMEM_OVERLIFE
```

## package/MM-ERROR/BiscuitOS-MM-ERROR-EARLY-IO-RSVDMEM-MT-UESIZE/Kconfig
```kconfig
menuconfig PK_MM_ERR_EARLYIOMEM_UESIZE
	bool "EARLY-IOREMAP BUG: Free Uncorrect Size"

if PK_MM_ERR_EARLYIOMEM_UESIZE

config PK_MM_ERR_EARLYIOMEM_UESIZE_VERSION
	default "default"
	string "verstion"

config PK_MM_ERR_EARLYIOMEM_UESIZE_TAR
	default "tar.gz"
	string "tar type"

config PK_MM_ERR_EARLYIOMEM_UESIZE_URL
	default "https://gitee.com/BiscuitOS_team/HardStack/raw/Gitee/Memory-Allocator/MM-ERROR/BiscuitOS-MM-ERROR-EARLY-IO-RSVDMEM-MT-UESIZE"
	string "url"

config PK_MM_ERR_EARLYIOMEM_UESIZE_GITHUB
	string "GitHub"

config PK_MM_ERR_EARLYIOMEM_UESIZE_SRCFILE
	default "main.c Kconfig Makefile BiscuitOS_Insert.bs"
	string "Source code list"

config PK_MM_ERR_EARLYIOMEM_UESIZE_CSRCFILE
	string "Compile source code list"

config PK_MM_ERR_EARLYIOMEM_UESIZE_CONFIG
	string "CONFIG: Project Configure Options"

config PK_MM_ERR_EARLYIOMEM_UESIZE_LIBPATH
	string "LIBS: Libraries to pass to the linker, e.g. -l<library>"

config PK_MM_ERR_EARLYIOMEM_UESIZE_CPPFLAGS
	string "CPPFLAGS: C/C++ preprocessor flags, e.g. -I<include dir>"

config PK_MM_ERR_EARLYIOMEM_UESIZE_DPKCONFIG
	string "PKG_CONFIG_PATH: Directories to add to pkg-config's search path"

config PK_MM_ERR_EARLYIOMEM_UESIZE_CFLAGS
	string "CFLAGS: C compiler flags"

config PK_MM_ERR_EARLYIOMEM_UESIZE_LDFLAGS
	string "LDFLAGS: Linker flags"

config PK_MM_ERR_EARLYIOMEM_UESIZE_CXXFLAGS
	string "CXXFLAGS: C++ compiler flags"

config PK_MM_ERR_EARLYIOMEM_UESIZE_ASFLAGS
	string "CCASFLAGS: assembler compiler flags (defaults to CFLAGS)"

config PK_MM_ERR_EARLYIOMEM_UESIZE_BUILDARCH
	string "--host options on configure for Architecture"

endif # PK_MM_ERR_EARLYIOMEM_UESIZE
```

## package/MM-ERROR/BiscuitOS-MM-ERROR-EARLY-IO-RSVDMEM-MT-UNFREE/Kconfig
```kconfig
menuconfig PK_MM_ERR_EARLYIOMEM_UNFREE
	bool "EARLY-IOREMAP BUG: Ignore Free"

if PK_MM_ERR_EARLYIOMEM_UNFREE

config PK_MM_ERR_EARLYIOMEM_UNFREE_VERSION
	default "default"
	string "verstion"

config PK_MM_ERR_EARLYIOMEM_UNFREE_TAR
	default "tar.gz"
	string "tar type"

config PK_MM_ERR_EARLYIOMEM_UNFREE_URL
	default "https://gitee.com/BiscuitOS_team/HardStack/raw/Gitee/Memory-Allocator/MM-ERROR/BiscuitOS-MM-ERROR-EARLY-IO-RSVDMEM-MT-UNFREE"
	string "url"

config PK_MM_ERR_EARLYIOMEM_UNFREE_GITHUB
	string "GitHub"

config PK_MM_ERR_EARLYIOMEM_UNFREE_SRCFILE
	default "main.c Kconfig Makefile BiscuitOS_Insert.bs"
	string "Source code list"

config PK_MM_ERR_EARLYIOMEM_UNFREE_CSRCFILE
	string "Compile source code list"

config PK_MM_ERR_EARLYIOMEM_UNFREE_CONFIG
	string "CONFIG: Project Configure Options"

config PK_MM_ERR_EARLYIOMEM_UNFREE_LIBPATH
	string "LIBS: Libraries to pass to the linker, e.g. -l<library>"

config PK_MM_ERR_EARLYIOMEM_UNFREE_CPPFLAGS
	string "CPPFLAGS: C/C++ preprocessor flags, e.g. -I<include dir>"

config PK_MM_ERR_EARLYIOMEM_UNFREE_DPKCONFIG
	string "PKG_CONFIG_PATH: Directories to add to pkg-config's search path"

config PK_MM_ERR_EARLYIOMEM_UNFREE_CFLAGS
	string "CFLAGS: C compiler flags"

config PK_MM_ERR_EARLYIOMEM_UNFREE_LDFLAGS
	string "LDFLAGS: Linker flags"

config PK_MM_ERR_EARLYIOMEM_UNFREE_CXXFLAGS
	string "CXXFLAGS: C++ compiler flags"

config PK_MM_ERR_EARLYIOMEM_UNFREE_ASFLAGS
	string "CCASFLAGS: assembler compiler flags (defaults to CFLAGS)"

config PK_MM_ERR_EARLYIOMEM_UNFREE_BUILDARCH
	string "--host options on configure for Architecture"

endif # PK_MM_ERR_EARLYIOMEM_UNFREE
```
