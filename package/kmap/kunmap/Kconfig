## package/kvm/BiscuitOS-qemu-kvm-1G/Kconfig
```kconfig
menuconfig PK_BISCUITOS_QEMU_KVM_1G
	bool "QEMU KVM 1G HugePage on BiscuitOS+"

if PK_BISCUITOS_QEMU_KVM_1G

config PK_BISCUITOS_QEMU_KVM_1G_VERSION
	default "4.0.0"
	string "verstion"

config PK_BISCUITOS_QEMU_KVM_1G_TAR
	default "tar.xz"
	string "tar type"

config PK_BISCUITOS_QEMU_KVM_1G_URL
	default "https://download.qemu.org/"
	string "url"

config PK_BISCUITOS_QEMU_KVM_1G_GITHUB
	string "GitHub"

config PK_BISCUITOS_QEMU_KVM_1G_SRCFILE
	string "Source code list"

config PK_BISCUITOS_QEMU_KVM_1G_CONFIG
	default "--target-list=x86_64-softmmu --enable-kvm --enable-virtfs --static --disable-libusb --audio-drv-list=oss --disable-werror --disable-gtk"
	string "CONFIG: Project Configure Options"

config PK_BISCUITOS_QEMU_KVM_1G_LIBPATH
	string "LIBS: Libraries to pass to the linker, e.g. -l<library>"

config PK_BISCUITOS_QEMU_KVM_1G_CPPFLAGS
	string "CPPFLAGS: C/C++ preprocessor flags, e.g. -I<include dir>"

config PK_BISCUITOS_QEMU_KVM_1G_DPKCONFIG
	string "PKG_CONFIG_PATH: Directories to add to pkg-config's search path"

config PK_BISCUITOS_QEMU_KVM_1G_CFLAGS
	string "CFLAGS: C compiler flags"

config PK_BISCUITOS_QEMU_KVM_1G_LDFLAGS
	string "LDFLAGS: Linker flags"

config PK_BISCUITOS_QEMU_KVM_1G_CXXFLAGS
	string "CXXFLAGS: C++ compiler flags"

config PK_BISCUITOS_QEMU_KVM_1G_ASFLAGS
	string "CCASFLAGS: assembler compiler flags (defaults to CFLAGS)"

config PK_BISCUITOS_QEMU_KVM_1G_BUILDARCH
	default "x86_64-unknown-linux-gnu"
	string "--host options on configure for Architecture"

endif # PK_BISCUITOS_QEMU_KVM_1G
```

## package/kvm/BiscuitOS-qemu-kvm-2M/Kconfig
```kconfig
menuconfig PK_BISCUITOS_QEMU_KVM_2M
	bool "QEMU KVM 2M HugePage on BiscuitOS+"

if PK_BISCUITOS_QEMU_KVM_2M

config PK_BISCUITOS_QEMU_KVM_2M_VERSION
	default "4.0.0"
	string "verstion"

config PK_BISCUITOS_QEMU_KVM_2M_TAR
	default "tar.xz"
	string "tar type"

config PK_BISCUITOS_QEMU_KVM_2M_URL
	default "https://download.qemu.org/"
	string "url"

config PK_BISCUITOS_QEMU_KVM_2M_GITHUB
	string "GitHub"

config PK_BISCUITOS_QEMU_KVM_2M_SRCFILE
	string "Source code list"

config PK_BISCUITOS_QEMU_KVM_2M_CONFIG
	default "--target-list=x86_64-softmmu --enable-kvm --enable-virtfs --static --disable-libusb --audio-drv-list=oss --disable-werror"
	string "CONFIG: Project Configure Options"

config PK_BISCUITOS_QEMU_KVM_2M_LIBPATH
	string "LIBS: Libraries to pass to the linker, e.g. -l<library>"

config PK_BISCUITOS_QEMU_KVM_2M_CPPFLAGS
	string "CPPFLAGS: C/C++ preprocessor flags, e.g. -I<include dir>"

config PK_BISCUITOS_QEMU_KVM_2M_DPKCONFIG
	string "PKG_CONFIG_PATH: Directories to add to pkg-config's search path"

config PK_BISCUITOS_QEMU_KVM_2M_CFLAGS
	string "CFLAGS: C compiler flags"

config PK_BISCUITOS_QEMU_KVM_2M_LDFLAGS
	string "LDFLAGS: Linker flags"

config PK_BISCUITOS_QEMU_KVM_2M_CXXFLAGS
	string "CXXFLAGS: C++ compiler flags"

config PK_BISCUITOS_QEMU_KVM_2M_ASFLAGS
	string "CCASFLAGS: assembler compiler flags (defaults to CFLAGS)"

config PK_BISCUITOS_QEMU_KVM_2M_BUILDARCH
	default "x86_64-unknown-linux-gnu"
	string "--host options on configure for Architecture"

endif # PK_BISCUITOS_QEMU_KVM_2M
```

## package/kvm/BiscuitOS-qemu-kvm/Kconfig
```kconfig
menuconfig PK_BISCUITOS_QEMU_KVM
	bool "QEMU KVM on BiscuitOS+"

if PK_BISCUITOS_QEMU_KVM

config PK_BISCUITOS_QEMU_KVM_VERSION
	default "4.0.0"
	string "verstion"

config PK_BISCUITOS_QEMU_KVM_TAR
	default "tar.xz"
	string "tar type"

config PK_BISCUITOS_QEMU_KVM_URL
	default "https://download.qemu.org/"
	string "url"

config PK_BISCUITOS_QEMU_KVM_GITHUB
	string "GitHub"

config PK_BISCUITOS_QEMU_KVM_SRCFILE
	string "Source code list"

config PK_BISCUITOS_QEMU_KVM_CONFIG
	default "--target-list=x86_64-softmmu --enable-kvm --enable-virtfs --static --disable-libusb --audio-drv-list=oss --disable-werror"
	string "CONFIG: Project Configure Options"

config PK_BISCUITOS_QEMU_KVM_LIBPATH
	string "LIBS: Libraries to pass to the linker, e.g. -l<library>"

config PK_BISCUITOS_QEMU_KVM_CPPFLAGS
	string "CPPFLAGS: C/C++ preprocessor flags, e.g. -I<include dir>"

config PK_BISCUITOS_QEMU_KVM_DPKCONFIG
	string "PKG_CONFIG_PATH: Directories to add to pkg-config's search path"

config PK_BISCUITOS_QEMU_KVM_CFLAGS
	string "CFLAGS: C compiler flags"

config PK_BISCUITOS_QEMU_KVM_LDFLAGS
	string "LDFLAGS: Linker flags"

config PK_BISCUITOS_QEMU_KVM_CXXFLAGS
	string "CXXFLAGS: C++ compiler flags"

config PK_BISCUITOS_QEMU_KVM_ASFLAGS
	string "CCASFLAGS: assembler compiler flags (defaults to CFLAGS)"

config PK_BISCUITOS_QEMU_KVM_BUILDARCH
	default "x86_64-unknown-linux-gnu"
	string "--host options on configure for Architecture"

endif # PK_BISCUITOS_QEMU_KVM
```
