## package/kvm/BiscuitOS-Broiler/Kconfig
```kconfig
menuconfig PK_BROILER
	bool "BiscuitOS hyperv: Broiler"

if PK_BROILER

config PK_BROILER_VERSION
	default "default"
	string "verstion"

config PK_BROILER_TAR
	default "tar.xz"
	string "tar type"

config PK_BROILER_URL
	default ""
	string "url"

config PK_BROILER_GITHUB
	default "https://gitee.com/BiscuitOS_team/broiler.git"
	string "github"

config PK_BROILER_SRCFILE
	string "Source code list"

config PK_BROILER_CONFIG
	default ""
	string "CONFIG: Project Configure Options"

config PK_BROILER_LIBPATH
	string "LIBS: Libraries to pass to the linker, e.g. -l<library>"

config PK_BROILER_CPPFLAGS
	string "CPPFLAGS: C/C++ preprocessor flags, e.g. -I<include dir>"

config PK_BROILER_DPKCONFIG
	string "PKG_CONFIG_PATH: Directories to add to pkg-config's search path"

config PK_BROILER_CFLAGS
	string "CFLAGS: C compiler flags"

config PK_BROILER_LDFLAGS
	default "-static"
	string "LDFLAGS: Linker flags"

config PK_BROILER_CXXFLAGS
	string "CXXFLAGS: C++ compiler flags"

config PK_BROILER_ASFLAGS
	string "CCASFLAGS: assembler compiler flags (defaults to CFLAGS)"

config PK_BROILER_BUILDARCH
	default "x86_64-unknown-linux-gnu"
	string "--host options on configure for Architecture"

endif # PK_BROILER
```

## package/kvm/BiscuitOS-QEMU-PCI-module/Kconfig
```kconfig
menuconfig PK_BISCUITOS_QEMU_PCI_MOD
	bool "PCI Device Drive for QEMU on BiscuitOS"

if PK_BISCUITOS_QEMU_PCI_MOD

config PK_BISCUITOS_QEMU_PCI_MOD_VERSION
	default "0.0.1"
	string "verstion"

config PK_BISCUITOS_QEMU_PCI_MOD_TAR
	default "tar.gz"
	string "tar type"

config PK_BISCUITOS_QEMU_PCI_MOD_URL
	default "https://gitee.com/BiscuitOS_team/HardStack/raw/Gitee/Virtualization/QEMU/PCI/PCI-Common-Driver"
	string "url"

config PK_BISCUITOS_QEMU_PCI_MOD_GITHUB
	string "GitHub"

config PK_BISCUITOS_QEMU_PCI_MOD_SRCFILE
	default "main.c Kconfig Makefile"
	string "Source code list"

config PK_BISCUITOS_QEMU_PCI_MOD_CSRCFILE
	string "Compile source code list"

config PK_BISCUITOS_QEMU_PCI_MOD_CONFIG
	string "CONFIG: Project Configure Options"

config PK_BISCUITOS_QEMU_PCI_MOD_LIBPATH
	string "LIBS: Libraries to pass to the linker, e.g. -l<library>"

config PK_BISCUITOS_QEMU_PCI_MOD_CPPFLAGS
	string "CPPFLAGS: C/C++ preprocessor flags, e.g. -I<include dir>"

config PK_BISCUITOS_QEMU_PCI_MOD_DPKCONFIG
	string "PKG_CONFIG_PATH: Directories to add to pkg-config's search path"

config PK_BISCUITOS_QEMU_PCI_MOD_CFLAGS
	string "CFLAGS: C compiler flags"

config PK_BISCUITOS_QEMU_PCI_MOD_LDFLAGS
	string "LDFLAGS: Linker flags"

config PK_BISCUITOS_QEMU_PCI_MOD_CXXFLAGS
	string "CXXFLAGS: C++ compiler flags"

config PK_BISCUITOS_QEMU_PCI_MOD_ASFLAGS
	string "CCASFLAGS: assembler compiler flags (defaults to CFLAGS)"

config PK_BISCUITOS_QEMU_PCI_MOD_BUILDARCH
	string "--host options on configure for Architecture"

endif # PK_BISCUITOS_QEMU_PCI_MOD
```

## package/kvm/BiscuitOS-UKVM-1G/Kconfig
```kconfig
menuconfig PK_BISCUITOS_UKVM_1G
	bool "KVM Application on BiscuitOS (1Gig HugePage)"

if PK_BISCUITOS_UKVM_1G

config PK_BISCUITOS_UKVM_1G_VERSION
	default "default"
	string "verstion"

config PK_BISCUITOS_UKVM_1G_TAR
	default "tar.gz"
	string "tar type"

config PK_BISCUITOS_UKVM_1G_URL
	default "https://gitee.com/BiscuitOS_team/HardStack/raw/Gitee/Virtualization/KVM/BiscuitOS-UKVM-1G"
	string "url"

config PK_BISCUITOS_UKVM_1G_GITHUB
	string "GitHub"

config PK_BISCUITOS_UKVM_1G_SRCFILE
	default "main.c Makefile BiscuitOS-Virtual-Machine.S RunBiscuitOS.sh"
	string "Source code list"

config PK_BISCUITOS_UKVM_1G_CSRCFILE
	string "Compile source code list"

config PK_BISCUITOS_UKVM_1G_CONFIG
	string "CONFIG: Project Configure Options"

config PK_BISCUITOS_UKVM_1G_LIBPATH
	string "LIBS: Libraries to pass to the linker, e.g. -l<library>"

config PK_BISCUITOS_UKVM_1G_CPPFLAGS
	string "CPPFLAGS: C/C++ preprocessor flags, e.g. -I<include dir>"

config PK_BISCUITOS_UKVM_1G_DPKCONFIG
	string "PKG_CONFIG_PATH: Directories to add to pkg-config's search path"

config PK_BISCUITOS_UKVM_1G_CFLAGS
	string "CFLAGS: C compiler flags"

config PK_BISCUITOS_UKVM_1G_LDFLAGS
	string "LDFLAGS: Linker flags"

config PK_BISCUITOS_UKVM_1G_CXXFLAGS
	string "CXXFLAGS: C++ compiler flags"

config PK_BISCUITOS_UKVM_1G_ASFLAGS
	string "CCASFLAGS: assembler compiler flags (defaults to CFLAGS)"

config PK_BISCUITOS_UKVM_1G_BUILDARCH
	string "--host options on configure for Architecture"

endif # PK_BISCUITOS_UKVM_1G
```

## package/kvm/BiscuitOS-UKVM-2M/Kconfig
```kconfig
menuconfig PK_BISCUITOS_UKVM_2M
	bool "KVM Application on BiscuitOS (2MiB HugePage)"

if PK_BISCUITOS_UKVM_2M

config PK_BISCUITOS_UKVM_2M_VERSION
	default "default"
	string "verstion"

config PK_BISCUITOS_UKVM_2M_TAR
	default "tar.gz"
	string "tar type"

config PK_BISCUITOS_UKVM_2M_URL
	default "https://gitee.com/BiscuitOS_team/HardStack/raw/Gitee/Virtualization/KVM/BiscuitOS-UKVM-2M"
	string "url"

config PK_BISCUITOS_UKVM_2M_GITHUB
	string "GitHub"

config PK_BISCUITOS_UKVM_2M_SRCFILE
	default "main.c Makefile BiscuitOS-Virtual-Machine.S RunBiscuitOS.sh"
	string "Source code list"

config PK_BISCUITOS_UKVM_2M_CSRCFILE
	string "Compile source code list"

config PK_BISCUITOS_UKVM_2M_CONFIG
	string "CONFIG: Project Configure Options"

config PK_BISCUITOS_UKVM_2M_LIBPATH
	string "LIBS: Libraries to pass to the linker, e.g. -l<library>"

config PK_BISCUITOS_UKVM_2M_CPPFLAGS
	string "CPPFLAGS: C/C++ preprocessor flags, e.g. -I<include dir>"

config PK_BISCUITOS_UKVM_2M_DPKCONFIG
	string "PKG_CONFIG_PATH: Directories to add to pkg-config's search path"

config PK_BISCUITOS_UKVM_2M_CFLAGS
	string "CFLAGS: C compiler flags"

config PK_BISCUITOS_UKVM_2M_LDFLAGS
	string "LDFLAGS: Linker flags"

config PK_BISCUITOS_UKVM_2M_CXXFLAGS
	string "CXXFLAGS: C++ compiler flags"

config PK_BISCUITOS_UKVM_2M_ASFLAGS
	string "CCASFLAGS: assembler compiler flags (defaults to CFLAGS)"

config PK_BISCUITOS_UKVM_2M_BUILDARCH
	string "--host options on configure for Architecture"

endif # PK_BISCUITOS_UKVM_2M
```

## package/kvm/BiscuitOS-UKVM-SMAP-kernel/Kconfig
```kconfig
menuconfig PK_BISCUITOS_UKVM_SMAP_KERNEL
	bool "KVM App Specific MMAP on BiscuitOS (Kernel+)"

if PK_BISCUITOS_UKVM_SMAP_KERNEL

config PK_BISCUITOS_UKVM_SMAP_KERNEL_VERSION
	default "kernel"
	string "verstion"

config PK_BISCUITOS_UKVM_SMAP_KERNEL_TAR
	default "tar.gz"
	string "tar type"

config PK_BISCUITOS_UKVM_SMAP_KERNEL_URL
	default "https://gitee.com/BiscuitOS_team/HardStack/raw/Gitee/Virtualization/KVM/BiscuitOS-UKVM-Specific-mmap/kernel"
	string "url"

config PK_BISCUITOS_UKVM_SMAP_KERNEL_GITHUB
	string "GitHub"

config PK_BISCUITOS_UKVM_SMAP_KERNEL_SRCFILE
	default "main.c Kconfig Makefile"
	string "Source code list"

config PK_BISCUITOS_UKVM_SMAP_KERNEL_CSRCFILE
	string "Compile source code list"

config PK_BISCUITOS_UKVM_SMAP_KERNEL_CONFIG
	string "CONFIG: Project Configure Options"

config PK_BISCUITOS_UKVM_SMAP_KERNEL_LIBPATH
	string "LIBS: Libraries to pass to the linker, e.g. -l<library>"

config PK_BISCUITOS_UKVM_SMAP_KERNEL_CPPFLAGS
	string "CPPFLAGS: C/C++ preprocessor flags, e.g. -I<include dir>"

config PK_BISCUITOS_UKVM_SMAP_KERNEL_DPKCONFIG
	string "PKG_CONFIG_PATH: Directories to add to pkg-config's search path"

config PK_BISCUITOS_UKVM_SMAP_KERNEL_CFLAGS
	string "CFLAGS: C compiler flags"

config PK_BISCUITOS_UKVM_SMAP_KERNEL_LDFLAGS
	string "LDFLAGS: Linker flags"

config PK_BISCUITOS_UKVM_SMAP_KERNEL_CXXFLAGS
	string "CXXFLAGS: C++ compiler flags"

config PK_BISCUITOS_UKVM_SMAP_KERNEL_ASFLAGS
	string "CCASFLAGS: assembler compiler flags (defaults to CFLAGS)"

config PK_BISCUITOS_UKVM_SMAP_KERNEL_BUILDARCH
	string "--host options on configure for Architecture"

endif # PK_BISCUITOS_UKVM_SMAP_KERNEL
```

## package/kvm/BiscuitOS-UKVM-SMAP-userspace/Kconfig
```kconfig
menuconfig PK_BISCUITOS_UKVM_SMAP_USER
	select PK_BISCUITOS_UKVM_SMAP_KERNEL
	bool "KVM App Specific MMAP on BiscuitOS (Userspace+)"

if PK_BISCUITOS_UKVM_SMAP_USER

config PK_BISCUITOS_UKVM_SMAP_USER_VERSION
	default "userspace"
	string "verstion"

config PK_BISCUITOS_UKVM_SMAP_USER_TAR
	default "tar.gz"
	string "tar type"

config PK_BISCUITOS_UKVM_SMAP_USER_URL
	default "https://gitee.com/BiscuitOS_team/HardStack/raw/Gitee/Virtualization/KVM/BiscuitOS-UKVM-Specific-mmap/userspace"
	string "url"

config PK_BISCUITOS_UKVM_SMAP_USER_GITHUB
	string "GitHub"

config PK_BISCUITOS_UKVM_SMAP_USER_SRCFILE
	default "main.c Makefile BiscuitOS-Virtual-Machine.S RunBiscuitOS.sh"
	string "Source code list"

config PK_BISCUITOS_UKVM_SMAP_USER_CSRCFILE
	string "Compile source code list"

config PK_BISCUITOS_UKVM_SMAP_USER_CONFIG
	string "CONFIG: Project Configure Options"

config PK_BISCUITOS_UKVM_SMAP_USER_LIBPATH
	string "LIBS: Libraries to pass to the linker, e.g. -l<library>"

config PK_BISCUITOS_UKVM_SMAP_USER_CPPFLAGS
	string "CPPFLAGS: C/C++ preprocessor flags, e.g. -I<include dir>"

config PK_BISCUITOS_UKVM_SMAP_USER_DPKCONFIG
	string "PKG_CONFIG_PATH: Directories to add to pkg-config's search path"

config PK_BISCUITOS_UKVM_SMAP_USER_CFLAGS
	string "CFLAGS: C compiler flags"

config PK_BISCUITOS_UKVM_SMAP_USER_LDFLAGS
	string "LDFLAGS: Linker flags"

config PK_BISCUITOS_UKVM_SMAP_USER_CXXFLAGS
	string "CXXFLAGS: C++ compiler flags"

config PK_BISCUITOS_UKVM_SMAP_USER_ASFLAGS
	string "CCASFLAGS: assembler compiler flags (defaults to CFLAGS)"

config PK_BISCUITOS_UKVM_SMAP_USER_BUILDARCH
	string "--host options on configure for Architecture"

endif # PK_BISCUITOS_UKVM_SMAP_USER
```

## package/kvm/BiscuitOS-UKVM/Kconfig
```kconfig
menuconfig PK_BISCUITOS_UKVM
	bool "KVM Application on BiscuitOS (Default)"

if PK_BISCUITOS_UKVM

config PK_BISCUITOS_UKVM_VERSION
	default "default"
	string "verstion"

config PK_BISCUITOS_UKVM_TAR
	default "tar.gz"
	string "tar type"

config PK_BISCUITOS_UKVM_URL
	default "https://gitee.com/BiscuitOS_team/HardStack/raw/Gitee/Virtualization/KVM/BiscuitOS-UKVM"
	string "url"

config PK_BISCUITOS_UKVM_GITHUB
	string "GitHub"

config PK_BISCUITOS_UKVM_SRCFILE
	default "main.c Makefile BiscuitOS-Virtual-Machine.S"
	string "Source code list"

config PK_BISCUITOS_UKVM_CSRCFILE
	string "Compile source code list"

config PK_BISCUITOS_UKVM_CONFIG
	string "CONFIG: Project Configure Options"

config PK_BISCUITOS_UKVM_LIBPATH
	string "LIBS: Libraries to pass to the linker, e.g. -l<library>"

config PK_BISCUITOS_UKVM_CPPFLAGS
	string "CPPFLAGS: C/C++ preprocessor flags, e.g. -I<include dir>"

config PK_BISCUITOS_UKVM_DPKCONFIG
	string "PKG_CONFIG_PATH: Directories to add to pkg-config's search path"

config PK_BISCUITOS_UKVM_CFLAGS
	string "CFLAGS: C compiler flags"

config PK_BISCUITOS_UKVM_LDFLAGS
	string "LDFLAGS: Linker flags"

config PK_BISCUITOS_UKVM_CXXFLAGS
	string "CXXFLAGS: C++ compiler flags"

config PK_BISCUITOS_UKVM_ASFLAGS
	string "CCASFLAGS: assembler compiler flags (defaults to CFLAGS)"

config PK_BISCUITOS_UKVM_BUILDARCH
	string "--host options on configure for Architecture"

endif # PK_BISCUITOS_UKVM
```

## package/kvm/BiscuitOS-kvmtools-2M/Kconfig
```kconfig
menuconfig PK_BISCUITOS_KVM_TOOLS_2M
	bool "Native Linux KVM tool (2M Hugepage) on BiscuitOS+"

if PK_BISCUITOS_KVM_TOOLS_2M

config PK_BISCUITOS_KVM_TOOLS_2M_VERSION
	default "github"
	string "verstion"

config PK_BISCUITOS_KVM_TOOLS_2M_TAR
	default "tar.xz"
	string "tar type"

config PK_BISCUITOS_KVM_TOOLS_2M_URL
	default "https://download.qemu.org/"
	string "url"

config PK_BISCUITOS_KVM_TOOLS_2M_GITHUB
	default "https://github.com/kvmtool/kvmtool.git"
	string "github"

config PK_BISCUITOS_KVM_TOOLS_2M_SRCFILE
	string "Source code list"

config PK_BISCUITOS_KVM_TOOLS_2M_CONFIG
	default ""
	string "CONFIG: Project Configure Options"

config PK_BISCUITOS_KVM_TOOLS_2M_LIBPATH
	string "LIBS: Libraries to pass to the linker, e.g. -l<library>"

config PK_BISCUITOS_KVM_TOOLS_2M_CPPFLAGS
	string "CPPFLAGS: C/C++ preprocessor flags, e.g. -I<include dir>"

config PK_BISCUITOS_KVM_TOOLS_2M_DPKCONFIG
	string "PKG_CONFIG_PATH: Directories to add to pkg-config's search path"

config PK_BISCUITOS_KVM_TOOLS_2M_CFLAGS
	string "CFLAGS: C compiler flags"

config PK_BISCUITOS_KVM_TOOLS_2M_LDFLAGS
	default "-static"
	string "LDFLAGS: Linker flags"

config PK_BISCUITOS_KVM_TOOLS_2M_CXXFLAGS
	string "CXXFLAGS: C++ compiler flags"

config PK_BISCUITOS_KVM_TOOLS_2M_ASFLAGS
	string "CCASFLAGS: assembler compiler flags (defaults to CFLAGS)"

config PK_BISCUITOS_KVM_TOOLS_2M_BUILDARCH
	default "x86_64-unknown-linux-gnu"
	string "--host options on configure for Architecture"

endif # PK_BISCUITOS_KVM_TOOLS_2M
```

## package/kvm/BiscuitOS-kvmtools/Kconfig
```kconfig
menuconfig PK_BISCUITOS_KVM_TOOLS
	bool "Native Linux KVM tool on BiscuitOS+"

if PK_BISCUITOS_KVM_TOOLS

config PK_BISCUITOS_KVM_TOOLS_VERSION
	default "github"
	string "verstion"

config PK_BISCUITOS_KVM_TOOLS_TAR
	default "tar.xz"
	string "tar type"

config PK_BISCUITOS_KVM_TOOLS_URL
	default "https://download.qemu.org/"
	string "url"

config PK_BISCUITOS_KVM_TOOLS_GITHUB
	default "https://github.com/kvmtool/kvmtool.git"
	string "github"

config PK_BISCUITOS_KVM_TOOLS_SRCFILE
	string "Source code list"

config PK_BISCUITOS_KVM_TOOLS_CONFIG
	default ""
	string "CONFIG: Project Configure Options"

config PK_BISCUITOS_KVM_TOOLS_LIBPATH
	string "LIBS: Libraries to pass to the linker, e.g. -l<library>"

config PK_BISCUITOS_KVM_TOOLS_CPPFLAGS
	string "CPPFLAGS: C/C++ preprocessor flags, e.g. -I<include dir>"

config PK_BISCUITOS_KVM_TOOLS_DPKCONFIG
	string "PKG_CONFIG_PATH: Directories to add to pkg-config's search path"

config PK_BISCUITOS_KVM_TOOLS_CFLAGS
	string "CFLAGS: C compiler flags"

config PK_BISCUITOS_KVM_TOOLS_LDFLAGS
	string "LDFLAGS: Linker flags"

config PK_BISCUITOS_KVM_TOOLS_CXXFLAGS
	string "CXXFLAGS: C++ compiler flags"

config PK_BISCUITOS_KVM_TOOLS_ASFLAGS
	string "CCASFLAGS: assembler compiler flags (defaults to CFLAGS)"

config PK_BISCUITOS_KVM_TOOLS_BUILDARCH
	default "x86_64-unknown-linux-gnu"
	string "--host options on configure for Architecture"

endif # PK_BISCUITOS_KVM_TOOLS
```

## package/kvm/BiscuitOS-qemu-host/Kconfig
```kconfig
menuconfig PK_BISCUITOS_QEMU_HOST
	bool "Host QEMU for BiscuitOS"

if PK_BISCUITOS_QEMU_HOST

config PK_BISCUITOS_QEMU_HOST_VERSION
	default "default"
	string "verstion"

config PK_BISCUITOS_QEMU_HOST_TAR
	default "tar.xz"
	string "tar type"

config PK_BISCUITOS_QEMU_HOST_URL
	default "https://download.qemu.org/"
	string "url"

config PK_BISCUITOS_QEMU_HOST_GITHUB
	string "GitHub"

config PK_BISCUITOS_QEMU_HOST_SRCFILE
	string "Source code list"

config PK_BISCUITOS_QEMU_HOST_CONFIG
	default "none"
	string "CONFIG: Project Configure Options"

config PK_BISCUITOS_QEMU_HOST_LIBPATH
	string "LIBS: Libraries to pass to the linker, e.g. -l<library>"

config PK_BISCUITOS_QEMU_HOST_CPPFLAGS
	string "CPPFLAGS: C/C++ preprocessor flags, e.g. -I<include dir>"

config PK_BISCUITOS_QEMU_HOST_DPKCONFIG
	string "PKG_CONFIG_PATH: Directories to add to pkg-config's search path"

config PK_BISCUITOS_QEMU_HOST_CFLAGS
	string "CFLAGS: C compiler flags"

config PK_BISCUITOS_QEMU_HOST_LDFLAGS
	string "LDFLAGS: Linker flags"

config PK_BISCUITOS_QEMU_HOST_CXXFLAGS
	string "CXXFLAGS: C++ compiler flags"

config PK_BISCUITOS_QEMU_HOST_ASFLAGS
	string "CCASFLAGS: assembler compiler flags (defaults to CFLAGS)"

config PK_BISCUITOS_QEMU_HOST_BUILDARCH
	default "x86_64-unknown-linux-gnu"
	string "--host options on configure for Architecture"

endif # PK_BISCUITOS_QEMU_HOST
```
