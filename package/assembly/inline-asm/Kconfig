## package/assembly/inline-asm/Kconfig
```kconfig
menuconfig PK_ASSEMBLY_INLINE
	bool "Inline Assembly"

if PK_ASSEMBLY_INLINE

# demo 
source "package/assembly/inline-asm/demo/Kconfig"

endif # PK_ASSEMBLY_INLINE
```

## package/assembly/inline-asm/demo/Kconfig
```kconfig
menuconfig PK_INLINE_ASM_DEMO
	bool "Inline assembly DEMO"

if PK_INLINE_ASM_DEMO

config PK_INLINE_ASM_DEMO_VERSION
	default "0.0.1"
	string "verstion"

config PK_INLINE_ASM_DEMO_TAR
	default "tar.gz"
	string "tar type"

config PK_INLINE_ASM_DEMO_URL
	default "https://gitee.com/BiscuitOS_team/HardStack/raw/Gitee/Language/Assembly/inline-GNU-Assembly/demo"
	string "url"

config PK_INLINE_ASM_DEMO_GITHUB
	string "GitHub"

config PK_INLINE_ASM_DEMO_SRCFILE
	default "main.c Kconfig Makefile"
	string "Source code list"

config PK_INLINE_ASM_DEMO_CSRCFILE
	string "Compile source code list"

config PK_INLINE_ASM_DEMO_CONFIG
	string "CONFIG: Project Configure Options"

config PK_INLINE_ASM_DEMO_LIBPATH
	string "LIBS: Libraries to pass to the linker, e.g. -l<library>"

config PK_INLINE_ASM_DEMO_CPPFLAGS
	string "CPPFLAGS: C/C++ preprocessor flags, e.g. -I<include dir>"

config PK_INLINE_ASM_DEMO_DPKCONFIG
	string "PKG_CONFIG_PATH: Directories to add to pkg-config's search path"

config PK_INLINE_ASM_DEMO_CFLAGS
	string "CFLAGS: C compiler flags"

config PK_INLINE_ASM_DEMO_LDFLAGS
	string "LDFLAGS: Linker flags"

config PK_INLINE_ASM_DEMO_CXXFLAGS
	string "CXXFLAGS: C++ compiler flags"

config PK_INLINE_ASM_DEMO_ASFLAGS
	string "CCASFLAGS: assembler compiler flags (defaults to CFLAGS)"

config PK_INLINE_ASM_DEMO_BUILDARCH
	string "--host options on configure for Architecture"

endif # PK_INLINE_ASM_DEMO
```

## package/assembly/x86/Kconfig
```kconfig
menuconfig PK_ASSEMBLY_X86
	bool "X86/i386/X64 Assembly"

if PK_ASSEMBLY_X86

# mov 
source "package/assembly/x86/mov/Kconfig"

# rdmsr 
source "package/assembly/x86/rdmsr/Kconfig"

# rdtsc
source "package/assembly/x86/rdtsc/Kconfig"

# rdtsc-app
source "package/assembly/x86/rdtsc-app/Kconfig"

# wrmsr 
source "package/assembly/x86/wrmsr/Kconfig"

endif # PK_ASSEMBLY_X86
```

## package/assembly/x86/rdmsr/Kconfig
```kconfig
menuconfig PK_X86_ASM_RDMSR
	bool "RDMSR"

if PK_X86_ASM_RDMSR

config PK_X86_ASM_RDMSR_VERSION
	default "0.0.1"
	string "verstion"

config PK_X86_ASM_RDMSR_TAR
	default "tar.gz"
	string "tar type"

config PK_X86_ASM_RDMSR_URL
	default "https://gitee.com/BiscuitOS_team/HardStack/raw/Gitee/Language/Assembly/X86-GNU-Assembly/rdmsr"
	string "url"

config PK_X86_ASM_RDMSR_GITHUB
	string "GitHub"

config PK_X86_ASM_RDMSR_SRCFILE
	default "main.c Kconfig Makefile"
	string "Source code list"

config PK_X86_ASM_RDMSR_CSRCFILE
	string "Compile source code list"

config PK_X86_ASM_RDMSR_CONFIG
	string "CONFIG: Project Configure Options"

config PK_X86_ASM_RDMSR_LIBPATH
	string "LIBS: Libraries to pass to the linker, e.g. -l<library>"

config PK_X86_ASM_RDMSR_CPPFLAGS
	string "CPPFLAGS: C/C++ preprocessor flags, e.g. -I<include dir>"

config PK_X86_ASM_RDMSR_DPKCONFIG
	string "PKG_CONFIG_PATH: Directories to add to pkg-config's search path"

config PK_X86_ASM_RDMSR_CFLAGS
	string "CFLAGS: C compiler flags"

config PK_X86_ASM_RDMSR_LDFLAGS
	string "LDFLAGS: Linker flags"

config PK_X86_ASM_RDMSR_CXXFLAGS
	string "CXXFLAGS: C++ compiler flags"

config PK_X86_ASM_RDMSR_ASFLAGS
	string "CCASFLAGS: assembler compiler flags (defaults to CFLAGS)"

config PK_X86_ASM_RDMSR_BUILDARCH
	string "--host options on configure for Architecture"

endif # PK_X86_ASM_RDMSR
```

## package/assembly/x86/rdtsc-app/Kconfig
```kconfig
menuconfig PK_X86_ASM_RDTSC_APP
	bool "RDTSC on Userspace"

if PK_X86_ASM_RDTSC_APP

config PK_X86_ASM_RDTSC_APP_VERSION
	default "0.0.1"
	string "verstion"

config PK_X86_ASM_RDTSC_APP_TAR
	default "tar.gz"
	string "tar type"

config PK_X86_ASM_RDTSC_APP_URL
	default "https://gitee.com/BiscuitOS_team/HardStack/raw/Gitee/Language/Assembly/X86-GNU-Assembly/rdtsc-app"
	string "url"

config PK_X86_ASM_RDTSC_APP_GITHUB
	string "GitHub"

config PK_X86_ASM_RDTSC_APP_SRCFILE
	default "main.c Kconfig Makefile"
	string "Source code list"

config PK_X86_ASM_RDTSC_APP_CSRCFILE
	string "Compile source code list"

config PK_X86_ASM_RDTSC_APP_CONFIG
	string "CONFIG: Project Configure Options"

config PK_X86_ASM_RDTSC_APP_LIBPATH
	string "LIBS: Libraries to pass to the linker, e.g. -l<library>"

config PK_X86_ASM_RDTSC_APP_CPPFLAGS
	string "CPPFLAGS: C/C++ preprocessor flags, e.g. -I<include dir>"

config PK_X86_ASM_RDTSC_APP_DPKCONFIG
	string "PKG_CONFIG_PATH: Directories to add to pkg-config's search path"

config PK_X86_ASM_RDTSC_APP_CFLAGS
	string "CFLAGS: C compiler flags"

config PK_X86_ASM_RDTSC_APP_LDFLAGS
	string "LDFLAGS: Linker flags"

config PK_X86_ASM_RDTSC_APP_CXXFLAGS
	string "CXXFLAGS: C++ compiler flags"

config PK_X86_ASM_RDTSC_APP_ASFLAGS
	string "CCASFLAGS: assembler compiler flags (defaults to CFLAGS)"

config PK_X86_ASM_RDTSC_APP_BUILDARCH
	string "--host options on configure for Architecture"

endif # PK_X86_ASM_RDTSC_APP
```

## package/assembly/x86/rdtsc/Kconfig
```kconfig
menuconfig PK_X86_ASM_RDTSC
	bool "RDTSC"

if PK_X86_ASM_RDTSC

config PK_X86_ASM_RDTSC_VERSION
	default "0.0.1"
	string "verstion"

config PK_X86_ASM_RDTSC_TAR
	default "tar.gz"
	string "tar type"

config PK_X86_ASM_RDTSC_URL
	default "https://gitee.com/BiscuitOS_team/HardStack/raw/Gitee/Language/Assembly/X86-GNU-Assembly/rdtsc"
	string "url"

config PK_X86_ASM_RDTSC_GITHUB
	string "GitHub"

config PK_X86_ASM_RDTSC_SRCFILE
	default "main.c Kconfig Makefile"
	string "Source code list"

config PK_X86_ASM_RDTSC_CSRCFILE
	string "Compile source code list"

config PK_X86_ASM_RDTSC_CONFIG
	string "CONFIG: Project Configure Options"

config PK_X86_ASM_RDTSC_LIBPATH
	string "LIBS: Libraries to pass to the linker, e.g. -l<library>"

config PK_X86_ASM_RDTSC_CPPFLAGS
	string "CPPFLAGS: C/C++ preprocessor flags, e.g. -I<include dir>"

config PK_X86_ASM_RDTSC_DPKCONFIG
	string "PKG_CONFIG_PATH: Directories to add to pkg-config's search path"

config PK_X86_ASM_RDTSC_CFLAGS
	string "CFLAGS: C compiler flags"

config PK_X86_ASM_RDTSC_LDFLAGS
	string "LDFLAGS: Linker flags"

config PK_X86_ASM_RDTSC_CXXFLAGS
	string "CXXFLAGS: C++ compiler flags"

config PK_X86_ASM_RDTSC_ASFLAGS
	string "CCASFLAGS: assembler compiler flags (defaults to CFLAGS)"

config PK_X86_ASM_RDTSC_BUILDARCH
	string "--host options on configure for Architecture"

endif # PK_X86_ASM_RDTSC
```

## package/assembly/x86/wrmsr/Kconfig
```kconfig
menuconfig PK_X86_ASM_WRMSR
	bool "WRMSR"

if PK_X86_ASM_WRMSR

config PK_X86_ASM_WRMSR_VERSION
	default "0.0.1"
	string "verstion"

config PK_X86_ASM_WRMSR_TAR
	default "tar.gz"
	string "tar type"

config PK_X86_ASM_WRMSR_URL
	default "https://gitee.com/BiscuitOS_team/HardStack/raw/Gitee/Language/Assembly/X86-GNU-Assembly/wrmsr"
	string "url"

config PK_X86_ASM_WRMSR_GITHUB
	string "GitHub"

config PK_X86_ASM_WRMSR_SRCFILE
	default "main.c Kconfig Makefile"
	string "Source code list"

config PK_X86_ASM_WRMSR_CSRCFILE
	string "Compile source code list"

config PK_X86_ASM_WRMSR_CONFIG
	string "CONFIG: Project Configure Options"

config PK_X86_ASM_WRMSR_LIBPATH
	string "LIBS: Libraries to pass to the linker, e.g. -l<library>"

config PK_X86_ASM_WRMSR_CPPFLAGS
	string "CPPFLAGS: C/C++ preprocessor flags, e.g. -I<include dir>"

config PK_X86_ASM_WRMSR_DPKCONFIG
	string "PKG_CONFIG_PATH: Directories to add to pkg-config's search path"

config PK_X86_ASM_WRMSR_CFLAGS
	string "CFLAGS: C compiler flags"

config PK_X86_ASM_WRMSR_LDFLAGS
	string "LDFLAGS: Linker flags"

config PK_X86_ASM_WRMSR_CXXFLAGS
	string "CXXFLAGS: C++ compiler flags"

config PK_X86_ASM_WRMSR_ASFLAGS
	string "CCASFLAGS: assembler compiler flags (defaults to CFLAGS)"

config PK_X86_ASM_WRMSR_BUILDARCH
	string "--host options on configure for Architecture"

endif # PK_X86_ASM_WRMSR
```

## package/atk/Kconfig
```kconfig
menuconfig PK_ATK
	bool "atk"

if PK_ATK

config PK_ATK_VERSION
	default "2.24.0"
	string "verstion"

config PK_ATK_TAR
	default "tar.xz"
	string "tar type"

config PK_ATK_URL
	default "http://ftp.gnome.org/pub/gnome/sources/atk/2.24/"
	string "url"

config PK_ATK_GITHUB
	string "GitHub"

config PK_ATK_SRCFILE
	string "Source code list"

config PK_ATK_CONFIG
	default "--enable-silent-rules --disable-static"
	string "CONFIG: Project Configure Options"

config PK_ATK_LIBPATH
	string "LIBS: Libraries to pass to the linker, e.g. -l<library>"

config PK_ATK_CPPFLAGS
	string "CPPFLAGS: C/C++ preprocessor flags, e.g. -I<include dir>"

config PK_ATK_DPKCONFIG
	string "PKG_CONFIG_PATH: Directories to add to pkg-config's search path"

config PK_ATK_CFLAGS
	string "CFLAGS: C compiler flags"

config PK_ATK_LDFLAGS
	string "LDFLAGS: Linker flags"

config PK_ATK_CXXFLAGS
	string "CXXFLAGS: C++ compiler flags"

config PK_ATK_ASFLAGS
	string "CCASFLAGS: assembler compiler flags (defaults to CFLAGS)"

config PK_ATK_BUILDARCH
	default "x86_64-unknown-linux-gnu"
	string "--host options on configure for Architecture"

endif # PK_ATK
```

## package/autoconf/Kconfig
```kconfig
menuconfig PK_AUTOCONF
	bool "autoconf"

if PK_AUTOCONF

config PK_AUTOCONF_VERSION
	default "2.69"
	string "verstion"

config PK_AUTOCONF_TAR
	default "tar.gz"
	string "tar type"

config PK_AUTOCONF_URL
	default "http://ftp.gnu.org/pub/gnu/autoconf/"
	string "url"

config PK_AUTOCONF_GITHUB
	string "GitHub"

config PK_AUTOCONF_SRCFILE
	string "Source code list"

config PK_AUTOCONF_CONFIG
	default "--enable-silent-rules --disable-static"
	string "CONFIG: Project Configure Options"

config PK_AUTOCONF_LIBPATH
	string "LIBS: Libraries to pass to the linker, e.g. -l<library>"

config PK_AUTOCONF_CPPFLAGS
	string "CPPFLAGS: C/C++ preprocessor flags, e.g. -I<include dir>"

config PK_AUTOCONF_DPKCONFIG
	string "PKG_CONFIG_PATH: Directories to add to pkg-config's search path"

config PK_AUTOCONF_CFLAGS
	string "CFLAGS: C compiler flags"

config PK_AUTOCONF_LDFLAGS
	string "LDFLAGS: Linker flags"

config PK_AUTOCONF_CXXFLAGS
	string "CXXFLAGS: C++ compiler flags"

config PK_AUTOCONF_ASFLAGS
	string "CCASFLAGS: assembler compiler flags (defaults to CFLAGS)"

config PK_AUTOCONF_BUILDARCH
	default "x86_64-unknown-linux-gnu"
	string "--host options on configure for Architecture"

endif # PK_AUTOCONF
```

## package/automake/Kconfig
```kconfig
menuconfig PK_AUTOMAKE
	bool "automake"

if PK_AUTOMAKE

config PK_AUTOMAKE_VERSION
	default "1.16"
	string "verstion"

config PK_AUTOMAKE_TAR
	default "tar.gz"
	string "tar type"

config PK_AUTOMAKE_URL
	default "http://ftp.gnu.org/pub/gnu/automake/"
	string "url"

config PK_AUTOMAKE_GITHUB
	string "GitHub"

config PK_AUTOMAKE_SRCFILE
	string "Source code list"

config PK_AUTOMAKE_CONFIG
	default "--enable-silent-rules --disable-static"
	string "CONFIG: Project Configure Options"

config PK_AUTOMAKE_LIBPATH
	string "LIBS: Libraries to pass to the linker, e.g. -l<library>"

config PK_AUTOMAKE_CPPFLAGS
	string "CPPFLAGS: C/C++ preprocessor flags, e.g. -I<include dir>"

config PK_AUTOMAKE_DPKCONFIG
	string "PKG_CONFIG_PATH: Directories to add to pkg-config's search path"

config PK_AUTOMAKE_CFLAGS
	string "CFLAGS: C compiler flags"

config PK_AUTOMAKE_LDFLAGS
	string "LDFLAGS: Linker flags"

config PK_AUTOMAKE_CXXFLAGS
	string "CXXFLAGS: C++ compiler flags"

config PK_AUTOMAKE_ASFLAGS
	string "CCASFLAGS: assembler compiler flags (defaults to CFLAGS)"

config PK_AUTOMAKE_BUILDARCH
	default "x86_64-unknown-linux-gnu"
	string "--host options on configure for Architecture"

endif # PK_AUTOMAKE
```

## package/bash/Kconfig
```kconfig
#
# kconfig for GNU bash
#
config PACKAGE_GNU_BASH
	bool "GNU bash"
	help
	  Bash is a Unix shell and command language written by Brian 
          Fox for the GNU Project as a free software replacement for 
          the Bourne shell. First released in 1989, it has been 
          distributed widely as the default login shell for most 
          Linux distributions.
```

## package/bigreqsproto/Kconfig
```kconfig
menuconfig PK_BIGREQSPROTO
	bool "bigreqsproto"

if PK_BIGREQSPROTO

config PK_BIGREQSPROTO_VERSION
	default "1.1.2"
	string "verstion"

config PK_BIGREQSPROTO_TAR
	default "tar.gz"
	string "tar type"

config PK_BIGREQSPROTO_URL
	default "https://www.x.org/releases/individual/proto/"
	string "url"

config PK_BIGREQSPROTO_GITHUB
	string "GitHub"

config PK_BIGREQSPROTO_SRCFILE
	string "Source code list"

config PK_BIGREQSPROTO_CONFIG
	default "--enable-silent-rules --disable-static"
	string "CONFIG: Project Configure Options"

config PK_BIGREQSPROTO_LIBPATH
	string "LIBS: Libraries to pass to the linker, e.g. -l<library>"

config PK_BIGREQSPROTO_CPPFLAGS
	string "CPPFLAGS: C/C++ preprocessor flags, e.g. -I<include dir>"

config PK_BIGREQSPROTO_DPKCONFIG
	string "PKG_CONFIG_PATH: Directories to add to pkg-config's search path"

config PK_BIGREQSPROTO_CFLAGS
	string "CFLAGS: C compiler flags"

config PK_BIGREQSPROTO_LDFLAGS
	string "LDFLAGS: Linker flags"

config PK_BIGREQSPROTO_CXXFLAGS
	string "CXXFLAGS: C++ compiler flags"

config PK_BIGREQSPROTO_ASFLAGS
	string "CCASFLAGS: assembler compiler flags (defaults to CFLAGS)"

config PK_BIGREQSPROTO_BUILDARCH
	default "x86_64-unknown-linux-gnu"
	string "--host options on configure for Architecture"

endif # PK_BIGREQSPROTO
```

## package/bitmap/Kconfig
```kconfig
menuconfig PK_BITMAP
	bool "Bitmap"

if PK_BITMAP

# Emulate PID
source package/bitmap/emulate-pid/Kconfig

# C-trie Protocol
source package/bitmap/LC-trie/Kconfig

endif # PK_BITMAP
```

## package/bitmap/LC-trie/Kconfig
```kconfig
menuconfig PK_BITMAP_LC_TRIE
	bool "LC-trie Protocol"

if PK_BITMAP_LC_TRIE

config PK_BITMAP_LC_TRIE_VERSION
	default "0.0.1"
	string "verstion"

config PK_BITMAP_LC_TRIE_TAR
	default "tar.gz"
	string "tar type"

config PK_BITMAP_LC_TRIE_URL
	default "https://gitee.com/BiscuitOS_team/HardStack/raw/Gitee/Algorithem/bitmap/LC-trie"
	string "url"

config PK_BITMAP_LC_TRIE_GITHUB
	string "GitHub"

config PK_BITMAP_LC_TRIE_SRCFILE
	default "Kconfig Makefile bits32_trie.c bits32_trie_debug.c bits32_trie_debug.h bits32_trie.h bits32_trie_insert.c bits32_trie_insert.h bits32_trie_lookup.c bits32_trie_lookup.h bits32_trie_new.c bits32_trie_new.h bits32_trie_remove.c bits32_trie_remove.h readme.txt"
	string "Source code list"

config PK_BITMAP_LC_TRIE_CSRCFILE
	string "Compile source code list"

config PK_BITMAP_LC_TRIE_CONFIG
	string "CONFIG: Project Configure Options"

config PK_BITMAP_LC_TRIE_LIBPATH
	string "LIBS: Libraries to pass to the linker, e.g. -l<library>"

config PK_BITMAP_LC_TRIE_CPPFLAGS
	string "CPPFLAGS: C/C++ preprocessor flags, e.g. -I<include dir>"

config PK_BITMAP_LC_TRIE_DPKCONFIG
	string "PKG_CONFIG_PATH: Directories to add to pkg-config's search path"

config PK_BITMAP_LC_TRIE_CFLAGS
	string "CFLAGS: C compiler flags"

config PK_BITMAP_LC_TRIE_LDFLAGS
	string "LDFLAGS: Linker flags"

config PK_BITMAP_LC_TRIE_CXXFLAGS
	string "CXXFLAGS: C++ compiler flags"

config PK_BITMAP_LC_TRIE_ASFLAGS
	string "CCASFLAGS: assembler compiler flags (defaults to CFLAGS)"

config PK_BITMAP_LC_TRIE_BUILDARCH
	string "--host options on configure for Architecture"

endif # PK_BITMAP_LC_TRIE
```
