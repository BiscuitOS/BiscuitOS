## package/bitmap/emulate-pid/Kconfig
```kconfig
menuconfig PK_BITMAP_EMULATE_PID
	bool "Emulate PID Allocating and Releasing"

if PK_BITMAP_EMULATE_PID

config PK_BITMAP_EMULATE_PID_VERSION
	default "0.0.1"
	string "verstion"

config PK_BITMAP_EMULATE_PID_TAR
	default "tar.gz"
	string "tar type"

config PK_BITMAP_EMULATE_PID_URL
	default "https://gitee.com/BiscuitOS_team/HardStack/raw/Gitee/Algorithem/bitmap/Emulate_PID"
	string "url"

config PK_BITMAP_EMULATE_PID_GITHUB
	string "GitHub"

config PK_BITMAP_EMULATE_PID_SRCFILE
	default "Kconfig main.c Makefile"
	string "Source code list"

config PK_BITMAP_EMULATE_PID_CSRCFILE
	string "Compile source code list"

config PK_BITMAP_EMULATE_PID_CONFIG
	string "CONFIG: Project Configure Options"

config PK_BITMAP_EMULATE_PID_LIBPATH
	string "LIBS: Libraries to pass to the linker, e.g. -l<library>"

config PK_BITMAP_EMULATE_PID_CPPFLAGS
	string "CPPFLAGS: C/C++ preprocessor flags, e.g. -I<include dir>"

config PK_BITMAP_EMULATE_PID_DPKCONFIG
	string "PKG_CONFIG_PATH: Directories to add to pkg-config's search path"

config PK_BITMAP_EMULATE_PID_CFLAGS
	string "CFLAGS: C compiler flags"

config PK_BITMAP_EMULATE_PID_LDFLAGS
	string "LDFLAGS: Linker flags"

config PK_BITMAP_EMULATE_PID_CXXFLAGS
	string "CXXFLAGS: C++ compiler flags"

config PK_BITMAP_EMULATE_PID_ASFLAGS
	string "CCASFLAGS: assembler compiler flags (defaults to CFLAGS)"

config PK_BITMAP_EMULATE_PID_BUILDARCH
	string "--host options on configure for Architecture"

endif # PK_BITMAP_EMULATE_PID
```

## package/bitops/Kconfig
```kconfig
menuconfig PK_BITOPS
	bool "bitops"

if PK_BITOPS

# rol8
source package/bitops/rol8/Kconfig

# rol16
source package/bitops/rol16/Kconfig

# rol32
source package/bitops/rol32/Kconfig

# ror8
source package/bitops/ror8/Kconfig

# ror16
source package/bitops/ror16/Kconfig

# ror32
source package/bitops/ror32/Kconfig

endif # PK_BITOPS
```

## package/bitops/rol16/Kconfig
```kconfig
menuconfig PK_BITOPS_ROL16
	bool "rol16()"

if PK_BITOPS_ROL16

config PK_BITOPS_ROL16_VERSION
	default "0.0.1"
	string "verstion"

config PK_BITOPS_ROL16_TAR
	default "tar.gz"
	string "tar type"

config PK_BITOPS_ROL16_URL
	default "https://gitee.com/BiscuitOS_team/HardStack/raw/Gitee/Algorithem/bitmap/API/rol16"
	string "url"

config PK_BITOPS_ROL16_GITHUB
	string "GitHub"

config PK_BITOPS_ROL16_SRCFILE
	default "bitops.c Kconfig Makefile"
	string "Source code list"

config PK_BITOPS_ROL16_CSRCFILE
	string "Compile source code list"

config PK_BITOPS_ROL16_CONFIG
	string "CONFIG: Project Configure Options"

config PK_BITOPS_ROL16_LIBPATH
	string "LIBS: Libraries to pass to the linker, e.g. -l<library>"

config PK_BITOPS_ROL16_CPPFLAGS
	string "CPPFLAGS: C/C++ preprocessor flags, e.g. -I<include dir>"

config PK_BITOPS_ROL16_DPKCONFIG
	string "PKG_CONFIG_PATH: Directories to add to pkg-config's search path"

config PK_BITOPS_ROL16_CFLAGS
	string "CFLAGS: C compiler flags"

config PK_BITOPS_ROL16_LDFLAGS
	string "LDFLAGS: Linker flags"

config PK_BITOPS_ROL16_CXXFLAGS
	string "CXXFLAGS: C++ compiler flags"

config PK_BITOPS_ROL16_ASFLAGS
	string "CCASFLAGS: assembler compiler flags (defaults to CFLAGS)"

config PK_BITOPS_ROL16_BUILDARCH
	string "--host options on configure for Architecture"

endif # PK_BITOPS_ROL16
```

## package/bitops/rol32/Kconfig
```kconfig
menuconfig PK_BITOPS_ROL32
	bool "rol32()"

if PK_BITOPS_ROL32

config PK_BITOPS_ROL32_VERSION
	default "0.0.1"
	string "verstion"

config PK_BITOPS_ROL32_TAR
	default "tar.gz"
	string "tar type"

config PK_BITOPS_ROL32_URL
	default "https://gitee.com/BiscuitOS_team/HardStack/raw/Gitee/Algorithem/bitmap/API/rol32"
	string "url"

config PK_BITOPS_ROL32_GITHUB
	string "GitHub"

config PK_BITOPS_ROL32_SRCFILE
	default "bitops.c Kconfig Makefile"
	string "Source code list"

config PK_BITOPS_ROL32_CSRCFILE
	string "Compile source code list"

config PK_BITOPS_ROL32_CONFIG
	string "CONFIG: Project Configure Options"

config PK_BITOPS_ROL32_LIBPATH
	string "LIBS: Libraries to pass to the linker, e.g. -l<library>"

config PK_BITOPS_ROL32_CPPFLAGS
	string "CPPFLAGS: C/C++ preprocessor flags, e.g. -I<include dir>"

config PK_BITOPS_ROL32_DPKCONFIG
	string "PKG_CONFIG_PATH: Directories to add to pkg-config's search path"

config PK_BITOPS_ROL32_CFLAGS
	string "CFLAGS: C compiler flags"

config PK_BITOPS_ROL32_LDFLAGS
	string "LDFLAGS: Linker flags"

config PK_BITOPS_ROL32_CXXFLAGS
	string "CXXFLAGS: C++ compiler flags"

config PK_BITOPS_ROL32_ASFLAGS
	string "CCASFLAGS: assembler compiler flags (defaults to CFLAGS)"

config PK_BITOPS_ROL32_BUILDARCH
	string "--host options on configure for Architecture"

endif # PK_BITOPS_ROL32
```

## package/bitops/rol8/Kconfig
```kconfig
menuconfig PK_BITOPS_ROL8
	bool "rol8()"

if PK_BITOPS_ROL8

config PK_BITOPS_ROL8_VERSION
	default "0.0.1"
	string "verstion"

config PK_BITOPS_ROL8_TAR
	default "tar.gz"
	string "tar type"

config PK_BITOPS_ROL8_URL
	default "https://gitee.com/BiscuitOS_team/HardStack/raw/Gitee/Algorithem/bitmap/API/rol8"
	string "url"

config PK_BITOPS_ROL8_GITHUB
	string "GitHub"

config PK_BITOPS_ROL8_SRCFILE
	default "bitops.c Kconfig Makefile"
	string "Source code list"

config PK_BITOPS_ROL8_CSRCFILE
	string "Compile source code list"

config PK_BITOPS_ROL8_CONFIG
	string "CONFIG: Project Configure Options"

config PK_BITOPS_ROL8_LIBPATH
	string "LIBS: Libraries to pass to the linker, e.g. -l<library>"

config PK_BITOPS_ROL8_CPPFLAGS
	string "CPPFLAGS: C/C++ preprocessor flags, e.g. -I<include dir>"

config PK_BITOPS_ROL8_DPKCONFIG
	string "PKG_CONFIG_PATH: Directories to add to pkg-config's search path"

config PK_BITOPS_ROL8_CFLAGS
	string "CFLAGS: C compiler flags"

config PK_BITOPS_ROL8_LDFLAGS
	string "LDFLAGS: Linker flags"

config PK_BITOPS_ROL8_CXXFLAGS
	string "CXXFLAGS: C++ compiler flags"

config PK_BITOPS_ROL8_ASFLAGS
	string "CCASFLAGS: assembler compiler flags (defaults to CFLAGS)"

config PK_BITOPS_ROL8_BUILDARCH
	string "--host options on configure for Architecture"

endif # PK_BITOPS_ROL8
```

## package/bitops/ror16/Kconfig
```kconfig
menuconfig PK_BITOPS_ROR16
	bool "ror16()"

if PK_BITOPS_ROR16

config PK_BITOPS_ROR16_VERSION
	default "0.0.1"
	string "verstion"

config PK_BITOPS_ROR16_TAR
	default "tar.gz"
	string "tar type"

config PK_BITOPS_ROR16_URL
	default "https://gitee.com/BiscuitOS_team/HardStack/raw/Gitee/Algorithem/bitmap/API/ror16"
	string "url"

config PK_BITOPS_ROR16_GITHUB
	string "GitHub"

config PK_BITOPS_ROR16_SRCFILE
	default "bitops.c Kconfig Makefile"
	string "Source code list"

config PK_BITOPS_ROR16_CSRCFILE
	string "Compile source code list"

config PK_BITOPS_ROR16_CONFIG
	string "CONFIG: Project Configure Options"

config PK_BITOPS_ROR16_LIBPATH
	string "LIBS: Libraries to pass to the linker, e.g. -l<library>"

config PK_BITOPS_ROR16_CPPFLAGS
	string "CPPFLAGS: C/C++ preprocessor flags, e.g. -I<include dir>"

config PK_BITOPS_ROR16_DPKCONFIG
	string "PKG_CONFIG_PATH: Directories to add to pkg-config's search path"

config PK_BITOPS_ROR16_CFLAGS
	string "CFLAGS: C compiler flags"

config PK_BITOPS_ROR16_LDFLAGS
	string "LDFLAGS: Linker flags"

config PK_BITOPS_ROR16_CXXFLAGS
	string "CXXFLAGS: C++ compiler flags"

config PK_BITOPS_ROR16_ASFLAGS
	string "CCASFLAGS: assembler compiler flags (defaults to CFLAGS)"

config PK_BITOPS_ROR16_BUILDARCH
	string "--host options on configure for Architecture"

endif # PK_BITOPS_ROR16
```

## package/bitops/ror32/Kconfig
```kconfig
menuconfig PK_BITOPS_ROR32
	bool "ror32()"

if PK_BITOPS_ROR32

config PK_BITOPS_ROR32_VERSION
	default "0.0.1"
	string "verstion"

config PK_BITOPS_ROR32_TAR
	default "tar.gz"
	string "tar type"

config PK_BITOPS_ROR32_URL
	default "https://gitee.com/BiscuitOS_team/HardStack/raw/Gitee/Algorithem/bitmap/API/ror32"
	string "url"

config PK_BITOPS_ROR32_GITHUB
	string "GitHub"

config PK_BITOPS_ROR32_SRCFILE
	default "bitops.c Kconfig Makefile"
	string "Source code list"

config PK_BITOPS_ROR32_CSRCFILE
	string "Compile source code list"

config PK_BITOPS_ROR32_CONFIG
	string "CONFIG: Project Configure Options"

config PK_BITOPS_ROR32_LIBPATH
	string "LIBS: Libraries to pass to the linker, e.g. -l<library>"

config PK_BITOPS_ROR32_CPPFLAGS
	string "CPPFLAGS: C/C++ preprocessor flags, e.g. -I<include dir>"

config PK_BITOPS_ROR32_DPKCONFIG
	string "PKG_CONFIG_PATH: Directories to add to pkg-config's search path"

config PK_BITOPS_ROR32_CFLAGS
	string "CFLAGS: C compiler flags"

config PK_BITOPS_ROR32_LDFLAGS
	string "LDFLAGS: Linker flags"

config PK_BITOPS_ROR32_CXXFLAGS
	string "CXXFLAGS: C++ compiler flags"

config PK_BITOPS_ROR32_ASFLAGS
	string "CCASFLAGS: assembler compiler flags (defaults to CFLAGS)"

config PK_BITOPS_ROR32_BUILDARCH
	string "--host options on configure for Architecture"

endif # PK_BITOPS_ROR32
```

## package/bitops/ror8/Kconfig
```kconfig
menuconfig PK_BITOPS_ROR8
	bool "ror8()"

if PK_BITOPS_ROR8

config PK_BITOPS_ROR8_VERSION
	default "0.0.1"
	string "verstion"

config PK_BITOPS_ROR8_TAR
	default "tar.gz"
	string "tar type"

config PK_BITOPS_ROR8_URL
	default "https://gitee.com/BiscuitOS_team/HardStack/raw/Gitee/Algorithem/bitmap/API/ror8"
	string "url"

config PK_BITOPS_ROR8_GITHUB
	string "GitHub"

config PK_BITOPS_ROR8_SRCFILE
	default "bitops.c Kconfig Makefile"
	string "Source code list"

config PK_BITOPS_ROR8_CSRCFILE
	string "Compile source code list"

config PK_BITOPS_ROR8_CONFIG
	string "CONFIG: Project Configure Options"

config PK_BITOPS_ROR8_LIBPATH
	string "LIBS: Libraries to pass to the linker, e.g. -l<library>"

config PK_BITOPS_ROR8_CPPFLAGS
	string "CPPFLAGS: C/C++ preprocessor flags, e.g. -I<include dir>"

config PK_BITOPS_ROR8_DPKCONFIG
	string "PKG_CONFIG_PATH: Directories to add to pkg-config's search path"

config PK_BITOPS_ROR8_CFLAGS
	string "CFLAGS: C compiler flags"

config PK_BITOPS_ROR8_LDFLAGS
	string "LDFLAGS: Linker flags"

config PK_BITOPS_ROR8_CXXFLAGS
	string "CXXFLAGS: C++ compiler flags"

config PK_BITOPS_ROR8_ASFLAGS
	string "CCASFLAGS: assembler compiler flags (defaults to CFLAGS)"

config PK_BITOPS_ROR8_BUILDARCH
	string "--host options on configure for Architecture"

endif # PK_BITOPS_ROR8
```

## package/buddy/Kconfig
```kconfig
menuconfig PK_BUDDY
	bool "Buddy Physical Memory Allocator"

if PK_BUDDY

# Buddy Userspace
source package/buddy/buddy_userspace/Kconfig

# Buddy Highmem Userspace
source package/buddy/buddy_highmem_userspace/Kconfig

# PCP Userspace
source package/buddy/PCP_userspace/Kconfig

endif # PK_BUDDY
```

## package/buddy/PCP_userspace/Kconfig
```kconfig
menuconfig PK_PCP_USERSPACE
	bool "PCP Allocator on Userspace"

if PK_PCP_USERSPACE

config PK_PCP_USERSPACE_VERSION
	default "0.0.1"
	string "verstion"

config PK_PCP_USERSPACE_TAR
	default "tar.gz"
	string "tar type"

config PK_PCP_USERSPACE_URL
	default "https://gitee.com/BiscuitOS_team/HardStack/raw/Gitee/Memory-Allocator/Buddy/PCP_userspace"
	string "url"

config PK_PCP_USERSPACE_GITHUB
	string "GitHub"

config PK_PCP_USERSPACE_SRCFILE
	default "main.c Makefile README.md include/linux/buddy.h include/linux/list.h mm/buddy.c"
	string "Source code list"

config PK_PCP_USERSPACE_CSRCFILE
	string "Compile source code list"

config PK_PCP_USERSPACE_CONFIG
	string "CONFIG: Project Configure Options"

config PK_PCP_USERSPACE_LIBPATH
	string "LIBS: Libraries to pass to the linker, e.g. -l<library>"

config PK_PCP_USERSPACE_CPPFLAGS
	string "CPPFLAGS: C/C++ preprocessor flags, e.g. -I<include dir>"

config PK_PCP_USERSPACE_DPKCONFIG
	string "PKG_CONFIG_PATH: Directories to add to pkg-config's search path"

config PK_PCP_USERSPACE_CFLAGS
	string "CFLAGS: C compiler flags"

config PK_PCP_USERSPACE_LDFLAGS
	string "LDFLAGS: Linker flags"

config PK_PCP_USERSPACE_CXXFLAGS
	string "CXXFLAGS: C++ compiler flags"

config PK_PCP_USERSPACE_ASFLAGS
	string "CCASFLAGS: assembler compiler flags (defaults to CFLAGS)"

config PK_PCP_USERSPACE_BUILDARCH
	string "--host options on configure for Architecture"

endif # PK_PCP_USERSPACE
```

## package/buddy/buddy_highmem_userspace/Kconfig
```kconfig
menuconfig PK_BUDDY_HIGHMEM_USERSPACE
	bool "Buddy Allocator (Highmem) on Userspace"

if PK_BUDDY_HIGHMEM_USERSPACE

config PK_BUDDY_HIGHMEM_USERSPACE_VERSION
	default "0.0.1"
	string "verstion"

config PK_BUDDY_HIGHMEM_USERSPACE_TAR
	default "tar.gz"
	string "tar type"

config PK_BUDDY_HIGHMEM_USERSPACE_URL
	default "https://gitee.com/BiscuitOS_team/HardStack/raw/Gitee/Memory-Allocator/Buddy/HighMem_usespace"
	string "url"

config PK_BUDDY_HIGHMEM_USERSPACE_GITHUB
	string "GitHub"

config PK_BUDDY_HIGHMEM_USERSPACE_SRCFILE
	default "main.c Makefile README.md include/linux/buddy.h include/linux/list.h mm/buddy.c"
	string "Source code list"

config PK_BUDDY_HIGHMEM_USERSPACE_CSRCFILE
	string "Compile source code list"

config PK_BUDDY_HIGHMEM_USERSPACE_CONFIG
	string "CONFIG: Project Configure Options"

config PK_BUDDY_HIGHMEM_USERSPACE_LIBPATH
	string "LIBS: Libraries to pass to the linker, e.g. -l<library>"

config PK_BUDDY_HIGHMEM_USERSPACE_CPPFLAGS
	string "CPPFLAGS: C/C++ preprocessor flags, e.g. -I<include dir>"

config PK_BUDDY_HIGHMEM_USERSPACE_DPKCONFIG
	string "PKG_CONFIG_PATH: Directories to add to pkg-config's search path"

config PK_BUDDY_HIGHMEM_USERSPACE_CFLAGS
	string "CFLAGS: C compiler flags"

config PK_BUDDY_HIGHMEM_USERSPACE_LDFLAGS
	string "LDFLAGS: Linker flags"

config PK_BUDDY_HIGHMEM_USERSPACE_CXXFLAGS
	string "CXXFLAGS: C++ compiler flags"

config PK_BUDDY_HIGHMEM_USERSPACE_ASFLAGS
	string "CCASFLAGS: assembler compiler flags (defaults to CFLAGS)"

config PK_BUDDY_HIGHMEM_USERSPACE_BUILDARCH
	string "--host options on configure for Architecture"

endif # PK_BUDDY_HIGHMEM_USERSPACE
```
