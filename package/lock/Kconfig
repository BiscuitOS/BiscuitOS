## package/lock/Kconfig
```kconfig
menuconfig PK_LOCK
	bool "Lock Mechanism on Linux"

if PK_LOCK

# rculock
source package/lock/rculock/Kconfig

# rwlock
source package/lock/rwlock/Kconfig

# seqlock
source package/lock/seqlock/Kconfig

endif # PK_LOCK
```

## package/lock/rculock/Kconfig
```kconfig
menuconfig PK_RCULOCK
	bool "rculock"

if PK_RCULOCK

# rculock base
source package/lock/rculock/rculock_base/Kconfig

endif # PK_RCULOCK
```

## package/lock/rculock/rculock_base/Kconfig
```kconfig
menuconfig PK_RCULOCK_BASE
	bool "rculock basic usage"

if PK_RCULOCK_BASE

config PK_RCULOCK_BASE_VERSION
	default "0.0.1"
	string "verstion"

config PK_RCULOCK_BASE_TAR
	default "tar.gz"
	string "tar type"

config PK_RCULOCK_BASE_URL
	default "https://gitee.com/BiscuitOS_team/HardStack/raw/Gitee/Algorithem/rculock/base"
	string "url"

config PK_RCULOCK_BASE_GITHUB
	string "GitHub"

config PK_RCULOCK_BASE_SRCFILE
	default "main.c Kconfig Makefile"
	string "Source code list"

config PK_RCULOCK_BASE_CSRCFILE
	string "Compile source code list"

config PK_RCULOCK_BASE_CONFIG
	string "CONFIG: Project Configure Options"

config PK_RCULOCK_BASE_LIBPATH
	string "LIBS: Libraries to pass to the linker, e.g. -l<library>"

config PK_RCULOCK_BASE_CPPFLAGS
	string "CPPFLAGS: C/C++ preprocessor flags, e.g. -I<include dir>"

config PK_RCULOCK_BASE_DPKCONFIG
	string "PKG_CONFIG_PATH: Directories to add to pkg-config's search path"

config PK_RCULOCK_BASE_CFLAGS
	string "CFLAGS: C compiler flags"

config PK_RCULOCK_BASE_LDFLAGS
	string "LDFLAGS: Linker flags"

config PK_RCULOCK_BASE_CXXFLAGS
	string "CXXFLAGS: C++ compiler flags"

config PK_RCULOCK_BASE_ASFLAGS
	string "CCASFLAGS: assembler compiler flags (defaults to CFLAGS)"

config PK_RCULOCK_BASE_BUILDARCH
	string "--host options on configure for Architecture"

endif # PK_RCULOCK_BASE
```

## package/lock/rwlock/Kconfig
```kconfig
menuconfig PK_RWLOCK
	bool "rwlock"

if PK_RWLOCK

# rwlock base
source package/lock/rwlock/rwlock_base/Kconfig

endif # PK_RWLOCK
```

## package/lock/seqlock/Kconfig
```kconfig
menuconfig PK_SEQLOCK
	bool "seqlock"

if PK_SEQLOCK

# seqlock base
source package/lock/seqlock/seqlock_base/Kconfig

endif # PK_SEQLOCK
```

## package/lock/seqlock/seqlock_base/Kconfig
```kconfig
menuconfig PK_SEQLOCK_BASE
	bool "seqlock basic usage"

if PK_SEQLOCK_BASE

config PK_SEQLOCK_BASE_VERSION
	default "0.0.1"
	string "verstion"

config PK_SEQLOCK_BASE_TAR
	default "tar.gz"
	string "tar type"

config PK_SEQLOCK_BASE_URL
	default "https://gitee.com/BiscuitOS_team/HardStack/raw/Gitee/Algorithem/seqlock/base"
	string "url"

config PK_SEQLOCK_BASE_GITHUB
	string "GitHub"

config PK_SEQLOCK_BASE_SRCFILE
	default "main.c Kconfig Makefile"
	string "Source code list"

config PK_SEQLOCK_BASE_CSRCFILE
	string "Compile source code list"

config PK_SEQLOCK_BASE_CONFIG
	string "CONFIG: Project Configure Options"

config PK_SEQLOCK_BASE_LIBPATH
	string "LIBS: Libraries to pass to the linker, e.g. -l<library>"

config PK_SEQLOCK_BASE_CPPFLAGS
	string "CPPFLAGS: C/C++ preprocessor flags, e.g. -I<include dir>"

config PK_SEQLOCK_BASE_DPKCONFIG
	string "PKG_CONFIG_PATH: Directories to add to pkg-config's search path"

config PK_SEQLOCK_BASE_CFLAGS
	string "CFLAGS: C compiler flags"

config PK_SEQLOCK_BASE_LDFLAGS
	string "LDFLAGS: Linker flags"

config PK_SEQLOCK_BASE_CXXFLAGS
	string "CXXFLAGS: C++ compiler flags"

config PK_SEQLOCK_BASE_ASFLAGS
	string "CCASFLAGS: assembler compiler flags (defaults to CFLAGS)"

config PK_SEQLOCK_BASE_BUILDARCH
	string "--host options on configure for Architecture"

endif # PK_SEQLOCK_BASE
```

## package/lzip/Kconfig
```kconfig
menuconfig PK_LZIP
	bool "lzip"

if PK_LZIP

config PK_LZIP_VERSION
	default "1.20"
	string "verstion"

config PK_LZIP_TAR
	default "tar.gz"
	string "tar type"

config PK_LZIP_URL
	default "http://download.savannah.gnu.org/releases/lzip"
	string "url"

config PK_LZIP_GITHUB
	string "GitHub"

config PK_LZIP_SRCFILE
	string "Source code list"

config PK_LZIP_CONFIG
	default "--enable-silent-rules"
	string "CONFIG: Project Configure Options"

config PK_LZIP_LIBPATH
	string "LIBS: Libraries to pass to the linker, e.g. -l<library>"

config PK_LZIP_CPPFLAGS
	string "CPPFLAGS: C/C++ preprocessor flags, e.g. -I<include dir>"

config PK_LZIP_DPKCONFIG
	string "PKG_CONFIG_PATH: Directories to add to pkg-config's search path"

config PK_LZIP_CFLAGS
	string "CFLAGS: C compiler flags"

config PK_LZIP_LDFLAGS
	string "LDFLAGS: Linker flags"

config PK_LZIP_CXXFLAGS
	string "CXXFLAGS: C++ compiler flags"

config PK_LZIP_ASFLAGS
	string "CCASFLAGS: assembler compiler flags (defaults to CFLAGS)"

config PK_LZIP_BUILDARCH
	default "x86_64-unknown-linux-gnu"
	string "--host options on configure for Architecture"

endif # PK_LZIP
```

## package/madvise/BiscuitOS-madvise-KSM/Kconfig
```kconfig
menuconfig PK_MADVISE_KSM
	bool "MADVISE: KSM"

if PK_MADVISE_KSM

config PK_MADVISE_KSM_VERSION
	default "default"
	string "verstion"

config PK_MADVISE_KSM_TAR
	default "tar.gz"
	string "tar type"

config PK_MADVISE_KSM_URL
	default "https://gitee.com/BiscuitOS_team/HardStack/raw/Gitee/Memory-Allocator/madvise/BiscuitOS-madvise-KSM"
	string "url"

config PK_MADVISE_KSM_GITHUB
	string "GitHub"

config PK_MADVISE_KSM_SRCFILE
	default "main.c Makefile"
	string "Source code list"

config PK_MADVISE_KSM_CSRCFILE
	string "Compile source code list"

config PK_MADVISE_KSM_CONFIG
	string "CONFIG: Project Configure Options"

config PK_MADVISE_KSM_LIBPATH
	string "LIBS: Libraries to pass to the linker, e.g. -l<library>"

config PK_MADVISE_KSM_CPPFLAGS
	string "CPPFLAGS: C/C++ preprocessor flags, e.g. -I<include dir>"

config PK_MADVISE_KSM_DPKCONFIG
	string "PKG_CONFIG_PATH: Directories to add to pkg-config's search path"

config PK_MADVISE_KSM_CFLAGS
	string "CFLAGS: C compiler flags"

config PK_MADVISE_KSM_LDFLAGS
	string "LDFLAGS: Linker flags"

config PK_MADVISE_KSM_CXXFLAGS
	string "CXXFLAGS: C++ compiler flags"

config PK_MADVISE_KSM_ASFLAGS
	string "CCASFLAGS: assembler compiler flags (defaults to CFLAGS)"

config PK_MADVISE_KSM_BUILDARCH
	string "--host options on configure for Architecture"

endif # PK_MADVISE_KSM
```

## package/madvise/BiscuitOS-madvise-MADV_DONTFORK/Kconfig
```kconfig
menuconfig PK_MADVISE_MADV_DONTFORK
	bool "MADV_DONTFORK: Don't inherit across fork"

if PK_MADVISE_MADV_DONTFORK

config PK_MADVISE_MADV_DONTFORK_VERSION
	default "default"
	string "verstion"

config PK_MADVISE_MADV_DONTFORK_TAR
	default "tar.gz"
	string "tar type"

config PK_MADVISE_MADV_DONTFORK_URL
	default "https://gitee.com/BiscuitOS_team/HardStack/raw/Gitee/Memory-Allocator/MADVISE-MECH/BiscuitOS-madvise-MADV_DONTFORK"
	string "url"

config PK_MADVISE_MADV_DONTFORK_GITHUB
	string "GitHub"

config PK_MADVISE_MADV_DONTFORK_SRCFILE
	default "main.c Makefile"
	string "Source code list"

config PK_MADVISE_MADV_DONTFORK_CSRCFILE
	string "Compile source code list"

config PK_MADVISE_MADV_DONTFORK_CONFIG
	string "CONFIG: Project Configure Options"

config PK_MADVISE_MADV_DONTFORK_LIBPATH
	string "LIBS: Libraries to pass to the linker, e.g. -l<library>"

config PK_MADVISE_MADV_DONTFORK_CPPFLAGS
	string "CPPFLAGS: C/C++ preprocessor flags, e.g. -I<include dir>"

config PK_MADVISE_MADV_DONTFORK_DPKCONFIG
	string "PKG_CONFIG_PATH: Directories to add to pkg-config's search path"

config PK_MADVISE_MADV_DONTFORK_CFLAGS
	string "CFLAGS: C compiler flags"

config PK_MADVISE_MADV_DONTFORK_LDFLAGS
	string "LDFLAGS: Linker flags"

config PK_MADVISE_MADV_DONTFORK_CXXFLAGS
	string "CXXFLAGS: C++ compiler flags"

config PK_MADVISE_MADV_DONTFORK_ASFLAGS
	string "CCASFLAGS: assembler compiler flags (defaults to CFLAGS)"

config PK_MADVISE_MADV_DONTFORK_BUILDARCH
	string "--host options on configure for Architecture"

endif # PK_MADVISE_MADV_DONTFORK
```

## package/madvise/BiscuitOS-madvise-MADV_DONTNEED/Kconfig
```kconfig
menuconfig PK_MADVISE_MADV_DONTNEED
	bool "MADV_DONTNEED: Don't need these pages"

if PK_MADVISE_MADV_DONTNEED

config PK_MADVISE_MADV_DONTNEED_VERSION
	default "default"
	string "verstion"

config PK_MADVISE_MADV_DONTNEED_TAR
	default "tar.gz"
	string "tar type"

config PK_MADVISE_MADV_DONTNEED_URL
	default "https://gitee.com/BiscuitOS_team/HardStack/raw/Gitee/Memory-Allocator/MADVISE-MECH/BiscuitOS-madvise-MADV_DONTNEED"
	string "url"

config PK_MADVISE_MADV_DONTNEED_GITHUB
	string "GitHub"

config PK_MADVISE_MADV_DONTNEED_SRCFILE
	default "main.c Makefile"
	string "Source code list"

config PK_MADVISE_MADV_DONTNEED_CSRCFILE
	string "Compile source code list"

config PK_MADVISE_MADV_DONTNEED_CONFIG
	string "CONFIG: Project Configure Options"

config PK_MADVISE_MADV_DONTNEED_LIBPATH
	string "LIBS: Libraries to pass to the linker, e.g. -l<library>"

config PK_MADVISE_MADV_DONTNEED_CPPFLAGS
	string "CPPFLAGS: C/C++ preprocessor flags, e.g. -I<include dir>"

config PK_MADVISE_MADV_DONTNEED_DPKCONFIG
	string "PKG_CONFIG_PATH: Directories to add to pkg-config's search path"

config PK_MADVISE_MADV_DONTNEED_CFLAGS
	string "CFLAGS: C compiler flags"

config PK_MADVISE_MADV_DONTNEED_LDFLAGS
	string "LDFLAGS: Linker flags"

config PK_MADVISE_MADV_DONTNEED_CXXFLAGS
	string "CXXFLAGS: C++ compiler flags"

config PK_MADVISE_MADV_DONTNEED_ASFLAGS
	string "CCASFLAGS: assembler compiler flags (defaults to CFLAGS)"

config PK_MADVISE_MADV_DONTNEED_BUILDARCH
	string "--host options on configure for Architecture"

endif # PK_MADVISE_MADV_DONTNEED
```

## package/madvise/BiscuitOS-madvise-MADV_FREE/Kconfig
```kconfig
menuconfig PK_MADVISE_MADV_FREE
	bool "MADV_FREE: Free pages only if memory pressure"

if PK_MADVISE_MADV_FREE

config PK_MADVISE_MADV_FREE_VERSION
	default "default"
	string "verstion"

config PK_MADVISE_MADV_FREE_TAR
	default "tar.gz"
	string "tar type"

config PK_MADVISE_MADV_FREE_URL
	default "https://gitee.com/BiscuitOS_team/HardStack/raw/Gitee/Memory-Allocator/MADVISE-MECH/BiscuitOS-madvise-MADV_FREE"
	string "url"

config PK_MADVISE_MADV_FREE_GITHUB
	string "GitHub"

config PK_MADVISE_MADV_FREE_SRCFILE
	default "main.c Makefile"
	string "Source code list"

config PK_MADVISE_MADV_FREE_CSRCFILE
	string "Compile source code list"

config PK_MADVISE_MADV_FREE_CONFIG
	string "CONFIG: Project Configure Options"

config PK_MADVISE_MADV_FREE_LIBPATH
	string "LIBS: Libraries to pass to the linker, e.g. -l<library>"

config PK_MADVISE_MADV_FREE_CPPFLAGS
	string "CPPFLAGS: C/C++ preprocessor flags, e.g. -I<include dir>"

config PK_MADVISE_MADV_FREE_DPKCONFIG
	string "PKG_CONFIG_PATH: Directories to add to pkg-config's search path"

config PK_MADVISE_MADV_FREE_CFLAGS
	string "CFLAGS: C compiler flags"

config PK_MADVISE_MADV_FREE_LDFLAGS
	string "LDFLAGS: Linker flags"

config PK_MADVISE_MADV_FREE_CXXFLAGS
	string "CXXFLAGS: C++ compiler flags"

config PK_MADVISE_MADV_FREE_ASFLAGS
	string "CCASFLAGS: assembler compiler flags (defaults to CFLAGS)"

config PK_MADVISE_MADV_FREE_BUILDARCH
	string "--host options on configure for Architecture"

endif # PK_MADVISE_MADV_FREE
```

## package/madvise/BiscuitOS-madvise-MADV_NORMAL/Kconfig
```kconfig
menuconfig PK_MADVISE_MADV_NORMAL
	bool "MADV_NORMAL: Default madvise"

if PK_MADVISE_MADV_NORMAL

config PK_MADVISE_MADV_NORMAL_VERSION
	default "default"
	string "verstion"

config PK_MADVISE_MADV_NORMAL_TAR
	default "tar.gz"
	string "tar type"

config PK_MADVISE_MADV_NORMAL_URL
	default "https://gitee.com/BiscuitOS_team/HardStack/raw/Gitee/Memory-Allocator/MADVISE-MECH/BiscuitOS-madvise-MADV_NORMAL"
	string "url"

config PK_MADVISE_MADV_NORMAL_GITHUB
	string "GitHub"

config PK_MADVISE_MADV_NORMAL_SRCFILE
	default "main.c Makefile"
	string "Source code list"

config PK_MADVISE_MADV_NORMAL_CSRCFILE
	string "Compile source code list"

config PK_MADVISE_MADV_NORMAL_CONFIG
	string "CONFIG: Project Configure Options"

config PK_MADVISE_MADV_NORMAL_LIBPATH
	string "LIBS: Libraries to pass to the linker, e.g. -l<library>"

config PK_MADVISE_MADV_NORMAL_CPPFLAGS
	string "CPPFLAGS: C/C++ preprocessor flags, e.g. -I<include dir>"

config PK_MADVISE_MADV_NORMAL_DPKCONFIG
	string "PKG_CONFIG_PATH: Directories to add to pkg-config's search path"

config PK_MADVISE_MADV_NORMAL_CFLAGS
	string "CFLAGS: C compiler flags"

config PK_MADVISE_MADV_NORMAL_LDFLAGS
	string "LDFLAGS: Linker flags"

config PK_MADVISE_MADV_NORMAL_CXXFLAGS
	string "CXXFLAGS: C++ compiler flags"

config PK_MADVISE_MADV_NORMAL_ASFLAGS
	string "CCASFLAGS: assembler compiler flags (defaults to CFLAGS)"

config PK_MADVISE_MADV_NORMAL_BUILDARCH
	string "--host options on configure for Architecture"

endif # PK_MADVISE_MADV_NORMAL
```

## package/madvise/BiscuitOS-madvise-MADV_PAGEOUT/Kconfig
```kconfig
menuconfig PK_MADVISE_MADV_PAGEOUT
	bool "MADV_PAGEOUT: Reclaim or SwapOut Page"

if PK_MADVISE_MADV_PAGEOUT

config PK_MADVISE_MADV_PAGEOUT_VERSION
	default "default"
	string "verstion"

config PK_MADVISE_MADV_PAGEOUT_TAR
	default "tar.gz"
	string "tar type"

config PK_MADVISE_MADV_PAGEOUT_URL
	default "https://gitee.com/BiscuitOS_team/HardStack/raw/Gitee/Memory-Allocator/MADVISE-MECH/BiscuitOS-madvise-MADV_PAGEOUT"
	string "url"

config PK_MADVISE_MADV_PAGEOUT_GITHUB
	string "GitHub"

config PK_MADVISE_MADV_PAGEOUT_SRCFILE
	default "main.c Makefile RunBiscuitOS.sh"
	string "Source code list"

config PK_MADVISE_MADV_PAGEOUT_CSRCFILE
	string "Compile source code list"

config PK_MADVISE_MADV_PAGEOUT_CONFIG
	string "CONFIG: Project Configure Options"

config PK_MADVISE_MADV_PAGEOUT_LIBPATH
	string "LIBS: Libraries to pass to the linker, e.g. -l<library>"

config PK_MADVISE_MADV_PAGEOUT_CPPFLAGS
	string "CPPFLAGS: C/C++ preprocessor flags, e.g. -I<include dir>"

config PK_MADVISE_MADV_PAGEOUT_DPKCONFIG
	string "PKG_CONFIG_PATH: Directories to add to pkg-config's search path"

config PK_MADVISE_MADV_PAGEOUT_CFLAGS
	string "CFLAGS: C compiler flags"

config PK_MADVISE_MADV_PAGEOUT_LDFLAGS
	string "LDFLAGS: Linker flags"

config PK_MADVISE_MADV_PAGEOUT_CXXFLAGS
	string "CXXFLAGS: C++ compiler flags"

config PK_MADVISE_MADV_PAGEOUT_ASFLAGS
	string "CCASFLAGS: assembler compiler flags (defaults to CFLAGS)"

config PK_MADVISE_MADV_PAGEOUT_BUILDARCH
	string "--host options on configure for Architecture"

endif # PK_MADVISE_MADV_PAGEOUT
```

## package/madvise/BiscuitOS-madvise-MADV_RANDOM/Kconfig
```kconfig
menuconfig PK_MADVISE_MADV_RANDOM
	bool "MADV_RANDOM: Expect random page references"

if PK_MADVISE_MADV_RANDOM

config PK_MADVISE_MADV_RANDOM_VERSION
	default "default"
	string "verstion"

config PK_MADVISE_MADV_RANDOM_TAR
	default "tar.gz"
	string "tar type"

config PK_MADVISE_MADV_RANDOM_URL
	default "https://gitee.com/BiscuitOS_team/HardStack/raw/Gitee/Memory-Allocator/MADVISE-MECH/BiscuitOS-madvise-MADV_RANDOM"
	string "url"

config PK_MADVISE_MADV_RANDOM_GITHUB
	string "GitHub"

config PK_MADVISE_MADV_RANDOM_SRCFILE
	default "main.c Makefile"
	string "Source code list"

config PK_MADVISE_MADV_RANDOM_CSRCFILE
	string "Compile source code list"

config PK_MADVISE_MADV_RANDOM_CONFIG
	string "CONFIG: Project Configure Options"

config PK_MADVISE_MADV_RANDOM_LIBPATH
	string "LIBS: Libraries to pass to the linker, e.g. -l<library>"

config PK_MADVISE_MADV_RANDOM_CPPFLAGS
	string "CPPFLAGS: C/C++ preprocessor flags, e.g. -I<include dir>"

config PK_MADVISE_MADV_RANDOM_DPKCONFIG
	string "PKG_CONFIG_PATH: Directories to add to pkg-config's search path"

config PK_MADVISE_MADV_RANDOM_CFLAGS
	string "CFLAGS: C compiler flags"

config PK_MADVISE_MADV_RANDOM_LDFLAGS
	string "LDFLAGS: Linker flags"

config PK_MADVISE_MADV_RANDOM_CXXFLAGS
	string "CXXFLAGS: C++ compiler flags"

config PK_MADVISE_MADV_RANDOM_ASFLAGS
	string "CCASFLAGS: assembler compiler flags (defaults to CFLAGS)"

config PK_MADVISE_MADV_RANDOM_BUILDARCH
	string "--host options on configure for Architecture"

endif # PK_MADVISE_MADV_RANDOM
```
