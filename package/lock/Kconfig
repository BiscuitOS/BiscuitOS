## package/madvise/BiscuitOS-madvise-MADV_REMOVE/Kconfig
```kconfig
menuconfig PK_MADVISE_MADV_REMOVE
	bool "MADV_REMOVE: Remove these pages & resources"

if PK_MADVISE_MADV_REMOVE

config PK_MADVISE_MADV_REMOVE_VERSION
	default "default"
	string "verstion"

config PK_MADVISE_MADV_REMOVE_TAR
	default "tar.gz"
	string "tar type"

config PK_MADVISE_MADV_REMOVE_URL
	default "https://gitee.com/BiscuitOS_team/HardStack/raw/Gitee/Memory-Allocator/MADVISE-MECH/BiscuitOS-madvise-MADV_REMOVE"
	string "url"

config PK_MADVISE_MADV_REMOVE_GITHUB
	string "GitHub"

config PK_MADVISE_MADV_REMOVE_SRCFILE
	default "main.c Makefile RunBiscuitOS.sh"
	string "Source code list"

config PK_MADVISE_MADV_REMOVE_CSRCFILE
	string "Compile source code list"

config PK_MADVISE_MADV_REMOVE_CONFIG
	string "CONFIG: Project Configure Options"

config PK_MADVISE_MADV_REMOVE_LIBPATH
	string "LIBS: Libraries to pass to the linker, e.g. -l<library>"

config PK_MADVISE_MADV_REMOVE_CPPFLAGS
	string "CPPFLAGS: C/C++ preprocessor flags, e.g. -I<include dir>"

config PK_MADVISE_MADV_REMOVE_DPKCONFIG
	string "PKG_CONFIG_PATH: Directories to add to pkg-config's search path"

config PK_MADVISE_MADV_REMOVE_CFLAGS
	string "CFLAGS: C compiler flags"

config PK_MADVISE_MADV_REMOVE_LDFLAGS
	string "LDFLAGS: Linker flags"

config PK_MADVISE_MADV_REMOVE_CXXFLAGS
	string "CXXFLAGS: C++ compiler flags"

config PK_MADVISE_MADV_REMOVE_ASFLAGS
	string "CCASFLAGS: assembler compiler flags (defaults to CFLAGS)"

config PK_MADVISE_MADV_REMOVE_BUILDARCH
	string "--host options on configure for Architecture"

endif # PK_MADVISE_MADV_REMOVE
```

## package/madvise/BiscuitOS-madvise-MADV_SEQUENTIAL/Kconfig
```kconfig
menuconfig PK_MADVISE_MADV_SEQUENTIAL
	bool "MADV_SEQUENTIAL: Expect sequential page references"

if PK_MADVISE_MADV_SEQUENTIAL

config PK_MADVISE_MADV_SEQUENTIAL_VERSION
	default "default"
	string "verstion"

config PK_MADVISE_MADV_SEQUENTIAL_TAR
	default "tar.gz"
	string "tar type"

config PK_MADVISE_MADV_SEQUENTIAL_URL
	default "https://gitee.com/BiscuitOS_team/HardStack/raw/Gitee/Memory-Allocator/MADVISE-MECH/BiscuitOS-madvise-MADV_SEQUENTIAL"
	string "url"

config PK_MADVISE_MADV_SEQUENTIAL_GITHUB
	string "GitHub"

config PK_MADVISE_MADV_SEQUENTIAL_SRCFILE
	default "main.c Makefile"
	string "Source code list"

config PK_MADVISE_MADV_SEQUENTIAL_CSRCFILE
	string "Compile source code list"

config PK_MADVISE_MADV_SEQUENTIAL_CONFIG
	string "CONFIG: Project Configure Options"

config PK_MADVISE_MADV_SEQUENTIAL_LIBPATH
	string "LIBS: Libraries to pass to the linker, e.g. -l<library>"

config PK_MADVISE_MADV_SEQUENTIAL_CPPFLAGS
	string "CPPFLAGS: C/C++ preprocessor flags, e.g. -I<include dir>"

config PK_MADVISE_MADV_SEQUENTIAL_DPKCONFIG
	string "PKG_CONFIG_PATH: Directories to add to pkg-config's search path"

config PK_MADVISE_MADV_SEQUENTIAL_CFLAGS
	string "CFLAGS: C compiler flags"

config PK_MADVISE_MADV_SEQUENTIAL_LDFLAGS
	string "LDFLAGS: Linker flags"

config PK_MADVISE_MADV_SEQUENTIAL_CXXFLAGS
	string "CXXFLAGS: C++ compiler flags"

config PK_MADVISE_MADV_SEQUENTIAL_ASFLAGS
	string "CCASFLAGS: assembler compiler flags (defaults to CFLAGS)"

config PK_MADVISE_MADV_SEQUENTIAL_BUILDARCH
	string "--host options on configure for Architecture"

endif # PK_MADVISE_MADV_SEQUENTIAL
```

## package/madvise/BiscuitOS-madvise-MADV_WILLNEED/Kconfig
```kconfig
menuconfig PK_MADVISE_MADV_WILLNEED
	bool "MADV_WILLNEED: Will need these pages "

if PK_MADVISE_MADV_WILLNEED

config PK_MADVISE_MADV_WILLNEED_VERSION
	default "default"
	string "verstion"

config PK_MADVISE_MADV_WILLNEED_TAR
	default "tar.gz"
	string "tar type"

config PK_MADVISE_MADV_WILLNEED_URL
	default "https://gitee.com/BiscuitOS_team/HardStack/raw/Gitee/Memory-Allocator/MADVISE-MECH/BiscuitOS-madvise-MADV_WILLNEED"
	string "url"

config PK_MADVISE_MADV_WILLNEED_GITHUB
	string "GitHub"

config PK_MADVISE_MADV_WILLNEED_SRCFILE
	default "main.c Makefile"
	string "Source code list"

config PK_MADVISE_MADV_WILLNEED_CSRCFILE
	string "Compile source code list"

config PK_MADVISE_MADV_WILLNEED_CONFIG
	string "CONFIG: Project Configure Options"

config PK_MADVISE_MADV_WILLNEED_LIBPATH
	string "LIBS: Libraries to pass to the linker, e.g. -l<library>"

config PK_MADVISE_MADV_WILLNEED_CPPFLAGS
	string "CPPFLAGS: C/C++ preprocessor flags, e.g. -I<include dir>"

config PK_MADVISE_MADV_WILLNEED_DPKCONFIG
	string "PKG_CONFIG_PATH: Directories to add to pkg-config's search path"

config PK_MADVISE_MADV_WILLNEED_CFLAGS
	string "CFLAGS: C compiler flags"

config PK_MADVISE_MADV_WILLNEED_LDFLAGS
	string "LDFLAGS: Linker flags"

config PK_MADVISE_MADV_WILLNEED_CXXFLAGS
	string "CXXFLAGS: C++ compiler flags"

config PK_MADVISE_MADV_WILLNEED_ASFLAGS
	string "CCASFLAGS: assembler compiler flags (defaults to CFLAGS)"

config PK_MADVISE_MADV_WILLNEED_BUILDARCH
	string "--host options on configure for Architecture"

endif # PK_MADVISE_MADV_WILLNEED
```

## package/madvise/Kconfig
```kconfig
menuconfig PK_MADVISE
	bool "Madvise: Memory advise Mechanism"

if PK_MADVISE

# MADV_NORMAL
source package/madvise/BiscuitOS-madvise-MADV_NORMAL/Kconfig

# MADV_RANDOM
source package/madvise/BiscuitOS-madvise-MADV_RANDOM/Kconfig

# MADV_SEQUENTIAL
source package/madvise/BiscuitOS-madvise-MADV_SEQUENTIAL/Kconfig

# MADV_WILLNEED
source package/madvise/BiscuitOS-madvise-MADV_WILLNEED/Kconfig

# MADV_DONTNEED
source package/madvise/BiscuitOS-madvise-MADV_DONTNEED/Kconfig

# MADV_FREE
source package/madvise/BiscuitOS-madvise-MADV_FREE/Kconfig

# MADV_REMOVE
source package/madvise/BiscuitOS-madvise-MADV_REMOVE/Kconfig

# MADV_DONTFORK
source package/madvise/BiscuitOS-madvise-MADV_DONTFORK/Kconfig

# KSM
source package/madvise/BiscuitOS-madvise-KSM/Kconfig

# MADV_PAGEOUT
source package/madvise/BiscuitOS-madvise-MADV_PAGEOUT/Kconfig

endif # PK_MADVISE
```

## package/memblock/BiscuitOS/Kconfig
```kconfig
menuconfig PK_MEMBLOCK_DEMO
	bool "memblock_demo"

if PK_MEMBLOCK_DEMO

config PK_MEMBLOCK_DEMO_VERSION
	default "default"
	string "verstion"

config PK_MEMBLOCK_DEMO_TAR
	default "tar.gz"
	string "tar type"

config PK_MEMBLOCK_DEMO_URL
	default "https://gitee.com/BiscuitOS_team/HardStack/raw/Gitee/Memory-Allocator/Memblock-allocator/memblock_demo"
	string "url"

config PK_MEMBLOCK_DEMO_GITHUB
	string "GitHub"

config PK_MEMBLOCK_DEMO_SRCFILE
	default "main.c Kconfig Makefile BiscuitOS_Insert.bs"
	string "Source code list"

config PK_MEMBLOCK_DEMO_CSRCFILE
	string "Compile source code list"

config PK_MEMBLOCK_DEMO_CONFIG
	string "CONFIG: Project Configure Options"

config PK_MEMBLOCK_DEMO_LIBPATH
	string "LIBS: Libraries to pass to the linker, e.g. -l<library>"

config PK_MEMBLOCK_DEMO_CPPFLAGS
	string "CPPFLAGS: C/C++ preprocessor flags, e.g. -I<include dir>"

config PK_MEMBLOCK_DEMO_DPKCONFIG
	string "PKG_CONFIG_PATH: Directories to add to pkg-config's search path"

config PK_MEMBLOCK_DEMO_CFLAGS
	string "CFLAGS: C compiler flags"

config PK_MEMBLOCK_DEMO_LDFLAGS
	string "LDFLAGS: Linker flags"

config PK_MEMBLOCK_DEMO_CXXFLAGS
	string "CXXFLAGS: C++ compiler flags"

config PK_MEMBLOCK_DEMO_ASFLAGS
	string "CCASFLAGS: assembler compiler flags (defaults to CFLAGS)"

config PK_MEMBLOCK_DEMO_BUILDARCH
	string "--host options on configure for Architecture"

endif # PK_MEMBLOCK_DEMO
```

## package/memblock/Kconfig
```kconfig
menuconfig PK_MEMBLOCK
	bool "MEMBLOCK Memory Allocator"

if PK_MEMBLOCK

# memblock on userspace
source package/memblock/memblock_userspace/Kconfig

# memblock_set_region_node
source package/memblock/memblock_set_region_node/Kconfig

endif # PK_MEMBLOCK
```

## package/memblock/memblock_userspace/Kconfig
```kconfig
menuconfig PK_MEMBLOCK_USERSPACE
	bool "MEMBLOCK Allocator on Userspace"

if PK_MEMBLOCK_USERSPACE

config PK_MEMBLOCK_USERSPACE_VERSION
	default "0.0.1"
	string "verstion"

config PK_MEMBLOCK_USERSPACE_TAR
	default "tar.gz"
	string "tar type"

config PK_MEMBLOCK_USERSPACE_URL
	default "https://gitee.com/BiscuitOS_team/HardStack/raw/Gitee/Memory-Allocator/Memblock-allocator/memblock_userspace"
	string "url"

config PK_MEMBLOCK_USERSPACE_GITHUB
	string "GitHub"

config PK_MEMBLOCK_USERSPACE_SRCFILE
	default "main.c include/linux/memblock.h include/linux/biscuitos.h include/linux/mm.h mm/memblock.c README.md Makefile"
	string "Source code list"

config PK_MEMBLOCK_USERSPACE_CSRCFILE
	string "Compile source code list"

config PK_MEMBLOCK_USERSPACE_CONFIG
	string "CONFIG: Project Configure Options"

config PK_MEMBLOCK_USERSPACE_LIBPATH
	string "LIBS: Libraries to pass to the linker, e.g. -l<library>"

config PK_MEMBLOCK_USERSPACE_CPPFLAGS
	string "CPPFLAGS: C/C++ preprocessor flags, e.g. -I<include dir>"

config PK_MEMBLOCK_USERSPACE_DPKCONFIG
	string "PKG_CONFIG_PATH: Directories to add to pkg-config's search path"

config PK_MEMBLOCK_USERSPACE_CFLAGS
	string "CFLAGS: C compiler flags"

config PK_MEMBLOCK_USERSPACE_LDFLAGS
	string "LDFLAGS: Linker flags"

config PK_MEMBLOCK_USERSPACE_CXXFLAGS
	string "CXXFLAGS: C++ compiler flags"

config PK_MEMBLOCK_USERSPACE_ASFLAGS
	string "CCASFLAGS: assembler compiler flags (defaults to CFLAGS)"

config PK_MEMBLOCK_USERSPACE_BUILDARCH
	string "--host options on configure for Architecture"

endif # PK_MEMBLOCK_USERSPACE
```

## package/memory-leak/BiscuitOS-ASAN/Kconfig
```kconfig
menuconfig PK_ASAN
	bool "GCC Address Sanitizer (ASAN)"

if PK_ASAN

config PK_ASAN_VERSION
	default "default"
	string "verstion"

config PK_ASAN_TAR
	default "tar.gz"
	string "tar type"

config PK_ASAN_URL
	default "https://gitee.com/BiscuitOS_team/HardStack/raw/Gitee/Memory-Allocator/Memory-Leak/BiscuitOS-ASAN"
	string "url"

config PK_ASAN_GITHUB
	string "GitHub"

config PK_ASAN_SRCFILE
	default "main.c Makefile"
	string "Source code list"

config PK_ASAN_CSRCFILE
	string "Compile source code list"

config PK_ASAN_CONFIG
	string "CONFIG: Project Configure Options"

config PK_ASAN_LIBPATH
	string "LIBS: Libraries to pass to the linker, e.g. -l<library>"

config PK_ASAN_CPPFLAGS
	string "CPPFLAGS: C/C++ preprocessor flags, e.g. -I<include dir>"

config PK_ASAN_DPKCONFIG
	string "PKG_CONFIG_PATH: Directories to add to pkg-config's search path"

config PK_ASAN_CFLAGS
	string "CFLAGS: C compiler flags"

config PK_ASAN_LDFLAGS
	string "LDFLAGS: Linker flags"

config PK_ASAN_CXXFLAGS
	string "CXXFLAGS: C++ compiler flags"

config PK_ASAN_ASFLAGS
	string "CCASFLAGS: assembler compiler flags (defaults to CFLAGS)"

config PK_ASAN_BUILDARCH
	string "--host options on configure for Architecture"

endif # PK_ASAN
```

## package/memory-leak/Kconfig
```kconfig
menuconfig PK_MEMORY_LEAK
	bool "Memory Leak"

if PK_MEMORY_LEAK

# GCC ASAN 
source package/memory-leak/BiscuitOS-ASAN/Kconfig

endif # PK_MEMORY_LEAK
```

## package/memory-mapping/BiscuitOS-MMAP-Alloc-Special-Memory-Userspace/Kconfig
```kconfig
menuconfig PK_MMAP_SPECIAL_U
	bool "Special Alloc: Alloc Special memory on Userspace"

if PK_MMAP_SPECIAL_U

config PK_MMAP_SPECIAL_U_VERSION
	default "default"
	string "verstion"

config PK_MMAP_SPECIAL_U_TAR
	default "tar.gz"
	string "tar type"

config PK_MMAP_SPECIAL_U_URL
	default "https://gitee.com/BiscuitOS_team/HardStack/raw/Gitee/Memory-Allocator/MMAP/BiscuitOS-MMAP-Alloc-Special-Memory-Userspace"
	string "url"

config PK_MMAP_SPECIAL_U_GITHUB
	string "GitHub"

config PK_MMAP_SPECIAL_U_SRCFILE
	default "main.c Makefile"
	string "Source code list"

config PK_MMAP_SPECIAL_U_CSRCFILE
	string "Compile source code list"

config PK_MMAP_SPECIAL_U_CONFIG
	string "CONFIG: Project Configure Options"

config PK_MMAP_SPECIAL_U_LIBPATH
	string "LIBS: Libraries to pass to the linker, e.g. -l<library>"

config PK_MMAP_SPECIAL_U_CPPFLAGS
	string "CPPFLAGS: C/C++ preprocessor flags, e.g. -I<include dir>"

config PK_MMAP_SPECIAL_U_DPKCONFIG
	string "PKG_CONFIG_PATH: Directories to add to pkg-config's search path"

config PK_MMAP_SPECIAL_U_CFLAGS
	string "CFLAGS: C compiler flags"

config PK_MMAP_SPECIAL_U_LDFLAGS
	string "LDFLAGS: Linker flags"

config PK_MMAP_SPECIAL_U_CXXFLAGS
	string "CXXFLAGS: C++ compiler flags"

config PK_MMAP_SPECIAL_U_ASFLAGS
	string "CCASFLAGS: assembler compiler flags (defaults to CFLAGS)"

config PK_MMAP_SPECIAL_U_BUILDARCH
	string "--host options on configure for Architecture"

endif # PK_MMAP_SPECIAL_U
```

## package/memory-mapping/BiscuitOS-MMAP-LazyAlloc-VMALLOC32/Kconfig
```kconfig
menuconfig PK_MMAP_LAZYALLOC_VMALLOC32
	select PK_MMAP_SPECIAL_U
	bool "Lazy-Alloc: Memory from VMALLOC32"

if PK_MMAP_LAZYALLOC_VMALLOC32

config PK_MMAP_LAZYALLOC_VMALLOC32_VERSION
	default "default"
	string "verstion"

config PK_MMAP_LAZYALLOC_VMALLOC32_TAR
	default "tar.gz"
	string "tar type"

config PK_MMAP_LAZYALLOC_VMALLOC32_URL
	default "https://gitee.com/BiscuitOS_team/HardStack/raw/Gitee/Memory-Allocator/MMAP/BiscuitOS-MMAP-LazyAlloc-VMALLOC32"
	string "url"

config PK_MMAP_LAZYALLOC_VMALLOC32_GITHUB
	string "GitHub"

config PK_MMAP_LAZYALLOC_VMALLOC32_SRCFILE
	default "main.c Kconfig Makefile RunBiscuitOS.sh"
	string "Source code list"

config PK_MMAP_LAZYALLOC_VMALLOC32_CSRCFILE
	string "Compile source code list"

config PK_MMAP_LAZYALLOC_VMALLOC32_CONFIG
	string "CONFIG: Project Configure Options"

config PK_MMAP_LAZYALLOC_VMALLOC32_LIBPATH
	string "LIBS: Libraries to pass to the linker, e.g. -l<library>"

config PK_MMAP_LAZYALLOC_VMALLOC32_CPPFLAGS
	string "CPPFLAGS: C/C++ preprocessor flags, e.g. -I<include dir>"

config PK_MMAP_LAZYALLOC_VMALLOC32_DPKCONFIG
	string "PKG_CONFIG_PATH: Directories to add to pkg-config's search path"

config PK_MMAP_LAZYALLOC_VMALLOC32_CFLAGS
	string "CFLAGS: C compiler flags"

config PK_MMAP_LAZYALLOC_VMALLOC32_LDFLAGS
	string "LDFLAGS: Linker flags"

config PK_MMAP_LAZYALLOC_VMALLOC32_CXXFLAGS
	string "CXXFLAGS: C++ compiler flags"

config PK_MMAP_LAZYALLOC_VMALLOC32_ASFLAGS
	string "CCASFLAGS: assembler compiler flags (defaults to CFLAGS)"

config PK_MMAP_LAZYALLOC_VMALLOC32_BUILDARCH
	string "--host options on configure for Architecture"

endif # PK_MMAP_LAZYALLOC_VMALLOC32
```
