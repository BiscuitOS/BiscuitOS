## package/notifier/mmu-notifier/Kconfig
```kconfig
menuconfig PK_NOTIFIER_MMU
	bool "MMU notifier (Kernel Portion)"

if PK_NOTIFIER_MMU

config PK_NOTIFIER_MMU_VERSION
	default "0.0.1"
	string "verstion"

config PK_NOTIFIER_MMU_TAR
	default "tar.gz"
	string "tar type"

config PK_NOTIFIER_MMU_URL
	default "https://gitee.com/BiscuitOS_team/HardStack/raw/Gitee/SubSystem/notifier/mmu_notifier/kernel"
	string "url"

config PK_NOTIFIER_MMU_GITHUB
	string "GitHub"

config PK_NOTIFIER_MMU_SRCFILE
	default "main.c Kconfig Makefile"
	string "Source code list"

config PK_NOTIFIER_MMU_CSRCFILE
	string "Compile source code list"

config PK_NOTIFIER_MMU_CONFIG
	string "CONFIG: Project Configure Options"

config PK_NOTIFIER_MMU_LIBPATH
	string "LIBS: Libraries to pass to the linker, e.g. -l<library>"

config PK_NOTIFIER_MMU_CPPFLAGS
	string "CPPFLAGS: C/C++ preprocessor flags, e.g. -I<include dir>"

config PK_NOTIFIER_MMU_DPKCONFIG
	string "PKG_CONFIG_PATH: Directories to add to pkg-config's search path"

config PK_NOTIFIER_MMU_CFLAGS
	string "CFLAGS: C compiler flags"

config PK_NOTIFIER_MMU_LDFLAGS
	string "LDFLAGS: Linker flags"

config PK_NOTIFIER_MMU_CXXFLAGS
	string "CXXFLAGS: C++ compiler flags"

config PK_NOTIFIER_MMU_ASFLAGS
	string "CCASFLAGS: assembler compiler flags (defaults to CFLAGS)"

config PK_NOTIFIER_MMU_BUILDARCH
	string "--host options on configure for Architecture"

endif # PK_NOTIFIER_MMU
```

## package/notifier/mmu-userspace-notifier/Kconfig
```kconfig
menuconfig PK_NOTIFIER_MMU_USER
	select PK_NOTIFIER_MMU
	bool "MMU notifier (Userspace Portion)"

if PK_NOTIFIER_MMU_USER

config PK_NOTIFIER_MMU_USER_VERSION
	default "0.0.1"
	string "verstion"

config PK_NOTIFIER_MMU_USER_TAR
	default "tar.gz"
	string "tar type"

config PK_NOTIFIER_MMU_USER_URL
	default "https://gitee.com/BiscuitOS_team/HardStack/raw/Gitee/SubSystem/notifier/mmu_notifier/userspace"
	string "url"

config PK_NOTIFIER_MMU_USER_GITHUB
	string "GitHub"

config PK_NOTIFIER_MMU_USER_SRCFILE
	default "main.c Makefile"
	string "Source code list"

config PK_NOTIFIER_MMU_USER_CSRCFILE
	string "Compile source code list"

config PK_NOTIFIER_MMU_USER_CONFIG
	string "CONFIG: Project Configure Options"

config PK_NOTIFIER_MMU_USER_LIBPATH
	string "LIBS: Libraries to pass to the linker, e.g. -l<library>"

config PK_NOTIFIER_MMU_USER_CPPFLAGS
	string "CPPFLAGS: C/C++ preprocessor flags, e.g. -I<include dir>"

config PK_NOTIFIER_MMU_USER_DPKCONFIG
	string "PKG_CONFIG_PATH: Directories to add to pkg-config's search path"

config PK_NOTIFIER_MMU_USER_CFLAGS
	string "CFLAGS: C compiler flags"

config PK_NOTIFIER_MMU_USER_LDFLAGS
	string "LDFLAGS: Linker flags"

config PK_NOTIFIER_MMU_USER_CXXFLAGS
	string "CXXFLAGS: C++ compiler flags"

config PK_NOTIFIER_MMU_USER_ASFLAGS
	string "CCASFLAGS: assembler compiler flags (defaults to CFLAGS)"

config PK_NOTIFIER_MMU_USER_BUILDARCH
	string "--host options on configure for Architecture"

endif # PK_NOTIFIER_MMU_USER
```

## package/notifier/reboot-notifier/Kconfig
```kconfig
menuconfig PK_NOTIFIER_REBOOT
	bool "Reboot notifier"

if PK_NOTIFIER_REBOOT

config PK_NOTIFIER_REBOOT_VERSION
	default "0.0.1"
	string "verstion"

config PK_NOTIFIER_REBOOT_TAR
	default "tar.gz"
	string "tar type"

config PK_NOTIFIER_REBOOT_URL
	default "https://gitee.com/BiscuitOS_team/HardStack/raw/Gitee/SubSystem/notifier/reboot_notifier"
	string "url"

config PK_NOTIFIER_REBOOT_GITHUB
	string "GitHub"

config PK_NOTIFIER_REBOOT_SRCFILE
	default "main.c Kconfig Makefile"
	string "Source code list"

config PK_NOTIFIER_REBOOT_CSRCFILE
	string "Compile source code list"

config PK_NOTIFIER_REBOOT_CONFIG
	string "CONFIG: Project Configure Options"

config PK_NOTIFIER_REBOOT_LIBPATH
	string "LIBS: Libraries to pass to the linker, e.g. -l<library>"

config PK_NOTIFIER_REBOOT_CPPFLAGS
	string "CPPFLAGS: C/C++ preprocessor flags, e.g. -I<include dir>"

config PK_NOTIFIER_REBOOT_DPKCONFIG
	string "PKG_CONFIG_PATH: Directories to add to pkg-config's search path"

config PK_NOTIFIER_REBOOT_CFLAGS
	string "CFLAGS: C compiler flags"

config PK_NOTIFIER_REBOOT_LDFLAGS
	string "LDFLAGS: Linker flags"

config PK_NOTIFIER_REBOOT_CXXFLAGS
	string "CXXFLAGS: C++ compiler flags"

config PK_NOTIFIER_REBOOT_ASFLAGS
	string "CCASFLAGS: assembler compiler flags (defaults to CFLAGS)"

config PK_NOTIFIER_REBOOT_BUILDARCH
	string "--host options on configure for Architecture"

endif # PK_NOTIFIER_REBOOT
```

## package/objdump/Kconfig
```kconfig
#
# objdump utilise
#
config PACKAGE_OBJDUMP
	bool "objdump               bintuilise"
	help
	  Binutilise for objdump
```

## package/openssl/Kconfig
```kconfig
menuconfig PK_OPENSSL
	bool "openssl"

if PK_OPENSSL

config PK_OPENSSL_VERSION
	default "1.0.2e"
	string "verstion"

config PK_OPENSSL_TAR
	default "tar.gz"
	string "tar type"

config PK_OPENSSL_URL
	default "http://repository.timesys.com/buildsources/o/openssl/openssl-1.0.2e/"
	string "url"

config PK_OPENSSL_GITHUB
	string "GitHub"

config PK_OPENSSL_SRCFILE
	string "Source code list"

config PK_OPENSSL_CONFIG
	default "dist"
	string "CONFIG: Project Configure Options"

config PK_OPENSSL_LIBPATH
	string "LIBS: Libraries to pass to the linker, e.g. -l<library>"

config PK_OPENSSL_CPPFLAGS
	string "CPPFLAGS: C/C++ preprocessor flags, e.g. -I<include dir>"

config PK_OPENSSL_DPKCONFIG
	string "PKG_CONFIG_PATH: Directories to add to pkg-config's search path"

config PK_OPENSSL_CFLAGS
	string "CFLAGS: C compiler flags"

config PK_OPENSSL_LDFLAGS
	string "LDFLAGS: Linker flags"

config PK_OPENSSL_CXXFLAGS
	string "CXXFLAGS: C++ compiler flags"

config PK_OPENSSL_ASFLAGS
	string "CCASFLAGS: assembler compiler flags (defaults to CFLAGS)"

config PK_OPENSSL_BUILDARCH
	default "x86_64-unknown-linux-gnu"
	string "--host options on configure for Architecture"

endif # PK_OPENSSL
```

## package/page-fault/BiscuitOS-PAGE-FAULT-Kernel-Virtual-Address-BUG0/Kconfig
```kconfig
menuconfig PK_PAGE_FAULT_KVADDR_BUG0
	bool "Page Fault: Kernel Virtual Address with BUG0"

if PK_PAGE_FAULT_KVADDR_BUG0

config PK_PAGE_FAULT_KVADDR_BUG0_VERSION
	default "default"
	string "verstion"

config PK_PAGE_FAULT_KVADDR_BUG0_TAR
	default "tar.gz"
	string "tar type"

config PK_PAGE_FAULT_KVADDR_BUG0_URL
	default "https://gitee.com/BiscuitOS_team/HardStack/raw/Gitee/Memory-Allocator/PAGE-FAULT/BiscuitOS-PAGE-FAULT-Kernel-Virtual-Address-BUG0/"
	string "url"

config PK_PAGE_FAULT_KVADDR_BUG0_GITHUB
	string "GitHub"

config PK_PAGE_FAULT_KVADDR_BUG0_SRCFILE
	default "main.c Makefile Kconfig"
	string "Source code list"

config PK_PAGE_FAULT_KVADDR_BUG0_CSRCFILE
	string "Compile source code list"

config PK_PAGE_FAULT_KVADDR_BUG0_CONFIG
	string "CONFIG: Project Configure Options"

config PK_PAGE_FAULT_KVADDR_BUG0_LIBPATH
	string "LIBS: Libraries to pass to the linker, e.g. -l<library>"

config PK_PAGE_FAULT_KVADDR_BUG0_CPPFLAGS
	string "CPPFLAGS: C/C++ preprocessor flags, e.g. -I<include dir>"

config PK_PAGE_FAULT_KVADDR_BUG0_DPKCONFIG
	string "PKG_CONFIG_PATH: Directories to add to pkg-config's search path"

config PK_PAGE_FAULT_KVADDR_BUG0_CFLAGS
	string "CFLAGS: C compiler flags"

config PK_PAGE_FAULT_KVADDR_BUG0_LDFLAGS
	string "LDFLAGS: Linker flags"

config PK_PAGE_FAULT_KVADDR_BUG0_CXXFLAGS
	string "CXXFLAGS: C++ compiler flags"

config PK_PAGE_FAULT_KVADDR_BUG0_ASFLAGS
	string "CCASFLAGS: assembler compiler flags (defaults to CFLAGS)"

config PK_PAGE_FAULT_KVADDR_BUG0_BUILDARCH
	string "--host options on configure for Architecture"

endif # PK_PAGE_FAULT_KVADDR_BUG0
```

## package/page-fault/BiscuitOS-PAGE-FAULT-anonymous-private-mapping/Kconfig
```kconfig
menuconfig PK_PAGE_FAULT_ANON_PRIVATE
	bool "Page Fault: Aonoymous private mapping"

if PK_PAGE_FAULT_ANON_PRIVATE

config PK_PAGE_FAULT_ANON_PRIVATE_VERSION
	default "default"
	string "verstion"

config PK_PAGE_FAULT_ANON_PRIVATE_TAR
	default "tar.gz"
	string "tar type"

config PK_PAGE_FAULT_ANON_PRIVATE_URL
	default "https://gitee.com/BiscuitOS_team/HardStack/raw/Gitee/Memory-Allocator/PAGE-FAULT/BiscuitOS-PAGE-FAULT-anonymous-private-mapping/"
	string "url"

config PK_PAGE_FAULT_ANON_PRIVATE_GITHUB
	string "GitHub"

config PK_PAGE_FAULT_ANON_PRIVATE_SRCFILE
	default "main.c Makefile"
	string "Source code list"

config PK_PAGE_FAULT_ANON_PRIVATE_CSRCFILE
	string "Compile source code list"

config PK_PAGE_FAULT_ANON_PRIVATE_CONFIG
	string "CONFIG: Project Configure Options"

config PK_PAGE_FAULT_ANON_PRIVATE_LIBPATH
	string "LIBS: Libraries to pass to the linker, e.g. -l<library>"

config PK_PAGE_FAULT_ANON_PRIVATE_CPPFLAGS
	string "CPPFLAGS: C/C++ preprocessor flags, e.g. -I<include dir>"

config PK_PAGE_FAULT_ANON_PRIVATE_DPKCONFIG
	string "PKG_CONFIG_PATH: Directories to add to pkg-config's search path"

config PK_PAGE_FAULT_ANON_PRIVATE_CFLAGS
	string "CFLAGS: C compiler flags"

config PK_PAGE_FAULT_ANON_PRIVATE_LDFLAGS
	string "LDFLAGS: Linker flags"

config PK_PAGE_FAULT_ANON_PRIVATE_CXXFLAGS
	string "CXXFLAGS: C++ compiler flags"

config PK_PAGE_FAULT_ANON_PRIVATE_ASFLAGS
	string "CCASFLAGS: assembler compiler flags (defaults to CFLAGS)"

config PK_PAGE_FAULT_ANON_PRIVATE_BUILDARCH
	string "--host options on configure for Architecture"

endif # PK_PAGE_FAULT_ANON_PRIVATE
```

## package/page-fault/BiscuitOS-page-fault-user-address-on-kernel/Kconfig
```kconfig
menuconfig PK_PAGE_FAULT_USER_ADDR_KERNEL
	bool "Paging userspace address (Kernel+)"

if PK_PAGE_FAULT_USER_ADDR_KERNEL

config PK_PAGE_FAULT_USER_ADDR_KERNEL_VERSION
	default "default"
	string "verstion"

config PK_PAGE_FAULT_USER_ADDR_KERNEL_TAR
	default "tar.gz"
	string "tar type"

config PK_PAGE_FAULT_USER_ADDR_KERNEL_URL
	default "https://gitee.com/BiscuitOS_team/HardStack/raw/Gitee/Memory-Allocator/page-fault/BiscuitOS-page-fault-user-address/kernel"
	string "url"

config PK_PAGE_FAULT_USER_ADDR_KERNEL_GITHUB
	string "GitHub"

config PK_PAGE_FAULT_USER_ADDR_KERNEL_SRCFILE
	default "main.c Kconfig Makefile RunBiscuitOS.sh"
	string "Source code list"

config PK_PAGE_FAULT_USER_ADDR_KERNEL_CSRCFILE
	string "Compile source code list"

config PK_PAGE_FAULT_USER_ADDR_KERNEL_CONFIG
	string "CONFIG: Project Configure Options"

config PK_PAGE_FAULT_USER_ADDR_KERNEL_LIBPATH
	string "LIBS: Libraries to pass to the linker, e.g. -l<library>"

config PK_PAGE_FAULT_USER_ADDR_KERNEL_CPPFLAGS
	string "CPPFLAGS: C/C++ preprocessor flags, e.g. -I<include dir>"

config PK_PAGE_FAULT_USER_ADDR_KERNEL_DPKCONFIG
	string "PKG_CONFIG_PATH: Directories to add to pkg-config's search path"

config PK_PAGE_FAULT_USER_ADDR_KERNEL_CFLAGS
	string "CFLAGS: C compiler flags"

config PK_PAGE_FAULT_USER_ADDR_KERNEL_LDFLAGS
	string "LDFLAGS: Linker flags"

config PK_PAGE_FAULT_USER_ADDR_KERNEL_CXXFLAGS
	string "CXXFLAGS: C++ compiler flags"

config PK_PAGE_FAULT_USER_ADDR_KERNEL_ASFLAGS
	string "CCASFLAGS: assembler compiler flags (defaults to CFLAGS)"

config PK_PAGE_FAULT_USER_ADDR_KERNEL_BUILDARCH
	string "--host options on configure for Architecture"

endif # PK_PAGE_FAULT_USER_ADDR_KERNEL
```

## package/page-fault/BiscuitOS-page-fault-user-address-on-userspace/Kconfig
```kconfig
menuconfig PK_PAGE_FAULT_USER_ADDR_USERSPACE
	select PK_PAGE_FAULT_USER_ADDR_KERNEL
	bool "User Address Page Fault (Userspace+)"

if PK_PAGE_FAULT_USER_ADDR_USERSPACE

config PK_PAGE_FAULT_USER_ADDR_USERSPACE_VERSION
	default "default"
	string "verstion"

config PK_PAGE_FAULT_USER_ADDR_USERSPACE_TAR
	default "tar.gz"
	string "tar type"

config PK_PAGE_FAULT_USER_ADDR_USERSPACE_URL
	default "https://gitee.com/BiscuitOS_team/HardStack/raw/Gitee/Memory-Allocator/page-fault/BiscuitOS-page-fault-user-address/userspace"
	string "url"

config PK_PAGE_FAULT_USER_ADDR_USERSPACE_GITHUB
	string "GitHub"

config PK_PAGE_FAULT_USER_ADDR_USERSPACE_SRCFILE
	default "main.c Makefile"
	string "Source code list"

config PK_PAGE_FAULT_USER_ADDR_USERSPACE_CSRCFILE
	string "Compile source code list"

config PK_PAGE_FAULT_USER_ADDR_USERSPACE_CONFIG
	string "CONFIG: Project Configure Options"

config PK_PAGE_FAULT_USER_ADDR_USERSPACE_LIBPATH
	string "LIBS: Libraries to pass to the linker, e.g. -l<library>"

config PK_PAGE_FAULT_USER_ADDR_USERSPACE_CPPFLAGS
	string "CPPFLAGS: C/C++ preprocessor flags, e.g. -I<include dir>"

config PK_PAGE_FAULT_USER_ADDR_USERSPACE_DPKCONFIG
	string "PKG_CONFIG_PATH: Directories to add to pkg-config's search path"

config PK_PAGE_FAULT_USER_ADDR_USERSPACE_CFLAGS
	string "CFLAGS: C compiler flags"

config PK_PAGE_FAULT_USER_ADDR_USERSPACE_LDFLAGS
	string "LDFLAGS: Linker flags"

config PK_PAGE_FAULT_USER_ADDR_USERSPACE_CXXFLAGS
	string "CXXFLAGS: C++ compiler flags"

config PK_PAGE_FAULT_USER_ADDR_USERSPACE_ASFLAGS
	string "CCASFLAGS: assembler compiler flags (defaults to CFLAGS)"

config PK_PAGE_FAULT_USER_ADDR_USERSPACE_BUILDARCH
	string "--host options on configure for Architecture"

endif # PK_PAGE_FAULT_USER_ADDR_USERSPACE
```

## package/page-fault/Kconfig
```kconfig
menuconfig PK_PAGE_FAULT
	bool "Page Fault Mechanism"

if PK_PAGE_FAULT

# Page fault user address (Userspace+)
source package/page-fault/BiscuitOS-page-fault-user-address-on-userspace/Kconfig

# Page fault user address (Kernel+)
source package/page-fault/BiscuitOS-page-fault-user-address-on-kernel/Kconfig

# Page fault: anonymous private mapping
source package/page-fault/BiscuitOS-PAGE-FAULT-anonymous-private-mapping/Kconfig

endif # PK_PAGE_FAULT
```

## package/page/Kconfig
```kconfig
menuconfig PK_PAGE
	bool "Page Mechansim"

if PK_PAGE

# PageReserved
source package/page/PageReserved/Kconfig

endif # PK_PAGE
```

## package/page/PageReserved/BiscuitOS-PageReserved-from-MEMBLOCK/Kconfig
```kconfig
menuconfig PK_PAGERESERVED_MEMBLOCK
	bool "PageReserved From MEMBLOCK"

if PK_PAGERESERVED_MEMBLOCK

config PK_PAGERESERVED_MEMBLOCK_VERSION
	default "default"
	string "verstion"

config PK_PAGERESERVED_MEMBLOCK_TAR
	default "tar.gz"
	string "tar type"

config PK_PAGERESERVED_MEMBLOCK_URL
	default "https://gitee.com/BiscuitOS_team/HardStack/raw/Gitee/Memory-Allocator/PAGE-MECH/PageReserved/BiscuitOS-PageReserved-from-MEMBLOCK"
	string "url"

config PK_PAGERESERVED_MEMBLOCK_GITHUB
	string "GitHub"

config PK_PAGERESERVED_MEMBLOCK_SRCFILE
	default "main.c Kconfig Makefile BiscuitOS_Insert.bs"
	string "Source code list"

config PK_PAGERESERVED_MEMBLOCK_CSRCFILE
	string "Compile source code list"

config PK_PAGERESERVED_MEMBLOCK_CONFIG
	string "CONFIG: Project Configure Options"

config PK_PAGERESERVED_MEMBLOCK_LIBPATH
	string "LIBS: Libraries to pass to the linker, e.g. -l<library>"

config PK_PAGERESERVED_MEMBLOCK_CPPFLAGS
	string "CPPFLAGS: C/C++ preprocessor flags, e.g. -I<include dir>"

config PK_PAGERESERVED_MEMBLOCK_DPKCONFIG
	string "PKG_CONFIG_PATH: Directories to add to pkg-config's search path"

config PK_PAGERESERVED_MEMBLOCK_CFLAGS
	string "CFLAGS: C compiler flags"

config PK_PAGERESERVED_MEMBLOCK_LDFLAGS
	string "LDFLAGS: Linker flags"

config PK_PAGERESERVED_MEMBLOCK_CXXFLAGS
	string "CXXFLAGS: C++ compiler flags"

config PK_PAGERESERVED_MEMBLOCK_ASFLAGS
	string "CCASFLAGS: assembler compiler flags (defaults to CFLAGS)"

config PK_PAGERESERVED_MEMBLOCK_BUILDARCH
	string "--host options on configure for Architecture"

endif # PK_PAGERESERVED_MEMBLOCK
```

## package/page/PageReserved/Kconfig
```kconfig
menuconfig PK_PAGERESERVED
	bool "PageReserved"

if PK_PAGERESERVED

# PageReserved From MEMBLOCK
source package/page/PageReserved/BiscuitOS-PageReserved-from-MEMBLOCK/Kconfig

endif # PK_PAGERESERVED
```
