## package/nodemask/nodes_or/Kconfig
```kconfig
menuconfig PK_NODES_OR
	bool "nodes_or"

if PK_NODES_OR

config PK_NODES_OR_VERSION
	default "default"
	string "verstion"

config PK_NODES_OR_TAR
	default "tar.gz"
	string "tar type"

config PK_NODES_OR_URL
	default "https://gitee.com/BiscuitOS_team/HardStack/raw/Gitee/Algorithem/nodemask/nodes_or"
	string "url"

config PK_NODES_OR_GITHUB
	string "GitHub"

config PK_NODES_OR_SRCFILE
	default "main.c Kconfig Makefile"
	string "Source code list"

config PK_NODES_OR_CSRCFILE
	string "Compile source code list"

config PK_NODES_OR_CONFIG
	string "CONFIG: Project Configure Options"

config PK_NODES_OR_LIBPATH
	string "LIBS: Libraries to pass to the linker, e.g. -l<library>"

config PK_NODES_OR_CPPFLAGS
	string "CPPFLAGS: C/C++ preprocessor flags, e.g. -I<include dir>"

config PK_NODES_OR_DPKCONFIG
	string "PKG_CONFIG_PATH: Directories to add to pkg-config's search path"

config PK_NODES_OR_CFLAGS
	string "CFLAGS: C compiler flags"

config PK_NODES_OR_LDFLAGS
	string "LDFLAGS: Linker flags"

config PK_NODES_OR_CXXFLAGS
	string "CXXFLAGS: C++ compiler flags"

config PK_NODES_OR_ASFLAGS
	string "CCASFLAGS: assembler compiler flags (defaults to CFLAGS)"

config PK_NODES_OR_BUILDARCH
	string "--host options on configure for Architecture"

endif # PK_NODES_OR
```

## package/nodemask/nodes_setall/Kconfig
```kconfig
menuconfig PK_NODES_SETALL
	bool "nodes_setall"

if PK_NODES_SETALL

config PK_NODES_SETALL_VERSION
	default "default"
	string "verstion"

config PK_NODES_SETALL_TAR
	default "tar.gz"
	string "tar type"

config PK_NODES_SETALL_URL
	default "https://gitee.com/BiscuitOS_team/HardStack/raw/Gitee/Algorithem/nodemask/nodes_setall"
	string "url"

config PK_NODES_SETALL_GITHUB
	string "GitHub"

config PK_NODES_SETALL_SRCFILE
	default "main.c Kconfig Makefile"
	string "Source code list"

config PK_NODES_SETALL_CSRCFILE
	string "Compile source code list"

config PK_NODES_SETALL_CONFIG
	string "CONFIG: Project Configure Options"

config PK_NODES_SETALL_LIBPATH
	string "LIBS: Libraries to pass to the linker, e.g. -l<library>"

config PK_NODES_SETALL_CPPFLAGS
	string "CPPFLAGS: C/C++ preprocessor flags, e.g. -I<include dir>"

config PK_NODES_SETALL_DPKCONFIG
	string "PKG_CONFIG_PATH: Directories to add to pkg-config's search path"

config PK_NODES_SETALL_CFLAGS
	string "CFLAGS: C compiler flags"

config PK_NODES_SETALL_LDFLAGS
	string "LDFLAGS: Linker flags"

config PK_NODES_SETALL_CXXFLAGS
	string "CXXFLAGS: C++ compiler flags"

config PK_NODES_SETALL_ASFLAGS
	string "CCASFLAGS: assembler compiler flags (defaults to CFLAGS)"

config PK_NODES_SETALL_BUILDARCH
	string "--host options on configure for Architecture"

endif # PK_NODES_SETALL
```

## package/nodemask/nodes_shift_left/Kconfig
```kconfig
menuconfig PK_NODES_SHIFT_LEFT
	bool "nodes_shift_left"

if PK_NODES_SHIFT_LEFT

config PK_NODES_SHIFT_LEFT_VERSION
	default "default"
	string "verstion"

config PK_NODES_SHIFT_LEFT_TAR
	default "tar.gz"
	string "tar type"

config PK_NODES_SHIFT_LEFT_URL
	default "https://gitee.com/BiscuitOS_team/HardStack/raw/Gitee/Algorithem/nodemask/nodes_shift_left"
	string "url"

config PK_NODES_SHIFT_LEFT_GITHUB
	string "GitHub"

config PK_NODES_SHIFT_LEFT_SRCFILE
	default "main.c Kconfig Makefile"
	string "Source code list"

config PK_NODES_SHIFT_LEFT_CSRCFILE
	string "Compile source code list"

config PK_NODES_SHIFT_LEFT_CONFIG
	string "CONFIG: Project Configure Options"

config PK_NODES_SHIFT_LEFT_LIBPATH
	string "LIBS: Libraries to pass to the linker, e.g. -l<library>"

config PK_NODES_SHIFT_LEFT_CPPFLAGS
	string "CPPFLAGS: C/C++ preprocessor flags, e.g. -I<include dir>"

config PK_NODES_SHIFT_LEFT_DPKCONFIG
	string "PKG_CONFIG_PATH: Directories to add to pkg-config's search path"

config PK_NODES_SHIFT_LEFT_CFLAGS
	string "CFLAGS: C compiler flags"

config PK_NODES_SHIFT_LEFT_LDFLAGS
	string "LDFLAGS: Linker flags"

config PK_NODES_SHIFT_LEFT_CXXFLAGS
	string "CXXFLAGS: C++ compiler flags"

config PK_NODES_SHIFT_LEFT_ASFLAGS
	string "CCASFLAGS: assembler compiler flags (defaults to CFLAGS)"

config PK_NODES_SHIFT_LEFT_BUILDARCH
	string "--host options on configure for Architecture"

endif # PK_NODES_SHIFT_LEFT
```

## package/nodemask/nodes_shift_right/Kconfig
```kconfig
menuconfig PK_NODES_SHIFT_RIGHT
	bool "nodes_shift_right"

if PK_NODES_SHIFT_RIGHT

config PK_NODES_SHIFT_RIGHT_VERSION
	default "default"
	string "verstion"

config PK_NODES_SHIFT_RIGHT_TAR
	default "tar.gz"
	string "tar type"

config PK_NODES_SHIFT_RIGHT_URL
	default "https://gitee.com/BiscuitOS_team/HardStack/raw/Gitee/Algorithem/nodemask/nodes_shift_right"
	string "url"

config PK_NODES_SHIFT_RIGHT_GITHUB
	string "GitHub"

config PK_NODES_SHIFT_RIGHT_SRCFILE
	default "main.c Kconfig Makefile"
	string "Source code list"

config PK_NODES_SHIFT_RIGHT_CSRCFILE
	string "Compile source code list"

config PK_NODES_SHIFT_RIGHT_CONFIG
	string "CONFIG: Project Configure Options"

config PK_NODES_SHIFT_RIGHT_LIBPATH
	string "LIBS: Libraries to pass to the linker, e.g. -l<library>"

config PK_NODES_SHIFT_RIGHT_CPPFLAGS
	string "CPPFLAGS: C/C++ preprocessor flags, e.g. -I<include dir>"

config PK_NODES_SHIFT_RIGHT_DPKCONFIG
	string "PKG_CONFIG_PATH: Directories to add to pkg-config's search path"

config PK_NODES_SHIFT_RIGHT_CFLAGS
	string "CFLAGS: C compiler flags"

config PK_NODES_SHIFT_RIGHT_LDFLAGS
	string "LDFLAGS: Linker flags"

config PK_NODES_SHIFT_RIGHT_CXXFLAGS
	string "CXXFLAGS: C++ compiler flags"

config PK_NODES_SHIFT_RIGHT_ASFLAGS
	string "CCASFLAGS: assembler compiler flags (defaults to CFLAGS)"

config PK_NODES_SHIFT_RIGHT_BUILDARCH
	string "--host options on configure for Architecture"

endif # PK_NODES_SHIFT_RIGHT
```

## package/nodemask/nodes_subset/Kconfig
```kconfig
menuconfig PK_NODES_SUBSET
	bool "nodes_subset"

if PK_NODES_SUBSET

config PK_NODES_SUBSET_VERSION
	default "default"
	string "verstion"

config PK_NODES_SUBSET_TAR
	default "tar.gz"
	string "tar type"

config PK_NODES_SUBSET_URL
	default "https://gitee.com/BiscuitOS_team/HardStack/raw/Gitee/Algorithem/nodemask/nodes_subset"
	string "url"

config PK_NODES_SUBSET_GITHUB
	string "GitHub"

config PK_NODES_SUBSET_SRCFILE
	default "main.c Kconfig Makefile"
	string "Source code list"

config PK_NODES_SUBSET_CSRCFILE
	string "Compile source code list"

config PK_NODES_SUBSET_CONFIG
	string "CONFIG: Project Configure Options"

config PK_NODES_SUBSET_LIBPATH
	string "LIBS: Libraries to pass to the linker, e.g. -l<library>"

config PK_NODES_SUBSET_CPPFLAGS
	string "CPPFLAGS: C/C++ preprocessor flags, e.g. -I<include dir>"

config PK_NODES_SUBSET_DPKCONFIG
	string "PKG_CONFIG_PATH: Directories to add to pkg-config's search path"

config PK_NODES_SUBSET_CFLAGS
	string "CFLAGS: C compiler flags"

config PK_NODES_SUBSET_LDFLAGS
	string "LDFLAGS: Linker flags"

config PK_NODES_SUBSET_CXXFLAGS
	string "CXXFLAGS: C++ compiler flags"

config PK_NODES_SUBSET_ASFLAGS
	string "CCASFLAGS: assembler compiler flags (defaults to CFLAGS)"

config PK_NODES_SUBSET_BUILDARCH
	string "--host options on configure for Architecture"

endif # PK_NODES_SUBSET
```

## package/nodemask/nodes_weight/Kconfig
```kconfig
menuconfig PK_NODES_WEIGHT
	bool "nodes_weight"

if PK_NODES_WEIGHT

config PK_NODES_WEIGHT_VERSION
	default "default"
	string "verstion"

config PK_NODES_WEIGHT_TAR
	default "tar.gz"
	string "tar type"

config PK_NODES_WEIGHT_URL
	default "https://gitee.com/BiscuitOS_team/HardStack/raw/Gitee/Algorithem/nodemask/nodes_weight"
	string "url"

config PK_NODES_WEIGHT_GITHUB
	string "GitHub"

config PK_NODES_WEIGHT_SRCFILE
	default "main.c Kconfig Makefile"
	string "Source code list"

config PK_NODES_WEIGHT_CSRCFILE
	string "Compile source code list"

config PK_NODES_WEIGHT_CONFIG
	string "CONFIG: Project Configure Options"

config PK_NODES_WEIGHT_LIBPATH
	string "LIBS: Libraries to pass to the linker, e.g. -l<library>"

config PK_NODES_WEIGHT_CPPFLAGS
	string "CPPFLAGS: C/C++ preprocessor flags, e.g. -I<include dir>"

config PK_NODES_WEIGHT_DPKCONFIG
	string "PKG_CONFIG_PATH: Directories to add to pkg-config's search path"

config PK_NODES_WEIGHT_CFLAGS
	string "CFLAGS: C compiler flags"

config PK_NODES_WEIGHT_LDFLAGS
	string "LDFLAGS: Linker flags"

config PK_NODES_WEIGHT_CXXFLAGS
	string "CXXFLAGS: C++ compiler flags"

config PK_NODES_WEIGHT_ASFLAGS
	string "CCASFLAGS: assembler compiler flags (defaults to CFLAGS)"

config PK_NODES_WEIGHT_BUILDARCH
	string "--host options on configure for Architecture"

endif # PK_NODES_WEIGHT
```

## package/nodemask/nodes_xor/Kconfig
```kconfig
menuconfig PK_NODES_XOR
	bool "nodes_xor"

if PK_NODES_XOR

config PK_NODES_XOR_VERSION
	default "default"
	string "verstion"

config PK_NODES_XOR_TAR
	default "tar.gz"
	string "tar type"

config PK_NODES_XOR_URL
	default "https://gitee.com/BiscuitOS_team/HardStack/raw/Gitee/Algorithem/nodemask/nodes_xor"
	string "url"

config PK_NODES_XOR_GITHUB
	string "GitHub"

config PK_NODES_XOR_SRCFILE
	default "main.c Kconfig Makefile"
	string "Source code list"

config PK_NODES_XOR_CSRCFILE
	string "Compile source code list"

config PK_NODES_XOR_CONFIG
	string "CONFIG: Project Configure Options"

config PK_NODES_XOR_LIBPATH
	string "LIBS: Libraries to pass to the linker, e.g. -l<library>"

config PK_NODES_XOR_CPPFLAGS
	string "CPPFLAGS: C/C++ preprocessor flags, e.g. -I<include dir>"

config PK_NODES_XOR_DPKCONFIG
	string "PKG_CONFIG_PATH: Directories to add to pkg-config's search path"

config PK_NODES_XOR_CFLAGS
	string "CFLAGS: C compiler flags"

config PK_NODES_XOR_LDFLAGS
	string "LDFLAGS: Linker flags"

config PK_NODES_XOR_CXXFLAGS
	string "CXXFLAGS: C++ compiler flags"

config PK_NODES_XOR_ASFLAGS
	string "CCASFLAGS: assembler compiler flags (defaults to CFLAGS)"

config PK_NODES_XOR_BUILDARCH
	string "--host options on configure for Architecture"

endif # PK_NODES_XOR
```

## package/nodemask/num_online_nodes/Kconfig
```kconfig
menuconfig PK_NUM_ONLINE_NODES
	bool "num_online_nodes"

if PK_NUM_ONLINE_NODES

config PK_NUM_ONLINE_NODES_VERSION
	default "default"
	string "verstion"

config PK_NUM_ONLINE_NODES_TAR
	default "tar.gz"
	string "tar type"

config PK_NUM_ONLINE_NODES_URL
	default "https://gitee.com/BiscuitOS_team/HardStack/raw/Gitee/Algorithem/nodemask/num_online_nodes"
	string "url"

config PK_NUM_ONLINE_NODES_GITHUB
	string "GitHub"

config PK_NUM_ONLINE_NODES_SRCFILE
	default "main.c Kconfig Makefile"
	string "Source code list"

config PK_NUM_ONLINE_NODES_CSRCFILE
	string "Compile source code list"

config PK_NUM_ONLINE_NODES_CONFIG
	string "CONFIG: Project Configure Options"

config PK_NUM_ONLINE_NODES_LIBPATH
	string "LIBS: Libraries to pass to the linker, e.g. -l<library>"

config PK_NUM_ONLINE_NODES_CPPFLAGS
	string "CPPFLAGS: C/C++ preprocessor flags, e.g. -I<include dir>"

config PK_NUM_ONLINE_NODES_DPKCONFIG
	string "PKG_CONFIG_PATH: Directories to add to pkg-config's search path"

config PK_NUM_ONLINE_NODES_CFLAGS
	string "CFLAGS: C compiler flags"

config PK_NUM_ONLINE_NODES_LDFLAGS
	string "LDFLAGS: Linker flags"

config PK_NUM_ONLINE_NODES_CXXFLAGS
	string "CXXFLAGS: C++ compiler flags"

config PK_NUM_ONLINE_NODES_ASFLAGS
	string "CCASFLAGS: assembler compiler flags (defaults to CFLAGS)"

config PK_NUM_ONLINE_NODES_BUILDARCH
	string "--host options on configure for Architecture"

endif # PK_NUM_ONLINE_NODES
```

## package/nodemask/num_possible_nodes/Kconfig
```kconfig
menuconfig PK_NUM_POSSIBLE_NODES
	bool "num_possible_nodes"

if PK_NUM_POSSIBLE_NODES

config PK_NUM_POSSIBLE_NODES_VERSION
	default "default"
	string "verstion"

config PK_NUM_POSSIBLE_NODES_TAR
	default "tar.gz"
	string "tar type"

config PK_NUM_POSSIBLE_NODES_URL
	default "https://gitee.com/BiscuitOS_team/HardStack/raw/Gitee/Algorithem/nodemask/num_possible_nodes"
	string "url"

config PK_NUM_POSSIBLE_NODES_GITHUB
	string "GitHub"

config PK_NUM_POSSIBLE_NODES_SRCFILE
	default "main.c Kconfig Makefile"
	string "Source code list"

config PK_NUM_POSSIBLE_NODES_CSRCFILE
	string "Compile source code list"

config PK_NUM_POSSIBLE_NODES_CONFIG
	string "CONFIG: Project Configure Options"

config PK_NUM_POSSIBLE_NODES_LIBPATH
	string "LIBS: Libraries to pass to the linker, e.g. -l<library>"

config PK_NUM_POSSIBLE_NODES_CPPFLAGS
	string "CPPFLAGS: C/C++ preprocessor flags, e.g. -I<include dir>"

config PK_NUM_POSSIBLE_NODES_DPKCONFIG
	string "PKG_CONFIG_PATH: Directories to add to pkg-config's search path"

config PK_NUM_POSSIBLE_NODES_CFLAGS
	string "CFLAGS: C compiler flags"

config PK_NUM_POSSIBLE_NODES_LDFLAGS
	string "LDFLAGS: Linker flags"

config PK_NUM_POSSIBLE_NODES_CXXFLAGS
	string "CXXFLAGS: C++ compiler flags"

config PK_NUM_POSSIBLE_NODES_ASFLAGS
	string "CCASFLAGS: assembler compiler flags (defaults to CFLAGS)"

config PK_NUM_POSSIBLE_NODES_BUILDARCH
	string "--host options on configure for Architecture"

endif # PK_NUM_POSSIBLE_NODES
```

## package/notifier/Kconfig
```kconfig
menuconfig PK_KERNEL_NOTIFIER
	bool "Notifier mechanism on Kernel"

if PK_KERNEL_NOTIFIER

# Base 
source package/notifier/kernel-notifier-base/Kconfig

# reboot-notifer
source package/notifier/reboot-notifier/Kconfig

# mmu-notifer
source package/notifier/mmu-notifier/Kconfig

# mmu-userspace-notifer
source package/notifier/mmu-userspace-notifier/Kconfig

endif # PK_KERNEL_NOTIFIER
```

## package/notifier/kernel-notifier-base/Kconfig
```kconfig
menuconfig PK_NOTIFIER_BASE
	bool "Kernel notifier Base Demo"

if PK_NOTIFIER_BASE

config PK_NOTIFIER_BASE_VERSION
	default "0.0.1"
	string "verstion"

config PK_NOTIFIER_BASE_TAR
	default "tar.gz"
	string "tar type"

config PK_NOTIFIER_BASE_URL
	default "https://gitee.com/BiscuitOS_team/HardStack/raw/Gitee/SubSystem/notifier/base"
	string "url"

config PK_NOTIFIER_BASE_GITHUB
	string "GitHub"

config PK_NOTIFIER_BASE_SRCFILE
	default "main.c Kconfig Makefile"
	string "Source code list"

config PK_NOTIFIER_BASE_CSRCFILE
	string "Compile source code list"

config PK_NOTIFIER_BASE_CONFIG
	string "CONFIG: Project Configure Options"

config PK_NOTIFIER_BASE_LIBPATH
	string "LIBS: Libraries to pass to the linker, e.g. -l<library>"

config PK_NOTIFIER_BASE_CPPFLAGS
	string "CPPFLAGS: C/C++ preprocessor flags, e.g. -I<include dir>"

config PK_NOTIFIER_BASE_DPKCONFIG
	string "PKG_CONFIG_PATH: Directories to add to pkg-config's search path"

config PK_NOTIFIER_BASE_CFLAGS
	string "CFLAGS: C compiler flags"

config PK_NOTIFIER_BASE_LDFLAGS
	string "LDFLAGS: Linker flags"

config PK_NOTIFIER_BASE_CXXFLAGS
	string "CXXFLAGS: C++ compiler flags"

config PK_NOTIFIER_BASE_ASFLAGS
	string "CCASFLAGS: assembler compiler flags (defaults to CFLAGS)"

config PK_NOTIFIER_BASE_BUILDARCH
	string "--host options on configure for Architecture"

endif # PK_NOTIFIER_BASE
```
