## package/paging/BiscuitOS-Compact-kernel/Kconfig
```kconfig
menuconfig PK_COMPACT_KERNEL
	bool "Memory Compact Mechanism on BiscuitOS (Kernel+)"

if PK_COMPACT_KERNEL

config PK_COMPACT_KERNEL_VERSION
	default "default"
	string "verstion"

config PK_COMPACT_KERNEL_TAR
	default "tar.gz"
	string "tar type"

config PK_COMPACT_KERNEL_URL
	default "https://gitee.com/BiscuitOS_team/HardStack/raw/Gitee/Memory-Allocator/Paging/BiscuitOS-Compact/kernel"
	string "url"

config PK_COMPACT_KERNEL_GITHUB
	string "GitHub"

config PK_COMPACT_KERNEL_SRCFILE
	default "main.c Kconfig Makefile RunBiscuitOS.sh"
	string "Source code list"

config PK_COMPACT_KERNEL_CSRCFILE
	string "Compile source code list"

config PK_COMPACT_KERNEL_CONFIG
	string "CONFIG: Project Configure Options"

config PK_COMPACT_KERNEL_LIBPATH
	string "LIBS: Libraries to pass to the linker, e.g. -l<library>"

config PK_COMPACT_KERNEL_CPPFLAGS
	string "CPPFLAGS: C/C++ preprocessor flags, e.g. -I<include dir>"

config PK_COMPACT_KERNEL_DPKCONFIG
	string "PKG_CONFIG_PATH: Directories to add to pkg-config's search path"

config PK_COMPACT_KERNEL_CFLAGS
	string "CFLAGS: C compiler flags"

config PK_COMPACT_KERNEL_LDFLAGS
	string "LDFLAGS: Linker flags"

config PK_COMPACT_KERNEL_CXXFLAGS
	string "CXXFLAGS: C++ compiler flags"

config PK_COMPACT_KERNEL_ASFLAGS
	string "CCASFLAGS: assembler compiler flags (defaults to CFLAGS)"

config PK_COMPACT_KERNEL_BUILDARCH
	string "--host options on configure for Architecture"

endif # PK_COMPACT_KERNEL
```
