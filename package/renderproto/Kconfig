## package/renderproto/Kconfig
```kconfig
menuconfig PK_RENDERPROTO
	bool "renderproto"

if PK_RENDERPROTO

config PK_RENDERPROTO_VERSION
	default "0.11"
	string "verstion"

config PK_RENDERPROTO_TAR
	default "tar.gz"
	string "tar type"

config PK_RENDERPROTO_URL
	default "https://www.x.org/releases/individual/proto/"
	string "url"

config PK_RENDERPROTO_GITHUB
	string "GitHub"

config PK_RENDERPROTO_SRCFILE
	string "Source code list"

config PK_RENDERPROTO_CONFIG
	default "--disable-static"
	string "CONFIG: Project Configure Options"

config PK_RENDERPROTO_LIBPATH
	string "LIBS: Libraries to pass to the linker, e.g. -l<library>"

config PK_RENDERPROTO_CPPFLAGS
	string "CPPFLAGS: C/C++ preprocessor flags, e.g. -I<include dir>"

config PK_RENDERPROTO_DPKCONFIG
	string "PKG_CONFIG_PATH: Directories to add to pkg-config's search path"

config PK_RENDERPROTO_CFLAGS
	string "CFLAGS: C compiler flags"

config PK_RENDERPROTO_LDFLAGS
	string "LDFLAGS: Linker flags"

config PK_RENDERPROTO_CXXFLAGS
	string "CXXFLAGS: C++ compiler flags"

config PK_RENDERPROTO_ASFLAGS
	string "CCASFLAGS: assembler compiler flags (defaults to CFLAGS)"

config PK_RENDERPROTO_BUILDARCH
	default "x86_64-unknown-linux-gnu"
	string "--host options on configure for Architecture"

endif # PK_RENDERPROTO
```

## package/resourceproto/Kconfig
```kconfig
menuconfig PK_RESOURCEPROTO
	bool "resourceproto"

if PK_RESOURCEPROTO

config PK_RESOURCEPROTO_VERSION
	default "1.2.0"
	string "verstion"

config PK_RESOURCEPROTO_TAR
	default "tar.gz"
	string "tar type"

config PK_RESOURCEPROTO_URL
	default "https://www.x.org/releases/individual/proto/"
	string "url"

config PK_RESOURCEPROTO_GITHUB
	string "GitHub"

config PK_RESOURCEPROTO_SRCFILE
	string "Source code list"

config PK_RESOURCEPROTO_CONFIG
	default "--enable-silent-rules --disable-static"
	string "CONFIG: Project Configure Options"

config PK_RESOURCEPROTO_LIBPATH
	string "LIBS: Libraries to pass to the linker, e.g. -l<library>"

config PK_RESOURCEPROTO_CPPFLAGS
	string "CPPFLAGS: C/C++ preprocessor flags, e.g. -I<include dir>"

config PK_RESOURCEPROTO_DPKCONFIG
	string "PKG_CONFIG_PATH: Directories to add to pkg-config's search path"

config PK_RESOURCEPROTO_CFLAGS
	string "CFLAGS: C compiler flags"

config PK_RESOURCEPROTO_LDFLAGS
	string "LDFLAGS: Linker flags"

config PK_RESOURCEPROTO_CXXFLAGS
	string "CXXFLAGS: C++ compiler flags"

config PK_RESOURCEPROTO_ASFLAGS
	string "CCASFLAGS: assembler compiler flags (defaults to CFLAGS)"

config PK_RESOURCEPROTO_BUILDARCH
	default "x86_64-unknown-linux-gnu"
	string "--host options on configure for Architecture"

endif # PK_RESOURCEPROTO
```

## package/riscv-pk/Kconfig
```kconfig
menuconfig PK_RISCV_PK
	bool "riscv-pk"

if PK_RISCV_PK

config PK_RISCV_PK_VERSION
	default "1.0.0"
	string "verstion"

config PK_RISCV_PK_TAR
	default "tar.gz"
	string "tar type"

config PK_RISCV_PK_URL
	default ""
	string "url"

config PK_RISCV_PK_GITHUB
	string "GitHub"

config PK_RISCV_PK_SRCFILE
	string "Source code list"

config PK_RISCV_PK_CONFIG
	default ""
	string "CONFIG: Project Configure Options"

config PK_RISCV_PK_LIBPATH
	string "LIBS: Libraries to pass to the linker, e.g. -l<library>"

config PK_RISCV_PK_CPPFLAGS
	string "CPPFLAGS: C/C++ preprocessor flags, e.g. -I<include dir>"

config PK_RISCV_PK_DPKCONFIG
	string "PKG_CONFIG_PATH: Directories to add to pkg-config's search path"

config PK_RISCV_PK_CFLAGS
	string "CFLAGS: C compiler flags"

config PK_RISCV_PK_LDFLAGS
	string "LDFLAGS: Linker flags"

config PK_RISCV_PK_CXXFLAGS
	string "CXXFLAGS: C++ compiler flags"

config PK_RISCV_PK_ASFLAGS
	string "CCASFLAGS: assembler compiler flags (defaults to CFLAGS)"

config PK_RISCV_PK_BUILDARCH
	default "x86_64-unknown-linux-gnu"
	string "--host options on configure for Architecture"

endif # PK_RISCV_PK
```

## package/rpi-4b-bootloader/Kconfig
```kconfig
menuconfig PK_RPI_4B_BOOTLOADER
	bool "RaspberryPi 4B Bootloader"

if PK_RPI_4B_BOOTLOADER

config PK_RPI_4B_BOOTLOADER_VERSION
	default "1.0.0"
	string "verstion"

config PK_RPI_4B_BOOTLOADER_TAR
	default "tar.bz2"
	string "tar type"

config PK_RPI_4B_BOOTLOADER_URL
	default "https://raw.githubusercontent.com/BiscuitOS/PackageManage/master/package/"
	string "url"

config PK_RPI_4B_BOOTLOADER_GITHUB
	string "GitHub"

config PK_RPI_4B_BOOTLOADER_SRCFILE
	default "rpi-4b-bootloader.tar.bz2"
	string "Source code list"

config PK_RPI_4B_BOOTLOADER_CONFIG
	default ""
	string "CONFIG: Project Configure Options"

config PK_RPI_4B_BOOTLOADER_LIBPATH
	string "LIBS: Libraries to pass to the linker, e.g. -l<library>"

config PK_RPI_4B_BOOTLOADER_CPPFLAGS
	string "CPPFLAGS: C/C++ preprocessor flags, e.g. -I<include dir>"

config PK_RPI_4B_BOOTLOADER_DPKCONFIG
	string "PKG_CONFIG_PATH: Directories to add to pkg-config's search path"

config PK_RPI_4B_BOOTLOADER_CFLAGS
	string "CFLAGS: C compiler flags"

config PK_RPI_4B_BOOTLOADER_LDFLAGS
	string "LDFLAGS: Linker flags"

config PK_RPI_4B_BOOTLOADER_CXXFLAGS
	string "CXXFLAGS: C++ compiler flags"

config PK_RPI_4B_BOOTLOADER_ASFLAGS
	string "CCASFLAGS: assembler compiler flags (defaults to CFLAGS)"

config PK_RPI_4B_BOOTLOADER_BUILDARCH
	default "x86_64-unknown-linux-gnu"
	string "--host options on configure for Architecture"

endif # PK_RPI_4B_BOOTLOADER
```

## package/scrnsaverproto/Kconfig
```kconfig
menuconfig PK_SCRNSAVERPROTO
	bool "scrnsaverproto"

if PK_SCRNSAVERPROTO

config PK_SCRNSAVERPROTO_VERSION
	default "1.2.2"
	string "verstion"

config PK_SCRNSAVERPROTO_TAR
	default "tar.gz"
	string "tar type"

config PK_SCRNSAVERPROTO_URL
	default "https://www.x.org/releases/individual/proto/"
	string "url"

config PK_SCRNSAVERPROTO_GITHUB
	string "GitHub"

config PK_SCRNSAVERPROTO_SRCFILE
	string "Source code list"

config PK_SCRNSAVERPROTO_CONFIG
	default "--enable-silent-rules --disable-static"
	string "CONFIG: Project Configure Options"

config PK_SCRNSAVERPROTO_LIBPATH
	string "LIBS: Libraries to pass to the linker, e.g. -l<library>"

config PK_SCRNSAVERPROTO_CPPFLAGS
	string "CPPFLAGS: C/C++ preprocessor flags, e.g. -I<include dir>"

config PK_SCRNSAVERPROTO_DPKCONFIG
	string "PKG_CONFIG_PATH: Directories to add to pkg-config's search path"

config PK_SCRNSAVERPROTO_CFLAGS
	string "CFLAGS: C compiler flags"

config PK_SCRNSAVERPROTO_LDFLAGS
	string "LDFLAGS: Linker flags"

config PK_SCRNSAVERPROTO_CXXFLAGS
	string "CXXFLAGS: C++ compiler flags"

config PK_SCRNSAVERPROTO_ASFLAGS
	string "CCASFLAGS: assembler compiler flags (defaults to CFLAGS)"

config PK_SCRNSAVERPROTO_BUILDARCH
	default "x86_64-unknown-linux-gnu"
	string "--host options on configure for Architecture"

endif # PK_SCRNSAVERPROTO
```

## package/slab/KMEM_CACHE_USERCOPY/Kconfig
```kconfig
menuconfig PK_KMEM_CACHE_USERCOPY
	bool "KMEM_CACHE_USERCOPY()"

if PK_KMEM_CACHE_USERCOPY

config PK_KMEM_CACHE_USERCOPY_VERSION
	default "0.0.1"
	string "verstion"

config PK_KMEM_CACHE_USERCOPY_TAR
	default "tar.gz"
	string "tar type"

config PK_KMEM_CACHE_USERCOPY_URL
	default "https://gitee.com/BiscuitOS_team/HardStack/raw/Gitee/Memory-Allocator/slab/API/KMEM_CACHE_USERCOPY"
	string "url"

config PK_KMEM_CACHE_USERCOPY_GITHUB
	string "GitHub"

config PK_KMEM_CACHE_USERCOPY_SRCFILE
	default "core.c Kconfig Makefile"
	string "Source code list"

config PK_KMEM_CACHE_USERCOPY_CSRCFILE
	string "Compile source code list"

config PK_KMEM_CACHE_USERCOPY_CONFIG
	string "CONFIG: Project Configure Options"

config PK_KMEM_CACHE_USERCOPY_LIBPATH
	string "LIBS: Libraries to pass to the linker, e.g. -l<library>"

config PK_KMEM_CACHE_USERCOPY_CPPFLAGS
	string "CPPFLAGS: C/C++ preprocessor flags, e.g. -I<include dir>"

config PK_KMEM_CACHE_USERCOPY_DPKCONFIG
	string "PKG_CONFIG_PATH: Directories to add to pkg-config's search path"

config PK_KMEM_CACHE_USERCOPY_CFLAGS
	string "CFLAGS: C compiler flags"

config PK_KMEM_CACHE_USERCOPY_LDFLAGS
	string "LDFLAGS: Linker flags"

config PK_KMEM_CACHE_USERCOPY_CXXFLAGS
	string "CXXFLAGS: C++ compiler flags"

config PK_KMEM_CACHE_USERCOPY_ASFLAGS
	string "CCASFLAGS: assembler compiler flags (defaults to CFLAGS)"

config PK_KMEM_CACHE_USERCOPY_BUILDARCH
	string "--host options on configure for Architecture"

endif # PK_KMEM_CACHE_USERCOPY
```

## package/slab/Kconfig
```kconfig
menuconfig PK_SLAB
	bool "Slab/Slub/Slob Memory Allocator"

if PK_SLAB

# __getname
source package/slab/__getname/Kconfig

# kfree_const
source package/slab/kfree_const/Kconfig

# kmalloc_userspace
source package/slab/kmalloc_userspace/Kconfig

# kmemdup
source package/slab/kmemdup/Kconfig

# kmem_cache_create_usercopy module
source package/slab/kmem_cache_create_usercopy_mod/Kconfig

# kmem_cache_create_usercopy app
source package/slab/kmem_cache_create_usercopy_app/Kconfig

# KMEM_CACHE_USERCOPY
source package/slab/KMEM_CACHE_USERCOPY/Kconfig

# kmem_cache_userspace
source package/slab/kmem_cache_userspace/Kconfig

# kstrdup_const
source package/slab/kstrdup_const/Kconfig

# Name on userspace
source package/slab/name_userspace/Kconfig

# __putname
source package/slab/__putname/Kconfig

# slub on userspace
source package/slab/slub_userspace/Kconfig

# strncpy_from_user app
source package/slab/strncpy_from_user_app/Kconfig

# strncpy_from_user module
source package/slab/strncpy_from_user_mod/Kconfig

endif # PK_SLAB
```

## package/slab/__getname/Kconfig
```kconfig
menuconfig PK___GETNAME
	bool "__getname()"

if PK___GETNAME

config PK___GETNAME_VERSION
	default "0.0.1"
	string "verstion"

config PK___GETNAME_TAR
	default "tar.gz"
	string "tar type"

config PK___GETNAME_URL
	default "https://gitee.com/BiscuitOS_team/HardStack/raw/Gitee/Memory-Allocator/slab/API/__getname"
	string "url"

config PK___GETNAME_GITHUB
	string "GitHub"

config PK___GETNAME_SRCFILE
	default "core.c Makefile"
	string "Source code list"

config PK___GETNAME_CSRCFILE
	string "Compile source code list"

config PK___GETNAME_CONFIG
	string "CONFIG: Project Configure Options"

config PK___GETNAME_LIBPATH
	string "LIBS: Libraries to pass to the linker, e.g. -l<library>"

config PK___GETNAME_CPPFLAGS
	string "CPPFLAGS: C/C++ preprocessor flags, e.g. -I<include dir>"

config PK___GETNAME_DPKCONFIG
	string "PKG_CONFIG_PATH: Directories to add to pkg-config's search path"

config PK___GETNAME_CFLAGS
	string "CFLAGS: C compiler flags"

config PK___GETNAME_LDFLAGS
	string "LDFLAGS: Linker flags"

config PK___GETNAME_CXXFLAGS
	string "CXXFLAGS: C++ compiler flags"

config PK___GETNAME_ASFLAGS
	string "CCASFLAGS: assembler compiler flags (defaults to CFLAGS)"

config PK___GETNAME_BUILDARCH
	string "--host options on configure for Architecture"

endif # PK___GETNAME
```

## package/slab/__putname/Kconfig
```kconfig
menuconfig PK___PUTNAME
	bool "__putname()"

if PK___PUTNAME

config PK___PUTNAME_VERSION
	default "0.0.1"
	string "verstion"

config PK___PUTNAME_TAR
	default "tar.gz"
	string "tar type"

config PK___PUTNAME_URL
	default "https://gitee.com/BiscuitOS_team/HardStack/raw/Gitee/Memory-Allocator/slab/API/__putname"
	string "url"

config PK___PUTNAME_GITHUB
	string "GitHub"

config PK___PUTNAME_SRCFILE
	default "core.c Makefile"
	string "Source code list"

config PK___PUTNAME_CSRCFILE
	string "Compile source code list"

config PK___PUTNAME_CONFIG
	string "CONFIG: Project Configure Options"

config PK___PUTNAME_LIBPATH
	string "LIBS: Libraries to pass to the linker, e.g. -l<library>"

config PK___PUTNAME_CPPFLAGS
	string "CPPFLAGS: C/C++ preprocessor flags, e.g. -I<include dir>"

config PK___PUTNAME_DPKCONFIG
	string "PKG_CONFIG_PATH: Directories to add to pkg-config's search path"

config PK___PUTNAME_CFLAGS
	string "CFLAGS: C compiler flags"

config PK___PUTNAME_LDFLAGS
	string "LDFLAGS: Linker flags"

config PK___PUTNAME_CXXFLAGS
	string "CXXFLAGS: C++ compiler flags"

config PK___PUTNAME_ASFLAGS
	string "CCASFLAGS: assembler compiler flags (defaults to CFLAGS)"

config PK___PUTNAME_BUILDARCH
	string "--host options on configure for Architecture"

endif # PK___PUTNAME
```

## package/slab/kfree_const/Kconfig
```kconfig
menuconfig PK_KFREE_CONST
	bool "kfree_const()"

if PK_KFREE_CONST

config PK_KFREE_CONST_VERSION
	default "0.0.1"
	string "verstion"

config PK_KFREE_CONST_TAR
	default "tar.gz"
	string "tar type"

config PK_KFREE_CONST_URL
	default "https://gitee.com/BiscuitOS_team/HardStack/raw/Gitee/Memory-Allocator/slab/API/kfree_const"
	string "url"

config PK_KFREE_CONST_GITHUB
	string "GitHub"

config PK_KFREE_CONST_SRCFILE
	default "core.c Makefile"
	string "Source code list"

config PK_KFREE_CONST_CSRCFILE
	string "Compile source code list"

config PK_KFREE_CONST_CONFIG
	string "CONFIG: Project Configure Options"

config PK_KFREE_CONST_LIBPATH
	string "LIBS: Libraries to pass to the linker, e.g. -l<library>"

config PK_KFREE_CONST_CPPFLAGS
	string "CPPFLAGS: C/C++ preprocessor flags, e.g. -I<include dir>"

config PK_KFREE_CONST_DPKCONFIG
	string "PKG_CONFIG_PATH: Directories to add to pkg-config's search path"

config PK_KFREE_CONST_CFLAGS
	string "CFLAGS: C compiler flags"

config PK_KFREE_CONST_LDFLAGS
	string "LDFLAGS: Linker flags"

config PK_KFREE_CONST_CXXFLAGS
	string "CXXFLAGS: C++ compiler flags"

config PK_KFREE_CONST_ASFLAGS
	string "CCASFLAGS: assembler compiler flags (defaults to CFLAGS)"

config PK_KFREE_CONST_BUILDARCH
	string "--host options on configure for Architecture"

endif # PK_KFREE_CONST
```

## package/slab/kmalloc_userspace/Kconfig
```kconfig
menuconfig PK_KMALLOC_USERSPACE
	bool "Kmalloc Allocator on Userspace"

if PK_KMALLOC_USERSPACE

config PK_KMALLOC_USERSPACE_VERSION
	default "0.0.1"
	string "verstion"

config PK_KMALLOC_USERSPACE_TAR
	default "tar.gz"
	string "tar type"

config PK_KMALLOC_USERSPACE_URL
	default "https://gitee.com/BiscuitOS_team/HardStack/raw/Gitee/Memory-Allocator/slab/kmalloc_userspace"
	string "url"

config PK_KMALLOC_USERSPACE_GITHUB
	string "GitHub"

config PK_KMALLOC_USERSPACE_SRCFILE
	default "main.c include/linux/buddy.h include/linux/list.h include/linux/bitmap.h include/linux/getorder.h include/linux/biscuitos.h mm/kasprintf.c README.md include/linux/gfp.h include/linux/slub.h mm/buddy.c Makefile mm/slub.c"
	string "Source code list"

config PK_KMALLOC_USERSPACE_CSRCFILE
	string "Compile source code list"

config PK_KMALLOC_USERSPACE_CONFIG
	string "CONFIG: Project Configure Options"

config PK_KMALLOC_USERSPACE_LIBPATH
	string "LIBS: Libraries to pass to the linker, e.g. -l<library>"

config PK_KMALLOC_USERSPACE_CPPFLAGS
	string "CPPFLAGS: C/C++ preprocessor flags, e.g. -I<include dir>"

config PK_KMALLOC_USERSPACE_DPKCONFIG
	string "PKG_CONFIG_PATH: Directories to add to pkg-config's search path"

config PK_KMALLOC_USERSPACE_CFLAGS
	string "CFLAGS: C compiler flags"

config PK_KMALLOC_USERSPACE_LDFLAGS
	string "LDFLAGS: Linker flags"

config PK_KMALLOC_USERSPACE_CXXFLAGS
	string "CXXFLAGS: C++ compiler flags"

config PK_KMALLOC_USERSPACE_ASFLAGS
	string "CCASFLAGS: assembler compiler flags (defaults to CFLAGS)"

config PK_KMALLOC_USERSPACE_BUILDARCH
	string "--host options on configure for Architecture"

endif # PK_KMALLOC_USERSPACE
```
