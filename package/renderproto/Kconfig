## package/slab/kmem_cache_create_usercopy_app/Kconfig
```kconfig
menuconfig PK_KMEM_CACHE_CREATE_APP
	select PK_KMEM_CACHE_CREATE_MOD
	bool "kmem_cache_create_usercopy() Appliacation"

if PK_KMEM_CACHE_CREATE_APP

config PK_KMEM_CACHE_CREATE_APP_VERSION
	default "0.0.1"
	string "verstion"

config PK_KMEM_CACHE_CREATE_APP_TAR
	default "tar.gz"
	string "tar type"

config PK_KMEM_CACHE_CREATE_APP_URL
	default "https://gitee.com/BiscuitOS_team/HardStack/raw/Gitee/Memory-Allocator/slab/API/kmem_cache_create_usercopy/userland"
	string "url"

config PK_KMEM_CACHE_CREATE_APP_GITHUB
	string "GitHub"

config PK_KMEM_CACHE_CREATE_APP_SRCFILE
	default "core.c Makefile"
	string "Source code list"

config PK_KMEM_CACHE_CREATE_APP_CSRCFILE
	string "Compile source code list"

config PK_KMEM_CACHE_CREATE_APP_CONFIG
	string "CONFIG: Project Configure Options"

config PK_KMEM_CACHE_CREATE_APP_LIBPATH
	string "LIBS: Libraries to pass to the linker, e.g. -l<library>"

config PK_KMEM_CACHE_CREATE_APP_CPPFLAGS
	string "CPPFLAGS: C/C++ preprocessor flags, e.g. -I<include dir>"

config PK_KMEM_CACHE_CREATE_APP_DPKCONFIG
	string "PKG_CONFIG_PATH: Directories to add to pkg-config's search path"

config PK_KMEM_CACHE_CREATE_APP_CFLAGS
	string "CFLAGS: C compiler flags"

config PK_KMEM_CACHE_CREATE_APP_LDFLAGS
	string "LDFLAGS: Linker flags"

config PK_KMEM_CACHE_CREATE_APP_CXXFLAGS
	string "CXXFLAGS: C++ compiler flags"

config PK_KMEM_CACHE_CREATE_APP_ASFLAGS
	string "CCASFLAGS: assembler compiler flags (defaults to CFLAGS)"

config PK_KMEM_CACHE_CREATE_APP_BUILDARCH
	string "--host options on configure for Architecture"

endif # PK_KMEM_CACHE_CREATE_APP
```

## package/slab/kmemdup/Kconfig
```kconfig
menuconfig PK_KMEMDUP
	bool "kmemdup()"

if PK_KMEMDUP

config PK_KMEMDUP_VERSION
	default "0.0.1"
	string "verstion"

config PK_KMEMDUP_TAR
	default "tar.gz"
	string "tar type"

config PK_KMEMDUP_URL
	default "https://gitee.com/BiscuitOS_team/HardStack/raw/Gitee/Memory-Allocator/slab/API/kmemdup"
	string "url"

config PK_KMEMDUP_GITHUB
	string "GitHub"

config PK_KMEMDUP_SRCFILE
	default "core.c Makefile"
	string "Source code list"

config PK_KMEMDUP_CSRCFILE
	string "Compile source code list"

config PK_KMEMDUP_CONFIG
	string "CONFIG: Project Configure Options"

config PK_KMEMDUP_LIBPATH
	string "LIBS: Libraries to pass to the linker, e.g. -l<library>"

config PK_KMEMDUP_CPPFLAGS
	string "CPPFLAGS: C/C++ preprocessor flags, e.g. -I<include dir>"

config PK_KMEMDUP_DPKCONFIG
	string "PKG_CONFIG_PATH: Directories to add to pkg-config's search path"

config PK_KMEMDUP_CFLAGS
	string "CFLAGS: C compiler flags"

config PK_KMEMDUP_LDFLAGS
	string "LDFLAGS: Linker flags"

config PK_KMEMDUP_CXXFLAGS
	string "CXXFLAGS: C++ compiler flags"

config PK_KMEMDUP_ASFLAGS
	string "CCASFLAGS: assembler compiler flags (defaults to CFLAGS)"

config PK_KMEMDUP_BUILDARCH
	string "--host options on configure for Architecture"

endif # PK_KMEMDUP
```

## package/slab/kstrdup_const/Kconfig
```kconfig
menuconfig PK_KSTRDUP_CONST
	bool "kstrdup_const()"

if PK_KSTRDUP_CONST

config PK_KSTRDUP_CONST_VERSION
	default "0.0.1"
	string "verstion"

config PK_KSTRDUP_CONST_TAR
	default "tar.gz"
	string "tar type"

config PK_KSTRDUP_CONST_URL
	default "https://gitee.com/BiscuitOS_team/HardStack/raw/Gitee/Memory-Allocator/slab/API/kstrdup_const"
	string "url"

config PK_KSTRDUP_CONST_GITHUB
	string "GitHub"

config PK_KSTRDUP_CONST_SRCFILE
	default "core.c Makefile"
	string "Source code list"

config PK_KSTRDUP_CONST_CSRCFILE
	string "Compile source code list"

config PK_KSTRDUP_CONST_CONFIG
	string "CONFIG: Project Configure Options"

config PK_KSTRDUP_CONST_LIBPATH
	string "LIBS: Libraries to pass to the linker, e.g. -l<library>"

config PK_KSTRDUP_CONST_CPPFLAGS
	string "CPPFLAGS: C/C++ preprocessor flags, e.g. -I<include dir>"

config PK_KSTRDUP_CONST_DPKCONFIG
	string "PKG_CONFIG_PATH: Directories to add to pkg-config's search path"

config PK_KSTRDUP_CONST_CFLAGS
	string "CFLAGS: C compiler flags"

config PK_KSTRDUP_CONST_LDFLAGS
	string "LDFLAGS: Linker flags"

config PK_KSTRDUP_CONST_CXXFLAGS
	string "CXXFLAGS: C++ compiler flags"

config PK_KSTRDUP_CONST_ASFLAGS
	string "CCASFLAGS: assembler compiler flags (defaults to CFLAGS)"

config PK_KSTRDUP_CONST_BUILDARCH
	string "--host options on configure for Architecture"

endif # PK_KSTRDUP_CONST
```

## package/slab/name_userspace/Kconfig
```kconfig
menuconfig PK_NAME_USERSPACE
	bool "Name Allocator on Userspace"

if PK_NAME_USERSPACE

config PK_NAME_USERSPACE_VERSION
	default "0.0.1"
	string "verstion"

config PK_NAME_USERSPACE_TAR
	default "tar.gz"
	string "tar type"

config PK_NAME_USERSPACE_URL
	default "https://gitee.com/BiscuitOS_team/HardStack/raw/Gitee/Memory-Allocator/slab/name_userspace"
	string "url"

config PK_NAME_USERSPACE_GITHUB
	string "GitHub"

config PK_NAME_USERSPACE_SRCFILE
	default "main.c include/linux/buddy.h include/linux/list.h include/linux/bitmap.h include/linux/getorder.h include/linux/biscuitos.h mm/kasprintf.c README.md include/linux/gfp.h include/linux/slub.h mm/buddy.c Makefile mm/slub.c"
	string "Source code list"

config PK_NAME_USERSPACE_CSRCFILE
	string "Compile source code list"

config PK_NAME_USERSPACE_CONFIG
	string "CONFIG: Project Configure Options"

config PK_NAME_USERSPACE_LIBPATH
	string "LIBS: Libraries to pass to the linker, e.g. -l<library>"

config PK_NAME_USERSPACE_CPPFLAGS
	string "CPPFLAGS: C/C++ preprocessor flags, e.g. -I<include dir>"

config PK_NAME_USERSPACE_DPKCONFIG
	string "PKG_CONFIG_PATH: Directories to add to pkg-config's search path"

config PK_NAME_USERSPACE_CFLAGS
	string "CFLAGS: C compiler flags"

config PK_NAME_USERSPACE_LDFLAGS
	string "LDFLAGS: Linker flags"

config PK_NAME_USERSPACE_CXXFLAGS
	string "CXXFLAGS: C++ compiler flags"

config PK_NAME_USERSPACE_ASFLAGS
	string "CCASFLAGS: assembler compiler flags (defaults to CFLAGS)"

config PK_NAME_USERSPACE_BUILDARCH
	string "--host options on configure for Architecture"

endif # PK_NAME_USERSPACE
```

## package/slab/slub_pcpu_cache_userspace/Kconfig
```kconfig
menuconfig PK_SLUB_USERSPACE
	bool "SLUB Allocator on Userspace"

if PK_SLUB_USERSPACE

config PK_SLUB_USERSPACE_VERSION
	default "0.0.1"
	string "verstion"

config PK_SLUB_USERSPACE_TAR
	default "tar.gz"
	string "tar type"

config PK_SLUB_USERSPACE_URL
	default "https://gitee.com/BiscuitOS_team/HardStack/raw/Gitee/Memory-Allocator/slab/slub_userspace"
	string "url"

config PK_SLUB_USERSPACE_GITHUB
	string "GitHub"

config PK_SLUB_USERSPACE_SRCFILE
	default "core.c include/linux/buddy.h include/linux/list.h include/linux/bitmap.h include/linux/getorder.h include/linux/biscuitos.h mm/kasprintf.c README.md include/linux/gfp.h include/linux/slub.h mm/buddy.c Makefile mm/slub.c"
	string "Source code list"

config PK_SLUB_USERSPACE_CSRCFILE
	string "Compile source code list"

config PK_SLUB_USERSPACE_CONFIG
	string "CONFIG: Project Configure Options"

config PK_SLUB_USERSPACE_LIBPATH
	string "LIBS: Libraries to pass to the linker, e.g. -l<library>"

config PK_SLUB_USERSPACE_CPPFLAGS
	string "CPPFLAGS: C/C++ preprocessor flags, e.g. -I<include dir>"

config PK_SLUB_USERSPACE_DPKCONFIG
	string "PKG_CONFIG_PATH: Directories to add to pkg-config's search path"

config PK_SLUB_USERSPACE_CFLAGS
	string "CFLAGS: C compiler flags"

config PK_SLUB_USERSPACE_LDFLAGS
	string "LDFLAGS: Linker flags"

config PK_SLUB_USERSPACE_CXXFLAGS
	string "CXXFLAGS: C++ compiler flags"

config PK_SLUB_USERSPACE_ASFLAGS
	string "CCASFLAGS: assembler compiler flags (defaults to CFLAGS)"

config PK_SLUB_USERSPACE_BUILDARCH
	string "--host options on configure for Architecture"

endif # PK_SLUB_USERSPACE
```

## package/slab/strncpy_from_user_app/Kconfig
```kconfig
menuconfig PK_STRNCPY_FROM_USER_APP
	select PK_STRNCPY_FROM_USER_MOD
	bool "strncpy_from_user() Appliacation"

if PK_STRNCPY_FROM_USER_APP

config PK_STRNCPY_FROM_USER_APP_VERSION
	default "0.0.1"
	string "verstion"

config PK_STRNCPY_FROM_USER_APP_TAR
	default "tar.gz"
	string "tar type"

config PK_STRNCPY_FROM_USER_APP_URL
	default "https://gitee.com/BiscuitOS_team/HardStack/raw/Gitee/Memory-Allocator/slab/API/strncpy_from_user/userland"
	string "url"

config PK_STRNCPY_FROM_USER_APP_GITHUB
	string "GitHub"

config PK_STRNCPY_FROM_USER_APP_SRCFILE
	default "core.c Makefile"
	string "Source code list"

config PK_STRNCPY_FROM_USER_APP_CSRCFILE
	string "Compile source code list"

config PK_STRNCPY_FROM_USER_APP_CONFIG
	string "CONFIG: Project Configure Options"

config PK_STRNCPY_FROM_USER_APP_LIBPATH
	string "LIBS: Libraries to pass to the linker, e.g. -l<library>"

config PK_STRNCPY_FROM_USER_APP_CPPFLAGS
	string "CPPFLAGS: C/C++ preprocessor flags, e.g. -I<include dir>"

config PK_STRNCPY_FROM_USER_APP_DPKCONFIG
	string "PKG_CONFIG_PATH: Directories to add to pkg-config's search path"

config PK_STRNCPY_FROM_USER_APP_CFLAGS
	string "CFLAGS: C compiler flags"

config PK_STRNCPY_FROM_USER_APP_LDFLAGS
	string "LDFLAGS: Linker flags"

config PK_STRNCPY_FROM_USER_APP_CXXFLAGS
	string "CXXFLAGS: C++ compiler flags"

config PK_STRNCPY_FROM_USER_APP_ASFLAGS
	string "CCASFLAGS: assembler compiler flags (defaults to CFLAGS)"

config PK_STRNCPY_FROM_USER_APP_BUILDARCH
	string "--host options on configure for Architecture"

endif # PK_STRNCPY_FROM_USER_APP
```

## package/slab/strncpy_from_user_mod/Kconfig
```kconfig
menuconfig PK_STRNCPY_FROM_USER_MOD
	bool "strncpy_from_user() module"

if PK_STRNCPY_FROM_USER_MOD

config PK_STRNCPY_FROM_USER_MOD_VERSION
	default "0.0.1"
	string "verstion"

config PK_STRNCPY_FROM_USER_MOD_TAR
	default "tar.gz"
	string "tar type"

config PK_STRNCPY_FROM_USER_MOD_URL
	default "https://gitee.com/BiscuitOS_team/HardStack/raw/Gitee/Memory-Allocator/slab/API/strncpy_from_user/kernel"
	string "url"

config PK_STRNCPY_FROM_USER_MOD_GITHUB
	string "GitHub"

config PK_STRNCPY_FROM_USER_MOD_SRCFILE
	default "core.c Kconfig Makefile"
	string "Source code list"

config PK_STRNCPY_FROM_USER_MOD_CSRCFILE
	string "Compile source code list"

config PK_STRNCPY_FROM_USER_MOD_CONFIG
	string "CONFIG: Project Configure Options"

config PK_STRNCPY_FROM_USER_MOD_LIBPATH
	string "LIBS: Libraries to pass to the linker, e.g. -l<library>"

config PK_STRNCPY_FROM_USER_MOD_CPPFLAGS
	string "CPPFLAGS: C/C++ preprocessor flags, e.g. -I<include dir>"

config PK_STRNCPY_FROM_USER_MOD_DPKCONFIG
	string "PKG_CONFIG_PATH: Directories to add to pkg-config's search path"

config PK_STRNCPY_FROM_USER_MOD_CFLAGS
	string "CFLAGS: C compiler flags"

config PK_STRNCPY_FROM_USER_MOD_LDFLAGS
	string "LDFLAGS: Linker flags"

config PK_STRNCPY_FROM_USER_MOD_CXXFLAGS
	string "CXXFLAGS: C++ compiler flags"

config PK_STRNCPY_FROM_USER_MOD_ASFLAGS
	string "CCASFLAGS: assembler compiler flags (defaults to CFLAGS)"

config PK_STRNCPY_FROM_USER_MOD_BUILDARCH
	string "--host options on configure for Architecture"

endif # PK_STRNCPY_FROM_USER_MOD
```

## package/snake/Kconfig
```kconfig
menuconfig PK_SNAKE
	select PK_NCURSES
	bool "Game: snake"

if PK_SNAKE

config PK_SNAKE_VERSION
	default "0.0.1"
	string "verstion"

config PK_SNAKE_TAR
	default "tar.gz"
	string "tar type"

config PK_SNAKE_URL
	default "https://gitee.com/BiscuitOS_team/HardStack/raw/Gitee/GAME/snake"
	string "url"

config PK_SNAKE_GITHUB
	string "GitHub"

config PK_SNAKE_SRCFILE
	default "snake.c Makefile"
	string "Source code list"

config PK_SNAKE_CSRCFILE
	string "Compile source code list"

config PK_SNAKE_CONFIG
	string "CONFIG: Project Configure Options"

config PK_SNAKE_LIBPATH
	string "LIBS: Libraries to pass to the linker, e.g. -l<library>"

config PK_SNAKE_CPPFLAGS
	string "CPPFLAGS: C/C++ preprocessor flags, e.g. -I<include dir>"

config PK_SNAKE_DPKCONFIG
	string "PKG_CONFIG_PATH: Directories to add to pkg-config's search path"

config PK_SNAKE_CFLAGS
	string "CFLAGS: C compiler flags"

config PK_SNAKE_LDFLAGS
	string "LDFLAGS: Linker flags"

config PK_SNAKE_CXXFLAGS
	string "CXXFLAGS: C++ compiler flags"

config PK_SNAKE_ASFLAGS
	string "CCASFLAGS: assembler compiler flags (defaults to CFLAGS)"

config PK_SNAKE_BUILDARCH
	string "--host options on configure for Architecture"

endif # PK_SNAKE
```

## package/spi/Kconfig
```kconfig
menuconfig PK_SPI
	bool "SPI: Serial Peripheral Interface"

if PK_SPI

# SPI Module
source package/spi/spi_module/Kconfig

endif # PK_SPI
```

## package/spi/spi_module/Kconfig
```kconfig
menuconfig PK_SPI_MOD
	bool "SPI Device Driver Module"

if PK_SPI_MOD

config PK_SPI_MOD_VERSION
	default "0.0.1"
	string "verstion"

config PK_SPI_MOD_TAR
	default "tar.gz"
	string "tar type"

config PK_SPI_MOD_URL
	default "https://gitee.com/BiscuitOS_team/HardStack/raw/Gitee/Device-Driver/spi/base/kernel"
	string "url"

config PK_SPI_MOD_GITHUB
	string "GitHub"

config PK_SPI_MOD_SRCFILE
	default "spi.c Kconfig Makefile default.dts"
	string "Source code list"

config PK_SPI_MOD_CSRCFILE
	string "Compile source code list"

config PK_SPI_MOD_CONFIG
	string "CONFIG: Project Configure Options"

config PK_SPI_MOD_LIBPATH
	string "LIBS: Libraries to pass to the linker, e.g. -l<library>"

config PK_SPI_MOD_CPPFLAGS
	string "CPPFLAGS: C/C++ preprocessor flags, e.g. -I<include dir>"

config PK_SPI_MOD_DPKCONFIG
	string "PKG_CONFIG_PATH: Directories to add to pkg-config's search path"

config PK_SPI_MOD_CFLAGS
	string "CFLAGS: C compiler flags"

config PK_SPI_MOD_LDFLAGS
	string "LDFLAGS: Linker flags"

config PK_SPI_MOD_CXXFLAGS
	string "CXXFLAGS: C++ compiler flags"

config PK_SPI_MOD_ASFLAGS
	string "CCASFLAGS: assembler compiler flags (defaults to CFLAGS)"

config PK_SPI_MOD_BUILDARCH
	string "--host options on configure for Architecture"

endif # PK_SPI_MOD
```

## package/strace/Kconfig
```kconfig
menuconfig PK_STRACE
	bool "strace"

if PK_STRACE

config PK_STRACE_VERSION
	default "5.0"
	string "verstion"

config PK_STRACE_TAR
	default "tar.xz"
	string "tar type"

config PK_STRACE_URL
	default "https://src.fedoraproject.org/repo/pkgs/strace/strace-5.0.tar.xz/sha512/cba3280ada27ef434eda54d0e150f04ab89ad227d67b29bd0993f9ac7747eb32b0e49af8cc493b92eab99c0848ec8dc6bbd9b1db423abd53f19129dacbddf265/"
	string "url"

config PK_STRACE_GITHUB
	string "GitHub"

config PK_STRACE_SRCFILE
	string "Source code list"

config PK_STRACE_CONFIG
	default "--enable-silent-rules"
	string "CONFIG: Project Configure Options"

config PK_STRACE_LIBPATH
	string "LIBS: Libraries to pass to the linker, e.g. -l<library>"

config PK_STRACE_CPPFLAGS
	string "CPPFLAGS: C/C++ preprocessor flags, e.g. -I<include dir>"

config PK_STRACE_DPKCONFIG
	string "PKG_CONFIG_PATH: Directories to add to pkg-config's search path"

config PK_STRACE_CFLAGS
	string "CFLAGS: C compiler flags"

config PK_STRACE_LDFLAGS
	string "LDFLAGS: Linker flags"

config PK_STRACE_CXXFLAGS
	string "CXXFLAGS: C++ compiler flags"

config PK_STRACE_ASFLAGS
	string "CCASFLAGS: assembler compiler flags (defaults to CFLAGS)"

config PK_STRACE_BUILDARCH
	default "x86_64-unknown-linux-gnu"
	string "--host options on configure for Architecture"

endif # PK_STRACE
```
