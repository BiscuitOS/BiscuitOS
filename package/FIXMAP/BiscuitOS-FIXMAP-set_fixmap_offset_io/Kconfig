## package/FIXMAP/BiscuitOS-FIXMAP-set_fixmap_offset_io/Kconfig
```kconfig
menuconfig PK_FIXMAP_SET_FIXMAP_OFFSET_IO
	bool "FIXMAP API: set_fixmap_offset_io()"

if PK_FIXMAP_SET_FIXMAP_OFFSET_IO

config PK_FIXMAP_SET_FIXMAP_OFFSET_IO_VERSION
	default "default"
	string "verstion"

config PK_FIXMAP_SET_FIXMAP_OFFSET_IO_TAR
	default "tar.gz"
	string "tar type"

config PK_FIXMAP_SET_FIXMAP_OFFSET_IO_URL
	default "https://gitee.com/BiscuitOS_team/HardStack/raw/Gitee/Memory-Allocator/FIXMAP/BiscuitOS-FIXMAP-set_fixmap_offset_io"
	string "url"

config PK_FIXMAP_SET_FIXMAP_OFFSET_IO_GITHUB
	string "GitHub"

config PK_FIXMAP_SET_FIXMAP_OFFSET_IO_SRCFILE
	default "main.c Kconfig Makefile"
	string "Source code list"

config PK_FIXMAP_SET_FIXMAP_OFFSET_IO_CSRCFILE
	string "Compile source code list"

config PK_FIXMAP_SET_FIXMAP_OFFSET_IO_CONFIG
	string "CONFIG: Project Configure Options"

config PK_FIXMAP_SET_FIXMAP_OFFSET_IO_LIBPATH
	string "LIBS: Libraries to pass to the linker, e.g. -l<library>"

config PK_FIXMAP_SET_FIXMAP_OFFSET_IO_CPPFLAGS
	string "CPPFLAGS: C/C++ preprocessor flags, e.g. -I<include dir>"

config PK_FIXMAP_SET_FIXMAP_OFFSET_IO_DPKCONFIG
	string "PKG_CONFIG_PATH: Directories to add to pkg-config's search path"

config PK_FIXMAP_SET_FIXMAP_OFFSET_IO_CFLAGS
	string "CFLAGS: C compiler flags"

config PK_FIXMAP_SET_FIXMAP_OFFSET_IO_LDFLAGS
	string "LDFLAGS: Linker flags"

config PK_FIXMAP_SET_FIXMAP_OFFSET_IO_CXXFLAGS
	string "CXXFLAGS: C++ compiler flags"

config PK_FIXMAP_SET_FIXMAP_OFFSET_IO_ASFLAGS
	string "CCASFLAGS: assembler compiler flags (defaults to CFLAGS)"

config PK_FIXMAP_SET_FIXMAP_OFFSET_IO_BUILDARCH
	string "--host options on configure for Architecture"

endif # PK_FIXMAP_SET_FIXMAP_OFFSET_IO
```

## package/FIXMAP/BiscuitOS-FIXMAP-set_fixmap_offset_nocache/Kconfig
```kconfig
menuconfig PK_FIXMAP_SET_FIXMAP_OFFSET_NOCACHE
	bool "FIXMAP API: set_fixmap_offset_nocache()"

if PK_FIXMAP_SET_FIXMAP_OFFSET_NOCACHE

config PK_FIXMAP_SET_FIXMAP_OFFSET_NOCACHE_VERSION
	default "default"
	string "verstion"

config PK_FIXMAP_SET_FIXMAP_OFFSET_NOCACHE_TAR
	default "tar.gz"
	string "tar type"

config PK_FIXMAP_SET_FIXMAP_OFFSET_NOCACHE_URL
	default "https://gitee.com/BiscuitOS_team/HardStack/raw/Gitee/Memory-Allocator/FIXMAP/BiscuitOS-FIXMAP-set_fixmap_offset_nocache"
	string "url"

config PK_FIXMAP_SET_FIXMAP_OFFSET_NOCACHE_GITHUB
	string "GitHub"

config PK_FIXMAP_SET_FIXMAP_OFFSET_NOCACHE_SRCFILE
	default "main.c Kconfig Makefile"
	string "Source code list"

config PK_FIXMAP_SET_FIXMAP_OFFSET_NOCACHE_CSRCFILE
	string "Compile source code list"

config PK_FIXMAP_SET_FIXMAP_OFFSET_NOCACHE_CONFIG
	string "CONFIG: Project Configure Options"

config PK_FIXMAP_SET_FIXMAP_OFFSET_NOCACHE_LIBPATH
	string "LIBS: Libraries to pass to the linker, e.g. -l<library>"

config PK_FIXMAP_SET_FIXMAP_OFFSET_NOCACHE_CPPFLAGS
	string "CPPFLAGS: C/C++ preprocessor flags, e.g. -I<include dir>"

config PK_FIXMAP_SET_FIXMAP_OFFSET_NOCACHE_DPKCONFIG
	string "PKG_CONFIG_PATH: Directories to add to pkg-config's search path"

config PK_FIXMAP_SET_FIXMAP_OFFSET_NOCACHE_CFLAGS
	string "CFLAGS: C compiler flags"

config PK_FIXMAP_SET_FIXMAP_OFFSET_NOCACHE_LDFLAGS
	string "LDFLAGS: Linker flags"

config PK_FIXMAP_SET_FIXMAP_OFFSET_NOCACHE_CXXFLAGS
	string "CXXFLAGS: C++ compiler flags"

config PK_FIXMAP_SET_FIXMAP_OFFSET_NOCACHE_ASFLAGS
	string "CCASFLAGS: assembler compiler flags (defaults to CFLAGS)"

config PK_FIXMAP_SET_FIXMAP_OFFSET_NOCACHE_BUILDARCH
	string "--host options on configure for Architecture"

endif # PK_FIXMAP_SET_FIXMAP_OFFSET_NOCACHE
```

## package/FIXMAP/BiscuitOS-Permanent-VSYSCALL/Kconfig
```kconfig
menuconfig PK_PERMANENT_VSYSCALL
	bool "Permanent Mapping: VSYSCALL"

if PK_PERMANENT_VSYSCALL

config PK_PERMANENT_VSYSCALL_VERSION
	default "default"
	string "verstion"

config PK_PERMANENT_VSYSCALL_TAR
	default "tar.gz"
	string "tar type"

config PK_PERMANENT_VSYSCALL_URL
	default "https://gitee.com/BiscuitOS_team/HardStack/raw/Gitee/Memory-Allocator/FIXMAP/BiscuitOS-Permanent-VSYSCALL"
	string "url"

config PK_PERMANENT_VSYSCALL_GITHUB
	string "GitHub"

config PK_PERMANENT_VSYSCALL_SRCFILE
	default "main.c Makefile"
	string "Source code list"

config PK_PERMANENT_VSYSCALL_CSRCFILE
	string "Compile source code list"

config PK_PERMANENT_VSYSCALL_CONFIG
	string "CONFIG: Project Configure Options"

config PK_PERMANENT_VSYSCALL_LIBPATH
	string "LIBS: Libraries to pass to the linker, e.g. -l<library>"

config PK_PERMANENT_VSYSCALL_CPPFLAGS
	string "CPPFLAGS: C/C++ preprocessor flags, e.g. -I<include dir>"

config PK_PERMANENT_VSYSCALL_DPKCONFIG
	string "PKG_CONFIG_PATH: Directories to add to pkg-config's search path"

config PK_PERMANENT_VSYSCALL_CFLAGS
	string "CFLAGS: C compiler flags"

config PK_PERMANENT_VSYSCALL_LDFLAGS
	string "LDFLAGS: Linker flags"

config PK_PERMANENT_VSYSCALL_CXXFLAGS
	string "CXXFLAGS: C++ compiler flags"

config PK_PERMANENT_VSYSCALL_ASFLAGS
	string "CCASFLAGS: assembler compiler flags (defaults to CFLAGS)"

config PK_PERMANENT_VSYSCALL_BUILDARCH
	string "--host options on configure for Architecture"

endif # PK_PERMANENT_VSYSCALL
```

## package/FIXMAP/BiscuitOS-Permanent/Kconfig
```kconfig
menuconfig PK_PERMANENT
	bool "Permanent Mapping: Add New Entry"

if PK_PERMANENT

config PK_PERMANENT_VERSION
	default "default"
	string "verstion"

config PK_PERMANENT_TAR
	default "tar.gz"
	string "tar type"

config PK_PERMANENT_URL
	default "https://gitee.com/BiscuitOS_team/HardStack/raw/Gitee/Memory-Allocator/FIXMAP/BiscuitOS-Permanent"
	string "url"

config PK_PERMANENT_GITHUB
	string "GitHub"

config PK_PERMANENT_SRCFILE
	default "main.c Kconfig Makefile"
	string "Source code list"

config PK_PERMANENT_CSRCFILE
	string "Compile source code list"

config PK_PERMANENT_CONFIG
	string "CONFIG: Project Configure Options"

config PK_PERMANENT_LIBPATH
	string "LIBS: Libraries to pass to the linker, e.g. -l<library>"

config PK_PERMANENT_CPPFLAGS
	string "CPPFLAGS: C/C++ preprocessor flags, e.g. -I<include dir>"

config PK_PERMANENT_DPKCONFIG
	string "PKG_CONFIG_PATH: Directories to add to pkg-config's search path"

config PK_PERMANENT_CFLAGS
	string "CFLAGS: C compiler flags"

config PK_PERMANENT_LDFLAGS
	string "LDFLAGS: Linker flags"

config PK_PERMANENT_CXXFLAGS
	string "CXXFLAGS: C++ compiler flags"

config PK_PERMANENT_ASFLAGS
	string "CCASFLAGS: assembler compiler flags (defaults to CFLAGS)"

config PK_PERMANENT_BUILDARCH
	string "--host options on configure for Architecture"

endif # PK_PERMANENT
```

## package/FIXMAP/Kconfig
```kconfig
menuconfig PK_FIXMAP
	bool "FIXMAP Memory Allocator"

if PK_FIXMAP

# FIXMAP API: clear_fixmap
source package/FIXMAP/BiscuitOS-FIXMAP-clear_fixmap/Kconfig

# FIXMAP API: __fix_to_virt
source package/FIXMAP/BiscuitOS-FIXMAP-__fix_to_virt/Kconfig

# FIXMAP API: fix_to_virt
source package/FIXMAP/BiscuitOS-FIXMAP-fix_to_virt/Kconfig

# Permanent Mapping
source package/FIXMAP/BiscuitOS-Permanent/Kconfig

# Permanent Mapping VSYSCALL
source package/FIXMAP/BiscuitOS-Permanent-VSYSCALL/Kconfig

# FIXMAP API: __set_fixmap
source package/FIXMAP/BiscuitOS-FIXMAP-__set_fixmap/Kconfig

# FIXMAP API: set_fixmap
source package/FIXMAP/BiscuitOS-FIXMAP-set_fixmap/Kconfig

# FIXMAP API: __set_fixmap_offset
source package/FIXMAP/BiscuitOS-FIXMAP-__set_fixmap_offset/Kconfig

# FIXMAP API: set_fixmap_offset
source package/FIXMAP/BiscuitOS-FIXMAP-set_fixmap_offset/Kconfig

# FIXMAP API: set_fixmap_io
source package/FIXMAP/BiscuitOS-FIXMAP-set_fixmap_io/Kconfig

# FIXMAP API: set_fixmap_offset_io
source package/FIXMAP/BiscuitOS-FIXMAP-set_fixmap_offset_io/Kconfig

# FIXMAP API: set_fixmap_nocache
source package/FIXMAP/BiscuitOS-FIXMAP-set_fixmap_nocache/Kconfig

# FIXMAP API: set_fixmap_offset_nocache
source package/FIXMAP/BiscuitOS-FIXMAP-set_fixmap_offset_nocache/Kconfig

# FIXMAP API: __virt_to_fix
source package/FIXMAP/BiscuitOS-FIXMAP-__virt_to_fix/Kconfig

# FIXMAP API: virt_to_fix
source package/FIXMAP/BiscuitOS-FIXMAP-virt_to_fix/Kconfig

endif # PK_FIXMAP
```

## package/GPIO/GPIO_module/Kconfig
```kconfig
menuconfig PK_GPIO_MOD
	bool "GPIO Device Driver Module"

if PK_GPIO_MOD

config PK_GPIO_MOD_VERSION
	default "0.0.1"
	string "verstion"

config PK_GPIO_MOD_TAR
	default "tar.gz"
	string "tar type"

config PK_GPIO_MOD_URL
	default "https://gitee.com/BiscuitOS_team/HardStack/raw/Gitee/Device-Driver/GPIO/Base/kernel"
	string "url"

config PK_GPIO_MOD_GITHUB
	string "GitHub"

config PK_GPIO_MOD_SRCFILE
	default "gpio.c default.dts Kconfig Makefile"
	string "Source code list"

config PK_GPIO_MOD_CSRCFILE
	string "Compile source code list"

config PK_GPIO_MOD_CONFIG
	string "CONFIG: Project Configure Options"

config PK_GPIO_MOD_LIBPATH
	string "LIBS: Libraries to pass to the linker, e.g. -l<library>"

config PK_GPIO_MOD_CPPFLAGS
	string "CPPFLAGS: C/C++ preprocessor flags, e.g. -I<include dir>"

config PK_GPIO_MOD_DPKCONFIG
	string "PKG_CONFIG_PATH: Directories to add to pkg-config's search path"

config PK_GPIO_MOD_CFLAGS
	string "CFLAGS: C compiler flags"

config PK_GPIO_MOD_LDFLAGS
	string "LDFLAGS: Linker flags"

config PK_GPIO_MOD_CXXFLAGS
	string "CXXFLAGS: C++ compiler flags"

config PK_GPIO_MOD_ASFLAGS
	string "CCASFLAGS: assembler compiler flags (defaults to CFLAGS)"

config PK_GPIO_MOD_BUILDARCH
	string "--host options on configure for Architecture"

endif # PK_GPIO_MOD
```

## package/GPIO/Kconfig
```kconfig
menuconfig PK_GPIO
	bool "GPIO Device Driver and Application"

if PK_GPIO

# GPIO Device Driver Module
source package/GPIO/GPIO_module/Kconfig

endif # PK_GPIO
```

## package/GUN-GCC/BiscuitOS-GUN-GCC-V9-ASAN/Kconfig
```kconfig
menuconfig PK_GUN_GCC_V9_ASAN
	bool "GUN GCC V9.X ASAN on BiscuitOS"

if PK_GUN_GCC_V9_ASAN

config PK_GUN_GCC_V9_ASAN_VERSION
	default "9.2.0"
	string "verstion"

config PK_GUN_GCC_V9_ASAN_TAR
	default "tar.xz"
	string "tar type"

config PK_GUN_GCC_V9_ASAN_URL
	default "http://ftp.gnu.org/gnu/gcc"
	string "url"

config PK_GUN_GCC_V9_ASAN_GITHUB
	string "GitHub"

config PK_GUN_GCC_V9_ASAN_SRCFILE
	default "main.c Makefile"
	string "Source code list"

config PK_GUN_GCC_V9_ASAN_CSRCFILE
	string "Compile source code list"

config PK_GUN_GCC_V9_ASAN_CONFIG
	default "--enable-checking=release --enable-languages=c,c++ --disable-multilib"
	string "CONFIG: Project Configure Options"

config PK_GUN_GCC_V9_ASAN_LIBPATH
	string "LIBS: Libraries to pass to the linker, e.g. -l<library>"

config PK_GUN_GCC_V9_ASAN_CPPFLAGS
	string "CPPFLAGS: C/C++ preprocessor flags, e.g. -I<include dir>"

config PK_GUN_GCC_V9_ASAN_DPKCONFIG
	string "PKG_CONFIG_PATH: Directories to add to pkg-config's search path"

config PK_GUN_GCC_V9_ASAN_CFLAGS
	string "CFLAGS: C compiler flags"

config PK_GUN_GCC_V9_ASAN_LDFLAGS
	string "LDFLAGS: Linker flags"

config PK_GUN_GCC_V9_ASAN_CXXFLAGS
	string "CXXFLAGS: C++ compiler flags"

config PK_GUN_GCC_V9_ASAN_ASFLAGS
	string "CCASFLAGS: assembler compiler flags (defaults to CFLAGS)"

config PK_GUN_GCC_V9_ASAN_BUILDARCH
	string "--host options on configure for Architecture"

endif # PK_GUN_GCC_V9_ASAN
```

## package/GUN-GCC/BiscuitOS-GUN-GCC-V9-ASCAN/Kconfig
```kconfig
menuconfig PK_GUN_GCC_V9_ASCAN
	bool "GUN GCC V9.X ASCAN on BiscuitOS"

if PK_GUN_GCC_V9_ASCAN

config PK_GUN_GCC_V9_ASCAN_VERSION
	default "9.2.0"
	string "verstion"

config PK_GUN_GCC_V9_ASCAN_TAR
	default "tar.xz"
	string "tar type"

config PK_GUN_GCC_V9_ASCAN_URL
	default "http://ftp.gnu.org/gnu/gcc"
	string "url"

config PK_GUN_GCC_V9_ASCAN_GITHUB
	string "GitHub"

config PK_GUN_GCC_V9_ASCAN_SRCFILE
	default "main.c Makefile"
	string "Source code list"

config PK_GUN_GCC_V9_ASCAN_CSRCFILE
	string "Compile source code list"

config PK_GUN_GCC_V9_ASCAN_CONFIG
	default "--enable-checking=release --enable-languages=c,c++ --disable-multilib"
	string "CONFIG: Project Configure Options"

config PK_GUN_GCC_V9_ASCAN_LIBPATH
	string "LIBS: Libraries to pass to the linker, e.g. -l<library>"

config PK_GUN_GCC_V9_ASCAN_CPPFLAGS
	string "CPPFLAGS: C/C++ preprocessor flags, e.g. -I<include dir>"

config PK_GUN_GCC_V9_ASCAN_DPKCONFIG
	string "PKG_CONFIG_PATH: Directories to add to pkg-config's search path"

config PK_GUN_GCC_V9_ASCAN_CFLAGS
	string "CFLAGS: C compiler flags"

config PK_GUN_GCC_V9_ASCAN_LDFLAGS
	string "LDFLAGS: Linker flags"

config PK_GUN_GCC_V9_ASCAN_CXXFLAGS
	string "CXXFLAGS: C++ compiler flags"

config PK_GUN_GCC_V9_ASCAN_ASFLAGS
	string "CCASFLAGS: assembler compiler flags (defaults to CFLAGS)"

config PK_GUN_GCC_V9_ASCAN_BUILDARCH
	string "--host options on configure for Architecture"

endif # PK_GUN_GCC_V9_ASCAN
```

## package/GUN-GCC/BiscuitOS-GUN-GCC-V9/Kconfig
```kconfig
menuconfig PK_GUN_GCC_V9
	bool "GUN GCC V9.X Build on BiscuitOS"

if PK_GUN_GCC_V9

config PK_GUN_GCC_V9_VERSION
	default "9.2.0"
	string "verstion"

config PK_GUN_GCC_V9_TAR
	default "tar.xz"
	string "tar type"

config PK_GUN_GCC_V9_URL
	default "http://ftp.gnu.org/gnu/gcc"
	string "url"

config PK_GUN_GCC_V9_GITHUB
	string "GitHub"

config PK_GUN_GCC_V9_SRCFILE
	default "main.c Makefile"
	string "Source code list"

config PK_GUN_GCC_V9_CSRCFILE
	string "Compile source code list"

config PK_GUN_GCC_V9_CONFIG
	string "CONFIG: Project Configure Options"

config PK_GUN_GCC_V9_LIBPATH
	string "LIBS: Libraries to pass to the linker, e.g. -l<library>"

config PK_GUN_GCC_V9_CPPFLAGS
	string "CPPFLAGS: C/C++ preprocessor flags, e.g. -I<include dir>"

config PK_GUN_GCC_V9_DPKCONFIG
	string "PKG_CONFIG_PATH: Directories to add to pkg-config's search path"

config PK_GUN_GCC_V9_CFLAGS
	string "CFLAGS: C compiler flags"

config PK_GUN_GCC_V9_LDFLAGS
	string "LDFLAGS: Linker flags"

config PK_GUN_GCC_V9_CXXFLAGS
	string "CXXFLAGS: C++ compiler flags"

config PK_GUN_GCC_V9_ASFLAGS
	string "CCASFLAGS: assembler compiler flags (defaults to CFLAGS)"

config PK_GUN_GCC_V9_BUILDARCH
	string "--host options on configure for Architecture"

endif # PK_GUN_GCC_V9
```

## package/GUN-GCC/Kconfig
```kconfig
menuconfig PK_GUN_GCC
	bool "GUN GCC"

if PK_GUN_GCC

# GUN-GCC-V9
source package/GUN-GCC/BiscuitOS-GUN-GCC-V9/Kconfig

# GUN-GCC-V9-ASAN
source package/GUN-GCC/BiscuitOS-GUN-GCC-V9-ASAN/Kconfig

endif # PK_GUN_GCC
```

## package/HMM-MEMORY/BiscuitOS-CXL-DEVDAX/Kconfig
```kconfig
menuconfig PK_HMM_CXL_DEVDAX
	select PK_CXL_TOOLS
	select PK_NUMA
	select PK_NUMACTL_LIBNUMA 
	bool "CXL: CXL.mem AS DEVDAX"

if PK_HMM_CXL_DEVDAX

config PK_HMM_CXL_DEVDAX_VERSION
	default "default"
	string "verstion"

config PK_HMM_CXL_DEVDAX_TAR
	default "tar.gz"
	string "tar type"

config PK_HMM_CXL_DEVDAX_URL
	default "https://gitee.com/BiscuitOS_team/HardStack/raw/Gitee/Memory-Allocator/HMM-MECH/BiscuitOS-CXL-DEVDAX"
	string "url"

config PK_HMM_CXL_DEVDAX_GITHUB
	string "GitHub"

config PK_HMM_CXL_DEVDAX_SRCFILE
	default "main.c Makefile RunBiscuitOS.sh"
	string "Source code list"

config PK_HMM_CXL_DEVDAX_CSRCFILE
	string "Compile source code list"

config PK_HMM_CXL_DEVDAX_CONFIG
	string "CONFIG: Project Configure Options"

config PK_HMM_CXL_DEVDAX_LIBPATH
	string "LIBS: Libraries to pass to the linker, e.g. -l<library>"

config PK_HMM_CXL_DEVDAX_CPPFLAGS
	string "CPPFLAGS: C/C++ preprocessor flags, e.g. -I<include dir>"

config PK_HMM_CXL_DEVDAX_DPKCONFIG
	string "PKG_CONFIG_PATH: Directories to add to pkg-config's search path"

config PK_HMM_CXL_DEVDAX_CFLAGS
	string "CFLAGS: C compiler flags"

config PK_HMM_CXL_DEVDAX_LDFLAGS
	string "LDFLAGS: Linker flags"

config PK_HMM_CXL_DEVDAX_CXXFLAGS
	string "CXXFLAGS: C++ compiler flags"

config PK_HMM_CXL_DEVDAX_ASFLAGS
	string "CCASFLAGS: assembler compiler flags (defaults to CFLAGS)"

config PK_HMM_CXL_DEVDAX_BUILDARCH
	string "--host options on configure for Architecture"

endif # PK_HMM_CXL_DEVDAX
```
