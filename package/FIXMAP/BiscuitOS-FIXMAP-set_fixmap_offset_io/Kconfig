## package/HMM-MEMORY/BiscuitOS-CXL-FSDAX/Kconfig
```kconfig
menuconfig PK_HMM_CXL_FSDAX
	select PK_CXL_TOOLS
	select PK_NUMA
	select PK_NUMACTL_LIBNUMA 
	select PK_E2FSPROGS
	select PK_PCI
	select PK_PCIUTILS
	bool "CXL: CXL.mem AS FSDAX"

if PK_HMM_CXL_FSDAX

config PK_HMM_CXL_FSDAX_VERSION
	default "default"
	string "verstion"

config PK_HMM_CXL_FSDAX_TAR
	default "tar.gz"
	string "tar type"

config PK_HMM_CXL_FSDAX_URL
	default "https://gitee.com/BiscuitOS_team/HardStack/raw/Gitee/Memory-Allocator/HMM-MECH/BiscuitOS-CXL-FSDAX"
	string "url"

config PK_HMM_CXL_FSDAX_GITHUB
	string "GitHub"

config PK_HMM_CXL_FSDAX_SRCFILE
	default "main.c Makefile RunBiscuitOS.sh"
	string "Source code list"

config PK_HMM_CXL_FSDAX_CSRCFILE
	string "Compile source code list"

config PK_HMM_CXL_FSDAX_CONFIG
	string "CONFIG: Project Configure Options"

config PK_HMM_CXL_FSDAX_LIBPATH
	string "LIBS: Libraries to pass to the linker, e.g. -l<library>"

config PK_HMM_CXL_FSDAX_CPPFLAGS
	string "CPPFLAGS: C/C++ preprocessor flags, e.g. -I<include dir>"

config PK_HMM_CXL_FSDAX_DPKCONFIG
	string "PKG_CONFIG_PATH: Directories to add to pkg-config's search path"

config PK_HMM_CXL_FSDAX_CFLAGS
	string "CFLAGS: C compiler flags"

config PK_HMM_CXL_FSDAX_LDFLAGS
	string "LDFLAGS: Linker flags"

config PK_HMM_CXL_FSDAX_CXXFLAGS
	string "CXXFLAGS: C++ compiler flags"

config PK_HMM_CXL_FSDAX_ASFLAGS
	string "CCASFLAGS: assembler compiler flags (defaults to CFLAGS)"

config PK_HMM_CXL_FSDAX_BUILDARCH
	string "--host options on configure for Architecture"

endif # PK_HMM_CXL_FSDAX
```

## package/HMM-MEMORY/BiscuitOS-CXL-MHMLD/Kconfig
```kconfig
menuconfig PK_HMM_CXL_MHMLD
	select PK_CXL_TOOLS
	select PK_NUMA
	select PK_NUMACTL_LIBNUMA 
	select PK_PCI
	select PK_PCIUTILS
	bool "CXL MH-MLD: Multi Headers MLD"

if PK_HMM_CXL_MHMLD

config PK_HMM_CXL_MHMLD_VERSION
	default "default"
	string "verstion"

config PK_HMM_CXL_MHMLD_TAR
	default "tar.gz"
	string "tar type"

config PK_HMM_CXL_MHMLD_URL
	default "https://gitee.com/BiscuitOS_team/HardStack/raw/Gitee/Memory-Allocator/HMM-MECH/BiscuitOS-CXL-MHMLD"
	string "url"

config PK_HMM_CXL_MHMLD_GITHUB
	string "GitHub"

config PK_HMM_CXL_MHMLD_SRCFILE
	default "main.c Makefile RunBiscuitOS.sh"
	string "Source code list"

config PK_HMM_CXL_MHMLD_CSRCFILE
	string "Compile source code list"

config PK_HMM_CXL_MHMLD_CONFIG
	string "CONFIG: Project Configure Options"

config PK_HMM_CXL_MHMLD_LIBPATH
	string "LIBS: Libraries to pass to the linker, e.g. -l<library>"

config PK_HMM_CXL_MHMLD_CPPFLAGS
	string "CPPFLAGS: C/C++ preprocessor flags, e.g. -I<include dir>"

config PK_HMM_CXL_MHMLD_DPKCONFIG
	string "PKG_CONFIG_PATH: Directories to add to pkg-config's search path"

config PK_HMM_CXL_MHMLD_CFLAGS
	string "CFLAGS: C compiler flags"

config PK_HMM_CXL_MHMLD_LDFLAGS
	string "LDFLAGS: Linker flags"

config PK_HMM_CXL_MHMLD_CXXFLAGS
	string "CXXFLAGS: C++ compiler flags"

config PK_HMM_CXL_MHMLD_ASFLAGS
	string "CCASFLAGS: assembler compiler flags (defaults to CFLAGS)"

config PK_HMM_CXL_MHMLD_BUILDARCH
	string "--host options on configure for Architecture"

endif # PK_HMM_CXL_MHMLD
```

## package/HMM-MEMORY/BiscuitOS-CXL-MHSLD/Kconfig
```kconfig
menuconfig PK_HMM_CXL_MHSLD
	select PK_CXL_TOOLS
	select PK_NUMA
	select PK_NUMACTL_LIBNUMA 
	select PK_PCI
	select PK_PCIUTILS
	bool "CXL MH-SLD: Multi Headers SLD"

if PK_HMM_CXL_MHSLD

config PK_HMM_CXL_MHSLD_VERSION
	default "default"
	string "verstion"

config PK_HMM_CXL_MHSLD_TAR
	default "tar.gz"
	string "tar type"

config PK_HMM_CXL_MHSLD_URL
	default "https://gitee.com/BiscuitOS_team/HardStack/raw/Gitee/Memory-Allocator/HMM-MECH/BiscuitOS-CXL-MHSLD"
	string "url"

config PK_HMM_CXL_MHSLD_GITHUB
	string "GitHub"

config PK_HMM_CXL_MHSLD_SRCFILE
	default "main.c Makefile RunBiscuitOS.sh"
	string "Source code list"

config PK_HMM_CXL_MHSLD_CSRCFILE
	string "Compile source code list"

config PK_HMM_CXL_MHSLD_CONFIG
	string "CONFIG: Project Configure Options"

config PK_HMM_CXL_MHSLD_LIBPATH
	string "LIBS: Libraries to pass to the linker, e.g. -l<library>"

config PK_HMM_CXL_MHSLD_CPPFLAGS
	string "CPPFLAGS: C/C++ preprocessor flags, e.g. -I<include dir>"

config PK_HMM_CXL_MHSLD_DPKCONFIG
	string "PKG_CONFIG_PATH: Directories to add to pkg-config's search path"

config PK_HMM_CXL_MHSLD_CFLAGS
	string "CFLAGS: C compiler flags"

config PK_HMM_CXL_MHSLD_LDFLAGS
	string "LDFLAGS: Linker flags"

config PK_HMM_CXL_MHSLD_CXXFLAGS
	string "CXXFLAGS: C++ compiler flags"

config PK_HMM_CXL_MHSLD_ASFLAGS
	string "CCASFLAGS: assembler compiler flags (defaults to CFLAGS)"

config PK_HMM_CXL_MHSLD_BUILDARCH
	string "--host options on configure for Architecture"

endif # PK_HMM_CXL_MHSLD
```

## package/HMM-MEMORY/BiscuitOS-CXL-MLD/Kconfig
```kconfig
menuconfig PK_HMM_CXL_MLD
	select PK_CXL_TOOLS
	select PK_NUMA
	select PK_NUMACTL_LIBNUMA 
	select PK_PCI
	select PK_PCIUTILS
	bool "CXL MLD: Multi Logical Device"

if PK_HMM_CXL_MLD

config PK_HMM_CXL_MLD_VERSION
	default "default"
	string "verstion"

config PK_HMM_CXL_MLD_TAR
	default "tar.gz"
	string "tar type"

config PK_HMM_CXL_MLD_URL
	default "https://gitee.com/BiscuitOS_team/HardStack/raw/Gitee/Memory-Allocator/HMM-MECH/BiscuitOS-CXL-MLD"
	string "url"

config PK_HMM_CXL_MLD_GITHUB
	string "GitHub"

config PK_HMM_CXL_MLD_SRCFILE
	default "main.c Makefile RunBiscuitOS.sh"
	string "Source code list"

config PK_HMM_CXL_MLD_CSRCFILE
	string "Compile source code list"

config PK_HMM_CXL_MLD_CONFIG
	string "CONFIG: Project Configure Options"

config PK_HMM_CXL_MLD_LIBPATH
	string "LIBS: Libraries to pass to the linker, e.g. -l<library>"

config PK_HMM_CXL_MLD_CPPFLAGS
	string "CPPFLAGS: C/C++ preprocessor flags, e.g. -I<include dir>"

config PK_HMM_CXL_MLD_DPKCONFIG
	string "PKG_CONFIG_PATH: Directories to add to pkg-config's search path"

config PK_HMM_CXL_MLD_CFLAGS
	string "CFLAGS: C compiler flags"

config PK_HMM_CXL_MLD_LDFLAGS
	string "LDFLAGS: Linker flags"

config PK_HMM_CXL_MLD_CXXFLAGS
	string "CXXFLAGS: C++ compiler flags"

config PK_HMM_CXL_MLD_ASFLAGS
	string "CCASFLAGS: assembler compiler flags (defaults to CFLAGS)"

config PK_HMM_CXL_MLD_BUILDARCH
	string "--host options on configure for Architecture"

endif # PK_HMM_CXL_MLD
```

## package/HMM-MEMORY/BiscuitOS-CXL-SHMEM-GPU/Kconfig
```kconfig
menuconfig PK_HMM_CXL_SHMEM_GPU
	select DIY_CPU_Q35
	select DIY_VIOMMU
	select PK_CXL_TOOLS
	select PK_NUMA
	select PK_NUMACTL_LIBNUMA 
	select PK_PCI
	select PK_PCIUTILS
	bool "CXL SHMEM: GPU(VFIO)"

if PK_HMM_CXL_SHMEM_GPU

config PK_HMM_CXL_SHMEM_GPU_VERSION
	default "default"
	string "verstion"

config PK_HMM_CXL_SHMEM_GPU_TAR
	default "tar.gz"
	string "tar type"

config PK_HMM_CXL_SHMEM_GPU_URL
	default "https://gitee.com/BiscuitOS_team/HardStack/raw/Gitee/Memory-Allocator/HMM-MECH/BiscuitOS-CXL-SHMEM-GPU"
	string "url"

config PK_HMM_CXL_SHMEM_GPU_GITHUB
	string "GitHub"

config PK_HMM_CXL_SHMEM_GPU_SRCFILE
	default "main.c Makefile RunBiscuitOS.sh"
	string "Source code list"

config PK_HMM_CXL_SHMEM_GPU_CSRCFILE
	string "Compile source code list"

config PK_HMM_CXL_SHMEM_GPU_CONFIG
	string "CONFIG: Project Configure Options"

config PK_HMM_CXL_SHMEM_GPU_LIBPATH
	string "LIBS: Libraries to pass to the linker, e.g. -l<library>"

config PK_HMM_CXL_SHMEM_GPU_CPPFLAGS
	string "CPPFLAGS: C/C++ preprocessor flags, e.g. -I<include dir>"

config PK_HMM_CXL_SHMEM_GPU_DPKCONFIG
	string "PKG_CONFIG_PATH: Directories to add to pkg-config's search path"

config PK_HMM_CXL_SHMEM_GPU_CFLAGS
	string "CFLAGS: C compiler flags"

config PK_HMM_CXL_SHMEM_GPU_LDFLAGS
	string "LDFLAGS: Linker flags"

config PK_HMM_CXL_SHMEM_GPU_CXXFLAGS
	string "CXXFLAGS: C++ compiler flags"

config PK_HMM_CXL_SHMEM_GPU_ASFLAGS
	string "CCASFLAGS: assembler compiler flags (defaults to CFLAGS)"

config PK_HMM_CXL_SHMEM_GPU_BUILDARCH
	string "--host options on configure for Architecture"

endif # PK_HMM_CXL_SHMEM_GPU
```

## package/HMM-MEMORY/BiscuitOS-CXL-SLD/Kconfig
```kconfig
menuconfig PK_HMM_CXL_SLD
	select PK_CXL_TOOLS
	select PK_NUMA
	select PK_NUMACTL_LIBNUMA 
	select PK_PCI
	select PK_PCIUTILS
	bool "CXL SLD: Single Logical Device"

if PK_HMM_CXL_SLD

config PK_HMM_CXL_SLD_VERSION
	default "default"
	string "verstion"

config PK_HMM_CXL_SLD_TAR
	default "tar.gz"
	string "tar type"

config PK_HMM_CXL_SLD_URL
	default "https://gitee.com/BiscuitOS_team/HardStack/raw/Gitee/Memory-Allocator/HMM-MECH/BiscuitOS-CXL-SLD"
	string "url"

config PK_HMM_CXL_SLD_GITHUB
	string "GitHub"

config PK_HMM_CXL_SLD_SRCFILE
	default "main.c Makefile RunBiscuitOS.sh"
	string "Source code list"

config PK_HMM_CXL_SLD_CSRCFILE
	string "Compile source code list"

config PK_HMM_CXL_SLD_CONFIG
	string "CONFIG: Project Configure Options"

config PK_HMM_CXL_SLD_LIBPATH
	string "LIBS: Libraries to pass to the linker, e.g. -l<library>"

config PK_HMM_CXL_SLD_CPPFLAGS
	string "CPPFLAGS: C/C++ preprocessor flags, e.g. -I<include dir>"

config PK_HMM_CXL_SLD_DPKCONFIG
	string "PKG_CONFIG_PATH: Directories to add to pkg-config's search path"

config PK_HMM_CXL_SLD_CFLAGS
	string "CFLAGS: C compiler flags"

config PK_HMM_CXL_SLD_LDFLAGS
	string "LDFLAGS: Linker flags"

config PK_HMM_CXL_SLD_CXXFLAGS
	string "CXXFLAGS: C++ compiler flags"

config PK_HMM_CXL_SLD_ASFLAGS
	string "CCASFLAGS: assembler compiler flags (defaults to CFLAGS)"

config PK_HMM_CXL_SLD_BUILDARCH
	string "--host options on configure for Architecture"

endif # PK_HMM_CXL_SLD
```

## package/HMM-MEMORY/BiscuitOS-TIERED-MEMORY/Kconfig
```kconfig
menuconfig PK_HMM_TIERED_MEMORY
	select DIY_CPU_Q35
	select SUPPORT_DIY
	select PK_CXL_TOOLS
	select PK_NUMA
	select PK_NUMACTL_LIBNUMA 
	select PK_PCI
	select PK_PCIUTILS
	bool "TIERED MEMORY"

if PK_HMM_TIERED_MEMORY

config PK_HMM_TIERED_MEMORY_VERSION
	default "default"
	string "verstion"

config PK_HMM_TIERED_MEMORY_TAR
	default "tar.gz"
	string "tar type"

config PK_HMM_TIERED_MEMORY_URL
	default "https://gitee.com/BiscuitOS_team/HardStack/raw/Gitee/Memory-Allocator/HMM-MECH/BiscuitOS-TIERED-MEMORY"
	string "url"

config PK_HMM_TIERED_MEMORY_GITHUB
	string "GitHub"

config PK_HMM_TIERED_MEMORY_SRCFILE
	default "main.c Makefile RunBiscuitOS.sh"
	string "Source code list"

config PK_HMM_TIERED_MEMORY_CSRCFILE
	string "Compile source code list"

config PK_HMM_TIERED_MEMORY_CONFIG
	string "CONFIG: Project Configure Options"

config PK_HMM_TIERED_MEMORY_LIBPATH
	string "LIBS: Libraries to pass to the linker, e.g. -l<library>"

config PK_HMM_TIERED_MEMORY_CPPFLAGS
	string "CPPFLAGS: C/C++ preprocessor flags, e.g. -I<include dir>"

config PK_HMM_TIERED_MEMORY_DPKCONFIG
	string "PKG_CONFIG_PATH: Directories to add to pkg-config's search path"

config PK_HMM_TIERED_MEMORY_CFLAGS
	string "CFLAGS: C compiler flags"

config PK_HMM_TIERED_MEMORY_LDFLAGS
	string "LDFLAGS: Linker flags"

config PK_HMM_TIERED_MEMORY_CXXFLAGS
	string "CXXFLAGS: C++ compiler flags"

config PK_HMM_TIERED_MEMORY_ASFLAGS
	string "CCASFLAGS: assembler compiler flags (defaults to CFLAGS)"

config PK_HMM_TIERED_MEMORY_BUILDARCH
	string "--host options on configure for Architecture"

endif # PK_HMM_TIERED_MEMORY
```

## package/HMM-MEMORY/Kconfig
```kconfig
menuconfig PK_HMM
	bool "HETEROGENEOUS MEMORY MANAGEMENT"

if PK_HMM

# CXL
# CXL.mem SYSTEM-RAM
source package/HMM-MEMORY/BiscuitOS-CXL-MEMORY/Kconfig

# CXL.mem DEVDAX
source package/HMM-MEMORY/BiscuitOS-CXL-DEVDAX/Kconfig

# CXL.mem FSDAX
source package/HMM-MEMORY/BiscuitOS-CXL-FSDAX/Kconfig

# CXL SLD
source package/HMM-MEMORY/BiscuitOS-CXL-SLD/Kconfig

# CXL MLD
source package/HMM-MEMORY/BiscuitOS-CXL-MLD/Kconfig

# CXL MH-SLD
source package/HMM-MEMORY/BiscuitOS-CXL-MHSLD/Kconfig

# CXL MH-MLD
source package/HMM-MEMORY/BiscuitOS-CXL-MHMLD/Kconfig

# CXL GPU
source package/HMM-MEMORY/BiscuitOS-CXL-GPU/Kconfig

# CXL SHMEM: GPU
source package/HMM-MEMORY/BiscuitOS-CXL-SHMEM-GPU/Kconfig

# CXL TIERED MEMORY
source package/HMM-MEMORY/BiscuitOS-CXL-TIERED-MEMORY/Kconfig

# TIERED MEMORY
source package/HMM-MEMORY/BiscuitOS-TIERED-MEMORY/Kconfig

endif # PK_HMM
```

## package/IO/Async/Kconfig
```kconfig
menuconfig PK_IO_ASYNC
	bool "Asynchronous"

if PK_IO_ASYNC

# select_socket
source "package/IO/Async/select_socket/Kconfig"

endif # PK_IO_ASYNC
```

## package/IO/Async/select_socket/Kconfig
```kconfig
menuconfig PK_SELECT_SOCKET
	bool "select on socket"

if PK_SELECT_SOCKET

config PK_SELECT_SOCKET_VERSION
	default "0.0.1"
	string "verstion"

config PK_SELECT_SOCKET_TAR
	default "tar.gz"
	string "tar type"

config PK_SELECT_SOCKET_URL
	default "https://gitee.com/BiscuitOS_team/HardStack/raw/Gitee/IO/AsyncBlock/select_common"
	string "url"

config PK_SELECT_SOCKET_GITHUB
	string "GitHub"

config PK_SELECT_SOCKET_SRCFILE
	default "client.c service.c Makefile"
	string "Source code list"

config PK_SELECT_SOCKET_CSRCFILE
	string "Compile source code list"

config PK_SELECT_SOCKET_CONFIG
	string "CONFIG: Project Configure Options"

config PK_SELECT_SOCKET_LIBPATH
	string "LIBS: Libraries to pass to the linker, e.g. -l<library>"

config PK_SELECT_SOCKET_CPPFLAGS
	string "CPPFLAGS: C/C++ preprocessor flags, e.g. -I<include dir>"

config PK_SELECT_SOCKET_DPKCONFIG
	string "PKG_CONFIG_PATH: Directories to add to pkg-config's search path"

config PK_SELECT_SOCKET_CFLAGS
	string "CFLAGS: C compiler flags"

config PK_SELECT_SOCKET_LDFLAGS
	string "LDFLAGS: Linker flags"

config PK_SELECT_SOCKET_CXXFLAGS
	string "CXXFLAGS: C++ compiler flags"

config PK_SELECT_SOCKET_ASFLAGS
	string "CCASFLAGS: assembler compiler flags (defaults to CFLAGS)"

config PK_SELECT_SOCKET_BUILDARCH
	string "--host options on configure for Architecture"

endif # PK_SELECT_SOCKET
```

## package/IO/BiscuitOS-epoll/Kconfig
```kconfig
menuconfig PK_IO_BISCUITOS_EPOLL
	bool "Epoll mechanism on BiscuitOS"

if PK_IO_BISCUITOS_EPOLL

config PK_IO_BISCUITOS_EPOLL_VERSION
	default "default"
	string "verstion"

config PK_IO_BISCUITOS_EPOLL_TAR
	default "tar.gz"
	string "tar type"

config PK_IO_BISCUITOS_EPOLL_URL
	default "https://gitee.com/BiscuitOS_team/HardStack/raw/Gitee/IO/AsyncBlock/BiscuitOS-epoll"
	string "url"

config PK_IO_BISCUITOS_EPOLL_GITHUB
	string "GitHub"

config PK_IO_BISCUITOS_EPOLL_SRCFILE
	default "epoll.c Kconfig Makefile module.c RunBiscuitOS.sh"
	string "Source code list"

config PK_IO_BISCUITOS_EPOLL_CSRCFILE
	string "Compile source code list"

config PK_IO_BISCUITOS_EPOLL_CONFIG
	string "CONFIG: Project Configure Options"

config PK_IO_BISCUITOS_EPOLL_LIBPATH
	string "LIBS: Libraries to pass to the linker, e.g. -l<library>"

config PK_IO_BISCUITOS_EPOLL_CPPFLAGS
	string "CPPFLAGS: C/C++ preprocessor flags, e.g. -I<include dir>"

config PK_IO_BISCUITOS_EPOLL_DPKCONFIG
	string "PKG_CONFIG_PATH: Directories to add to pkg-config's search path"

config PK_IO_BISCUITOS_EPOLL_CFLAGS
	string "CFLAGS: C compiler flags"

config PK_IO_BISCUITOS_EPOLL_LDFLAGS
	string "LDFLAGS: Linker flags"

config PK_IO_BISCUITOS_EPOLL_CXXFLAGS
	string "CXXFLAGS: C++ compiler flags"

config PK_IO_BISCUITOS_EPOLL_ASFLAGS
	string "CCASFLAGS: assembler compiler flags (defaults to CFLAGS)"

config PK_IO_BISCUITOS_EPOLL_BUILDARCH
	string "--host options on configure for Architecture"

endif # PK_IO_BISCUITOS_EPOLL
```
