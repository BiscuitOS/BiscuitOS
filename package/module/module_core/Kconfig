## package/module/module_core/Kconfig
```kconfig
menuconfig PK_CORE_MOD
	bool "Basic Device Driver Module"

if PK_CORE_MOD

config PK_CORE_MOD_VERSION
	default "0.0.1"
	string "verstion"

config PK_CORE_MOD_TAR
	default "tar.gz"
	string "tar type"

config PK_CORE_MOD_URL
	default "https://gitee.com/BiscuitOS_team/HardStack/raw/Gitee/Device-Driver/base/core"
	string "url"

config PK_CORE_MOD_GITHUB
	string "GitHub"

config PK_CORE_MOD_SRCFILE
	default "core.c Kconfig Makefile"
	string "Source code list"

config PK_CORE_MOD_CSRCFILE
	string "Compile source code list"

config PK_CORE_MOD_CONFIG
	string "CONFIG: Project Configure Options"

config PK_CORE_MOD_LIBPATH
	string "LIBS: Libraries to pass to the linker, e.g. -l<library>"

config PK_CORE_MOD_CPPFLAGS
	string "CPPFLAGS: C/C++ preprocessor flags, e.g. -I<include dir>"

config PK_CORE_MOD_DPKCONFIG
	string "PKG_CONFIG_PATH: Directories to add to pkg-config's search path"

config PK_CORE_MOD_CFLAGS
	string "CFLAGS: C compiler flags"

config PK_CORE_MOD_LDFLAGS
	string "LDFLAGS: Linker flags"

config PK_CORE_MOD_CXXFLAGS
	string "CXXFLAGS: C++ compiler flags"

config PK_CORE_MOD_ASFLAGS
	string "CCASFLAGS: assembler compiler flags (defaults to CFLAGS)"

config PK_CORE_MOD_BUILDARCH
	string "--host options on configure for Architecture"

endif # PK_CORE_MOD
```

## package/ncurses/Kconfig
```kconfig
menuconfig PK_NCURSES
	bool "ncurses"

if PK_NCURSES

config PK_NCURSES_VERSION
	default "6.1"
	string "verstion"

config PK_NCURSES_TAR
	default "tar.gz"
	string "tar type"

config PK_NCURSES_URL
	default "http://ftp.gnu.org/pub/gnu/ncurses/"
	string "url"

config PK_NCURSES_GITHUB
	string "GitHub"

config PK_NCURSES_SRCFILE
	string "Source code list"

config PK_NCURSES_CONFIG
	default "--enable-silent-rules --disable-static --with-shared --disable-stripping"
	string "CONFIG: Project Configure Options"

config PK_NCURSES_LIBPATH
	string "LIBS: Libraries to pass to the linker, e.g. -l<library>"

config PK_NCURSES_CPPFLAGS
	string "CPPFLAGS: C/C++ preprocessor flags, e.g. -I<include dir>"

config PK_NCURSES_DPKCONFIG
	string "PKG_CONFIG_PATH: Directories to add to pkg-config's search path"

config PK_NCURSES_CFLAGS
	string "CFLAGS: C compiler flags"

config PK_NCURSES_LDFLAGS
	string "LDFLAGS: Linker flags"

config PK_NCURSES_CXXFLAGS
	string "CXXFLAGS: C++ compiler flags"

config PK_NCURSES_ASFLAGS
	string "CCASFLAGS: assembler compiler flags (defaults to CFLAGS)"

config PK_NCURSES_BUILDARCH
	default "x86_64-unknown-linux-gnu"
	string "--host options on configure for Architecture"

endif # PK_NCURSES
```

## package/ndctl/Kconfig
```kconfig
menuconfig PK_NDCTL
	bool "ndctl: LIBNVDIMM TOOLS"

if PK_NDCTL

config PK_NDCTL_VERSION
	default "default"
	string "verstion"

config PK_NDCTL_TAR
	default "tar.gz"
	string "tar type"

config PK_NDCTL_URL
	string "url"

config PK_NDCTL_GITHUB
	string "GitHub"

config PK_NDCTL_SRCFILE
	string "Source code list"

config PK_NDCTL_CONFIG
	default "--enable-silent-rules --disable-static"
	string "CONFIG: Project Configure Options"

config PK_NDCTL_LIBPATH
	string "LIBS: Libraries to pass to the linker, e.g. -l<library>"

config PK_NDCTL_CPPFLAGS
	string "CPPFLAGS: C/C++ preprocessor flags, e.g. -I<include dir>"

config PK_NDCTL_DPKCONFIG
	string "PKG_CONFIG_PATH: Directories to add to pkg-config's search path"

config PK_NDCTL_CFLAGS
	string "CFLAGS: C compiler flags"

config PK_NDCTL_LDFLAGS
	string "LDFLAGS: Linker flags"

config PK_NDCTL_CXXFLAGS
	string "CXXFLAGS: C++ compiler flags"

config PK_NDCTL_ASFLAGS
	string "CCASFLAGS: assembler compiler flags (defaults to CFLAGS)"

config PK_NDCTL_BUILDARCH
	default "x86_64-unknown-linux-gnu"
	string "--host options on configure for Architecture"

endif # PK_NDCTL
```

## package/nettle/Kconfig
```kconfig
menuconfig PK_NETTLE
	bool "nettle"
	select PK_GMP

if PK_NETTLE

config PK_NETTLE_VERSION
	default "3.4"
	string "verstion"

config PK_NETTLE_TAR
	default "tar.gz"
	string "tar type"

config PK_NETTLE_URL
	default "https://ftp.gnu.org/gnu/nettle"
	string "url"

config PK_NETTLE_GITHUB
	string "GitHub"

config PK_NETTLE_SRCFILE
	string "Source code list"

config PK_NETTLE_CONFIG
	default "--disable-openssl --enable-shared"
	string "CONFIG: Project Configure Options"

config PK_NETTLE_LIBPATH
	string "LIBS: Libraries to pass to the linker, e.g. -l<library>"

config PK_NETTLE_CPPFLAGS
	string "CPPFLAGS: C/C++ preprocessor flags, e.g. -I<include dir>"

config PK_NETTLE_DPKCONFIG
	string "PKG_CONFIG_PATH: Directories to add to pkg-config's search path"

config PK_NETTLE_CFLAGS
	string "CFLAGS: C compiler flags"

config PK_NETTLE_LDFLAGS
	string "LDFLAGS: Linker flags"

config PK_NETTLE_CXXFLAGS
	string "CXXFLAGS: C++ compiler flags"

config PK_NETTLE_ASFLAGS
	string "CCASFLAGS: assembler compiler flags (defaults to CFLAGS)"

config PK_NETTLE_BUILDARCH
	default "x86_64-unknown-linux-gnu"
	string "--host options on configure for Architecture"

endif # PK_NETTLE
```

## package/nodemask/Kconfig
```kconfig
menuconfig PK_NODEMASK
	bool "nodemask"

if PK_NODEMASK

# first_node
source package/nodemask/first_node/Kconfig

# first_unset_node
source package/nodemask/first_unset_node/Kconfig

# for_each_node_mask
source package/nodemask/for_each_node_mask/Kconfig

# for_each_node_state
source package/nodemask/for_each_node_state/Kconfig

# init_nodemask_of_node
source package/nodemask/init_nodemask_of_node/Kconfig

# next_memory_node
source package/nodemask/next_memory_node/Kconfig

# next_node
source package/nodemask/next_node/Kconfig

# next_node_in
source package/nodemask/next_node_in/Kconfig

# next_online_node
source package/nodemask/next_online_node/Kconfig

# node_clear
source package/nodemask/node_clear/Kconfig

# node_clear_state
source package/nodemask/node_clear_state/Kconfig

# node_isset
source package/nodemask/node_isset/Kconfig

# node_online
source package/nodemask/node_online/Kconfig

# node_possible
source package/nodemask/node_possible/Kconfig

# node_set
source package/nodemask/node_set/Kconfig

# node_set_offline
source package/nodemask/node_set_offline/Kconfig

# node_set_online
source package/nodemask/node_set_online/Kconfig

# node_set_state
source package/nodemask/node_set_state/Kconfig

# node_state
source package/nodemask/node_state/Kconfig

# node_test_and_set
source package/nodemask/node_test_and_set/Kconfig

# nodes_and
source package/nodemask/nodes_and/Kconfig

# nodes_andnot
source package/nodemask/nodes_andnot/Kconfig

# nodes_clear
source package/nodemask/nodes_clear/Kconfig

# nodes_complement
source package/nodemask/nodes_complement/Kconfig

# nodes_empty
source package/nodemask/nodes_empty/Kconfig

# nodes_equal
source package/nodemask/nodes_equal/Kconfig

# nodes_full
source package/nodemask/nodes_full/Kconfig

# nodes_intersects
source package/nodemask/nodes_intersects/Kconfig

# nodes_or
source package/nodemask/nodes_or/Kconfig

# nodes_setall
source package/nodemask/nodes_setall/Kconfig

# nodes_shift_left
source package/nodemask/nodes_shift_left/Kconfig

# nodes_shift_right
source package/nodemask/nodes_shift_right/Kconfig

# nodes_subset
source package/nodemask/nodes_subset/Kconfig

# nodes_weight
source package/nodemask/nodes_weight/Kconfig

# nodes_xor
source package/nodemask/nodes_xor/Kconfig

# num_node_state
source package/nodemask/num_node_state/Kconfig

# num_online_nodes
source package/nodemask/num_online_nodes/Kconfig

# num_possible_nodes
source package/nodemask/num_possible_nodes/Kconfig

endif # PK_NODEMASK
```

## package/nodemask/for_each_node_mask/Kconfig
```kconfig
menuconfig PK_FOR_EACH_NODE_MASK
	bool "for_each_node_mask"

if PK_FOR_EACH_NODE_MASK

config PK_FOR_EACH_NODE_MASK_VERSION
	default "default"
	string "verstion"

config PK_FOR_EACH_NODE_MASK_TAR
	default "tar.gz"
	string "tar type"

config PK_FOR_EACH_NODE_MASK_URL
	default "https://gitee.com/BiscuitOS_team/HardStack/raw/Gitee/Algorithem/nodemask/for_each_node_mask"
	string "url"

config PK_FOR_EACH_NODE_MASK_GITHUB
	string "GitHub"

config PK_FOR_EACH_NODE_MASK_SRCFILE
	default "main.c Kconfig Makefile"
	string "Source code list"

config PK_FOR_EACH_NODE_MASK_CSRCFILE
	string "Compile source code list"

config PK_FOR_EACH_NODE_MASK_CONFIG
	string "CONFIG: Project Configure Options"

config PK_FOR_EACH_NODE_MASK_LIBPATH
	string "LIBS: Libraries to pass to the linker, e.g. -l<library>"

config PK_FOR_EACH_NODE_MASK_CPPFLAGS
	string "CPPFLAGS: C/C++ preprocessor flags, e.g. -I<include dir>"

config PK_FOR_EACH_NODE_MASK_DPKCONFIG
	string "PKG_CONFIG_PATH: Directories to add to pkg-config's search path"

config PK_FOR_EACH_NODE_MASK_CFLAGS
	string "CFLAGS: C compiler flags"

config PK_FOR_EACH_NODE_MASK_LDFLAGS
	string "LDFLAGS: Linker flags"

config PK_FOR_EACH_NODE_MASK_CXXFLAGS
	string "CXXFLAGS: C++ compiler flags"

config PK_FOR_EACH_NODE_MASK_ASFLAGS
	string "CCASFLAGS: assembler compiler flags (defaults to CFLAGS)"

config PK_FOR_EACH_NODE_MASK_BUILDARCH
	string "--host options on configure for Architecture"

endif # PK_FOR_EACH_NODE_MASK
```

## package/nodemask/init_nodemask_of_node/Kconfig
```kconfig
menuconfig PK_INIT_NODEMASK_OF_NODE
	bool "init_nodemask_of_node"

if PK_INIT_NODEMASK_OF_NODE

config PK_INIT_NODEMASK_OF_NODE_VERSION
	default "default"
	string "verstion"

config PK_INIT_NODEMASK_OF_NODE_TAR
	default "tar.gz"
	string "tar type"

config PK_INIT_NODEMASK_OF_NODE_URL
	default "https://gitee.com/BiscuitOS_team/HardStack/raw/Gitee/Algorithem/nodemask/init_nodemask_of_node"
	string "url"

config PK_INIT_NODEMASK_OF_NODE_GITHUB
	string "GitHub"

config PK_INIT_NODEMASK_OF_NODE_SRCFILE
	default "main.c Kconfig Makefile"
	string "Source code list"

config PK_INIT_NODEMASK_OF_NODE_CSRCFILE
	string "Compile source code list"

config PK_INIT_NODEMASK_OF_NODE_CONFIG
	string "CONFIG: Project Configure Options"

config PK_INIT_NODEMASK_OF_NODE_LIBPATH
	string "LIBS: Libraries to pass to the linker, e.g. -l<library>"

config PK_INIT_NODEMASK_OF_NODE_CPPFLAGS
	string "CPPFLAGS: C/C++ preprocessor flags, e.g. -I<include dir>"

config PK_INIT_NODEMASK_OF_NODE_DPKCONFIG
	string "PKG_CONFIG_PATH: Directories to add to pkg-config's search path"

config PK_INIT_NODEMASK_OF_NODE_CFLAGS
	string "CFLAGS: C compiler flags"

config PK_INIT_NODEMASK_OF_NODE_LDFLAGS
	string "LDFLAGS: Linker flags"

config PK_INIT_NODEMASK_OF_NODE_CXXFLAGS
	string "CXXFLAGS: C++ compiler flags"

config PK_INIT_NODEMASK_OF_NODE_ASFLAGS
	string "CCASFLAGS: assembler compiler flags (defaults to CFLAGS)"

config PK_INIT_NODEMASK_OF_NODE_BUILDARCH
	string "--host options on configure for Architecture"

endif # PK_INIT_NODEMASK_OF_NODE
```

## package/nodemask/next_memory_node/Kconfig
```kconfig
menuconfig PK_NEXT_MEMORY_NODE
	bool "next_memory_node"

if PK_NEXT_MEMORY_NODE

config PK_NEXT_MEMORY_NODE_VERSION
	default "default"
	string "verstion"

config PK_NEXT_MEMORY_NODE_TAR
	default "tar.gz"
	string "tar type"

config PK_NEXT_MEMORY_NODE_URL
	default "https://gitee.com/BiscuitOS_team/HardStack/raw/Gitee/Algorithem/nodemask/next_memory_node"
	string "url"

config PK_NEXT_MEMORY_NODE_GITHUB
	string "GitHub"

config PK_NEXT_MEMORY_NODE_SRCFILE
	default "main.c Kconfig Makefile"
	string "Source code list"

config PK_NEXT_MEMORY_NODE_CSRCFILE
	string "Compile source code list"

config PK_NEXT_MEMORY_NODE_CONFIG
	string "CONFIG: Project Configure Options"

config PK_NEXT_MEMORY_NODE_LIBPATH
	string "LIBS: Libraries to pass to the linker, e.g. -l<library>"

config PK_NEXT_MEMORY_NODE_CPPFLAGS
	string "CPPFLAGS: C/C++ preprocessor flags, e.g. -I<include dir>"

config PK_NEXT_MEMORY_NODE_DPKCONFIG
	string "PKG_CONFIG_PATH: Directories to add to pkg-config's search path"

config PK_NEXT_MEMORY_NODE_CFLAGS
	string "CFLAGS: C compiler flags"

config PK_NEXT_MEMORY_NODE_LDFLAGS
	string "LDFLAGS: Linker flags"

config PK_NEXT_MEMORY_NODE_CXXFLAGS
	string "CXXFLAGS: C++ compiler flags"

config PK_NEXT_MEMORY_NODE_ASFLAGS
	string "CCASFLAGS: assembler compiler flags (defaults to CFLAGS)"

config PK_NEXT_MEMORY_NODE_BUILDARCH
	string "--host options on configure for Architecture"

endif # PK_NEXT_MEMORY_NODE
```

## package/nodemask/next_node_in/Kconfig
```kconfig
menuconfig PK_NEXT_NODE_IN
	bool "next_node_in"

if PK_NEXT_NODE_IN

config PK_NEXT_NODE_IN_VERSION
	default "default"
	string "verstion"

config PK_NEXT_NODE_IN_TAR
	default "tar.gz"
	string "tar type"

config PK_NEXT_NODE_IN_URL
	default "https://gitee.com/BiscuitOS_team/HardStack/raw/Gitee/Algorithem/nodemask/next_node_in"
	string "url"

config PK_NEXT_NODE_IN_GITHUB
	string "GitHub"

config PK_NEXT_NODE_IN_SRCFILE
	default "main.c Kconfig Makefile"
	string "Source code list"

config PK_NEXT_NODE_IN_CSRCFILE
	string "Compile source code list"

config PK_NEXT_NODE_IN_CONFIG
	string "CONFIG: Project Configure Options"

config PK_NEXT_NODE_IN_LIBPATH
	string "LIBS: Libraries to pass to the linker, e.g. -l<library>"

config PK_NEXT_NODE_IN_CPPFLAGS
	string "CPPFLAGS: C/C++ preprocessor flags, e.g. -I<include dir>"

config PK_NEXT_NODE_IN_DPKCONFIG
	string "PKG_CONFIG_PATH: Directories to add to pkg-config's search path"

config PK_NEXT_NODE_IN_CFLAGS
	string "CFLAGS: C compiler flags"

config PK_NEXT_NODE_IN_LDFLAGS
	string "LDFLAGS: Linker flags"

config PK_NEXT_NODE_IN_CXXFLAGS
	string "CXXFLAGS: C++ compiler flags"

config PK_NEXT_NODE_IN_ASFLAGS
	string "CCASFLAGS: assembler compiler flags (defaults to CFLAGS)"

config PK_NEXT_NODE_IN_BUILDARCH
	string "--host options on configure for Architecture"

endif # PK_NEXT_NODE_IN
```

## package/nodemask/next_online_node/Kconfig
```kconfig
menuconfig PK_NEXT_ONLINE_NODE
	bool "next_online_node"

if PK_NEXT_ONLINE_NODE

config PK_NEXT_ONLINE_NODE_VERSION
	default "default"
	string "verstion"

config PK_NEXT_ONLINE_NODE_TAR
	default "tar.gz"
	string "tar type"

config PK_NEXT_ONLINE_NODE_URL
	default "https://gitee.com/BiscuitOS_team/HardStack/raw/Gitee/Algorithem/nodemask/next_online_node"
	string "url"

config PK_NEXT_ONLINE_NODE_GITHUB
	string "GitHub"

config PK_NEXT_ONLINE_NODE_SRCFILE
	default "main.c Kconfig Makefile"
	string "Source code list"

config PK_NEXT_ONLINE_NODE_CSRCFILE
	string "Compile source code list"

config PK_NEXT_ONLINE_NODE_CONFIG
	string "CONFIG: Project Configure Options"

config PK_NEXT_ONLINE_NODE_LIBPATH
	string "LIBS: Libraries to pass to the linker, e.g. -l<library>"

config PK_NEXT_ONLINE_NODE_CPPFLAGS
	string "CPPFLAGS: C/C++ preprocessor flags, e.g. -I<include dir>"

config PK_NEXT_ONLINE_NODE_DPKCONFIG
	string "PKG_CONFIG_PATH: Directories to add to pkg-config's search path"

config PK_NEXT_ONLINE_NODE_CFLAGS
	string "CFLAGS: C compiler flags"

config PK_NEXT_ONLINE_NODE_LDFLAGS
	string "LDFLAGS: Linker flags"

config PK_NEXT_ONLINE_NODE_CXXFLAGS
	string "CXXFLAGS: C++ compiler flags"

config PK_NEXT_ONLINE_NODE_ASFLAGS
	string "CCASFLAGS: assembler compiler flags (defaults to CFLAGS)"

config PK_NEXT_ONLINE_NODE_BUILDARCH
	string "--host options on configure for Architecture"

endif # PK_NEXT_ONLINE_NODE
```
