## package/nodemask/nodes_complement/Kconfig
```kconfig
menuconfig PK_NODES_COMPLEMENT
	bool "nodes_complement"

if PK_NODES_COMPLEMENT

config PK_NODES_COMPLEMENT_VERSION
	default "default"
	string "verstion"

config PK_NODES_COMPLEMENT_TAR
	default "tar.gz"
	string "tar type"

config PK_NODES_COMPLEMENT_URL
	default "https://gitee.com/BiscuitOS_team/HardStack/raw/Gitee/Algorithem/nodemask/nodes_complement"
	string "url"

config PK_NODES_COMPLEMENT_GITHUB
	string "GitHub"

config PK_NODES_COMPLEMENT_SRCFILE
	default "main.c Kconfig Makefile"
	string "Source code list"

config PK_NODES_COMPLEMENT_CSRCFILE
	string "Compile source code list"

config PK_NODES_COMPLEMENT_CONFIG
	string "CONFIG: Project Configure Options"

config PK_NODES_COMPLEMENT_LIBPATH
	string "LIBS: Libraries to pass to the linker, e.g. -l<library>"

config PK_NODES_COMPLEMENT_CPPFLAGS
	string "CPPFLAGS: C/C++ preprocessor flags, e.g. -I<include dir>"

config PK_NODES_COMPLEMENT_DPKCONFIG
	string "PKG_CONFIG_PATH: Directories to add to pkg-config's search path"

config PK_NODES_COMPLEMENT_CFLAGS
	string "CFLAGS: C compiler flags"

config PK_NODES_COMPLEMENT_LDFLAGS
	string "LDFLAGS: Linker flags"

config PK_NODES_COMPLEMENT_CXXFLAGS
	string "CXXFLAGS: C++ compiler flags"

config PK_NODES_COMPLEMENT_ASFLAGS
	string "CCASFLAGS: assembler compiler flags (defaults to CFLAGS)"

config PK_NODES_COMPLEMENT_BUILDARCH
	string "--host options on configure for Architecture"

endif # PK_NODES_COMPLEMENT
```

## package/nodemask/nodes_empty/Kconfig
```kconfig
menuconfig PK_NODES_EMPTY
	bool "nodes_empty"

if PK_NODES_EMPTY

config PK_NODES_EMPTY_VERSION
	default "default"
	string "verstion"

config PK_NODES_EMPTY_TAR
	default "tar.gz"
	string "tar type"

config PK_NODES_EMPTY_URL
	default "https://gitee.com/BiscuitOS_team/HardStack/raw/Gitee/Algorithem/nodemask/nodes_empty"
	string "url"

config PK_NODES_EMPTY_GITHUB
	string "GitHub"

config PK_NODES_EMPTY_SRCFILE
	default "main.c Kconfig Makefile"
	string "Source code list"

config PK_NODES_EMPTY_CSRCFILE
	string "Compile source code list"

config PK_NODES_EMPTY_CONFIG
	string "CONFIG: Project Configure Options"

config PK_NODES_EMPTY_LIBPATH
	string "LIBS: Libraries to pass to the linker, e.g. -l<library>"

config PK_NODES_EMPTY_CPPFLAGS
	string "CPPFLAGS: C/C++ preprocessor flags, e.g. -I<include dir>"

config PK_NODES_EMPTY_DPKCONFIG
	string "PKG_CONFIG_PATH: Directories to add to pkg-config's search path"

config PK_NODES_EMPTY_CFLAGS
	string "CFLAGS: C compiler flags"

config PK_NODES_EMPTY_LDFLAGS
	string "LDFLAGS: Linker flags"

config PK_NODES_EMPTY_CXXFLAGS
	string "CXXFLAGS: C++ compiler flags"

config PK_NODES_EMPTY_ASFLAGS
	string "CCASFLAGS: assembler compiler flags (defaults to CFLAGS)"

config PK_NODES_EMPTY_BUILDARCH
	string "--host options on configure for Architecture"

endif # PK_NODES_EMPTY
```

## package/nodemask/nodes_equal/Kconfig
```kconfig
menuconfig PK_NODES_EQUAL
	bool "nodes_equal"

if PK_NODES_EQUAL

config PK_NODES_EQUAL_VERSION
	default "default"
	string "verstion"

config PK_NODES_EQUAL_TAR
	default "tar.gz"
	string "tar type"

config PK_NODES_EQUAL_URL
	default "https://gitee.com/BiscuitOS_team/HardStack/raw/Gitee/Algorithem/nodemask/nodes_equal"
	string "url"

config PK_NODES_EQUAL_GITHUB
	string "GitHub"

config PK_NODES_EQUAL_SRCFILE
	default "main.c Kconfig Makefile"
	string "Source code list"

config PK_NODES_EQUAL_CSRCFILE
	string "Compile source code list"

config PK_NODES_EQUAL_CONFIG
	string "CONFIG: Project Configure Options"

config PK_NODES_EQUAL_LIBPATH
	string "LIBS: Libraries to pass to the linker, e.g. -l<library>"

config PK_NODES_EQUAL_CPPFLAGS
	string "CPPFLAGS: C/C++ preprocessor flags, e.g. -I<include dir>"

config PK_NODES_EQUAL_DPKCONFIG
	string "PKG_CONFIG_PATH: Directories to add to pkg-config's search path"

config PK_NODES_EQUAL_CFLAGS
	string "CFLAGS: C compiler flags"

config PK_NODES_EQUAL_LDFLAGS
	string "LDFLAGS: Linker flags"

config PK_NODES_EQUAL_CXXFLAGS
	string "CXXFLAGS: C++ compiler flags"

config PK_NODES_EQUAL_ASFLAGS
	string "CCASFLAGS: assembler compiler flags (defaults to CFLAGS)"

config PK_NODES_EQUAL_BUILDARCH
	string "--host options on configure for Architecture"

endif # PK_NODES_EQUAL
```

## package/nodemask/nodes_full/Kconfig
```kconfig
menuconfig PK_NODES_FULL
	bool "nodes_full"

if PK_NODES_FULL

config PK_NODES_FULL_VERSION
	default "default"
	string "verstion"

config PK_NODES_FULL_TAR
	default "tar.gz"
	string "tar type"

config PK_NODES_FULL_URL
	default "https://gitee.com/BiscuitOS_team/HardStack/raw/Gitee/Algorithem/nodemask/nodes_full"
	string "url"

config PK_NODES_FULL_GITHUB
	string "GitHub"

config PK_NODES_FULL_SRCFILE
	default "main.c Kconfig Makefile"
	string "Source code list"

config PK_NODES_FULL_CSRCFILE
	string "Compile source code list"

config PK_NODES_FULL_CONFIG
	string "CONFIG: Project Configure Options"

config PK_NODES_FULL_LIBPATH
	string "LIBS: Libraries to pass to the linker, e.g. -l<library>"

config PK_NODES_FULL_CPPFLAGS
	string "CPPFLAGS: C/C++ preprocessor flags, e.g. -I<include dir>"

config PK_NODES_FULL_DPKCONFIG
	string "PKG_CONFIG_PATH: Directories to add to pkg-config's search path"

config PK_NODES_FULL_CFLAGS
	string "CFLAGS: C compiler flags"

config PK_NODES_FULL_LDFLAGS
	string "LDFLAGS: Linker flags"

config PK_NODES_FULL_CXXFLAGS
	string "CXXFLAGS: C++ compiler flags"

config PK_NODES_FULL_ASFLAGS
	string "CCASFLAGS: assembler compiler flags (defaults to CFLAGS)"

config PK_NODES_FULL_BUILDARCH
	string "--host options on configure for Architecture"

endif # PK_NODES_FULL
```
