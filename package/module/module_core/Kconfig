## package/nodemask/node_isset/Kconfig
```kconfig
menuconfig PK_NODE_ISSET
	bool "node_isset"

if PK_NODE_ISSET

config PK_NODE_ISSET_VERSION
	default "default"
	string "verstion"

config PK_NODE_ISSET_TAR
	default "tar.gz"
	string "tar type"

config PK_NODE_ISSET_URL
	default "https://gitee.com/BiscuitOS_team/HardStack/raw/Gitee/Algorithem/nodemask/node_isset"
	string "url"

config PK_NODE_ISSET_GITHUB
	string "GitHub"

config PK_NODE_ISSET_SRCFILE
	default "main.c Kconfig Makefile"
	string "Source code list"

config PK_NODE_ISSET_CSRCFILE
	string "Compile source code list"

config PK_NODE_ISSET_CONFIG
	string "CONFIG: Project Configure Options"

config PK_NODE_ISSET_LIBPATH
	string "LIBS: Libraries to pass to the linker, e.g. -l<library>"

config PK_NODE_ISSET_CPPFLAGS
	string "CPPFLAGS: C/C++ preprocessor flags, e.g. -I<include dir>"

config PK_NODE_ISSET_DPKCONFIG
	string "PKG_CONFIG_PATH: Directories to add to pkg-config's search path"

config PK_NODE_ISSET_CFLAGS
	string "CFLAGS: C compiler flags"

config PK_NODE_ISSET_LDFLAGS
	string "LDFLAGS: Linker flags"

config PK_NODE_ISSET_CXXFLAGS
	string "CXXFLAGS: C++ compiler flags"

config PK_NODE_ISSET_ASFLAGS
	string "CCASFLAGS: assembler compiler flags (defaults to CFLAGS)"

config PK_NODE_ISSET_BUILDARCH
	string "--host options on configure for Architecture"

endif # PK_NODE_ISSET
```

## package/nodemask/node_possible/Kconfig
```kconfig
menuconfig PK_NODE_POSSIBLE
	bool "node_possible"

if PK_NODE_POSSIBLE

config PK_NODE_POSSIBLE_VERSION
	default "default"
	string "verstion"

config PK_NODE_POSSIBLE_TAR
	default "tar.gz"
	string "tar type"

config PK_NODE_POSSIBLE_URL
	default "https://gitee.com/BiscuitOS_team/HardStack/raw/Gitee/Algorithem/nodemask/node_possible"
	string "url"

config PK_NODE_POSSIBLE_GITHUB
	string "GitHub"

config PK_NODE_POSSIBLE_SRCFILE
	default "main.c Kconfig Makefile"
	string "Source code list"

config PK_NODE_POSSIBLE_CSRCFILE
	string "Compile source code list"

config PK_NODE_POSSIBLE_CONFIG
	string "CONFIG: Project Configure Options"

config PK_NODE_POSSIBLE_LIBPATH
	string "LIBS: Libraries to pass to the linker, e.g. -l<library>"

config PK_NODE_POSSIBLE_CPPFLAGS
	string "CPPFLAGS: C/C++ preprocessor flags, e.g. -I<include dir>"

config PK_NODE_POSSIBLE_DPKCONFIG
	string "PKG_CONFIG_PATH: Directories to add to pkg-config's search path"

config PK_NODE_POSSIBLE_CFLAGS
	string "CFLAGS: C compiler flags"

config PK_NODE_POSSIBLE_LDFLAGS
	string "LDFLAGS: Linker flags"

config PK_NODE_POSSIBLE_CXXFLAGS
	string "CXXFLAGS: C++ compiler flags"

config PK_NODE_POSSIBLE_ASFLAGS
	string "CCASFLAGS: assembler compiler flags (defaults to CFLAGS)"

config PK_NODE_POSSIBLE_BUILDARCH
	string "--host options on configure for Architecture"

endif # PK_NODE_POSSIBLE
```

## package/nodemask/node_set/Kconfig
```kconfig
menuconfig PK_NODE_SET
	bool "node_set"

if PK_NODE_SET

config PK_NODE_SET_VERSION
	default "default"
	string "verstion"

config PK_NODE_SET_TAR
	default "tar.gz"
	string "tar type"

config PK_NODE_SET_URL
	default "https://gitee.com/BiscuitOS_team/HardStack/raw/Gitee/Algorithem/nodemask/node_set"
	string "url"

config PK_NODE_SET_GITHUB
	string "GitHub"

config PK_NODE_SET_SRCFILE
	default "main.c Kconfig Makefile"
	string "Source code list"

config PK_NODE_SET_CSRCFILE
	string "Compile source code list"

config PK_NODE_SET_CONFIG
	string "CONFIG: Project Configure Options"

config PK_NODE_SET_LIBPATH
	string "LIBS: Libraries to pass to the linker, e.g. -l<library>"

config PK_NODE_SET_CPPFLAGS
	string "CPPFLAGS: C/C++ preprocessor flags, e.g. -I<include dir>"

config PK_NODE_SET_DPKCONFIG
	string "PKG_CONFIG_PATH: Directories to add to pkg-config's search path"

config PK_NODE_SET_CFLAGS
	string "CFLAGS: C compiler flags"

config PK_NODE_SET_LDFLAGS
	string "LDFLAGS: Linker flags"

config PK_NODE_SET_CXXFLAGS
	string "CXXFLAGS: C++ compiler flags"

config PK_NODE_SET_ASFLAGS
	string "CCASFLAGS: assembler compiler flags (defaults to CFLAGS)"

config PK_NODE_SET_BUILDARCH
	string "--host options on configure for Architecture"

endif # PK_NODE_SET
```

## package/nodemask/node_set_offline/Kconfig
```kconfig
menuconfig PK_NODE_SET_OFFLINE
	bool "node_set_offline"

if PK_NODE_SET_OFFLINE

config PK_NODE_SET_OFFLINE_VERSION
	default "default"
	string "verstion"

config PK_NODE_SET_OFFLINE_TAR
	default "tar.gz"
	string "tar type"

config PK_NODE_SET_OFFLINE_URL
	default "https://gitee.com/BiscuitOS_team/HardStack/raw/Gitee/Algorithem/nodemask/node_set_offline"
	string "url"

config PK_NODE_SET_OFFLINE_GITHUB
	string "GitHub"

config PK_NODE_SET_OFFLINE_SRCFILE
	default "main.c Kconfig Makefile"
	string "Source code list"

config PK_NODE_SET_OFFLINE_CSRCFILE
	string "Compile source code list"

config PK_NODE_SET_OFFLINE_CONFIG
	string "CONFIG: Project Configure Options"

config PK_NODE_SET_OFFLINE_LIBPATH
	string "LIBS: Libraries to pass to the linker, e.g. -l<library>"

config PK_NODE_SET_OFFLINE_CPPFLAGS
	string "CPPFLAGS: C/C++ preprocessor flags, e.g. -I<include dir>"

config PK_NODE_SET_OFFLINE_DPKCONFIG
	string "PKG_CONFIG_PATH: Directories to add to pkg-config's search path"

config PK_NODE_SET_OFFLINE_CFLAGS
	string "CFLAGS: C compiler flags"

config PK_NODE_SET_OFFLINE_LDFLAGS
	string "LDFLAGS: Linker flags"

config PK_NODE_SET_OFFLINE_CXXFLAGS
	string "CXXFLAGS: C++ compiler flags"

config PK_NODE_SET_OFFLINE_ASFLAGS
	string "CCASFLAGS: assembler compiler flags (defaults to CFLAGS)"

config PK_NODE_SET_OFFLINE_BUILDARCH
	string "--host options on configure for Architecture"

endif # PK_NODE_SET_OFFLINE
```

## package/nodemask/node_set_online/Kconfig
```kconfig
menuconfig PK_NODE_SET_ONLINE
	bool "node_set_online"

if PK_NODE_SET_ONLINE

config PK_NODE_SET_ONLINE_VERSION
	default "default"
	string "verstion"

config PK_NODE_SET_ONLINE_TAR
	default "tar.gz"
	string "tar type"

config PK_NODE_SET_ONLINE_URL
	default "https://gitee.com/BiscuitOS_team/HardStack/raw/Gitee/Algorithem/nodemask/node_set_online"
	string "url"

config PK_NODE_SET_ONLINE_GITHUB
	string "GitHub"

config PK_NODE_SET_ONLINE_SRCFILE
	default "main.c Kconfig Makefile"
	string "Source code list"

config PK_NODE_SET_ONLINE_CSRCFILE
	string "Compile source code list"

config PK_NODE_SET_ONLINE_CONFIG
	string "CONFIG: Project Configure Options"

config PK_NODE_SET_ONLINE_LIBPATH
	string "LIBS: Libraries to pass to the linker, e.g. -l<library>"

config PK_NODE_SET_ONLINE_CPPFLAGS
	string "CPPFLAGS: C/C++ preprocessor flags, e.g. -I<include dir>"

config PK_NODE_SET_ONLINE_DPKCONFIG
	string "PKG_CONFIG_PATH: Directories to add to pkg-config's search path"

config PK_NODE_SET_ONLINE_CFLAGS
	string "CFLAGS: C compiler flags"

config PK_NODE_SET_ONLINE_LDFLAGS
	string "LDFLAGS: Linker flags"

config PK_NODE_SET_ONLINE_CXXFLAGS
	string "CXXFLAGS: C++ compiler flags"

config PK_NODE_SET_ONLINE_ASFLAGS
	string "CCASFLAGS: assembler compiler flags (defaults to CFLAGS)"

config PK_NODE_SET_ONLINE_BUILDARCH
	string "--host options on configure for Architecture"

endif # PK_NODE_SET_ONLINE
```

## package/nodemask/node_set_state/Kconfig
```kconfig
menuconfig PK_NODE_SET_STATE
	bool "node_set_state"

if PK_NODE_SET_STATE

config PK_NODE_SET_STATE_VERSION
	default "default"
	string "verstion"

config PK_NODE_SET_STATE_TAR
	default "tar.gz"
	string "tar type"

config PK_NODE_SET_STATE_URL
	default "https://gitee.com/BiscuitOS_team/HardStack/raw/Gitee/Algorithem/nodemask/node_set_state"
	string "url"

config PK_NODE_SET_STATE_GITHUB
	string "GitHub"

config PK_NODE_SET_STATE_SRCFILE
	default "main.c Kconfig Makefile"
	string "Source code list"

config PK_NODE_SET_STATE_CSRCFILE
	string "Compile source code list"

config PK_NODE_SET_STATE_CONFIG
	string "CONFIG: Project Configure Options"

config PK_NODE_SET_STATE_LIBPATH
	string "LIBS: Libraries to pass to the linker, e.g. -l<library>"

config PK_NODE_SET_STATE_CPPFLAGS
	string "CPPFLAGS: C/C++ preprocessor flags, e.g. -I<include dir>"

config PK_NODE_SET_STATE_DPKCONFIG
	string "PKG_CONFIG_PATH: Directories to add to pkg-config's search path"

config PK_NODE_SET_STATE_CFLAGS
	string "CFLAGS: C compiler flags"

config PK_NODE_SET_STATE_LDFLAGS
	string "LDFLAGS: Linker flags"

config PK_NODE_SET_STATE_CXXFLAGS
	string "CXXFLAGS: C++ compiler flags"

config PK_NODE_SET_STATE_ASFLAGS
	string "CCASFLAGS: assembler compiler flags (defaults to CFLAGS)"

config PK_NODE_SET_STATE_BUILDARCH
	string "--host options on configure for Architecture"

endif # PK_NODE_SET_STATE
```

## package/nodemask/node_state/Kconfig
```kconfig
menuconfig PK_NODE_STATE
	bool "node_state"

if PK_NODE_STATE

config PK_NODE_STATE_VERSION
	default "default"
	string "verstion"

config PK_NODE_STATE_TAR
	default "tar.gz"
	string "tar type"

config PK_NODE_STATE_URL
	default "https://gitee.com/BiscuitOS_team/HardStack/raw/Gitee/Algorithem/nodemask/node_state"
	string "url"

config PK_NODE_STATE_GITHUB
	string "GitHub"

config PK_NODE_STATE_SRCFILE
	default "main.c Kconfig Makefile"
	string "Source code list"

config PK_NODE_STATE_CSRCFILE
	string "Compile source code list"

config PK_NODE_STATE_CONFIG
	string "CONFIG: Project Configure Options"

config PK_NODE_STATE_LIBPATH
	string "LIBS: Libraries to pass to the linker, e.g. -l<library>"

config PK_NODE_STATE_CPPFLAGS
	string "CPPFLAGS: C/C++ preprocessor flags, e.g. -I<include dir>"

config PK_NODE_STATE_DPKCONFIG
	string "PKG_CONFIG_PATH: Directories to add to pkg-config's search path"

config PK_NODE_STATE_CFLAGS
	string "CFLAGS: C compiler flags"

config PK_NODE_STATE_LDFLAGS
	string "LDFLAGS: Linker flags"

config PK_NODE_STATE_CXXFLAGS
	string "CXXFLAGS: C++ compiler flags"

config PK_NODE_STATE_ASFLAGS
	string "CCASFLAGS: assembler compiler flags (defaults to CFLAGS)"

config PK_NODE_STATE_BUILDARCH
	string "--host options on configure for Architecture"

endif # PK_NODE_STATE
```

## package/nodemask/node_test_and_set/Kconfig
```kconfig
menuconfig PK_NODE_TEST_AND_SET
	bool "node_test_and_set"

if PK_NODE_TEST_AND_SET

config PK_NODE_TEST_AND_SET_VERSION
	default "default"
	string "verstion"

config PK_NODE_TEST_AND_SET_TAR
	default "tar.gz"
	string "tar type"

config PK_NODE_TEST_AND_SET_URL
	default "https://gitee.com/BiscuitOS_team/HardStack/raw/Gitee/Algorithem/nodemask/node_test_and_set"
	string "url"

config PK_NODE_TEST_AND_SET_GITHUB
	string "GitHub"

config PK_NODE_TEST_AND_SET_SRCFILE
	default "main.c Kconfig Makefile"
	string "Source code list"

config PK_NODE_TEST_AND_SET_CSRCFILE
	string "Compile source code list"

config PK_NODE_TEST_AND_SET_CONFIG
	string "CONFIG: Project Configure Options"

config PK_NODE_TEST_AND_SET_LIBPATH
	string "LIBS: Libraries to pass to the linker, e.g. -l<library>"

config PK_NODE_TEST_AND_SET_CPPFLAGS
	string "CPPFLAGS: C/C++ preprocessor flags, e.g. -I<include dir>"

config PK_NODE_TEST_AND_SET_DPKCONFIG
	string "PKG_CONFIG_PATH: Directories to add to pkg-config's search path"

config PK_NODE_TEST_AND_SET_CFLAGS
	string "CFLAGS: C compiler flags"

config PK_NODE_TEST_AND_SET_LDFLAGS
	string "LDFLAGS: Linker flags"

config PK_NODE_TEST_AND_SET_CXXFLAGS
	string "CXXFLAGS: C++ compiler flags"

config PK_NODE_TEST_AND_SET_ASFLAGS
	string "CCASFLAGS: assembler compiler flags (defaults to CFLAGS)"

config PK_NODE_TEST_AND_SET_BUILDARCH
	string "--host options on configure for Architecture"

endif # PK_NODE_TEST_AND_SET
```

## package/nodemask/nodes_and/Kconfig
```kconfig
menuconfig PK_NODES_AND
	bool "nodes_and"

if PK_NODES_AND

config PK_NODES_AND_VERSION
	default "default"
	string "verstion"

config PK_NODES_AND_TAR
	default "tar.gz"
	string "tar type"

config PK_NODES_AND_URL
	default "https://gitee.com/BiscuitOS_team/HardStack/raw/Gitee/Algorithem/nodemask/nodes_and"
	string "url"

config PK_NODES_AND_GITHUB
	string "GitHub"

config PK_NODES_AND_SRCFILE
	default "main.c Kconfig Makefile"
	string "Source code list"

config PK_NODES_AND_CSRCFILE
	string "Compile source code list"

config PK_NODES_AND_CONFIG
	string "CONFIG: Project Configure Options"

config PK_NODES_AND_LIBPATH
	string "LIBS: Libraries to pass to the linker, e.g. -l<library>"

config PK_NODES_AND_CPPFLAGS
	string "CPPFLAGS: C/C++ preprocessor flags, e.g. -I<include dir>"

config PK_NODES_AND_DPKCONFIG
	string "PKG_CONFIG_PATH: Directories to add to pkg-config's search path"

config PK_NODES_AND_CFLAGS
	string "CFLAGS: C compiler flags"

config PK_NODES_AND_LDFLAGS
	string "LDFLAGS: Linker flags"

config PK_NODES_AND_CXXFLAGS
	string "CXXFLAGS: C++ compiler flags"

config PK_NODES_AND_ASFLAGS
	string "CCASFLAGS: assembler compiler flags (defaults to CFLAGS)"

config PK_NODES_AND_BUILDARCH
	string "--host options on configure for Architecture"

endif # PK_NODES_AND
```

## package/nodemask/nodes_andnot/Kconfig
```kconfig
menuconfig PK_NODES_ANDNOT
	bool "nodes_andnot"

if PK_NODES_ANDNOT

config PK_NODES_ANDNOT_VERSION
	default "default"
	string "verstion"

config PK_NODES_ANDNOT_TAR
	default "tar.gz"
	string "tar type"

config PK_NODES_ANDNOT_URL
	default "https://gitee.com/BiscuitOS_team/HardStack/raw/Gitee/Algorithem/nodemask/nodes_andnot"
	string "url"

config PK_NODES_ANDNOT_GITHUB
	string "GitHub"

config PK_NODES_ANDNOT_SRCFILE
	default "main.c Kconfig Makefile"
	string "Source code list"

config PK_NODES_ANDNOT_CSRCFILE
	string "Compile source code list"

config PK_NODES_ANDNOT_CONFIG
	string "CONFIG: Project Configure Options"

config PK_NODES_ANDNOT_LIBPATH
	string "LIBS: Libraries to pass to the linker, e.g. -l<library>"

config PK_NODES_ANDNOT_CPPFLAGS
	string "CPPFLAGS: C/C++ preprocessor flags, e.g. -I<include dir>"

config PK_NODES_ANDNOT_DPKCONFIG
	string "PKG_CONFIG_PATH: Directories to add to pkg-config's search path"

config PK_NODES_ANDNOT_CFLAGS
	string "CFLAGS: C compiler flags"

config PK_NODES_ANDNOT_LDFLAGS
	string "LDFLAGS: Linker flags"

config PK_NODES_ANDNOT_CXXFLAGS
	string "CXXFLAGS: C++ compiler flags"

config PK_NODES_ANDNOT_ASFLAGS
	string "CCASFLAGS: assembler compiler flags (defaults to CFLAGS)"

config PK_NODES_ANDNOT_BUILDARCH
	string "--host options on configure for Architecture"

endif # PK_NODES_ANDNOT
```

## package/nodemask/nodes_clear/Kconfig
```kconfig
menuconfig PK_NODES_CLEAR
	bool "nodes_clear"

if PK_NODES_CLEAR

config PK_NODES_CLEAR_VERSION
	default "default"
	string "verstion"

config PK_NODES_CLEAR_TAR
	default "tar.gz"
	string "tar type"

config PK_NODES_CLEAR_URL
	default "https://gitee.com/BiscuitOS_team/HardStack/raw/Gitee/Algorithem/nodemask/nodes_clear"
	string "url"

config PK_NODES_CLEAR_GITHUB
	string "GitHub"

config PK_NODES_CLEAR_SRCFILE
	default "main.c Kconfig Makefile"
	string "Source code list"

config PK_NODES_CLEAR_CSRCFILE
	string "Compile source code list"

config PK_NODES_CLEAR_CONFIG
	string "CONFIG: Project Configure Options"

config PK_NODES_CLEAR_LIBPATH
	string "LIBS: Libraries to pass to the linker, e.g. -l<library>"

config PK_NODES_CLEAR_CPPFLAGS
	string "CPPFLAGS: C/C++ preprocessor flags, e.g. -I<include dir>"

config PK_NODES_CLEAR_DPKCONFIG
	string "PKG_CONFIG_PATH: Directories to add to pkg-config's search path"

config PK_NODES_CLEAR_CFLAGS
	string "CFLAGS: C compiler flags"

config PK_NODES_CLEAR_LDFLAGS
	string "LDFLAGS: Linker flags"

config PK_NODES_CLEAR_CXXFLAGS
	string "CXXFLAGS: C++ compiler flags"

config PK_NODES_CLEAR_ASFLAGS
	string "CCASFLAGS: assembler compiler flags (defaults to CFLAGS)"

config PK_NODES_CLEAR_BUILDARCH
	string "--host options on configure for Architecture"

endif # PK_NODES_CLEAR
```
