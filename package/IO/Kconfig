## package/LDD_input_app/Kconfig
```kconfig
menuconfig PK_LDD_INPUT_APP
	select PK_LDD_INPUT_MOD
	bool "LDD: Input Device Driver Application"

if PK_LDD_INPUT_APP

config PK_LDD_INPUT_APP_VERSION
	default "0.0.1"
	string "verstion"

config PK_LDD_INPUT_APP_TAR
	default "tar.gz"
	string "tar type"

config PK_LDD_INPUT_APP_URL
	default "https://raw.githubusercontent.com/BiscuitOS/HardStack/master/Device-Driver/input/Base/userland"
	string "url"

config PK_LDD_INPUT_APP_GITHUB
	string "GitHub"

config PK_LDD_INPUT_APP_SRCFILE
	default "input.c input.sh Makefile"
	string "Source code list"

config PK_LDD_INPUT_APP_CSRCFILE
	string "Compile source code list"

config PK_LDD_INPUT_APP_CONFIG
	string "CONFIG: Project Configure Options"

config PK_LDD_INPUT_APP_LIBPATH
	string "LIBS: Libraries to pass to the linker, e.g. -l<library>"

config PK_LDD_INPUT_APP_CPPFLAGS
	string "CPPFLAGS: C/C++ preprocessor flags, e.g. -I<include dir>"

config PK_LDD_INPUT_APP_DPKCONFIG
	string "PKG_CONFIG_PATH: Directories to add to pkg-config's search path"

config PK_LDD_INPUT_APP_CFLAGS
	string "CFLAGS: C compiler flags"

config PK_LDD_INPUT_APP_LDFLAGS
	string "LDFLAGS: Linker flags"

config PK_LDD_INPUT_APP_CXXFLAGS
	string "CXXFLAGS: C++ compiler flags"

config PK_LDD_INPUT_APP_ASFLAGS
	string "CCASFLAGS: assembler compiler flags (defaults to CFLAGS)"

config PK_LDD_INPUT_APP_BUILDARCH
	string "--host options on configure for Architecture"

endif # PK_LDD_INPUT_APP
```

## package/LDD_platform_attr_app/Kconfig
```kconfig
menuconfig PK_LDD_PLATFORM_ATTR_APP
	select PK_LDD_PLATFORM_ATTR_MOD
	bool "LDD: Platform Attribute Device Driver Application"

if PK_LDD_PLATFORM_ATTR_APP

config PK_LDD_PLATFORM_ATTR_APP_VERSION
	default "0.0.1"
	string "verstion"

config PK_LDD_PLATFORM_ATTR_APP_TAR
	default "tar.gz"
	string "tar type"

config PK_LDD_PLATFORM_ATTR_APP_URL
	default "https://gitee.com/BiscuitOS_team/HardStack/raw/Gitee/Device-Driver/Platform/Common/Attribute/userland"
	string "url"

config PK_LDD_PLATFORM_ATTR_APP_GITHUB
	string "GitHub"

config PK_LDD_PLATFORM_ATTR_APP_SRCFILE
	default "platform.c platform.sh Makefile"
	string "Source code list"

config PK_LDD_PLATFORM_ATTR_APP_CSRCFILE
	string "Compile source code list"

config PK_LDD_PLATFORM_ATTR_APP_CONFIG
	string "CONFIG: Project Configure Options"

config PK_LDD_PLATFORM_ATTR_APP_LIBPATH
	string "LIBS: Libraries to pass to the linker, e.g. -l<library>"

config PK_LDD_PLATFORM_ATTR_APP_CPPFLAGS
	string "CPPFLAGS: C/C++ preprocessor flags, e.g. -I<include dir>"

config PK_LDD_PLATFORM_ATTR_APP_DPKCONFIG
	string "PKG_CONFIG_PATH: Directories to add to pkg-config's search path"

config PK_LDD_PLATFORM_ATTR_APP_CFLAGS
	string "CFLAGS: C compiler flags"

config PK_LDD_PLATFORM_ATTR_APP_LDFLAGS
	string "LDFLAGS: Linker flags"

config PK_LDD_PLATFORM_ATTR_APP_CXXFLAGS
	string "CXXFLAGS: C++ compiler flags"

config PK_LDD_PLATFORM_ATTR_APP_ASFLAGS
	string "CCASFLAGS: assembler compiler flags (defaults to CFLAGS)"

config PK_LDD_PLATFORM_ATTR_APP_BUILDARCH
	string "--host options on configure for Architecture"

endif # PK_LDD_PLATFORM_ATTR_APP
```

## package/LDD_platform_resDTS_app/Kconfig
```kconfig
menuconfig PK_LDD_PLATFORM_RESDTS_APP
	select PK_LDD_PLATFORM_RESDTS_MOD
	bool "LDD: Platform Resource with DTS Application"

if PK_LDD_PLATFORM_RESDTS_APP

config PK_LDD_PLATFORM_RESDTS_APP_VERSION
	default "0.0.1"
	string "verstion"

config PK_LDD_PLATFORM_RESDTS_APP_TAR
	default "tar.gz"
	string "tar type"

config PK_LDD_PLATFORM_RESDTS_APP_URL
	default "https://raw.githubusercontent.com/BiscuitOS/HardStack/master/Device-Driver/Platform/DTS/Resource/userland"
	string "url"

config PK_LDD_PLATFORM_RESDTS_APP_GITHUB
	string "GitHub"

config PK_LDD_PLATFORM_RESDTS_APP_SRCFILE
	default "platform.c platform.sh Makefile"
	string "Source code list"

config PK_LDD_PLATFORM_RESDTS_APP_CSRCFILE
	string "Compile source code list"

config PK_LDD_PLATFORM_RESDTS_APP_CONFIG
	string "CONFIG: Project Configure Options"

config PK_LDD_PLATFORM_RESDTS_APP_LIBPATH
	string "LIBS: Libraries to pass to the linker, e.g. -l<library>"

config PK_LDD_PLATFORM_RESDTS_APP_CPPFLAGS
	string "CPPFLAGS: C/C++ preprocessor flags, e.g. -I<include dir>"

config PK_LDD_PLATFORM_RESDTS_APP_DPKCONFIG
	string "PKG_CONFIG_PATH: Directories to add to pkg-config's search path"

config PK_LDD_PLATFORM_RESDTS_APP_CFLAGS
	string "CFLAGS: C compiler flags"

config PK_LDD_PLATFORM_RESDTS_APP_LDFLAGS
	string "LDFLAGS: Linker flags"

config PK_LDD_PLATFORM_RESDTS_APP_CXXFLAGS
	string "CXXFLAGS: C++ compiler flags"

config PK_LDD_PLATFORM_RESDTS_APP_ASFLAGS
	string "CCASFLAGS: assembler compiler flags (defaults to CFLAGS)"

config PK_LDD_PLATFORM_RESDTS_APP_BUILDARCH
	string "--host options on configure for Architecture"

endif # PK_LDD_PLATFORM_RESDTS_APP
```

## package/MCE/BiscuitOS-MCE-Inject/Kconfig
```kconfig
menuconfig PK_MCE_MCE_INJECT
	select PK_MCE_MCELOG
	bool "mce-inject: Inject machine check errors on software"

if PK_MCE_MCE_INJECT

config PK_MCE_MCE_INJECT_VERSION
	default "github"
	string "verstion"

config PK_MCE_MCE_INJECT_TAR
	default "tar.xz"
	string "tar type"

config PK_MCE_MCE_INJECT_URL
	default "https://download.qemu.org/"
	string "url"

config PK_MCE_MCE_INJECT_GITHUB
	default "https://github.com/andikleen/mce-inject.git"
	string "github"

config PK_MCE_MCE_INJECT_SRCFILE
	string "Source code list"

config PK_MCE_MCE_INJECT_CONFIG
	default ""
	string "CONFIG: Project Configure Options"

config PK_MCE_MCE_INJECT_LIBPATH
	string "LIBS: Libraries to pass to the linker, e.g. -l<library>"

config PK_MCE_MCE_INJECT_CPPFLAGS
	string "CPPFLAGS: C/C++ preprocessor flags, e.g. -I<include dir>"

config PK_MCE_MCE_INJECT_DPKCONFIG
	string "PKG_CONFIG_PATH: Directories to add to pkg-config's search path"

config PK_MCE_MCE_INJECT_CFLAGS
	string "CFLAGS: C compiler flags"

config PK_MCE_MCE_INJECT_LDFLAGS
	string "LDFLAGS: Linker flags"

config PK_MCE_MCE_INJECT_CXXFLAGS
	string "CXXFLAGS: C++ compiler flags"

config PK_MCE_MCE_INJECT_ASFLAGS
	string "CCASFLAGS: assembler compiler flags (defaults to CFLAGS)"

config PK_MCE_MCE_INJECT_BUILDARCH
	default "x86_64-unknown-linux-gnu"
	string "--host options on configure for Architecture"

endif # PK_MCE_MCE_INJECT
```

## package/MCE/BiscuitOS-MCE-madvise-software-offline-poison-page/Kconfig
```kconfig
menuconfig PK_MCE_MADV_SOFT_OFFLINE_PAGE
	bool "MCE CE: Madvise software-offline CE Poison Page"

if PK_MCE_MADV_SOFT_OFFLINE_PAGE

config PK_MCE_MADV_SOFT_OFFLINE_PAGE_VERSION
	default "default"
	string "verstion"

config PK_MCE_MADV_SOFT_OFFLINE_PAGE_TAR
	default "tar.gz"
	string "tar type"

config PK_MCE_MADV_SOFT_OFFLINE_PAGE_URL
	default "https://gitee.com/BiscuitOS_team/HardStack/raw/Gitee/Memory-Allocator/MEMORY-FAILURE/BiscuitOS-MCE-madvise-software-offline-poison-page/"
	string "url"

config PK_MCE_MADV_SOFT_OFFLINE_PAGE_GITHUB
	string "GitHub"

config PK_MCE_MADV_SOFT_OFFLINE_PAGE_SRCFILE
	default "main.c Makefile RunBiscuitOS.sh"
	string "Source code list"

config PK_MCE_MADV_SOFT_OFFLINE_PAGE_CSRCFILE
	string "Compile source code list"

config PK_MCE_MADV_SOFT_OFFLINE_PAGE_CONFIG
	string "CONFIG: Project Configure Options"

config PK_MCE_MADV_SOFT_OFFLINE_PAGE_LIBPATH
	string "LIBS: Libraries to pass to the linker, e.g. -l<library>"

config PK_MCE_MADV_SOFT_OFFLINE_PAGE_CPPFLAGS
	string "CPPFLAGS: C/C++ preprocessor flags, e.g. -I<include dir>"

config PK_MCE_MADV_SOFT_OFFLINE_PAGE_DPKCONFIG
	string "PKG_CONFIG_PATH: Directories to add to pkg-config's search path"

config PK_MCE_MADV_SOFT_OFFLINE_PAGE_CFLAGS
	string "CFLAGS: C compiler flags"

config PK_MCE_MADV_SOFT_OFFLINE_PAGE_LDFLAGS
	string "LDFLAGS: Linker flags"

config PK_MCE_MADV_SOFT_OFFLINE_PAGE_CXXFLAGS
	string "CXXFLAGS: C++ compiler flags"

config PK_MCE_MADV_SOFT_OFFLINE_PAGE_ASFLAGS
	string "CCASFLAGS: assembler compiler flags (defaults to CFLAGS)"

config PK_MCE_MADV_SOFT_OFFLINE_PAGE_BUILDARCH
	string "--host options on configure for Architecture"

endif # PK_MCE_MADV_SOFT_OFFLINE_PAGE
```

## package/MCE/BiscuitOS-MCELOG/Kconfig
```kconfig
menuconfig PK_MCE_MCELOG
	bool "MCELOG: Logging Machine check errors"

if PK_MCE_MCELOG

config PK_MCE_MCELOG_VERSION
	default "github"
	string "verstion"

config PK_MCE_MCELOG_TAR
	default "tar.xz"
	string "tar type"

config PK_MCE_MCELOG_URL
	default "https://download.qemu.org/"
	string "url"

config PK_MCE_MCELOG_GITHUB
	default "https://github.com/andikleen/mcelog.git"
	string "github"

config PK_MCE_MCELOG_SRCFILE
	string "Source code list"

config PK_MCE_MCELOG_CONFIG
	default ""
	string "CONFIG: Project Configure Options"

config PK_MCE_MCELOG_LIBPATH
	string "LIBS: Libraries to pass to the linker, e.g. -l<library>"

config PK_MCE_MCELOG_CPPFLAGS
	string "CPPFLAGS: C/C++ preprocessor flags, e.g. -I<include dir>"

config PK_MCE_MCELOG_DPKCONFIG
	string "PKG_CONFIG_PATH: Directories to add to pkg-config's search path"

config PK_MCE_MCELOG_CFLAGS
	string "CFLAGS: C compiler flags"

config PK_MCE_MCELOG_LDFLAGS
	string "LDFLAGS: Linker flags"

config PK_MCE_MCELOG_CXXFLAGS
	string "CXXFLAGS: C++ compiler flags"

config PK_MCE_MCELOG_ASFLAGS
	string "CCASFLAGS: assembler compiler flags (defaults to CFLAGS)"

config PK_MCE_MCELOG_BUILDARCH
	default "x86_64-unknown-linux-gnu"
	string "--host options on configure for Architecture"

endif # PK_MCE_MCELOG
```

## package/MCE/Kconfig
```kconfig
menuconfig PK_MCE
	bool "MCE: Machine Check Exception Mechanism"

if PK_MCE

# MCELOG
source package/MCE/BiscuitOS-MCELOG/Kconfig

# MCE-Inject
source package/MCE/BiscuitOS-MCE-Inject/Kconfig

# MCE: software-offline poison page
source package/MCE/BiscuitOS-MCE-software-offline-poison-page/Kconfig

# MCE: hardware-offline poison page
source package/MCE/BiscuitOS-MCE-hardware-offline-poison-page/Kconfig

# MCE: madvise hardware-offline poison page
source package/MCE/BiscuitOS-MCE-madvise-hardware-offline-poison-page/Kconfig

# MCE: madvise software-offline poison page
source package/MCE/BiscuitOS-MCE-madvise-software-offline-poison-page/Kconfig

endif # PK_MCE
```

## package/MEMBLOCK/BiscuitOS-MEMBLOCK-DRIVER-MANAGED/Kconfig
```kconfig
menuconfig PK_MEMBLOCK_DRIVER_MANAGED
	bool "MEMBLOCK Driver Managned Memory"

if PK_MEMBLOCK_DRIVER_MANAGED

config PK_MEMBLOCK_DRIVER_MANAGED_VERSION
	default "default"
	string "verstion"

config PK_MEMBLOCK_DRIVER_MANAGED_TAR
	default "tar.gz"
	string "tar type"

config PK_MEMBLOCK_DRIVER_MANAGED_URL
	default "https://gitee.com/BiscuitOS_team/HardStack/raw/Gitee/Memory-Allocator/MEMBLOCK/BiscuitOS-MEMBLOCK-DRIVER-MANAGED"
	string "url"

config PK_MEMBLOCK_DRIVER_MANAGED_GITHUB
	string "GitHub"

config PK_MEMBLOCK_DRIVER_MANAGED_SRCFILE
	default "main.c Kconfig Makefile"
	string "Source code list"

config PK_MEMBLOCK_DRIVER_MANAGED_CSRCFILE
	string "Compile source code list"

config PK_MEMBLOCK_DRIVER_MANAGED_CONFIG
	string "CONFIG: Project Configure Options"

config PK_MEMBLOCK_DRIVER_MANAGED_LIBPATH
	string "LIBS: Libraries to pass to the linker, e.g. -l<library>"

config PK_MEMBLOCK_DRIVER_MANAGED_CPPFLAGS
	string "CPPFLAGS: C/C++ preprocessor flags, e.g. -I<include dir>"

config PK_MEMBLOCK_DRIVER_MANAGED_DPKCONFIG
	string "PKG_CONFIG_PATH: Directories to add to pkg-config's search path"

config PK_MEMBLOCK_DRIVER_MANAGED_CFLAGS
	string "CFLAGS: C compiler flags"

config PK_MEMBLOCK_DRIVER_MANAGED_LDFLAGS
	string "LDFLAGS: Linker flags"

config PK_MEMBLOCK_DRIVER_MANAGED_CXXFLAGS
	string "CXXFLAGS: C++ compiler flags"

config PK_MEMBLOCK_DRIVER_MANAGED_ASFLAGS
	string "CCASFLAGS: assembler compiler flags (defaults to CFLAGS)"

config PK_MEMBLOCK_DRIVER_MANAGED_BUILDARCH
	string "--host options on configure for Architecture"

endif # PK_MEMBLOCK_DRIVER_MANAGED
```

## package/MEMBLOCK/BiscuitOS-MEMBLOCK-Hotplug/Kconfig
```kconfig
menuconfig PK_MEMBLOCK_HOTPLUG
	bool "MEMBLOCK with Hotplug Memory"

if PK_MEMBLOCK_HOTPLUG

config PK_MEMBLOCK_HOTPLUG_VERSION
	default "default"
	string "verstion"

config PK_MEMBLOCK_HOTPLUG_TAR
	default "tar.gz"
	string "tar type"

config PK_MEMBLOCK_HOTPLUG_URL
	default "https://gitee.com/BiscuitOS_team/HardStack/raw/Gitee/Memory-Allocator/MEMBLOCK/BiscuitOS-MEMBLOCK-Hotplug"
	string "url"

config PK_MEMBLOCK_HOTPLUG_GITHUB
	string "GitHub"

config PK_MEMBLOCK_HOTPLUG_SRCFILE
	default "main.c Kconfig Makefile"
	string "Source code list"

config PK_MEMBLOCK_HOTPLUG_CSRCFILE
	string "Compile source code list"

config PK_MEMBLOCK_HOTPLUG_CONFIG
	string "CONFIG: Project Configure Options"

config PK_MEMBLOCK_HOTPLUG_LIBPATH
	string "LIBS: Libraries to pass to the linker, e.g. -l<library>"

config PK_MEMBLOCK_HOTPLUG_CPPFLAGS
	string "CPPFLAGS: C/C++ preprocessor flags, e.g. -I<include dir>"

config PK_MEMBLOCK_HOTPLUG_DPKCONFIG
	string "PKG_CONFIG_PATH: Directories to add to pkg-config's search path"

config PK_MEMBLOCK_HOTPLUG_CFLAGS
	string "CFLAGS: C compiler flags"

config PK_MEMBLOCK_HOTPLUG_LDFLAGS
	string "LDFLAGS: Linker flags"

config PK_MEMBLOCK_HOTPLUG_CXXFLAGS
	string "CXXFLAGS: C++ compiler flags"

config PK_MEMBLOCK_HOTPLUG_ASFLAGS
	string "CCASFLAGS: assembler compiler flags (defaults to CFLAGS)"

config PK_MEMBLOCK_HOTPLUG_BUILDARCH
	string "--host options on configure for Architecture"

endif # PK_MEMBLOCK_HOTPLUG
```

## package/MEMBLOCK/BiscuitOS-MEMBLOCK-KEEP-iterate-region/Kconfig
```kconfig
menuconfig PK_MEMBLOCK_KEEP_WORK
	bool "MEMBLOCK KEEP: Iterate Regions"

if PK_MEMBLOCK_KEEP_WORK

config PK_MEMBLOCK_KEEP_WORK_VERSION
	default "default"
	string "verstion"

config PK_MEMBLOCK_KEEP_WORK_TAR
	default "tar.gz"
	string "tar type"

config PK_MEMBLOCK_KEEP_WORK_URL
	default "https://gitee.com/BiscuitOS_team/HardStack/raw/Gitee/Memory-Allocator/MEMBLOCK/BiscuitOS-MEMBLOCK-KEEP-iterate-region"
	string "url"

config PK_MEMBLOCK_KEEP_WORK_GITHUB
	string "GitHub"

config PK_MEMBLOCK_KEEP_WORK_SRCFILE
	default "main.c Kconfig Makefile"
	string "Source code list"

config PK_MEMBLOCK_KEEP_WORK_CSRCFILE
	string "Compile source code list"

config PK_MEMBLOCK_KEEP_WORK_CONFIG
	string "CONFIG: Project Configure Options"

config PK_MEMBLOCK_KEEP_WORK_LIBPATH
	string "LIBS: Libraries to pass to the linker, e.g. -l<library>"

config PK_MEMBLOCK_KEEP_WORK_CPPFLAGS
	string "CPPFLAGS: C/C++ preprocessor flags, e.g. -I<include dir>"

config PK_MEMBLOCK_KEEP_WORK_DPKCONFIG
	string "PKG_CONFIG_PATH: Directories to add to pkg-config's search path"

config PK_MEMBLOCK_KEEP_WORK_CFLAGS
	string "CFLAGS: C compiler flags"

config PK_MEMBLOCK_KEEP_WORK_LDFLAGS
	string "LDFLAGS: Linker flags"

config PK_MEMBLOCK_KEEP_WORK_CXXFLAGS
	string "CXXFLAGS: C++ compiler flags"

config PK_MEMBLOCK_KEEP_WORK_ASFLAGS
	string "CCASFLAGS: assembler compiler flags (defaults to CFLAGS)"

config PK_MEMBLOCK_KEEP_WORK_BUILDARCH
	string "--host options on configure for Architecture"

endif # PK_MEMBLOCK_KEEP_WORK
```
