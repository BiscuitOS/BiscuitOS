## package/IO/Kconfig
```kconfig
menuconfig PK_IO
	bool "IO"

if PK_IO

# Async
source "package/IO/Async/Kconfig"

# BiscuitOS-epoll
source "package/IO/BiscuitOS-epoll/Kconfig"

# BiscuitOS-poll
source "package/IO/BiscuitOS-poll/Kconfig"

# BiscuitOS-select
source "package/IO/BiscuitOS-select/Kconfig"

endif # PK_IO
```

## package/IOMMU/BiscuitOS-IOMMU-PCI-DMA-MSIX/Kconfig
```kconfig
menuconfig PK_IOMMU_PCI_DMA_MSIX
	select HW_PCI_DMA_MSIX
	bool "IOMMU: PCI DMA MSIX with IOMMU"

if PK_IOMMU_PCI_DMA_MSIX

config PK_IOMMU_PCI_DMA_MSIX_VERSION
	default "default"
	string "verstion"

config PK_IOMMU_PCI_DMA_MSIX_TAR
	default "tar.gz"
	string "tar type"

config PK_IOMMU_PCI_DMA_MSIX_URL
	default "https://gitee.com/BiscuitOS_team/HardStack/raw/Gitee/Memory-Allocator/IOMMU-MECH/BiscuitOS-IOMMU-PCI-DMA-MSIX/"
	string "url"

config PK_IOMMU_PCI_DMA_MSIX_GITHUB
	string "GitHub"

config PK_IOMMU_PCI_DMA_MSIX_SRCFILE
	default "Kconfig main.c Makefile Makefile.host README.md RunBiscuitOS.sh"
	string "Source code list"

config PK_IOMMU_PCI_DMA_MSIX_CSRCFILE
	string "Compile source code list"

config PK_IOMMU_PCI_DMA_MSIX_CONFIG
	string "CONFIG: Project Configure Options"

config PK_IOMMU_PCI_DMA_MSIX_LIBPATH
	string "LIBS: Libraries to pass to the linker, e.g. -l<library>"

config PK_IOMMU_PCI_DMA_MSIX_CPPFLAGS
	string "CPPFLAGS: C/C++ preprocessor flags, e.g. -I<include dir>"

config PK_IOMMU_PCI_DMA_MSIX_DPKCONFIG
	string "PKG_CONFIG_PATH: Directories to add to pkg-config's search path"

config PK_IOMMU_PCI_DMA_MSIX_CFLAGS
	string "CFLAGS: C compiler flags"

config PK_IOMMU_PCI_DMA_MSIX_LDFLAGS
	string "LDFLAGS: Linker flags"

config PK_IOMMU_PCI_DMA_MSIX_CXXFLAGS
	string "CXXFLAGS: C++ compiler flags"

config PK_IOMMU_PCI_DMA_MSIX_ASFLAGS
	string "CCASFLAGS: assembler compiler flags (defaults to CFLAGS)"

config PK_IOMMU_PCI_DMA_MSIX_BUILDARCH
	string "--host options on configure for Architecture"

endif # PK_IOMMU_PCI_DMA_MSIX
```

## package/IOMMU/Kconfig
```kconfig
menuconfig PK_IOMMU
	select SUPPORT_DIY
	select DIY_CPU_Q35
	select DIY_VIOMMU
	bool "IOMMU: Input/Output Memory Management Unit"

if PK_IOMMU

# IOMMU: PCI DMA MSIX
source package/IOMMU/BiscuitOS-IOMMU-PCI-DMA-MSIX/Kconfig

endif # PK_IOMMU
```

## package/Kconfig
```kconfig
#
# Package common configure
#
menuconfig COMMON_UTILISE
	bool "Package"
	help
	  binutilise

if COMMON_UTILISE

# BiscuitOS Demo
source package/BiscuitOS-demo/Kconfig

# BiscuitOS Debug-stub
source package/BiscuitOS-debug-stub/Kconfig

# Address Space
source package/address-space/Kconfig

# Application Demo
source package/DemoApo/Kconfig

# arm-asm
source package/arm-asm/Kconfig

# Assembly
source package/assembly/Kconfig

# atk
source package/atk/Kconfig

# autoconf
source package/autoconf/Kconfig

# automake
source package/automake/Kconfig

# bigreqsproto
source package/bigreqsproto/Kconfig

# binutils
source package/gbinutils/Kconfig

# binutils
config PK_BINUTILS
	bool "binutils: Linux 0.x and 1.x"

# bitmap
source package/bitmap/Kconfig

# bitops
source package/bitops/Kconfig

# Broiler
source package/Broiler/Kconfig

# buddy
source package/buddy/Kconfig

# busybox
source package/busybox/Kconfig

# CACHE
source package/CACHE/Kconfig

# cairo
source package/cairo/Kconfig

# char
source package/char/Kconfig

# cmake
source package/cmake/Kconfig

# compositeproto
source package/compositeproto/Kconfig

# cpumask
source package/cpumask/Kconfig

# crash
source package/crash/Kconfig

# CMA
source package/CMA/Kconfig

# DMA
source package/DMA/Kconfig

# damageproto
source package/damageproto/Kconfig

# device-tree
source package/device-tree/Kconfig

# dr
source package/dr/Kconfig

# dri2proto
source package/dri2proto/Kconfig

# dri3proto
source package/dri3proto/Kconfig

# early-ioremap
source package/EARLY-IOREMAP/Kconfig

# expat
source package/expat/Kconfig

# filesystem
source package/filesystem/Kconfig

# FIXMAP
source package/FIXMAP/Kconfig

# fixesproto
source package/fixesproto/Kconfig

# fontconfig
source package/fontconfig/Kconfig

# fontsproto
source package/fontsproto/Kconfig

# freetype
source package/freetype/Kconfig

# glib
source package/glib/Kconfig

# glibc
source package/glibc/Kconfig

# glproto
source package/glproto/Kconfig

# gmp
source package/gmp/Kconfig

# gnutls
source package/gnutls/Kconfig

# gobject-introspection
source package/gobject-introspection/Kconfig

# gtk+
source package/gtk/Kconfig

# GUN-GCC
source package/GUN-GCC/Kconfig

config PK_GCC
	bool "GCC: Ancient linux 0.11"

# Game: 2048
source package/2048/Kconfig

# Game: snake
source package/snake/Kconfig

# Game: tetris
source package/tetris/Kconfig

# GPIO
source package/GPIO/Kconfig

# harfbuzz
source package/harfbuzz/Kconfig

# hash
source package/hash/Kconfig

# hello
source package/hello/Kconfig

# highmem
source package/highmem/Kconfig

# hugetlb and hugetlbfs
source package/hugetlb/Kconfig

# i2c
source package/i2c/Kconfig

# idr
source package/idr/Kconfig

# input
source package/input/Kconfig

# inputproto
source package/inputproto/Kconfig

# interval-tree
source package/interval-tree/Kconfig

# IO
source package/IO/Kconfig

# IOMMU
source package/IOMMU/Kconfig

# kbproto
source package/kbproto/Kconfig

# kernel hacking
source package/kernel_hacking/Kconfig

# kexec-tools
source package/kexec-tools/Kconfig

# kobject
source package/kobject/Kconfig

# kmap
source package/kmap/Kconfig

# ktime
source package/ktime/Kconfig

# kvm
source package/kvm/Kconfig

# Language
source package/language/Kconfig

# libdrm
source package/libdrm/Kconfig

# libelf
source package/libelf/Kconfig

# libepoxy
source package/libepoxy/Kconfig

# libffi
source package/libffi/Kconfig

# libfontenc
source package/libfontenc/Kconfig

# libnl
source package/libnl/Kconfig

# libpciaccess
source package/libpciaccess/Kconfig

# libpng
source package/libpng/Kconfig

# libvirt
source package/libvirt/Kconfig

# libxcb
source package/libxcb/Kconfig

# libxkbfile
source package/libxkbfile/Kconfig

# libxml2
source package/libxml2/Kconfig

# libxshmfence
source package/libxshmfence/Kconfig

# libX11
source package/libX11/Kconfig

# libXau
source package/libXau/Kconfig

# libXdamage
source package/libXdamage/Kconfig

# libXdmcp
source package/libXdmcp/Kconfig

# libXext
source package/libXext/Kconfig

# libXfixes
source package/libXfixes/Kconfig

# libXfont2
source package/libXfont2/Kconfig

# libXrender
source package/libXrender/Kconfig

# libXxf86vm
source package/libXxf86vm/Kconfig

# lock
source package/lock/Kconfig

# lzip
source package/lzip/Kconfig

# madvise
source package/madvise/Kconfig

# MCE
source package/MCE/Kconfig

# MMU
source package/MMU/Kconfig

# MMU shrink
source package/MMU_shrink/Kconfig

# memblock
source package/MEMBLOCK/Kconfig

# MM-ERROR
source package/MM-ERROR/Kconfig

# memory_history
source package/memory_history/Kconfig

# memory-sanitizers
source package/memory-sanitizers/Kconfig

# memory mapping
source package/memory-mapping/Kconfig

# Memory Mapping
source package/MEMORY-MMAP/Kconfig

# MTRR
source package/MTRR/Kconfig

# mesa
source package/mesa/Kconfig

# misc
source package/misc/Kconfig

# mmio
source package/mmio/Kconfig

# module
source package/module/Kconfig

# ncurses
source package/ncurses/Kconfig

# nettle
source package/nettle/Kconfig

# nodemask
source package/nodemask/Kconfig

# notifier
source package/notifier/Kconfig

# NUMA
source package/NUMA/Kconfig

# OOM
source package/OOM/Kconfig

# openssl
source package/openssl/Kconfig

# Page
source package/page/Kconfig

# page-fault
source package/page-fault/Kconfig

# paging
source package/paging/Kconfig

# pango
source package/pango/Kconfig

# pci
source package/pci/Kconfig

# pcre
source package/pcre/Kconfig

# percpu
source package/percpu/Kconfig

# perf
source package/PERF-TOOLS/Kconfig

# pgcache_scan
source package/pgcache_scan/Kconfig

# PIO
source package/pio/Kconfig

# pixman
source package/pixman/Kconfig

# platform
source package/platform/Kconfig

# power manager
source package/power_manager/Kconfig

# presentproto
source package/presentproto/Kconfig

# Python
source package/Python/Kconfig

# qemu-system
source package/qemu/Kconfig

# randrproto
source package/randrproto/Kconfig

# rbtree
source package/rbtree/Kconfig

# recordproto
source package/recordproto/Kconfig

# renderproto
source package/renderproto/Kconfig

# resourceproto
source package/resourceproto/Kconfig

# riscv-pk
source package/riscv-pk/Kconfig

# RaspberryPi 3B
source package/rpi-3b-bootloader/Kconfig

# RaspberryPi 4B
source package/rpi-4b-bootloader/Kconfig

# Register
source package/Register/Kconfig

# scrnsaverproto
source package/scrnsaverproto/Kconfig

# SHMEM
source package/SHMEM/Kconfig

# slab
source package/slab/Kconfig

# SMBIOS
source package/SMBIOS/Kconfig

# SMP
source package/SMP/Kconfig

# spi
source package/spi/Kconfig

# strace
source package/strace/Kconfig

# SWAP
source package/SWAP/Kconfig

# system call arm
source package/syscall/Kconfig

# tcmalloc
source package/tcmalloc/Kconfig

# transparent_hugepage
source package/THP/Kconfig

# util-linux
source package/util-linux/Kconfig

# UIO
source package/UIO/Kconfig

# VFS
source package/VFS/Kconfig

# Virtual address
source package/Virtual-Address/Kconfig

# vmalloc
source package/vmalloc/Kconfig

# videoproto
source package/videoproto/Kconfig

# workqueue
source package/workqueue/Kconfig

# xarray
source package/xarray/Kconfig

# xcb-proto
source package/xcb-proto/Kconfig

# xcmiscproto
source package/xcmiscproto/Kconfig

# xextproto
source package/xextproto/Kconfig

# xf86driproto
source package/xf86driproto/Kconfig

# xf86vidmodeproto
source package/xf86vidmodeproto/Kconfig

# xineramaproto
source package/xineramaproto/Kconfig

# xorg-server
source package/xorg-server/Kconfig

# xproto
source package/xproto/Kconfig

# xtrans
source package/xtrans/Kconfig

# zlib
source package/zlib/Kconfig

# ZONE
source package/ZONE/Kconfig

# zsmalloc
source package/zsmalloc/Kconfig

endif
```

## package/LDD_CMA_app/Kconfig
```kconfig
menuconfig PK_LDD_CMA_APP
	select PK_LDD_CMA_MOD
	bool "LDD: CMA (Contiguous Memory Allocate) Application"

if PK_LDD_CMA_APP

config PK_LDD_CMA_APP_VERSION
	default "0.0.1"
	string "verstion"

config PK_LDD_CMA_APP_TAR
	default "tar.gz"
	string "tar type"

config PK_LDD_CMA_APP_URL
	default "https://raw.githubusercontent.com/BiscuitOS/HardStack/master/Device-Driver/CMA/Base/userland"
	string "url"

config PK_LDD_CMA_APP_GITHUB
	string "GitHub"

config PK_LDD_CMA_APP_SRCFILE
	default "cma.c cma.sh Makefile"
	string "Source code list"

config PK_LDD_CMA_APP_CSRCFILE
	string "Compile source code list"

config PK_LDD_CMA_APP_CONFIG
	string "CONFIG: Project Configure Options"

config PK_LDD_CMA_APP_LIBPATH
	string "LIBS: Libraries to pass to the linker, e.g. -l<library>"

config PK_LDD_CMA_APP_CPPFLAGS
	string "CPPFLAGS: C/C++ preprocessor flags, e.g. -I<include dir>"

config PK_LDD_CMA_APP_DPKCONFIG
	string "PKG_CONFIG_PATH: Directories to add to pkg-config's search path"

config PK_LDD_CMA_APP_CFLAGS
	string "CFLAGS: C compiler flags"

config PK_LDD_CMA_APP_LDFLAGS
	string "LDFLAGS: Linker flags"

config PK_LDD_CMA_APP_CXXFLAGS
	string "CXXFLAGS: C++ compiler flags"

config PK_LDD_CMA_APP_ASFLAGS
	string "CCASFLAGS: assembler compiler flags (defaults to CFLAGS)"

config PK_LDD_CMA_APP_BUILDARCH
	string "--host options on configure for Architecture"

endif # PK_LDD_CMA_APP
```

## package/LDD_UIO_intr_app/Kconfig
```kconfig
menuconfig PK_LDD_UIO_INTR_APP
	select PK_LDD_UIO_INTR_MOD
	bool "LDD: UIO Interrupt Application"

if PK_LDD_UIO_INTR_APP

config PK_LDD_UIO_INTR_APP_VERSION
	default "0.0.1"
	string "verstion"

config PK_LDD_UIO_INTR_APP_TAR
	default "tar.gz"
	string "tar type"

config PK_LDD_UIO_INTR_APP_URL
	default "https://raw.githubusercontent.com/BiscuitOS/HardStack/master/Device-Driver/i2c/Device/UIO/Interrupt/userland"
	string "url"

config PK_LDD_UIO_INTR_APP_GITHUB
	string "GitHub"

config PK_LDD_UIO_INTR_APP_SRCFILE
	default "UIO.c Makefile"
	string "Source code list"

config PK_LDD_UIO_INTR_APP_CSRCFILE
	string "Compile source code list"

config PK_LDD_UIO_INTR_APP_CONFIG
	string "CONFIG: Project Configure Options"

config PK_LDD_UIO_INTR_APP_LIBPATH
	string "LIBS: Libraries to pass to the linker, e.g. -l<library>"

config PK_LDD_UIO_INTR_APP_CPPFLAGS
	string "CPPFLAGS: C/C++ preprocessor flags, e.g. -I<include dir>"

config PK_LDD_UIO_INTR_APP_DPKCONFIG
	string "PKG_CONFIG_PATH: Directories to add to pkg-config's search path"

config PK_LDD_UIO_INTR_APP_CFLAGS
	string "CFLAGS: C compiler flags"

config PK_LDD_UIO_INTR_APP_LDFLAGS
	string "LDFLAGS: Linker flags"

config PK_LDD_UIO_INTR_APP_CXXFLAGS
	string "CXXFLAGS: C++ compiler flags"

config PK_LDD_UIO_INTR_APP_ASFLAGS
	string "CCASFLAGS: assembler compiler flags (defaults to CFLAGS)"

config PK_LDD_UIO_INTR_APP_BUILDARCH
	string "--host options on configure for Architecture"

endif # PK_LDD_UIO_INTR_APP
```

## package/LDD_at24c08_chest/Kconfig
```kconfig
menuconfig PK_LDD_AT24C08_CHEST
	bool "LDD: AT24C08 Chest"

if PK_LDD_AT24C08_CHEST

config PK_LDD_AT24C08_CHEST_VERSION
	default "0.0.1"
	string "verstion"

config PK_LDD_AT24C08_CHEST_TAR
	default "tar.gz"
	string "tar type"

config PK_LDD_AT24C08_CHEST_URL
	default "https://gitee.com/BiscuitOS_team/HardStack/raw/Gitee/Device-Driver/i2c/Device/AT24C08/Chest"
	string "url"

config PK_LDD_AT24C08_CHEST_GITHUB
	string "GitHub"

config PK_LDD_AT24C08_CHEST_SRCFILE
	default "Makefile src/at24c08_lib.c src/chest.c src/main.c src/user_command.c include/at24c08_lib.h include/chest.h include/command.h"
	string "Source code list"

config PK_LDD_AT24C08_CHEST_CSRCFILE
	string "Compile source code list"

config PK_LDD_AT24C08_CHEST_CONFIG
	string "CONFIG: Project Configure Options"

config PK_LDD_AT24C08_CHEST_LIBPATH
	string "LIBS: Libraries to pass to the linker, e.g. -l<library>"

config PK_LDD_AT24C08_CHEST_CPPFLAGS
	string "CPPFLAGS: C/C++ preprocessor flags, e.g. -I<include dir>"

config PK_LDD_AT24C08_CHEST_DPKCONFIG
	string "PKG_CONFIG_PATH: Directories to add to pkg-config's search path"

config PK_LDD_AT24C08_CHEST_CFLAGS
	string "CFLAGS: C compiler flags"

config PK_LDD_AT24C08_CHEST_LDFLAGS
	string "LDFLAGS: Linker flags"

config PK_LDD_AT24C08_CHEST_CXXFLAGS
	string "CXXFLAGS: C++ compiler flags"

config PK_LDD_AT24C08_CHEST_ASFLAGS
	string "CCASFLAGS: assembler compiler flags (defaults to CFLAGS)"

config PK_LDD_AT24C08_CHEST_BUILDARCH
	string "--host options on configure for Architecture"

endif # PK_LDD_AT24C08_CHEST
```
