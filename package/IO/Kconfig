## package/MEMBLOCK/BiscuitOS-MEMBLOCK-MERGE-Adjacent-Diff-flags/Kconfig
```kconfig
menuconfig PK_MEMBLOCK_MERGE_ADJACENT_DF
	bool "MEMBLOCK Region: Adding Adjacent Region with Diff flags"

if PK_MEMBLOCK_MERGE_ADJACENT_DF

config PK_MEMBLOCK_MERGE_ADJACENT_DF_VERSION
	default "default"
	string "verstion"

config PK_MEMBLOCK_MERGE_ADJACENT_DF_TAR
	default "tar.gz"
	string "tar type"

config PK_MEMBLOCK_MERGE_ADJACENT_DF_URL
	default "https://gitee.com/BiscuitOS_team/HardStack/raw/Gitee/Memory-Allocator/MEMBLOCK/BiscuitOS-MEMBLOCK-MERGE-Adjacent-Diff-flags"
	string "url"

config PK_MEMBLOCK_MERGE_ADJACENT_DF_GITHUB
	string "GitHub"

config PK_MEMBLOCK_MERGE_ADJACENT_DF_SRCFILE
	default "main.c Kconfig Makefile BiscuitOS_Insert.bs"
	string "Source code list"

config PK_MEMBLOCK_MERGE_ADJACENT_DF_CSRCFILE
	string "Compile source code list"

config PK_MEMBLOCK_MERGE_ADJACENT_DF_CONFIG
	string "CONFIG: Project Configure Options"

config PK_MEMBLOCK_MERGE_ADJACENT_DF_LIBPATH
	string "LIBS: Libraries to pass to the linker, e.g. -l<library>"

config PK_MEMBLOCK_MERGE_ADJACENT_DF_CPPFLAGS
	string "CPPFLAGS: C/C++ preprocessor flags, e.g. -I<include dir>"

config PK_MEMBLOCK_MERGE_ADJACENT_DF_DPKCONFIG
	string "PKG_CONFIG_PATH: Directories to add to pkg-config's search path"

config PK_MEMBLOCK_MERGE_ADJACENT_DF_CFLAGS
	string "CFLAGS: C compiler flags"

config PK_MEMBLOCK_MERGE_ADJACENT_DF_LDFLAGS
	string "LDFLAGS: Linker flags"

config PK_MEMBLOCK_MERGE_ADJACENT_DF_CXXFLAGS
	string "CXXFLAGS: C++ compiler flags"

config PK_MEMBLOCK_MERGE_ADJACENT_DF_ASFLAGS
	string "CCASFLAGS: assembler compiler flags (defaults to CFLAGS)"

config PK_MEMBLOCK_MERGE_ADJACENT_DF_BUILDARCH
	string "--host options on configure for Architecture"

endif # PK_MEMBLOCK_MERGE_ADJACENT_DF
```

## package/MEMBLOCK/BiscuitOS-MEMBLOCK-MERGE-Adjacent/Kconfig
```kconfig
menuconfig PK_MEMBLOCK_MERGE_ADJACENT
	bool "MEMBLOCK Region: Adding Adjacent Region"

if PK_MEMBLOCK_MERGE_ADJACENT

config PK_MEMBLOCK_MERGE_ADJACENT_VERSION
	default "default"
	string "verstion"

config PK_MEMBLOCK_MERGE_ADJACENT_TAR
	default "tar.gz"
	string "tar type"

config PK_MEMBLOCK_MERGE_ADJACENT_URL
	default "https://gitee.com/BiscuitOS_team/HardStack/raw/Gitee/Memory-Allocator/MEMBLOCK/BiscuitOS-MEMBLOCK-MERGE-Adjacent"
	string "url"

config PK_MEMBLOCK_MERGE_ADJACENT_GITHUB
	string "GitHub"

config PK_MEMBLOCK_MERGE_ADJACENT_SRCFILE
	default "main.c Kconfig Makefile BiscuitOS_Insert.bs"
	string "Source code list"

config PK_MEMBLOCK_MERGE_ADJACENT_CSRCFILE
	string "Compile source code list"

config PK_MEMBLOCK_MERGE_ADJACENT_CONFIG
	string "CONFIG: Project Configure Options"

config PK_MEMBLOCK_MERGE_ADJACENT_LIBPATH
	string "LIBS: Libraries to pass to the linker, e.g. -l<library>"

config PK_MEMBLOCK_MERGE_ADJACENT_CPPFLAGS
	string "CPPFLAGS: C/C++ preprocessor flags, e.g. -I<include dir>"

config PK_MEMBLOCK_MERGE_ADJACENT_DPKCONFIG
	string "PKG_CONFIG_PATH: Directories to add to pkg-config's search path"

config PK_MEMBLOCK_MERGE_ADJACENT_CFLAGS
	string "CFLAGS: C compiler flags"

config PK_MEMBLOCK_MERGE_ADJACENT_LDFLAGS
	string "LDFLAGS: Linker flags"

config PK_MEMBLOCK_MERGE_ADJACENT_CXXFLAGS
	string "CXXFLAGS: C++ compiler flags"

config PK_MEMBLOCK_MERGE_ADJACENT_ASFLAGS
	string "CCASFLAGS: assembler compiler flags (defaults to CFLAGS)"

config PK_MEMBLOCK_MERGE_ADJACENT_BUILDARCH
	string "--host options on configure for Architecture"

endif # PK_MEMBLOCK_MERGE_ADJACENT
```

## package/MEMBLOCK/BiscuitOS-MEMBLOCK-MERGE-Intersection-Diff-flags/Kconfig
```kconfig
menuconfig PK_MEMBLOCK_MERGE_INTERSECTION_DF
	bool "MEMBLOCK Region: Adding Intersection Region with Diff flags"

if PK_MEMBLOCK_MERGE_INTERSECTION_DF

config PK_MEMBLOCK_MERGE_INTERSECTION_DF_VERSION
	default "default"
	string "verstion"

config PK_MEMBLOCK_MERGE_INTERSECTION_DF_TAR
	default "tar.gz"
	string "tar type"

config PK_MEMBLOCK_MERGE_INTERSECTION_DF_URL
	default "https://gitee.com/BiscuitOS_team/HardStack/raw/Gitee/Memory-Allocator/MEMBLOCK/BiscuitOS-MEMBLOCK-MERGE-Intersection-Diff-flags"
	string "url"

config PK_MEMBLOCK_MERGE_INTERSECTION_DF_GITHUB
	string "GitHub"

config PK_MEMBLOCK_MERGE_INTERSECTION_DF_SRCFILE
	default "main.c Kconfig Makefile BiscuitOS_Insert.bs"
	string "Source code list"

config PK_MEMBLOCK_MERGE_INTERSECTION_DF_CSRCFILE
	string "Compile source code list"

config PK_MEMBLOCK_MERGE_INTERSECTION_DF_CONFIG
	string "CONFIG: Project Configure Options"

config PK_MEMBLOCK_MERGE_INTERSECTION_DF_LIBPATH
	string "LIBS: Libraries to pass to the linker, e.g. -l<library>"

config PK_MEMBLOCK_MERGE_INTERSECTION_DF_CPPFLAGS
	string "CPPFLAGS: C/C++ preprocessor flags, e.g. -I<include dir>"

config PK_MEMBLOCK_MERGE_INTERSECTION_DF_DPKCONFIG
	string "PKG_CONFIG_PATH: Directories to add to pkg-config's search path"

config PK_MEMBLOCK_MERGE_INTERSECTION_DF_CFLAGS
	string "CFLAGS: C compiler flags"

config PK_MEMBLOCK_MERGE_INTERSECTION_DF_LDFLAGS
	string "LDFLAGS: Linker flags"

config PK_MEMBLOCK_MERGE_INTERSECTION_DF_CXXFLAGS
	string "CXXFLAGS: C++ compiler flags"

config PK_MEMBLOCK_MERGE_INTERSECTION_DF_ASFLAGS
	string "CCASFLAGS: assembler compiler flags (defaults to CFLAGS)"

config PK_MEMBLOCK_MERGE_INTERSECTION_DF_BUILDARCH
	string "--host options on configure for Architecture"

endif # PK_MEMBLOCK_MERGE_INTERSECTION_DF
```

## package/MEMBLOCK/BiscuitOS-MEMBLOCK-MERGE-Intersection/Kconfig
```kconfig
menuconfig PK_MEMBLOCK_MERGE_INTERSECTION
	bool "MEMBLOCK Region: Adding Intersection Region"

if PK_MEMBLOCK_MERGE_INTERSECTION

config PK_MEMBLOCK_MERGE_INTERSECTION_VERSION
	default "default"
	string "verstion"

config PK_MEMBLOCK_MERGE_INTERSECTION_TAR
	default "tar.gz"
	string "tar type"

config PK_MEMBLOCK_MERGE_INTERSECTION_URL
	default "https://gitee.com/BiscuitOS_team/HardStack/raw/Gitee/Memory-Allocator/MEMBLOCK/BiscuitOS-MEMBLOCK-MERGE-Intersection"
	string "url"

config PK_MEMBLOCK_MERGE_INTERSECTION_GITHUB
	string "GitHub"

config PK_MEMBLOCK_MERGE_INTERSECTION_SRCFILE
	default "main.c Kconfig Makefile BiscuitOS_Insert.bs"
	string "Source code list"

config PK_MEMBLOCK_MERGE_INTERSECTION_CSRCFILE
	string "Compile source code list"

config PK_MEMBLOCK_MERGE_INTERSECTION_CONFIG
	string "CONFIG: Project Configure Options"

config PK_MEMBLOCK_MERGE_INTERSECTION_LIBPATH
	string "LIBS: Libraries to pass to the linker, e.g. -l<library>"

config PK_MEMBLOCK_MERGE_INTERSECTION_CPPFLAGS
	string "CPPFLAGS: C/C++ preprocessor flags, e.g. -I<include dir>"

config PK_MEMBLOCK_MERGE_INTERSECTION_DPKCONFIG
	string "PKG_CONFIG_PATH: Directories to add to pkg-config's search path"

config PK_MEMBLOCK_MERGE_INTERSECTION_CFLAGS
	string "CFLAGS: C compiler flags"

config PK_MEMBLOCK_MERGE_INTERSECTION_LDFLAGS
	string "LDFLAGS: Linker flags"

config PK_MEMBLOCK_MERGE_INTERSECTION_CXXFLAGS
	string "CXXFLAGS: C++ compiler flags"

config PK_MEMBLOCK_MERGE_INTERSECTION_ASFLAGS
	string "CCASFLAGS: assembler compiler flags (defaults to CFLAGS)"

config PK_MEMBLOCK_MERGE_INTERSECTION_BUILDARCH
	string "--host options on configure for Architecture"

endif # PK_MEMBLOCK_MERGE_INTERSECTION
```

## package/MEMBLOCK/BiscuitOS-MEMBLOCK-MERGE-Separation/Kconfig
```kconfig
menuconfig PK_MEMBLOCK_MERGE_SEPARATION
	bool "MEMBLOCK Region: Adding Separation Region"

if PK_MEMBLOCK_MERGE_SEPARATION

config PK_MEMBLOCK_MERGE_SEPARATION_VERSION
	default "default"
	string "verstion"

config PK_MEMBLOCK_MERGE_SEPARATION_TAR
	default "tar.gz"
	string "tar type"

config PK_MEMBLOCK_MERGE_SEPARATION_URL
	default "https://gitee.com/BiscuitOS_team/HardStack/raw/Gitee/Memory-Allocator/MEMBLOCK/BiscuitOS-MEMBLOCK-MERGE-Separation"
	string "url"

config PK_MEMBLOCK_MERGE_SEPARATION_GITHUB
	string "GitHub"

config PK_MEMBLOCK_MERGE_SEPARATION_SRCFILE
	default "main.c Kconfig Makefile BiscuitOS_Insert.bs"
	string "Source code list"

config PK_MEMBLOCK_MERGE_SEPARATION_CSRCFILE
	string "Compile source code list"

config PK_MEMBLOCK_MERGE_SEPARATION_CONFIG
	string "CONFIG: Project Configure Options"

config PK_MEMBLOCK_MERGE_SEPARATION_LIBPATH
	string "LIBS: Libraries to pass to the linker, e.g. -l<library>"

config PK_MEMBLOCK_MERGE_SEPARATION_CPPFLAGS
	string "CPPFLAGS: C/C++ preprocessor flags, e.g. -I<include dir>"

config PK_MEMBLOCK_MERGE_SEPARATION_DPKCONFIG
	string "PKG_CONFIG_PATH: Directories to add to pkg-config's search path"

config PK_MEMBLOCK_MERGE_SEPARATION_CFLAGS
	string "CFLAGS: C compiler flags"

config PK_MEMBLOCK_MERGE_SEPARATION_LDFLAGS
	string "LDFLAGS: Linker flags"

config PK_MEMBLOCK_MERGE_SEPARATION_CXXFLAGS
	string "CXXFLAGS: C++ compiler flags"

config PK_MEMBLOCK_MERGE_SEPARATION_ASFLAGS
	string "CCASFLAGS: assembler compiler flags (defaults to CFLAGS)"

config PK_MEMBLOCK_MERGE_SEPARATION_BUILDARCH
	string "--host options on configure for Architecture"

endif # PK_MEMBLOCK_MERGE_SEPARATION
```

## package/MEMBLOCK/BiscuitOS-MEMBLOCK-MIRROR-MEMORY-lake-memory/Kconfig
```kconfig
menuconfig PK_MEMBLOCK_MIRROR_MEMORY_LAKE_MEM
	select PK_NUMA
	bool "MIRROR MEMORY: Lake Mirrorable Memory"

if PK_MEMBLOCK_MIRROR_MEMORY_LAKE_MEM

config PK_MEMBLOCK_MIRROR_MEMORY_LAKE_MEM_VERSION
	default "default"
	string "verstion"

config PK_MEMBLOCK_MIRROR_MEMORY_LAKE_MEM_TAR
	default "tar.gz"
	string "tar type"

config PK_MEMBLOCK_MIRROR_MEMORY_LAKE_MEM_URL
	default "https://gitee.com/BiscuitOS_team/HardStack/raw/Gitee/Memory-Allocator/MEMBLOCK/BiscuitOS-MEMBLOCK-MIRROR-MEMORY-lake-memory"
	string "url"

config PK_MEMBLOCK_MIRROR_MEMORY_LAKE_MEM_GITHUB
	string "GitHub"

config PK_MEMBLOCK_MIRROR_MEMORY_LAKE_MEM_SRCFILE
	default "main.c Kconfig Makefile BiscuitOS_Insert.bs"
	string "Source code list"

config PK_MEMBLOCK_MIRROR_MEMORY_LAKE_MEM_CSRCFILE
	string "Compile source code list"

config PK_MEMBLOCK_MIRROR_MEMORY_LAKE_MEM_CONFIG
	string "CONFIG: Project Configure Options"

config PK_MEMBLOCK_MIRROR_MEMORY_LAKE_MEM_LIBPATH
	string "LIBS: Libraries to pass to the linker, e.g. -l<library>"

config PK_MEMBLOCK_MIRROR_MEMORY_LAKE_MEM_CPPFLAGS
	string "CPPFLAGS: C/C++ preprocessor flags, e.g. -I<include dir>"

config PK_MEMBLOCK_MIRROR_MEMORY_LAKE_MEM_DPKCONFIG
	string "PKG_CONFIG_PATH: Directories to add to pkg-config's search path"

config PK_MEMBLOCK_MIRROR_MEMORY_LAKE_MEM_CFLAGS
	string "CFLAGS: C compiler flags"

config PK_MEMBLOCK_MIRROR_MEMORY_LAKE_MEM_LDFLAGS
	string "LDFLAGS: Linker flags"

config PK_MEMBLOCK_MIRROR_MEMORY_LAKE_MEM_CXXFLAGS
	string "CXXFLAGS: C++ compiler flags"

config PK_MEMBLOCK_MIRROR_MEMORY_LAKE_MEM_ASFLAGS
	string "CCASFLAGS: assembler compiler flags (defaults to CFLAGS)"

config PK_MEMBLOCK_MIRROR_MEMORY_LAKE_MEM_BUILDARCH
	string "--host options on configure for Architecture"

endif # PK_MEMBLOCK_MIRROR_MEMORY_LAKE_MEM
```

## package/MEMBLOCK/BiscuitOS-MEMBLOCK-MIRROR-MEMORY/Kconfig
```kconfig
menuconfig PK_MEMBLOCK_MIRROR_MEMORY
	select PK_NUMA
	bool "MIRROR MEMORY: mirror memory on MEMBLOCK"

if PK_MEMBLOCK_MIRROR_MEMORY

config PK_MEMBLOCK_MIRROR_MEMORY_VERSION
	default "default"
	string "verstion"

config PK_MEMBLOCK_MIRROR_MEMORY_TAR
	default "tar.gz"
	string "tar type"

config PK_MEMBLOCK_MIRROR_MEMORY_URL
	default "https://gitee.com/BiscuitOS_team/HardStack/raw/Gitee/Memory-Allocator/MEMBLOCK/BiscuitOS-MEMBLOCK-MIRROR-MEMORY"
	string "url"

config PK_MEMBLOCK_MIRROR_MEMORY_GITHUB
	string "GitHub"

config PK_MEMBLOCK_MIRROR_MEMORY_SRCFILE
	default "main.c Kconfig Makefile BiscuitOS_Insert.bs"
	string "Source code list"

config PK_MEMBLOCK_MIRROR_MEMORY_CSRCFILE
	string "Compile source code list"

config PK_MEMBLOCK_MIRROR_MEMORY_CONFIG
	string "CONFIG: Project Configure Options"

config PK_MEMBLOCK_MIRROR_MEMORY_LIBPATH
	string "LIBS: Libraries to pass to the linker, e.g. -l<library>"

config PK_MEMBLOCK_MIRROR_MEMORY_CPPFLAGS
	string "CPPFLAGS: C/C++ preprocessor flags, e.g. -I<include dir>"

config PK_MEMBLOCK_MIRROR_MEMORY_DPKCONFIG
	string "PKG_CONFIG_PATH: Directories to add to pkg-config's search path"

config PK_MEMBLOCK_MIRROR_MEMORY_CFLAGS
	string "CFLAGS: C compiler flags"

config PK_MEMBLOCK_MIRROR_MEMORY_LDFLAGS
	string "LDFLAGS: Linker flags"

config PK_MEMBLOCK_MIRROR_MEMORY_CXXFLAGS
	string "CXXFLAGS: C++ compiler flags"

config PK_MEMBLOCK_MIRROR_MEMORY_ASFLAGS
	string "CCASFLAGS: assembler compiler flags (defaults to CFLAGS)"

config PK_MEMBLOCK_MIRROR_MEMORY_BUILDARCH
	string "--host options on configure for Architecture"

endif # PK_MEMBLOCK_MIRROR_MEMORY
```

## package/MEMBLOCK/BiscuitOS-MEMBLOCK-NOMAP-IOREMAP/Kconfig
```kconfig
menuconfig PK_MEMBLOCK_NOMAP_IOREMAP
	bool "MEMBLOCK NOMAP Memory with ioremap"

if PK_MEMBLOCK_NOMAP_IOREMAP

config PK_MEMBLOCK_NOMAP_IOREMAP_VERSION
	default "default"
	string "verstion"

config PK_MEMBLOCK_NOMAP_IOREMAP_TAR
	default "tar.gz"
	string "tar type"

config PK_MEMBLOCK_NOMAP_IOREMAP_URL
	default "https://gitee.com/BiscuitOS_team/HardStack/raw/Gitee/Memory-Allocator/MEMBLOCK/BiscuitOS-MEMBLOCK-NOMAP-IOREMAP"
	string "url"

config PK_MEMBLOCK_NOMAP_IOREMAP_GITHUB
	string "GitHub"

config PK_MEMBLOCK_NOMAP_IOREMAP_SRCFILE
	default "main.c Kconfig Makefile"
	string "Source code list"

config PK_MEMBLOCK_NOMAP_IOREMAP_CSRCFILE
	string "Compile source code list"

config PK_MEMBLOCK_NOMAP_IOREMAP_CONFIG
	string "CONFIG: Project Configure Options"

config PK_MEMBLOCK_NOMAP_IOREMAP_LIBPATH
	string "LIBS: Libraries to pass to the linker, e.g. -l<library>"

config PK_MEMBLOCK_NOMAP_IOREMAP_CPPFLAGS
	string "CPPFLAGS: C/C++ preprocessor flags, e.g. -I<include dir>"

config PK_MEMBLOCK_NOMAP_IOREMAP_DPKCONFIG
	string "PKG_CONFIG_PATH: Directories to add to pkg-config's search path"

config PK_MEMBLOCK_NOMAP_IOREMAP_CFLAGS
	string "CFLAGS: C compiler flags"

config PK_MEMBLOCK_NOMAP_IOREMAP_LDFLAGS
	string "LDFLAGS: Linker flags"

config PK_MEMBLOCK_NOMAP_IOREMAP_CXXFLAGS
	string "CXXFLAGS: C++ compiler flags"

config PK_MEMBLOCK_NOMAP_IOREMAP_ASFLAGS
	string "CCASFLAGS: assembler compiler flags (defaults to CFLAGS)"

config PK_MEMBLOCK_NOMAP_IOREMAP_BUILDARCH
	string "--host options on configure for Architecture"

endif # PK_MEMBLOCK_NOMAP_IOREMAP
```
