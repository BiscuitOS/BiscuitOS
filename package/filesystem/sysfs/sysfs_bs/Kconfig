## package/filesystem/sysfs/sysfs_bs/Kconfig
```kconfig
menuconfig PK_SYSFS_BS
	select PK_STRACE
	select PK_SYSCALL
	select PK_SYS_OPEN
	select PK_SYS_OPEN_C
	select PK_SYS_OPEN_GETNAME
	select PK_SYS_OPEN_NUMBER
	select PK_SYS_CLOSE
	select PK_SYS_CLOSE_C
	select PK_SYS_MOUNT
	select PK_SYS_MOUNT_C
	bool "sysfs (BiscuitOS Tracking)"

if PK_SYSFS_BS

config PK_SYSFS_BS_VERSION
	default "0.0.1"
	string "verstion"

config PK_SYSFS_BS_TAR
	default "tar.gz"
	string "tar type"

config PK_SYSFS_BS_URL
	default "https://gitee.com/BiscuitOS_team/HardStack/raw/Gitee/fs/sysfs/sysfs_bs"
	string "url"

config PK_SYSFS_BS_GITHUB
	string "GitHub"

config PK_SYSFS_BS_SRCFILE
	default "README.md RunBiscuitOS_sysfs.sh Makefile mount.c internal.h"
	string "Source code list"

config PK_SYSFS_BS_CSRCFILE
	string "Compile source code list"

config PK_SYSFS_BS_CONFIG
	string "CONFIG: Project Configure Options"

config PK_SYSFS_BS_LIBPATH
	string "LIBS: Libraries to pass to the linker, e.g. -l<library>"

config PK_SYSFS_BS_CPPFLAGS
	string "CPPFLAGS: C/C++ preprocessor flags, e.g. -I<include dir>"

config PK_SYSFS_BS_DPKCONFIG
	string "PKG_CONFIG_PATH: Directories to add to pkg-config's search path"

config PK_SYSFS_BS_CFLAGS
	string "CFLAGS: C compiler flags"

config PK_SYSFS_BS_LDFLAGS
	string "LDFLAGS: Linker flags"

config PK_SYSFS_BS_CXXFLAGS
	string "CXXFLAGS: C++ compiler flags"

config PK_SYSFS_BS_ASFLAGS
	string "CCASFLAGS: assembler compiler flags (defaults to CFLAGS)"

config PK_SYSFS_BS_BUILDARCH
	string "--host options on configure for Architecture"

endif # PK_SYSFS_BS
```

## package/filesystem/sysfs/sysfs_module/Kconfig
```kconfig
menuconfig PK_FS_SYSFS_MOD
	bool "sysfs module"

if PK_FS_SYSFS_MOD

config PK_FS_SYSFS_MOD_VERSION
	default "0.0.1"
	string "verstion"

config PK_FS_SYSFS_MOD_TAR
	default "tar.gz"
	string "tar type"

config PK_FS_SYSFS_MOD_URL
	default "https://gitee.com/BiscuitOS_team/HardStack/raw/Gitee/fs/sysfs/module"
	string "url"

config PK_FS_SYSFS_MOD_GITHUB
	string "GitHub"

config PK_FS_SYSFS_MOD_SRCFILE
	default "bsfs/dir.c bsfs/file.c bsfs/symlink.c bsfs/inode.c bsfs/mount.c core.c bsvfs/mount.c include/linux/bsfs.h include/linux/bsvfs.h Kconfig Makefile"
	string "Source code list"

config PK_FS_SYSFS_MOD_CSRCFILE
	string "Compile source code list"

config PK_FS_SYSFS_MOD_CONFIG
	string "CONFIG: Project Configure Options"

config PK_FS_SYSFS_MOD_LIBPATH
	string "LIBS: Libraries to pass to the linker, e.g. -l<library>"

config PK_FS_SYSFS_MOD_CPPFLAGS
	string "CPPFLAGS: C/C++ preprocessor flags, e.g. -I<include dir>"

config PK_FS_SYSFS_MOD_DPKCONFIG
	string "PKG_CONFIG_PATH: Directories to add to pkg-config's search path"

config PK_FS_SYSFS_MOD_CFLAGS
	string "CFLAGS: C compiler flags"

config PK_FS_SYSFS_MOD_LDFLAGS
	string "LDFLAGS: Linker flags"

config PK_FS_SYSFS_MOD_CXXFLAGS
	string "CXXFLAGS: C++ compiler flags"

config PK_FS_SYSFS_MOD_ASFLAGS
	string "CCASFLAGS: assembler compiler flags (defaults to CFLAGS)"

config PK_FS_SYSFS_MOD_BUILDARCH
	string "--host options on configure for Architecture"

endif # PK_FS_SYSFS_MOD
```

## package/filesystem/tmpfs/Kconfig
```kconfig
menuconfig PK_FS_TMPFS
	bool "tmpfs"

if PK_FS_TMPFS

# tmpfs_bs
source "package/filesystem/tmpfs/tmpfs_bs/Kconfig"

endif # PK_FS_TMPFS
```

## package/filesystem/tmpfs/tmpfs_bs/Kconfig
```kconfig
menuconfig PK_TMPFS_BS
	select PK_SYSCALL
	select PK_SYS_CLOSE
	select PK_SYS_CLOSE_C
	select PK_SYS_OPEN
	select PK_SYS_OPEN_C
	select PK_SYS_MKDIR
	select PK_SYS_MKDIR_C
	select PK_SYS_MOUNT
	select PK_SYS_MOUNT_C
	select PK_SYS_READ
	select PK_SYS_READ_C
	select PK_SYS_WRITE
	select PK_SYS_WRITE_C
	select PK_STRACE
	bool "tmpfs_bs"

if PK_TMPFS_BS

config PK_TMPFS_BS_VERSION
	default "0.0.1"
	string "verstion"

config PK_TMPFS_BS_TAR
	default "tar.gz"
	string "tar type"

config PK_TMPFS_BS_URL
	default "https://gitee.com/BiscuitOS_team/HardStack/raw/Gitee/fs/tmpfs/tmpfs_bs"
	string "url"

config PK_TMPFS_BS_GITHUB
	string "GitHub"

config PK_TMPFS_BS_SRCFILE
	default "README.md RunBiscuitOS_ftrace.sh inode.c shmem.c internal.h Makefile"
	string "Source code list"

config PK_TMPFS_BS_CSRCFILE
	string "Compile source code list"

config PK_TMPFS_BS_CONFIG
	string "CONFIG: Project Configure Options"

config PK_TMPFS_BS_LIBPATH
	string "LIBS: Libraries to pass to the linker, e.g. -l<library>"

config PK_TMPFS_BS_CPPFLAGS
	string "CPPFLAGS: C/C++ preprocessor flags, e.g. -I<include dir>"

config PK_TMPFS_BS_DPKCONFIG
	string "PKG_CONFIG_PATH: Directories to add to pkg-config's search path"

config PK_TMPFS_BS_CFLAGS
	string "CFLAGS: C compiler flags"

config PK_TMPFS_BS_LDFLAGS
	string "LDFLAGS: Linker flags"

config PK_TMPFS_BS_CXXFLAGS
	string "CXXFLAGS: C++ compiler flags"

config PK_TMPFS_BS_ASFLAGS
	string "CCASFLAGS: assembler compiler flags (defaults to CFLAGS)"

config PK_TMPFS_BS_BUILDARCH
	string "--host options on configure for Architecture"

endif # PK_TMPFS_BS
```

## package/filesystem/vfs/Kconfig
```kconfig
menuconfig PK_FS_VFS
	bool "VFS: Linux Virtual Filesystem"

if PK_FS_VFS

# d_alloc
source "package/filesystem/vfs/d_alloc/Kconfig"

# d_alloc_anon
source "package/filesystem/vfs/d_alloc_anon/Kconfig"

# get_fs_type
source "package/filesystem/vfs/get_fs_type/Kconfig"

# inode_init_owner
source "package/filesystem/vfs/inode_init_owner/Kconfig"

# new_inode
source "package/filesystem/vfs/new_inode/Kconfig"

# sget
source "package/filesystem/vfs/sget/Kconfig"

# user_path app
source "package/filesystem/vfs/user_path_app/Kconfig"

# user_path module
source "package/filesystem/vfs/user_path_mod/Kconfig"

# user_path_at_empty app
source "package/filesystem/vfs/user_path_at_empty_app/Kconfig"

# user_path_at_empty module
source "package/filesystem/vfs/user_path_at_empty_mod/Kconfig"

endif # PK_FS_VFS
```

## package/filesystem/vfs/d_alloc/Kconfig
```kconfig
menuconfig PK_FS_D_ALLOC
	bool "d_alloc()"

if PK_FS_D_ALLOC

config PK_FS_D_ALLOC_VERSION
	default "0.0.1"
	string "verstion"

config PK_FS_D_ALLOC_TAR
	default "tar.gz"
	string "tar type"

config PK_FS_D_ALLOC_URL
	default "https://gitee.com/BiscuitOS_team/HardStack/raw/Gitee/fs/vfs/API/d_alloc"
	string "url"

config PK_FS_D_ALLOC_GITHUB
	string "GitHub"

config PK_FS_D_ALLOC_SRCFILE
	default "core.c Kconfig Makefile"
	string "Source code list"

config PK_FS_D_ALLOC_CSRCFILE
	string "Compile source code list"

config PK_FS_D_ALLOC_CONFIG
	string "CONFIG: Project Configure Options"

config PK_FS_D_ALLOC_LIBPATH
	string "LIBS: Libraries to pass to the linker, e.g. -l<library>"

config PK_FS_D_ALLOC_CPPFLAGS
	string "CPPFLAGS: C/C++ preprocessor flags, e.g. -I<include dir>"

config PK_FS_D_ALLOC_DPKCONFIG
	string "PKG_CONFIG_PATH: Directories to add to pkg-config's search path"

config PK_FS_D_ALLOC_CFLAGS
	string "CFLAGS: C compiler flags"

config PK_FS_D_ALLOC_LDFLAGS
	string "LDFLAGS: Linker flags"

config PK_FS_D_ALLOC_CXXFLAGS
	string "CXXFLAGS: C++ compiler flags"

config PK_FS_D_ALLOC_ASFLAGS
	string "CCASFLAGS: assembler compiler flags (defaults to CFLAGS)"

config PK_FS_D_ALLOC_BUILDARCH
	string "--host options on configure for Architecture"

endif # PK_FS_D_ALLOC
```

## package/filesystem/vfs/d_alloc_anon/Kconfig
```kconfig
menuconfig PK_FS_D_ALLOC_ANON
	bool "d_alloc_anon()"

if PK_FS_D_ALLOC_ANON

config PK_FS_D_ALLOC_ANON_VERSION
	default "0.0.1"
	string "verstion"

config PK_FS_D_ALLOC_ANON_TAR
	default "tar.gz"
	string "tar type"

config PK_FS_D_ALLOC_ANON_URL
	default "https://gitee.com/BiscuitOS_team/HardStack/raw/Gitee/fs/vfs/API/d_alloc_anon"
	string "url"

config PK_FS_D_ALLOC_ANON_GITHUB
	string "GitHub"

config PK_FS_D_ALLOC_ANON_SRCFILE
	default "core.c Kconfig Makefile"
	string "Source code list"

config PK_FS_D_ALLOC_ANON_CSRCFILE
	string "Compile source code list"

config PK_FS_D_ALLOC_ANON_CONFIG
	string "CONFIG: Project Configure Options"

config PK_FS_D_ALLOC_ANON_LIBPATH
	string "LIBS: Libraries to pass to the linker, e.g. -l<library>"

config PK_FS_D_ALLOC_ANON_CPPFLAGS
	string "CPPFLAGS: C/C++ preprocessor flags, e.g. -I<include dir>"

config PK_FS_D_ALLOC_ANON_DPKCONFIG
	string "PKG_CONFIG_PATH: Directories to add to pkg-config's search path"

config PK_FS_D_ALLOC_ANON_CFLAGS
	string "CFLAGS: C compiler flags"

config PK_FS_D_ALLOC_ANON_LDFLAGS
	string "LDFLAGS: Linker flags"

config PK_FS_D_ALLOC_ANON_CXXFLAGS
	string "CXXFLAGS: C++ compiler flags"

config PK_FS_D_ALLOC_ANON_ASFLAGS
	string "CCASFLAGS: assembler compiler flags (defaults to CFLAGS)"

config PK_FS_D_ALLOC_ANON_BUILDARCH
	string "--host options on configure for Architecture"

endif # PK_FS_D_ALLOC_ANON
```

## package/filesystem/vfs/dcache_hash/Kconfig
```kconfig
menuconfig PK_DCACHE_HASH
	bool "dcache_hash algorithm"

if PK_DCACHE_HASH

config PK_DCACHE_HASH_VERSION
	default "0.0.1"
	string "verstion"

config PK_DCACHE_HASH_TAR
	default "tar.gz"
	string "tar type"

config PK_DCACHE_HASH_URL
	default "https://gitee.com/BiscuitOS_team/HardStack/raw/Gitee/fs/sysfs/API/dcache_hash"
	string "url"

config PK_DCACHE_HASH_GITHUB
	string "GitHub"

config PK_DCACHE_HASH_SRCFILE
	default "core.c Kconfig Makefile"
	string "Source code list"

config PK_DCACHE_HASH_CSRCFILE
	string "Compile source code list"

config PK_DCACHE_HASH_CONFIG
	string "CONFIG: Project Configure Options"

config PK_DCACHE_HASH_LIBPATH
	string "LIBS: Libraries to pass to the linker, e.g. -l<library>"

config PK_DCACHE_HASH_CPPFLAGS
	string "CPPFLAGS: C/C++ preprocessor flags, e.g. -I<include dir>"

config PK_DCACHE_HASH_DPKCONFIG
	string "PKG_CONFIG_PATH: Directories to add to pkg-config's search path"

config PK_DCACHE_HASH_CFLAGS
	string "CFLAGS: C compiler flags"

config PK_DCACHE_HASH_LDFLAGS
	string "LDFLAGS: Linker flags"

config PK_DCACHE_HASH_CXXFLAGS
	string "CXXFLAGS: C++ compiler flags"

config PK_DCACHE_HASH_ASFLAGS
	string "CCASFLAGS: assembler compiler flags (defaults to CFLAGS)"

config PK_DCACHE_HASH_BUILDARCH
	string "--host options on configure for Architecture"

endif # PK_DCACHE_HASH
```

## package/filesystem/vfs/get_fs_type/Kconfig
```kconfig
menuconfig PK_FS_GET_FS_TYPE
	bool "get_fs_type()"

if PK_FS_GET_FS_TYPE

config PK_FS_GET_FS_TYPE_VERSION
	default "0.0.1"
	string "verstion"

config PK_FS_GET_FS_TYPE_TAR
	default "tar.gz"
	string "tar type"

config PK_FS_GET_FS_TYPE_URL
	default "https://gitee.com/BiscuitOS_team/HardStack/raw/Gitee/fs/vfs/API/get_fs_type"
	string "url"

config PK_FS_GET_FS_TYPE_GITHUB
	string "GitHub"

config PK_FS_GET_FS_TYPE_SRCFILE
	default "core.c Kconfig Makefile"
	string "Source code list"

config PK_FS_GET_FS_TYPE_CSRCFILE
	string "Compile source code list"

config PK_FS_GET_FS_TYPE_CONFIG
	string "CONFIG: Project Configure Options"

config PK_FS_GET_FS_TYPE_LIBPATH
	string "LIBS: Libraries to pass to the linker, e.g. -l<library>"

config PK_FS_GET_FS_TYPE_CPPFLAGS
	string "CPPFLAGS: C/C++ preprocessor flags, e.g. -I<include dir>"

config PK_FS_GET_FS_TYPE_DPKCONFIG
	string "PKG_CONFIG_PATH: Directories to add to pkg-config's search path"

config PK_FS_GET_FS_TYPE_CFLAGS
	string "CFLAGS: C compiler flags"

config PK_FS_GET_FS_TYPE_LDFLAGS
	string "LDFLAGS: Linker flags"

config PK_FS_GET_FS_TYPE_CXXFLAGS
	string "CXXFLAGS: C++ compiler flags"

config PK_FS_GET_FS_TYPE_ASFLAGS
	string "CCASFLAGS: assembler compiler flags (defaults to CFLAGS)"

config PK_FS_GET_FS_TYPE_BUILDARCH
	string "--host options on configure for Architecture"

endif # PK_FS_GET_FS_TYPE
```

## package/filesystem/vfs/inode_init_owner/Kconfig
```kconfig
menuconfig PK_FS_INODE_INIT_OWNER
	bool "inode_init_owner()"

if PK_FS_INODE_INIT_OWNER

config PK_FS_INODE_INIT_OWNER_VERSION
	default "0.0.1"
	string "verstion"

config PK_FS_INODE_INIT_OWNER_TAR
	default "tar.gz"
	string "tar type"

config PK_FS_INODE_INIT_OWNER_URL
	default "https://gitee.com/BiscuitOS_team/HardStack/raw/Gitee/fs/vfs/API/inode_init_owner"
	string "url"

config PK_FS_INODE_INIT_OWNER_GITHUB
	string "GitHub"

config PK_FS_INODE_INIT_OWNER_SRCFILE
	default "core.c Kconfig Makefile"
	string "Source code list"

config PK_FS_INODE_INIT_OWNER_CSRCFILE
	string "Compile source code list"

config PK_FS_INODE_INIT_OWNER_CONFIG
	string "CONFIG: Project Configure Options"

config PK_FS_INODE_INIT_OWNER_LIBPATH
	string "LIBS: Libraries to pass to the linker, e.g. -l<library>"

config PK_FS_INODE_INIT_OWNER_CPPFLAGS
	string "CPPFLAGS: C/C++ preprocessor flags, e.g. -I<include dir>"

config PK_FS_INODE_INIT_OWNER_DPKCONFIG
	string "PKG_CONFIG_PATH: Directories to add to pkg-config's search path"

config PK_FS_INODE_INIT_OWNER_CFLAGS
	string "CFLAGS: C compiler flags"

config PK_FS_INODE_INIT_OWNER_LDFLAGS
	string "LDFLAGS: Linker flags"

config PK_FS_INODE_INIT_OWNER_CXXFLAGS
	string "CXXFLAGS: C++ compiler flags"

config PK_FS_INODE_INIT_OWNER_ASFLAGS
	string "CCASFLAGS: assembler compiler flags (defaults to CFLAGS)"

config PK_FS_INODE_INIT_OWNER_BUILDARCH
	string "--host options on configure for Architecture"

endif # PK_FS_INODE_INIT_OWNER
```

## package/filesystem/vfs/new_inode/Kconfig
```kconfig
menuconfig PK_FS_NEW_INODE
	bool "new_inode()"

if PK_FS_NEW_INODE

config PK_FS_NEW_INODE_VERSION
	default "0.0.1"
	string "verstion"

config PK_FS_NEW_INODE_TAR
	default "tar.gz"
	string "tar type"

config PK_FS_NEW_INODE_URL
	default "https://gitee.com/BiscuitOS_team/HardStack/raw/Gitee/fs/vfs/API/new_inode"
	string "url"

config PK_FS_NEW_INODE_GITHUB
	string "GitHub"

config PK_FS_NEW_INODE_SRCFILE
	default "core.c Kconfig Makefile"
	string "Source code list"

config PK_FS_NEW_INODE_CSRCFILE
	string "Compile source code list"

config PK_FS_NEW_INODE_CONFIG
	string "CONFIG: Project Configure Options"

config PK_FS_NEW_INODE_LIBPATH
	string "LIBS: Libraries to pass to the linker, e.g. -l<library>"

config PK_FS_NEW_INODE_CPPFLAGS
	string "CPPFLAGS: C/C++ preprocessor flags, e.g. -I<include dir>"

config PK_FS_NEW_INODE_DPKCONFIG
	string "PKG_CONFIG_PATH: Directories to add to pkg-config's search path"

config PK_FS_NEW_INODE_CFLAGS
	string "CFLAGS: C compiler flags"

config PK_FS_NEW_INODE_LDFLAGS
	string "LDFLAGS: Linker flags"

config PK_FS_NEW_INODE_CXXFLAGS
	string "CXXFLAGS: C++ compiler flags"

config PK_FS_NEW_INODE_ASFLAGS
	string "CCASFLAGS: assembler compiler flags (defaults to CFLAGS)"

config PK_FS_NEW_INODE_BUILDARCH
	string "--host options on configure for Architecture"

endif # PK_FS_NEW_INODE
```

## package/filesystem/vfs/sget/Kconfig
```kconfig
menuconfig PK_FS_SGET
	bool "sget()"

if PK_FS_SGET

config PK_FS_SGET_VERSION
	default "0.0.1"
	string "verstion"

config PK_FS_SGET_TAR
	default "tar.gz"
	string "tar type"

config PK_FS_SGET_URL
	default "https://gitee.com/BiscuitOS_team/HardStack/raw/Gitee/fs/vfs/API/sget"
	string "url"

config PK_FS_SGET_GITHUB
	string "GitHub"

config PK_FS_SGET_SRCFILE
	default "core.c Kconfig Makefile"
	string "Source code list"

config PK_FS_SGET_CSRCFILE
	string "Compile source code list"

config PK_FS_SGET_CONFIG
	string "CONFIG: Project Configure Options"

config PK_FS_SGET_LIBPATH
	string "LIBS: Libraries to pass to the linker, e.g. -l<library>"

config PK_FS_SGET_CPPFLAGS
	string "CPPFLAGS: C/C++ preprocessor flags, e.g. -I<include dir>"

config PK_FS_SGET_DPKCONFIG
	string "PKG_CONFIG_PATH: Directories to add to pkg-config's search path"

config PK_FS_SGET_CFLAGS
	string "CFLAGS: C compiler flags"

config PK_FS_SGET_LDFLAGS
	string "LDFLAGS: Linker flags"

config PK_FS_SGET_CXXFLAGS
	string "CXXFLAGS: C++ compiler flags"

config PK_FS_SGET_ASFLAGS
	string "CCASFLAGS: assembler compiler flags (defaults to CFLAGS)"

config PK_FS_SGET_BUILDARCH
	string "--host options on configure for Architecture"

endif # PK_FS_SGET
```
