## package/filesystem/vfs/user_path_at_empty_app/Kconfig
```kconfig
menuconfig PK_USER_PATH_AT_EMPTY_APP
	select PK_USER_PATH_AT_EMPTY_MOD
	bool "user_path_at_empty() Appliacation"

if PK_USER_PATH_AT_EMPTY_APP

config PK_USER_PATH_AT_EMPTY_APP_VERSION
	default "0.0.1"
	string "verstion"

config PK_USER_PATH_AT_EMPTY_APP_TAR
	default "tar.gz"
	string "tar type"

config PK_USER_PATH_AT_EMPTY_APP_URL
	default "https://gitee.com/BiscuitOS_team/HardStack/raw/Gitee/fs/vfs/API/user_path_at_empty/userland"
	string "url"

config PK_USER_PATH_AT_EMPTY_APP_GITHUB
	string "GitHub"

config PK_USER_PATH_AT_EMPTY_APP_SRCFILE
	default "core.c Makefile"
	string "Source code list"

config PK_USER_PATH_AT_EMPTY_APP_CSRCFILE
	string "Compile source code list"

config PK_USER_PATH_AT_EMPTY_APP_CONFIG
	string "CONFIG: Project Configure Options"

config PK_USER_PATH_AT_EMPTY_APP_LIBPATH
	string "LIBS: Libraries to pass to the linker, e.g. -l<library>"

config PK_USER_PATH_AT_EMPTY_APP_CPPFLAGS
	string "CPPFLAGS: C/C++ preprocessor flags, e.g. -I<include dir>"

config PK_USER_PATH_AT_EMPTY_APP_DPKCONFIG
	string "PKG_CONFIG_PATH: Directories to add to pkg-config's search path"

config PK_USER_PATH_AT_EMPTY_APP_CFLAGS
	string "CFLAGS: C compiler flags"

config PK_USER_PATH_AT_EMPTY_APP_LDFLAGS
	string "LDFLAGS: Linker flags"

config PK_USER_PATH_AT_EMPTY_APP_CXXFLAGS
	string "CXXFLAGS: C++ compiler flags"

config PK_USER_PATH_AT_EMPTY_APP_ASFLAGS
	string "CCASFLAGS: assembler compiler flags (defaults to CFLAGS)"

config PK_USER_PATH_AT_EMPTY_APP_BUILDARCH
	string "--host options on configure for Architecture"

endif # PK_USER_PATH_AT_EMPTY_APP
```

## package/filesystem/vfs/user_path_at_empty_mod/Kconfig
```kconfig
menuconfig PK_USER_PATH_AT_EMPTY_MOD
	bool "user_path_at_empty() module"

if PK_USER_PATH_AT_EMPTY_MOD

config PK_USER_PATH_AT_EMPTY_MOD_VERSION
	default "0.0.1"
	string "verstion"

config PK_USER_PATH_AT_EMPTY_MOD_TAR
	default "tar.gz"
	string "tar type"

config PK_USER_PATH_AT_EMPTY_MOD_URL
	default "https://gitee.com/BiscuitOS_team/HardStack/raw/Gitee/fs/vfs/API/user_path_at_empty/kernel"
	string "url"

config PK_USER_PATH_AT_EMPTY_MOD_GITHUB
	string "GitHub"

config PK_USER_PATH_AT_EMPTY_MOD_SRCFILE
	default "core.c Kconfig Makefile"
	string "Source code list"

config PK_USER_PATH_AT_EMPTY_MOD_CSRCFILE
	string "Compile source code list"

config PK_USER_PATH_AT_EMPTY_MOD_CONFIG
	string "CONFIG: Project Configure Options"

config PK_USER_PATH_AT_EMPTY_MOD_LIBPATH
	string "LIBS: Libraries to pass to the linker, e.g. -l<library>"

config PK_USER_PATH_AT_EMPTY_MOD_CPPFLAGS
	string "CPPFLAGS: C/C++ preprocessor flags, e.g. -I<include dir>"

config PK_USER_PATH_AT_EMPTY_MOD_DPKCONFIG
	string "PKG_CONFIG_PATH: Directories to add to pkg-config's search path"

config PK_USER_PATH_AT_EMPTY_MOD_CFLAGS
	string "CFLAGS: C compiler flags"

config PK_USER_PATH_AT_EMPTY_MOD_LDFLAGS
	string "LDFLAGS: Linker flags"

config PK_USER_PATH_AT_EMPTY_MOD_CXXFLAGS
	string "CXXFLAGS: C++ compiler flags"

config PK_USER_PATH_AT_EMPTY_MOD_ASFLAGS
	string "CCASFLAGS: assembler compiler flags (defaults to CFLAGS)"

config PK_USER_PATH_AT_EMPTY_MOD_BUILDARCH
	string "--host options on configure for Architecture"

endif # PK_USER_PATH_AT_EMPTY_MOD
```

## package/fontconfig/Kconfig
```kconfig
menuconfig PK_FONTCONFIG
	bool "fontconfig"

if PK_FONTCONFIG

config PK_FONTCONFIG_VERSION
	default "2.12.4"
	string "verstion"

config PK_FONTCONFIG_TAR
	default "tar.gz"
	string "tar type"

config PK_FONTCONFIG_URL
	default "https://www.freedesktop.org/software/fontconfig/release/"
	string "url"

config PK_FONTCONFIG_GITHUB
	string "GitHub"

config PK_FONTCONFIG_SRCFILE
	string "Source code list"

config PK_FONTCONFIG_CONFIG
	default "--enable-silent-rules --disable-static"
	string "CONFIG: Project Configure Options"

config PK_FONTCONFIG_LIBPATH
	string "LIBS: Libraries to pass to the linker, e.g. -l<library>"

config PK_FONTCONFIG_CPPFLAGS
	string "CPPFLAGS: C/C++ preprocessor flags, e.g. -I<include dir>"

config PK_FONTCONFIG_DPKCONFIG
	string "PKG_CONFIG_PATH: Directories to add to pkg-config's search path"

config PK_FONTCONFIG_CFLAGS
	string "CFLAGS: C compiler flags"

config PK_FONTCONFIG_LDFLAGS
	string "LDFLAGS: Linker flags"

config PK_FONTCONFIG_CXXFLAGS
	string "CXXFLAGS: C++ compiler flags"

config PK_FONTCONFIG_ASFLAGS
	string "CCASFLAGS: assembler compiler flags (defaults to CFLAGS)"

config PK_FONTCONFIG_BUILDARCH
	default "x86_64-unknown-linux-gnu"
	string "--host options on configure for Architecture"

endif # PK_FONTCONFIG
```

## package/fontsproto/Kconfig
```kconfig
menuconfig PK_FONTSPROTO
	bool "fontsproto"

if PK_FONTSPROTO

config PK_FONTSPROTO_VERSION
	default "2.1.3"
	string "verstion"

config PK_FONTSPROTO_TAR
	default "tar.gz"
	string "tar type"

config PK_FONTSPROTO_URL
	default "https://www.x.org/releases/individual/proto/"
	string "url"

config PK_FONTSPROTO_GITHUB
	string "GitHub"

config PK_FONTSPROTO_SRCFILE
	string "Source code list"

config PK_FONTSPROTO_CONFIG
	default "--enable-silent-rules --disable-static"
	string "CONFIG: Project Configure Options"

config PK_FONTSPROTO_LIBPATH
	string "LIBS: Libraries to pass to the linker, e.g. -l<library>"

config PK_FONTSPROTO_CPPFLAGS
	string "CPPFLAGS: C/C++ preprocessor flags, e.g. -I<include dir>"

config PK_FONTSPROTO_DPKCONFIG
	string "PKG_CONFIG_PATH: Directories to add to pkg-config's search path"

config PK_FONTSPROTO_CFLAGS
	string "CFLAGS: C compiler flags"

config PK_FONTSPROTO_LDFLAGS
	string "LDFLAGS: Linker flags"

config PK_FONTSPROTO_CXXFLAGS
	string "CXXFLAGS: C++ compiler flags"

config PK_FONTSPROTO_ASFLAGS
	string "CCASFLAGS: assembler compiler flags (defaults to CFLAGS)"

config PK_FONTSPROTO_BUILDARCH
	default "x86_64-unknown-linux-gnu"
	string "--host options on configure for Architecture"

endif # PK_FONTSPROTO
```

## package/freetype/Kconfig
```kconfig
menuconfig PK_FREETYPE
	select PK_ZLIB
	bool "freetype"

if PK_FREETYPE

config PK_FREETYPE_VERSION
	default "2.8"
	string "verstion"

config PK_FREETYPE_TAR
	default "tar.gz"
	string "tar type"

config PK_FREETYPE_URL
	default "https://download.savannah.gnu.org/releases/freetype/"
	string "url"

config PK_FREETYPE_GITHUB
	string "GitHub"

config PK_FREETYPE_SRCFILE
	string "Source code list"

config PK_FREETYPE_CONFIG
	default "--enable-silent-rules --disable-static"
	string "CONFIG: Project Configure Options"

config PK_FREETYPE_LIBPATH
	string "LIBS: Libraries to pass to the linker, e.g. -l<library>"

config PK_FREETYPE_CPPFLAGS
	string "CPPFLAGS: C/C++ preprocessor flags, e.g. -I<include dir>"

config PK_FREETYPE_DPKCONFIG
	string "PKG_CONFIG_PATH: Directories to add to pkg-config's search path"

config PK_FREETYPE_CFLAGS
	string "CFLAGS: C compiler flags"

config PK_FREETYPE_LDFLAGS
	string "LDFLAGS: Linker flags"

config PK_FREETYPE_CXXFLAGS
	string "CXXFLAGS: C++ compiler flags"

config PK_FREETYPE_ASFLAGS
	string "CCASFLAGS: assembler compiler flags (defaults to CFLAGS)"

config PK_FREETYPE_BUILDARCH
	default "x86_64-unknown-linux-gnu"
	string "--host options on configure for Architecture"

endif # PK_FREETYPE
```

## package/game_tetris/Kconfig
```kconfig
menuconfig PK_GAME_TETRIS
	select PK_GNU_NCURSES
	bool "Game  tetris"

if PK_GAME_TETRIS

config GAME_TETRIS_VERSION
	default "0.11"
	string "verstion"

config GAME_TETRIS_TAR
	string "tar type"

config GAME_TETRIS_URL
	default "https://raw.githubusercontent.com/BiscuitOS/HardStack/master/GAME/tetris/"
	string "url"

config GAME_TETRIS_SRC
	default "tetris.c README.md Makefile keys.h settings.h"
	string "source code list"

config GAME_TETRIS_LDFLAGS
	default "-lncurses"
	string "LDFLAGS"

config GAME_TETRIS_CFLAGS
	default "-Wall -pedantic -g"
	string "CFLAGS"

config GAME_TETRIS_CONFIG
	string "configure"

endif # PK_GAME_TETRIS
```

## package/gbinutils/Kconfig
```kconfig
menuconfig PK_GBINUTILS
	bool "binutils"

if PK_GBINUTILS

config PK_GBINUTILS_VERSION
	default "2.32"
	string "verstion"

config PK_GBINUTILS_TAR
	default "tar.gz"
	string "tar type"

config PK_GBINUTILS_URL
	default "http://ftp.gnu.org/pub/gnu/binutils/"
	string "url"

config PK_GBINUTILS_GITHUB
	string "GitHub"

config PK_GBINUTILS_SRCFILE
	string "Source code list"

config PK_GBINUTILS_CONFIG
	default "--enable-silent-rules --disable-static"
	string "CONFIG: Project Configure Options"

config PK_GBINUTILS_LIBPATH
	string "LIBS: Libraries to pass to the linker, e.g. -l<library>"

config PK_GBINUTILS_CPPFLAGS
	string "CPPFLAGS: C/C++ preprocessor flags, e.g. -I<include dir>"

config PK_GBINUTILS_DPKCONFIG
	string "PKG_CONFIG_PATH: Directories to add to pkg-config's search path"

config PK_GBINUTILS_CFLAGS
	string "CFLAGS: C compiler flags"

config PK_GBINUTILS_LDFLAGS
	string "LDFLAGS: Linker flags"

config PK_GBINUTILS_CXXFLAGS
	string "CXXFLAGS: C++ compiler flags"

config PK_GBINUTILS_ASFLAGS
	string "CCASFLAGS: assembler compiler flags (defaults to CFLAGS)"

config PK_GBINUTILS_BUILDARCH
	default "x86_64-unknown-linux-gnu"
	string "--host options on configure for Architecture"

endif # PK_GBINUTILS
```

## package/gcc/Kconfig
```kconfig
#
# kconfig for gcc
#
config PACKAGE_GCC
	bool "GNU Compiler Collection (GCC)"
	help
	  The GNU Compiler Collection (GCC) is a compiler system 
	  produced by the GNU Project supporting various programming 
	  languages. GCC is a key component of the GNU toolchain and 
	  the standard compiler for most Unix-like Operating Systems. 
	  The Free Software Foundation (FSF) distributes GCC under the 
	  GNU General Public License (GNU GPL). GCC has played an 
	  important role in the growth of free software, as both a tool
	  and an example.
```

## package/glib/Kconfig
```kconfig
menuconfig PK_GLIB
	select PK_LIB_LIBFFI
	select PK_PCRE
	select PK_ZLIB
	select PK_UTIL_LINUX
	bool "glib"

if PK_GLIB

config PK_GLIB_VERSION
	default "2.52.3"
	string "verstion"

config PK_GLIB_TAR
	default "tar.xz"
	string "tar type"

config PK_GLIB_URL
	default "http://ftp.acc.umu.se/pub/GNOME/sources/glib/2.52/"
	string "url"

config PK_GLIB_GITHUB
	string "GitHub"

config PK_GLIB_SRCFILE
	string "Source code list"

config PK_GLIB_CONFIG
	default "--disable-man --disable-static --disable-largefile --disable-fam --disable-xattr --disable-libelf --disable-static glib_cv_stack_grows=no glib_cv_uscore=yes ac_cv_func_posix_getpwuid_r=yes ac_cv_func_posix_getgrgid_r=yes --disable-static --disable-man --enable-silent-rules"
	string "CONFIG: Project Configure Options"

config PK_GLIB_LIBPATH
	string "LIBS: Libraries to pass to the linker, e.g. -l<library>"

config PK_GLIB_CPPFLAGS
	string "CPPFLAGS: C/C++ preprocessor flags, e.g. -I<include dir>"

config PK_GLIB_DPKCONFIG
	string "PKG_CONFIG_PATH: Directories to add to pkg-config's search path"

config PK_GLIB_CFLAGS
	default "-Wno-missing-include-dirs"
	string "CFLAGS: C compiler flags"

config PK_GLIB_LDFLAGS
	string "LDFLAGS: Linker flags"

config PK_GLIB_CXXFLAGS
	string "CXXFLAGS: C++ compiler flags"

config PK_GLIB_ASFLAGS
	string "CCASFLAGS: assembler compiler flags (defaults to CFLAGS)"

config PK_GLIB_BUILDARCH
	default "x86_64-unknown-linux-gnu"
	string "--host options on configure for Architecture"

endif # PK_GLIB
```

## package/glibc/Kconfig
```kconfig
menuconfig PK_GLIBC
	bool "glibc"

if PK_GLIBC

config PK_GLIBC_VERSION
	default "2.24"
	string "verstion"

config PK_GLIBC_TAR
	default "tar.gz"
	string "tar type"

config PK_GLIBC_URL
	default "http://ftp.gnu.org/pub/gnu/glibc/"
	string "url"

config PK_GLIBC_GITHUB
	string "GitHub"

config PK_GLIBC_SRCFILE
	string "Source code list"

config PK_GLIBC_CONFIG
	default "--enable-silent-rules --disable-static"
	string "CONFIG: Project Configure Options"

config PK_GLIBC_LIBPATH
	string "LIBS: Libraries to pass to the linker, e.g. -l<library>"

config PK_GLIBC_CPPFLAGS
	string "CPPFLAGS: C/C++ preprocessor flags, e.g. -I<include dir>"

config PK_GLIBC_DPKCONFIG
	string "PKG_CONFIG_PATH: Directories to add to pkg-config's search path"

config PK_GLIBC_CFLAGS
	string "CFLAGS: C compiler flags"

config PK_GLIBC_LDFLAGS
	string "LDFLAGS: Linker flags"

config PK_GLIBC_CXXFLAGS
	string "CXXFLAGS: C++ compiler flags"

config PK_GLIBC_ASFLAGS
	string "CCASFLAGS: assembler compiler flags (defaults to CFLAGS)"

config PK_GLIBC_BUILDARCH
	default "x86_64-unknown-linux-gnu"
	string "--host options on configure for Architecture"

endif # PK_GLIBC
```

## package/glproto/Kconfig
```kconfig
menuconfig PK_GLPROTO
	bool "glproto"

if PK_GLPROTO

config PK_GLPROTO_VERSION
	default "1.4.17"
	string "verstion"

config PK_GLPROTO_TAR
	default "tar.gz"
	string "tar type"

config PK_GLPROTO_URL
	default "https://www.x.org/releases/individual/proto/"
	string "url"

config PK_GLPROTO_GITHUB
	string "GitHub"

config PK_GLPROTO_SRCFILE
	string "Source code list"

config PK_GLPROTO_CONFIG
	default "--enable-silent-rules --disable-static"
	string "CONFIG: Project Configure Options"

config PK_GLPROTO_LIBPATH
	string "LIBS: Libraries to pass to the linker, e.g. -l<library>"

config PK_GLPROTO_CPPFLAGS
	string "CPPFLAGS: C/C++ preprocessor flags, e.g. -I<include dir>"

config PK_GLPROTO_DPKCONFIG
	string "PKG_CONFIG_PATH: Directories to add to pkg-config's search path"

config PK_GLPROTO_CFLAGS
	string "CFLAGS: C compiler flags"

config PK_GLPROTO_LDFLAGS
	string "LDFLAGS: Linker flags"

config PK_GLPROTO_CXXFLAGS
	string "CXXFLAGS: C++ compiler flags"

config PK_GLPROTO_ASFLAGS
	string "CCASFLAGS: assembler compiler flags (defaults to CFLAGS)"

config PK_GLPROTO_BUILDARCH
	default "x86_64-unknown-linux-gnu"
	string "--host options on configure for Architecture"

endif # PK_GLPROTO
```

## package/gmp/Kconfig
```kconfig
menuconfig PK_GMP
	bool "gmp"

if PK_GMP

config PK_GMP_VERSION
	default "6.1.2"
	string "verstion"

config PK_GMP_TAR
	default "tar.xz"
	string "tar type"

config PK_GMP_URL
	default "https://gmplib.org/download/gmp"
	string "url"

config PK_GMP_GITHUB
	string "GitHub"

config PK_GMP_SRCFILE
	string "Source code list"

config PK_GMP_CONFIG
	default "--enable-silent-rules"
	string "CONFIG: Project Configure Options"

config PK_GMP_LIBPATH
	string "LIBS: Libraries to pass to the linker, e.g. -l<library>"

config PK_GMP_CPPFLAGS
	string "CPPFLAGS: C/C++ preprocessor flags, e.g. -I<include dir>"

config PK_GMP_DPKCONFIG
	string "PKG_CONFIG_PATH: Directories to add to pkg-config's search path"

config PK_GMP_CFLAGS
	string "CFLAGS: C compiler flags"

config PK_GMP_LDFLAGS
	string "LDFLAGS: Linker flags"

config PK_GMP_CXXFLAGS
	string "CXXFLAGS: C++ compiler flags"

config PK_GMP_ASFLAGS
	string "CCASFLAGS: assembler compiler flags (defaults to CFLAGS)"

config PK_GMP_BUILDARCH
	default "x86_64-unknown-linux-gnu"
	string "--host options on configure for Architecture"

endif # PK_GMP
```

## package/gnome_glib/Kconfig
```kconfig
menuconfig PK_GLIB
	select PK_LIBFFI
	select PK_PCRE
	select PK_ZLIB
	bool "glib"

if PK_GLIB

choice
	prompt "GLIB Release Version"

config GLIBR2
	bool "Glib 2.48"

endchoice

config LIB_GLIB_VERSION
	default "2.48.1" if GLIBR2
	string "verstion"

config LIB_GLIB_TAR
	default "tar.xz"
	string "tar type"

config LIB_GLIB_URL
	default "http://ftp.acc.umu.se/pub/GNOME/sources/glib/2.48/" if GLIBR2
	string "url"

config LIB_GLIB_SRC
	string "source code list"

config LIB_GLIB_LDFLAGS
	default "-lpcre"
	string "LDFLAGS"

config LIB_GLIB_CFLAGS
	default "-Wno-missing-include-dirs"
	string "CFLAGS"

config LIB_GLIB_CONFIG
	default "glib_cv_stack_grows=no glib_cv_uscore=yes ac_cv_func_posix_getpwuid_r=yes ac_cv_func_posix_getgrgid_r=yes"
	string "configure"

endif # PK_GLIB
```
