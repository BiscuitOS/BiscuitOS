## package/pci/BiscuitOS-PCI-QEMU-DEVICE-INTX/Kconfig
```kconfig
menuconfig PK_PCI_QEMU_DEV_INTX
	bool "QEMU PCI DEVICE: PCI INTX (BiscuitOS-PCI-INTX)"

if PK_PCI_QEMU_DEV_INTX

config PK_PCI_QEMU_DEV_INTX_VERSION
	default "default"
	string "verstion"

config PK_PCI_QEMU_DEV_INTX_TAR
	default "tar.gz"
	string "tar type"

config PK_PCI_QEMU_DEV_INTX_URL
	default "https://gitee.com/BiscuitOS_team/HardStack/raw/Gitee/Device-Driver/PCIe/BiscuitOS-PCI-QEMU-DEVICE-INTX"
	string "url"

config PK_PCI_QEMU_DEV_INTX_GITHUB
	string "GitHub"

config PK_PCI_QEMU_DEV_INTX_SRCFILE
	default "main.c Kconfig Makefile.objs README.md"
	string "Source code list"

config PK_PCI_QEMU_DEV_INTX_CSRCFILE
	string "Compile source code list"

config PK_PCI_QEMU_DEV_INTX_CONFIG
	string "CONFIG: Project Configure Options"

config PK_PCI_QEMU_DEV_INTX_LIBPATH
	string "LIBS: Libraries to pass to the linker, e.g. -l<library>"

config PK_PCI_QEMU_DEV_INTX_CPPFLAGS
	string "CPPFLAGS: C/C++ preprocessor flags, e.g. -I<include dir>"

config PK_PCI_QEMU_DEV_INTX_DPKCONFIG
	string "PKG_CONFIG_PATH: Directories to add to pkg-config's search path"

config PK_PCI_QEMU_DEV_INTX_CFLAGS
	string "CFLAGS: C compiler flags"

config PK_PCI_QEMU_DEV_INTX_LDFLAGS
	string "LDFLAGS: Linker flags"

config PK_PCI_QEMU_DEV_INTX_CXXFLAGS
	string "CXXFLAGS: C++ compiler flags"

config PK_PCI_QEMU_DEV_INTX_ASFLAGS
	string "CCASFLAGS: assembler compiler flags (defaults to CFLAGS)"

config PK_PCI_QEMU_DEV_INTX_BUILDARCH
	string "--host options on configure for Architecture"

endif # PK_PCI_QEMU_DEV_INTX
```

## package/pci/BiscuitOS-PCI-QEMU-DEVICE-MSIX/Kconfig
```kconfig
menuconfig PK_PCI_QEMU_DEV_MSIX
	bool "QEMU PCI DEVICE: PCI MSIX (BiscuitOS-PCI-MSIX)"

if PK_PCI_QEMU_DEV_MSIX

config PK_PCI_QEMU_DEV_MSIX_VERSION
	default "default"
	string "verstion"

config PK_PCI_QEMU_DEV_MSIX_TAR
	default "tar.gz"
	string "tar type"

config PK_PCI_QEMU_DEV_MSIX_URL
	default "https://gitee.com/BiscuitOS_team/HardStack/raw/Gitee/Device-Driver/PCIe/BiscuitOS-PCI-QEMU-DEVICE-MSIX"
	string "url"

config PK_PCI_QEMU_DEV_MSIX_GITHUB
	string "GitHub"

config PK_PCI_QEMU_DEV_MSIX_SRCFILE
	default "main.c Kconfig Makefile.objs README.md"
	string "Source code list"

config PK_PCI_QEMU_DEV_MSIX_CSRCFILE
	string "Compile source code list"

config PK_PCI_QEMU_DEV_MSIX_CONFIG
	string "CONFIG: Project Configure Options"

config PK_PCI_QEMU_DEV_MSIX_LIBPATH
	string "LIBS: Libraries to pass to the linker, e.g. -l<library>"

config PK_PCI_QEMU_DEV_MSIX_CPPFLAGS
	string "CPPFLAGS: C/C++ preprocessor flags, e.g. -I<include dir>"

config PK_PCI_QEMU_DEV_MSIX_DPKCONFIG
	string "PKG_CONFIG_PATH: Directories to add to pkg-config's search path"

config PK_PCI_QEMU_DEV_MSIX_CFLAGS
	string "CFLAGS: C compiler flags"

config PK_PCI_QEMU_DEV_MSIX_LDFLAGS
	string "LDFLAGS: Linker flags"

config PK_PCI_QEMU_DEV_MSIX_CXXFLAGS
	string "CXXFLAGS: C++ compiler flags"

config PK_PCI_QEMU_DEV_MSIX_ASFLAGS
	string "CCASFLAGS: assembler compiler flags (defaults to CFLAGS)"

config PK_PCI_QEMU_DEV_MSIX_BUILDARCH
	string "--host options on configure for Architecture"

endif # PK_PCI_QEMU_DEV_MSIX
```

## package/pci/BiscuitOS-dma-device-QEMU-emulate/Kconfig
```kconfig
menuconfig PK_DMA_QEMU_EMULATE
	bool "QEMU emulate DMA Device (BiscuitOS-DMA)"

if PK_DMA_QEMU_EMULATE

config PK_DMA_QEMU_EMULATE_VERSION
	default "default"
	string "verstion"

config PK_DMA_QEMU_EMULATE_TAR
	default "tar.gz"
	string "tar type"

config PK_DMA_QEMU_EMULATE_URL
	default "https://gitee.com/BiscuitOS_team/HardStack/raw/Gitee/Device-Driver/DMA/BiscuitOS-dma-device-QEMU-emulate"
	string "url"

config PK_DMA_QEMU_EMULATE_GITHUB
	string "GitHub"

config PK_DMA_QEMU_EMULATE_SRCFILE
	default "BiscuitOS-DMA.c Kconfig Makefile.objs README.md BiscuitOS-DMA-Datasheet.md"
	string "Source code list"

config PK_DMA_QEMU_EMULATE_CSRCFILE
	string "Compile source code list"

config PK_DMA_QEMU_EMULATE_CONFIG
	string "CONFIG: Project Configure Options"

config PK_DMA_QEMU_EMULATE_LIBPATH
	string "LIBS: Libraries to pass to the linker, e.g. -l<library>"

config PK_DMA_QEMU_EMULATE_CPPFLAGS
	string "CPPFLAGS: C/C++ preprocessor flags, e.g. -I<include dir>"

config PK_DMA_QEMU_EMULATE_DPKCONFIG
	string "PKG_CONFIG_PATH: Directories to add to pkg-config's search path"

config PK_DMA_QEMU_EMULATE_CFLAGS
	string "CFLAGS: C compiler flags"

config PK_DMA_QEMU_EMULATE_LDFLAGS
	string "LDFLAGS: Linker flags"

config PK_DMA_QEMU_EMULATE_CXXFLAGS
	string "CXXFLAGS: C++ compiler flags"

config PK_DMA_QEMU_EMULATE_ASFLAGS
	string "CCASFLAGS: assembler compiler flags (defaults to CFLAGS)"

config PK_DMA_QEMU_EMULATE_BUILDARCH
	string "--host options on configure for Architecture"

endif # PK_DMA_QEMU_EMULATE
```

## package/pci/BiscuitOS-dma-device-driver/Kconfig
```kconfig
menuconfig PK_DMA_COMMON_DD
	bool "DMA Common Device Driver Module (PCIe)"

if PK_DMA_COMMON_DD

config PK_DMA_COMMON_DD_VERSION
	default "default"
	string "verstion"

config PK_DMA_COMMON_DD_TAR
	default "tar.gz"
	string "tar type"

config PK_DMA_COMMON_DD_URL
	default "https://gitee.com/BiscuitOS_team/HardStack/raw/Gitee/Device-Driver/DMA/BiscuitOS-dma-device-driver"
	string "url"

config PK_DMA_COMMON_DD_GITHUB
	string "GitHub"

config PK_DMA_COMMON_DD_SRCFILE
	default "main.c Kconfig Makefile BiscuitOS-DMA-Datasheet.md RunBiscuitOS.sh"
	string "Source code list"

config PK_DMA_COMMON_DD_CSRCFILE
	string "Compile source code list"

config PK_DMA_COMMON_DD_CONFIG
	string "CONFIG: Project Configure Options"

config PK_DMA_COMMON_DD_LIBPATH
	string "LIBS: Libraries to pass to the linker, e.g. -l<library>"

config PK_DMA_COMMON_DD_CPPFLAGS
	string "CPPFLAGS: C/C++ preprocessor flags, e.g. -I<include dir>"

config PK_DMA_COMMON_DD_DPKCONFIG
	string "PKG_CONFIG_PATH: Directories to add to pkg-config's search path"

config PK_DMA_COMMON_DD_CFLAGS
	string "CFLAGS: C compiler flags"

config PK_DMA_COMMON_DD_LDFLAGS
	string "LDFLAGS: Linker flags"

config PK_DMA_COMMON_DD_CXXFLAGS
	string "CXXFLAGS: C++ compiler flags"

config PK_DMA_COMMON_DD_ASFLAGS
	string "CCASFLAGS: assembler compiler flags (defaults to CFLAGS)"

config PK_DMA_COMMON_DD_BUILDARCH
	string "--host options on configure for Architecture"

endif # PK_DMA_COMMON_DD
```

## package/pci/BiscuitOS-dma-userland/Kconfig
```kconfig
menuconfig PK_DMA_USERLAND
	select PK_DMA_COMMON_DD
	bool "DMA userland Application (BiscuitOS-DMA module)"

if PK_DMA_USERLAND

config PK_DMA_USERLAND_VERSION
	default "default"
	string "verstion"

config PK_DMA_USERLAND_TAR
	default "tar.gz"
	string "tar type"

config PK_DMA_USERLAND_URL
	default "https://gitee.com/BiscuitOS_team/HardStack/raw/Gitee/Device-Driver/DMA/BiscuitOS-dma-userland"
	string "url"

config PK_DMA_USERLAND_GITHUB
	string "GitHub"

config PK_DMA_USERLAND_SRCFILE
	default "main.c Makefile"
	string "Source code list"

config PK_DMA_USERLAND_CSRCFILE
	string "Compile source code list"

config PK_DMA_USERLAND_CONFIG
	string "CONFIG: Project Configure Options"

config PK_DMA_USERLAND_LIBPATH
	string "LIBS: Libraries to pass to the linker, e.g. -l<library>"

config PK_DMA_USERLAND_CPPFLAGS
	string "CPPFLAGS: C/C++ preprocessor flags, e.g. -I<include dir>"

config PK_DMA_USERLAND_DPKCONFIG
	string "PKG_CONFIG_PATH: Directories to add to pkg-config's search path"

config PK_DMA_USERLAND_CFLAGS
	string "CFLAGS: C compiler flags"

config PK_DMA_USERLAND_LDFLAGS
	string "LDFLAGS: Linker flags"

config PK_DMA_USERLAND_CXXFLAGS
	string "CXXFLAGS: C++ compiler flags"

config PK_DMA_USERLAND_ASFLAGS
	string "CCASFLAGS: assembler compiler flags (defaults to CFLAGS)"

config PK_DMA_USERLAND_BUILDARCH
	string "--host options on configure for Architecture"

endif # PK_DMA_USERLAND
```

## package/pci/BiscuitOS-pci-device-QEMU-emulate/Kconfig
```kconfig
menuconfig PK_PCI_QEMU_EMULATE
	bool "QEMU emulate PCIe Device (BiscuitOS-pcie)"

if PK_PCI_QEMU_EMULATE

config PK_PCI_QEMU_EMULATE_VERSION
	default "default"
	string "verstion"

config PK_PCI_QEMU_EMULATE_TAR
	default "tar.gz"
	string "tar type"

config PK_PCI_QEMU_EMULATE_URL
	default "https://gitee.com/BiscuitOS_team/HardStack/raw/Gitee/Device-Driver/PCIe/BiscuitOS-pci-device-QEMU-emulate"
	string "url"

config PK_PCI_QEMU_EMULATE_GITHUB
	string "GitHub"

config PK_PCI_QEMU_EMULATE_SRCFILE
	default "BiscuitOS-pci.c  Kconfig  Makefile.objs  README.md"
	string "Source code list"

config PK_PCI_QEMU_EMULATE_CSRCFILE
	string "Compile source code list"

config PK_PCI_QEMU_EMULATE_CONFIG
	string "CONFIG: Project Configure Options"

config PK_PCI_QEMU_EMULATE_LIBPATH
	string "LIBS: Libraries to pass to the linker, e.g. -l<library>"

config PK_PCI_QEMU_EMULATE_CPPFLAGS
	string "CPPFLAGS: C/C++ preprocessor flags, e.g. -I<include dir>"

config PK_PCI_QEMU_EMULATE_DPKCONFIG
	string "PKG_CONFIG_PATH: Directories to add to pkg-config's search path"

config PK_PCI_QEMU_EMULATE_CFLAGS
	string "CFLAGS: C compiler flags"

config PK_PCI_QEMU_EMULATE_LDFLAGS
	string "LDFLAGS: Linker flags"

config PK_PCI_QEMU_EMULATE_CXXFLAGS
	string "CXXFLAGS: C++ compiler flags"

config PK_PCI_QEMU_EMULATE_ASFLAGS
	string "CCASFLAGS: assembler compiler flags (defaults to CFLAGS)"

config PK_PCI_QEMU_EMULATE_BUILDARCH
	string "--host options on configure for Architecture"

endif # PK_PCI_QEMU_EMULATE
```
