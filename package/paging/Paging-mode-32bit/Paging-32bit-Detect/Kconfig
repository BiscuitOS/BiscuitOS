## package/paging/Paging-mode-32bit/Paging-32bit-Detect/Kconfig
```kconfig
menuconfig PK_PAGING_32BIT_DETECT
	bool "Detect Paging 32bit mode"

if PK_PAGING_32BIT_DETECT

config PK_PAGING_32BIT_DETECT_VERSION
	default "default"
	string "verstion"

config PK_PAGING_32BIT_DETECT_TAR
	default "tar.gz"
	string "tar type"

config PK_PAGING_32BIT_DETECT_URL
	default "https://gitee.com/BiscuitOS_team/HardStack/raw/Gitee/Memory-Allocator/Paging/paging_mode_32bit/Paging-32bit-detect"
	string "url"

config PK_PAGING_32BIT_DETECT_GITHUB
	string "GitHub"

config PK_PAGING_32BIT_DETECT_SRCFILE
	default "main.c Kconfig Makefile"
	string "Source code list"

config PK_PAGING_32BIT_DETECT_CSRCFILE
	string "Compile source code list"

config PK_PAGING_32BIT_DETECT_CONFIG
	string "CONFIG: Project Configure Options"

config PK_PAGING_32BIT_DETECT_LIBPATH
	string "LIBS: Libraries to pass to the linker, e.g. -l<library>"

config PK_PAGING_32BIT_DETECT_CPPFLAGS
	string "CPPFLAGS: C/C++ preprocessor flags, e.g. -I<include dir>"

config PK_PAGING_32BIT_DETECT_DPKCONFIG
	string "PKG_CONFIG_PATH: Directories to add to pkg-config's search path"

config PK_PAGING_32BIT_DETECT_CFLAGS
	string "CFLAGS: C compiler flags"

config PK_PAGING_32BIT_DETECT_LDFLAGS
	string "LDFLAGS: Linker flags"

config PK_PAGING_32BIT_DETECT_CXXFLAGS
	string "CXXFLAGS: C++ compiler flags"

config PK_PAGING_32BIT_DETECT_ASFLAGS
	string "CCASFLAGS: assembler compiler flags (defaults to CFLAGS)"

config PK_PAGING_32BIT_DETECT_BUILDARCH
	string "--host options on configure for Architecture"

endif # PK_PAGING_32BIT_DETECT
```

## package/paging/Paging-mode-32bit/Paging-32bit-FIXMAP/Kconfig
```kconfig
menuconfig PK_PAGING_32BIT_FIXMAP
	bool "FIXMAP Allocator with 32-Bit Paging"

if PK_PAGING_32BIT_FIXMAP

config PK_PAGING_32BIT_FIXMAP_VERSION
	default "default"
	string "verstion"

config PK_PAGING_32BIT_FIXMAP_TAR
	default "tar.gz"
	string "tar type"

config PK_PAGING_32BIT_FIXMAP_URL
	default "https://gitee.com/BiscuitOS_team/HardStack/raw/Gitee/Memory-Allocator/Paging/paging_mode_32bit/Paging-32bit-FIXMAP"
	string "url"

config PK_PAGING_32BIT_FIXMAP_GITHUB
	string "GitHub"

config PK_PAGING_32BIT_FIXMAP_SRCFILE
	default "main.c Kconfig Makefile"
	string "Source code list"

config PK_PAGING_32BIT_FIXMAP_CSRCFILE
	string "Compile source code list"

config PK_PAGING_32BIT_FIXMAP_CONFIG
	string "CONFIG: Project Configure Options"

config PK_PAGING_32BIT_FIXMAP_LIBPATH
	string "LIBS: Libraries to pass to the linker, e.g. -l<library>"

config PK_PAGING_32BIT_FIXMAP_CPPFLAGS
	string "CPPFLAGS: C/C++ preprocessor flags, e.g. -I<include dir>"

config PK_PAGING_32BIT_FIXMAP_DPKCONFIG
	string "PKG_CONFIG_PATH: Directories to add to pkg-config's search path"

config PK_PAGING_32BIT_FIXMAP_CFLAGS
	string "CFLAGS: C compiler flags"

config PK_PAGING_32BIT_FIXMAP_LDFLAGS
	string "LDFLAGS: Linker flags"

config PK_PAGING_32BIT_FIXMAP_CXXFLAGS
	string "CXXFLAGS: C++ compiler flags"

config PK_PAGING_32BIT_FIXMAP_ASFLAGS
	string "CCASFLAGS: assembler compiler flags (defaults to CFLAGS)"

config PK_PAGING_32BIT_FIXMAP_BUILDARCH
	string "--host options on configure for Architecture"

endif # PK_PAGING_32BIT_FIXMAP
```

## package/paging/Paging-mode-32bit/Paging-32bit-IO/Kconfig
```kconfig
menuconfig PK_PAGING_32BIT_IO
	bool "IO Memory Mapping (ioremap) with 32-Bit Paging"

if PK_PAGING_32BIT_IO

config PK_PAGING_32BIT_IO_VERSION
	default "default"
	string "verstion"

config PK_PAGING_32BIT_IO_TAR
	default "tar.gz"
	string "tar type"

config PK_PAGING_32BIT_IO_URL
	default "https://gitee.com/BiscuitOS_team/HardStack/raw/Gitee/Memory-Allocator/Paging/paging_mode_32bit/Paging-32bit-IO"
	string "url"

config PK_PAGING_32BIT_IO_GITHUB
	string "GitHub"

config PK_PAGING_32BIT_IO_SRCFILE
	default "main.c Kconfig Makefile"
	string "Source code list"

config PK_PAGING_32BIT_IO_CSRCFILE
	string "Compile source code list"

config PK_PAGING_32BIT_IO_CONFIG
	string "CONFIG: Project Configure Options"

config PK_PAGING_32BIT_IO_LIBPATH
	string "LIBS: Libraries to pass to the linker, e.g. -l<library>"

config PK_PAGING_32BIT_IO_CPPFLAGS
	string "CPPFLAGS: C/C++ preprocessor flags, e.g. -I<include dir>"

config PK_PAGING_32BIT_IO_DPKCONFIG
	string "PKG_CONFIG_PATH: Directories to add to pkg-config's search path"

config PK_PAGING_32BIT_IO_CFLAGS
	string "CFLAGS: C compiler flags"

config PK_PAGING_32BIT_IO_LDFLAGS
	string "LDFLAGS: Linker flags"

config PK_PAGING_32BIT_IO_CXXFLAGS
	string "CXXFLAGS: C++ compiler flags"

config PK_PAGING_32BIT_IO_ASFLAGS
	string "CCASFLAGS: assembler compiler flags (defaults to CFLAGS)"

config PK_PAGING_32BIT_IO_BUILDARCH
	string "--host options on configure for Architecture"

endif # PK_PAGING_32BIT_IO
```

## package/paging/Paging-mode-32bit/Paging-32bit-KMAP/Kconfig
```kconfig
menuconfig PK_PAGING_32BIT_KMAP
	bool "KMAP Allocator with 32-Bit Paging"

if PK_PAGING_32BIT_KMAP

config PK_PAGING_32BIT_KMAP_VERSION
	default "default"
	string "verstion"

config PK_PAGING_32BIT_KMAP_TAR
	default "tar.gz"
	string "tar type"

config PK_PAGING_32BIT_KMAP_URL
	default "https://gitee.com/BiscuitOS_team/HardStack/raw/Gitee/Memory-Allocator/Paging/paging_mode_32bit/Paging-32bit-KMAP"
	string "url"

config PK_PAGING_32BIT_KMAP_GITHUB
	string "GitHub"

config PK_PAGING_32BIT_KMAP_SRCFILE
	default "main.c Kconfig Makefile"
	string "Source code list"

config PK_PAGING_32BIT_KMAP_CSRCFILE
	string "Compile source code list"

config PK_PAGING_32BIT_KMAP_CONFIG
	string "CONFIG: Project Configure Options"

config PK_PAGING_32BIT_KMAP_LIBPATH
	string "LIBS: Libraries to pass to the linker, e.g. -l<library>"

config PK_PAGING_32BIT_KMAP_CPPFLAGS
	string "CPPFLAGS: C/C++ preprocessor flags, e.g. -I<include dir>"

config PK_PAGING_32BIT_KMAP_DPKCONFIG
	string "PKG_CONFIG_PATH: Directories to add to pkg-config's search path"

config PK_PAGING_32BIT_KMAP_CFLAGS
	string "CFLAGS: C compiler flags"

config PK_PAGING_32BIT_KMAP_LDFLAGS
	string "LDFLAGS: Linker flags"

config PK_PAGING_32BIT_KMAP_CXXFLAGS
	string "CXXFLAGS: C++ compiler flags"

config PK_PAGING_32BIT_KMAP_ASFLAGS
	string "CCASFLAGS: assembler compiler flags (defaults to CFLAGS)"

config PK_PAGING_32BIT_KMAP_BUILDARCH
	string "--host options on configure for Architecture"

endif # PK_PAGING_32BIT_KMAP
```

## package/paging/Paging-mode-32bit/Paging-32bit-Kernel-4M-Page/Kconfig
```kconfig
menuconfig PK_PAGING_32BIT_KERNEL_4M_PAGE
	bool "Translate Kernel Address With 4M Page"

if PK_PAGING_32BIT_KERNEL_4M_PAGE

config PK_PAGING_32BIT_KERNEL_4M_PAGE_VERSION
	default "default"
	string "verstion"

config PK_PAGING_32BIT_KERNEL_4M_PAGE_TAR
	default "tar.gz"
	string "tar type"

config PK_PAGING_32BIT_KERNEL_4M_PAGE_URL
	default "https://gitee.com/BiscuitOS_team/HardStack/raw/Gitee/Memory-Allocator/Paging/paging_mode_32bit/Paging-32bit-kernel-4MB-Page"
	string "url"

config PK_PAGING_32BIT_KERNEL_4M_PAGE_GITHUB
	string "GitHub"

config PK_PAGING_32BIT_KERNEL_4M_PAGE_SRCFILE
	default "main.c Kconfig Makefile"
	string "Source code list"

config PK_PAGING_32BIT_KERNEL_4M_PAGE_CSRCFILE
	string "Compile source code list"

config PK_PAGING_32BIT_KERNEL_4M_PAGE_CONFIG
	string "CONFIG: Project Configure Options"

config PK_PAGING_32BIT_KERNEL_4M_PAGE_LIBPATH
	string "LIBS: Libraries to pass to the linker, e.g. -l<library>"

config PK_PAGING_32BIT_KERNEL_4M_PAGE_CPPFLAGS
	string "CPPFLAGS: C/C++ preprocessor flags, e.g. -I<include dir>"

config PK_PAGING_32BIT_KERNEL_4M_PAGE_DPKCONFIG
	string "PKG_CONFIG_PATH: Directories to add to pkg-config's search path"

config PK_PAGING_32BIT_KERNEL_4M_PAGE_CFLAGS
	string "CFLAGS: C compiler flags"

config PK_PAGING_32BIT_KERNEL_4M_PAGE_LDFLAGS
	string "LDFLAGS: Linker flags"

config PK_PAGING_32BIT_KERNEL_4M_PAGE_CXXFLAGS
	string "CXXFLAGS: C++ compiler flags"

config PK_PAGING_32BIT_KERNEL_4M_PAGE_ASFLAGS
	string "CCASFLAGS: assembler compiler flags (defaults to CFLAGS)"

config PK_PAGING_32BIT_KERNEL_4M_PAGE_BUILDARCH
	string "--host options on configure for Architecture"

endif # PK_PAGING_32BIT_KERNEL_4M_PAGE
```

## package/paging/Paging-mode-32bit/Paging-32bit-Linear/Kconfig
```kconfig
menuconfig PK_PAGING_32BIT_LINEAR
	bool "Linear Mapping with 32-Bit Paging"

if PK_PAGING_32BIT_LINEAR

config PK_PAGING_32BIT_LINEAR_VERSION
	default "default"
	string "verstion"

config PK_PAGING_32BIT_LINEAR_TAR
	default "tar.gz"
	string "tar type"

config PK_PAGING_32BIT_LINEAR_URL
	default "https://gitee.com/BiscuitOS_team/HardStack/raw/Gitee/Memory-Allocator/Paging/paging_mode_32bit/Paging-32bit-Linear"
	string "url"

config PK_PAGING_32BIT_LINEAR_GITHUB
	string "GitHub"

config PK_PAGING_32BIT_LINEAR_SRCFILE
	default "main.c Kconfig Makefile"
	string "Source code list"

config PK_PAGING_32BIT_LINEAR_CSRCFILE
	string "Compile source code list"

config PK_PAGING_32BIT_LINEAR_CONFIG
	string "CONFIG: Project Configure Options"

config PK_PAGING_32BIT_LINEAR_LIBPATH
	string "LIBS: Libraries to pass to the linker, e.g. -l<library>"

config PK_PAGING_32BIT_LINEAR_CPPFLAGS
	string "CPPFLAGS: C/C++ preprocessor flags, e.g. -I<include dir>"

config PK_PAGING_32BIT_LINEAR_DPKCONFIG
	string "PKG_CONFIG_PATH: Directories to add to pkg-config's search path"

config PK_PAGING_32BIT_LINEAR_CFLAGS
	string "CFLAGS: C compiler flags"

config PK_PAGING_32BIT_LINEAR_LDFLAGS
	string "LDFLAGS: Linker flags"

config PK_PAGING_32BIT_LINEAR_CXXFLAGS
	string "CXXFLAGS: C++ compiler flags"

config PK_PAGING_32BIT_LINEAR_ASFLAGS
	string "CCASFLAGS: assembler compiler flags (defaults to CFLAGS)"

config PK_PAGING_32BIT_LINEAR_BUILDARCH
	string "--host options on configure for Architecture"

endif # PK_PAGING_32BIT_LINEAR
```

## package/paging/Paging-mode-32bit/Paging-32bit-PFN/Kconfig
```kconfig
menuconfig PK_PAGING_32BIT_PFN
	bool "Physical Frame Direct Mapping With 32-Bit Paging"

if PK_PAGING_32BIT_PFN

config PK_PAGING_32BIT_PFN_VERSION
	default "default"
	string "verstion"

config PK_PAGING_32BIT_PFN_TAR
	default "tar.gz"
	string "tar type"

config PK_PAGING_32BIT_PFN_URL
	default "https://gitee.com/BiscuitOS_team/HardStack/raw/Gitee/Memory-Allocator/Paging/paging_mode_32bit/Paging-32bit-PFN"
	string "url"

config PK_PAGING_32BIT_PFN_GITHUB
	string "GitHub"

config PK_PAGING_32BIT_PFN_SRCFILE
	default "main.c Kconfig Makefile"
	string "Source code list"

config PK_PAGING_32BIT_PFN_CSRCFILE
	string "Compile source code list"

config PK_PAGING_32BIT_PFN_CONFIG
	string "CONFIG: Project Configure Options"

config PK_PAGING_32BIT_PFN_LIBPATH
	string "LIBS: Libraries to pass to the linker, e.g. -l<library>"

config PK_PAGING_32BIT_PFN_CPPFLAGS
	string "CPPFLAGS: C/C++ preprocessor flags, e.g. -I<include dir>"

config PK_PAGING_32BIT_PFN_DPKCONFIG
	string "PKG_CONFIG_PATH: Directories to add to pkg-config's search path"

config PK_PAGING_32BIT_PFN_CFLAGS
	string "CFLAGS: C compiler flags"

config PK_PAGING_32BIT_PFN_LDFLAGS
	string "LDFLAGS: Linker flags"

config PK_PAGING_32BIT_PFN_CXXFLAGS
	string "CXXFLAGS: C++ compiler flags"

config PK_PAGING_32BIT_PFN_ASFLAGS
	string "CCASFLAGS: assembler compiler flags (defaults to CFLAGS)"

config PK_PAGING_32BIT_PFN_BUILDARCH
	string "--host options on configure for Architecture"

endif # PK_PAGING_32BIT_PFN
```

## package/paging/Paging-mode-32bit/Paging-32bit-PGD-kernel/Kconfig
```kconfig
menuconfig PK_PAGING_32BIT_PGD_K
	bool "PGD on Paging 32bit mode (Kernel+)"

if PK_PAGING_32BIT_PGD_K

config PK_PAGING_32BIT_PGD_K_VERSION
	default "default"
	string "verstion"

config PK_PAGING_32BIT_PGD_K_TAR
	default "tar.gz"
	string "tar type"

config PK_PAGING_32BIT_PGD_K_URL
	default "https://gitee.com/BiscuitOS_team/HardStack/raw/Gitee/Memory-Allocator/Paging/paging_mode_32bit/Paging-32bit-PGD/kernel"
	string "url"

config PK_PAGING_32BIT_PGD_K_GITHUB
	string "GitHub"

config PK_PAGING_32BIT_PGD_K_SRCFILE
	default "main.c Kconfig Makefile"
	string "Source code list"

config PK_PAGING_32BIT_PGD_K_CSRCFILE
	string "Compile source code list"

config PK_PAGING_32BIT_PGD_K_CONFIG
	string "CONFIG: Project Configure Options"

config PK_PAGING_32BIT_PGD_K_LIBPATH
	string "LIBS: Libraries to pass to the linker, e.g. -l<library>"

config PK_PAGING_32BIT_PGD_K_CPPFLAGS
	string "CPPFLAGS: C/C++ preprocessor flags, e.g. -I<include dir>"

config PK_PAGING_32BIT_PGD_K_DPKCONFIG
	string "PKG_CONFIG_PATH: Directories to add to pkg-config's search path"

config PK_PAGING_32BIT_PGD_K_CFLAGS
	string "CFLAGS: C compiler flags"

config PK_PAGING_32BIT_PGD_K_LDFLAGS
	string "LDFLAGS: Linker flags"

config PK_PAGING_32BIT_PGD_K_CXXFLAGS
	string "CXXFLAGS: C++ compiler flags"

config PK_PAGING_32BIT_PGD_K_ASFLAGS
	string "CCASFLAGS: assembler compiler flags (defaults to CFLAGS)"

config PK_PAGING_32BIT_PGD_K_BUILDARCH
	string "--host options on configure for Architecture"

endif # PK_PAGING_32BIT_PGD_K
```

## package/paging/Paging-mode-32bit/Paging-32bit-PKMAP/Kconfig
```kconfig
menuconfig PK_PAGING_32BIT_PKMAP
	bool "Permanent kamp Allocator (PKMAP) With 32-Bit Paging"

if PK_PAGING_32BIT_PKMAP

config PK_PAGING_32BIT_PKMAP_VERSION
	default "default"
	string "verstion"

config PK_PAGING_32BIT_PKMAP_TAR
	default "tar.gz"
	string "tar type"

config PK_PAGING_32BIT_PKMAP_URL
	default "https://gitee.com/BiscuitOS_team/HardStack/raw/Gitee/Memory-Allocator/Paging/paging_mode_32bit/Paging-32bit-PKMAP"
	string "url"

config PK_PAGING_32BIT_PKMAP_GITHUB
	string "GitHub"

config PK_PAGING_32BIT_PKMAP_SRCFILE
	default "main.c Kconfig Makefile"
	string "Source code list"

config PK_PAGING_32BIT_PKMAP_CSRCFILE
	string "Compile source code list"

config PK_PAGING_32BIT_PKMAP_CONFIG
	string "CONFIG: Project Configure Options"

config PK_PAGING_32BIT_PKMAP_LIBPATH
	string "LIBS: Libraries to pass to the linker, e.g. -l<library>"

config PK_PAGING_32BIT_PKMAP_CPPFLAGS
	string "CPPFLAGS: C/C++ preprocessor flags, e.g. -I<include dir>"

config PK_PAGING_32BIT_PKMAP_DPKCONFIG
	string "PKG_CONFIG_PATH: Directories to add to pkg-config's search path"

config PK_PAGING_32BIT_PKMAP_CFLAGS
	string "CFLAGS: C compiler flags"

config PK_PAGING_32BIT_PKMAP_LDFLAGS
	string "LDFLAGS: Linker flags"

config PK_PAGING_32BIT_PKMAP_CXXFLAGS
	string "CXXFLAGS: C++ compiler flags"

config PK_PAGING_32BIT_PKMAP_ASFLAGS
	string "CCASFLAGS: assembler compiler flags (defaults to CFLAGS)"

config PK_PAGING_32BIT_PKMAP_BUILDARCH
	string "--host options on configure for Architecture"

endif # PK_PAGING_32BIT_PKMAP
```
