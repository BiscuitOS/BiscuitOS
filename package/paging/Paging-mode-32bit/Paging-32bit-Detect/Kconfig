## package/paging/Paging-mode-32bit/Paging-32bit-VMALLOC/Kconfig
```kconfig
menuconfig PK_PAGING_32BIT_VMALLOC
	bool "VMALLOC Allocator with 32-Bit Paging"

if PK_PAGING_32BIT_VMALLOC

config PK_PAGING_32BIT_VMALLOC_VERSION
	default "default"
	string "verstion"

config PK_PAGING_32BIT_VMALLOC_TAR
	default "tar.gz"
	string "tar type"

config PK_PAGING_32BIT_VMALLOC_URL
	default "https://gitee.com/BiscuitOS_team/HardStack/raw/Gitee/Memory-Allocator/Paging/paging_mode_32bit/Paging-32bit-VMALLOC"
	string "url"

config PK_PAGING_32BIT_VMALLOC_GITHUB
	string "GitHub"

config PK_PAGING_32BIT_VMALLOC_SRCFILE
	default "main.c Kconfig Makefile"
	string "Source code list"

config PK_PAGING_32BIT_VMALLOC_CSRCFILE
	string "Compile source code list"

config PK_PAGING_32BIT_VMALLOC_CONFIG
	string "CONFIG: Project Configure Options"

config PK_PAGING_32BIT_VMALLOC_LIBPATH
	string "LIBS: Libraries to pass to the linker, e.g. -l<library>"

config PK_PAGING_32BIT_VMALLOC_CPPFLAGS
	string "CPPFLAGS: C/C++ preprocessor flags, e.g. -I<include dir>"

config PK_PAGING_32BIT_VMALLOC_DPKCONFIG
	string "PKG_CONFIG_PATH: Directories to add to pkg-config's search path"

config PK_PAGING_32BIT_VMALLOC_CFLAGS
	string "CFLAGS: C compiler flags"

config PK_PAGING_32BIT_VMALLOC_LDFLAGS
	string "LDFLAGS: Linker flags"

config PK_PAGING_32BIT_VMALLOC_CXXFLAGS
	string "CXXFLAGS: C++ compiler flags"

config PK_PAGING_32BIT_VMALLOC_ASFLAGS
	string "CCASFLAGS: assembler compiler flags (defaults to CFLAGS)"

config PK_PAGING_32BIT_VMALLOC_BUILDARCH
	string "--host options on configure for Architecture"

endif # PK_PAGING_32BIT_VMALLOC
```

## package/paging/Paging-mode-4level/Kconfig
```kconfig
menuconfig PK_PAGING_MODE_4LEVEL
	bool "X86 4-level Paging mode"

if PK_PAGING_MODE_4LEVEL

config PK_PAGING_MODE_4LEVEL_VERSION
	default "default"
	string "verstion"

config PK_PAGING_MODE_4LEVEL_TAR
	default "tar.gz"
	string "tar type"

config PK_PAGING_MODE_4LEVEL_URL
	default "https://gitee.com/BiscuitOS_team/HardStack/raw/Gitee/Memory-Allocator/Paging/paging_mode_4level"
	string "url"

config PK_PAGING_MODE_4LEVEL_GITHUB
	string "GitHub"

config PK_PAGING_MODE_4LEVEL_SRCFILE
	default "main.c Kconfig Makefile"
	string "Source code list"

config PK_PAGING_MODE_4LEVEL_CSRCFILE
	string "Compile source code list"

config PK_PAGING_MODE_4LEVEL_CONFIG
	string "CONFIG: Project Configure Options"

config PK_PAGING_MODE_4LEVEL_LIBPATH
	string "LIBS: Libraries to pass to the linker, e.g. -l<library>"

config PK_PAGING_MODE_4LEVEL_CPPFLAGS
	string "CPPFLAGS: C/C++ preprocessor flags, e.g. -I<include dir>"

config PK_PAGING_MODE_4LEVEL_DPKCONFIG
	string "PKG_CONFIG_PATH: Directories to add to pkg-config's search path"

config PK_PAGING_MODE_4LEVEL_CFLAGS
	string "CFLAGS: C compiler flags"

config PK_PAGING_MODE_4LEVEL_LDFLAGS
	string "LDFLAGS: Linker flags"

config PK_PAGING_MODE_4LEVEL_CXXFLAGS
	string "CXXFLAGS: C++ compiler flags"

config PK_PAGING_MODE_4LEVEL_ASFLAGS
	string "CCASFLAGS: assembler compiler flags (defaults to CFLAGS)"

config PK_PAGING_MODE_4LEVEL_BUILDARCH
	string "--host options on configure for Architecture"

endif # PK_PAGING_MODE_4LEVEL
```

## package/paging/Paging-mode-PAE/Kconfig
```kconfig
menuconfig PK_PAGING_MODE_PAE
	bool "X86 PAE Paging mode"

if PK_PAGING_MODE_PAE

config PK_PAGING_MODE_PAE_VERSION
	default "default"
	string "verstion"

config PK_PAGING_MODE_PAE_TAR
	default "tar.gz"
	string "tar type"

config PK_PAGING_MODE_PAE_URL
	default "https://gitee.com/BiscuitOS_team/HardStack/raw/Gitee/Memory-Allocator/Paging/paging_mode_PAE"
	string "url"

config PK_PAGING_MODE_PAE_GITHUB
	string "GitHub"

config PK_PAGING_MODE_PAE_SRCFILE
	default "main.c Kconfig Makefile"
	string "Source code list"

config PK_PAGING_MODE_PAE_CSRCFILE
	string "Compile source code list"

config PK_PAGING_MODE_PAE_CONFIG
	string "CONFIG: Project Configure Options"

config PK_PAGING_MODE_PAE_LIBPATH
	string "LIBS: Libraries to pass to the linker, e.g. -l<library>"

config PK_PAGING_MODE_PAE_CPPFLAGS
	string "CPPFLAGS: C/C++ preprocessor flags, e.g. -I<include dir>"

config PK_PAGING_MODE_PAE_DPKCONFIG
	string "PKG_CONFIG_PATH: Directories to add to pkg-config's search path"

config PK_PAGING_MODE_PAE_CFLAGS
	string "CFLAGS: C compiler flags"

config PK_PAGING_MODE_PAE_LDFLAGS
	string "LDFLAGS: Linker flags"

config PK_PAGING_MODE_PAE_CXXFLAGS
	string "CXXFLAGS: C++ compiler flags"

config PK_PAGING_MODE_PAE_ASFLAGS
	string "CCASFLAGS: assembler compiler flags (defaults to CFLAGS)"

config PK_PAGING_MODE_PAE_BUILDARCH
	string "--host options on configure for Architecture"

endif # PK_PAGING_MODE_PAE
```

## package/paging/Paging-mode/Kconfig
```kconfig
menuconfig PK_PAGING_MODE
	bool "X86 Paging mode"

if PK_PAGING_MODE

config PK_PAGING_MODE_VERSION
	default "default"
	string "verstion"

config PK_PAGING_MODE_TAR
	default "tar.gz"
	string "tar type"

config PK_PAGING_MODE_URL
	default "https://gitee.com/BiscuitOS_team/HardStack/raw/Gitee/Memory-Allocator/Paging/paging_mode"
	string "url"

config PK_PAGING_MODE_GITHUB
	string "GitHub"

config PK_PAGING_MODE_SRCFILE
	default "main.c Kconfig Makefile"
	string "Source code list"

config PK_PAGING_MODE_CSRCFILE
	string "Compile source code list"

config PK_PAGING_MODE_CONFIG
	string "CONFIG: Project Configure Options"

config PK_PAGING_MODE_LIBPATH
	string "LIBS: Libraries to pass to the linker, e.g. -l<library>"

config PK_PAGING_MODE_CPPFLAGS
	string "CPPFLAGS: C/C++ preprocessor flags, e.g. -I<include dir>"

config PK_PAGING_MODE_DPKCONFIG
	string "PKG_CONFIG_PATH: Directories to add to pkg-config's search path"

config PK_PAGING_MODE_CFLAGS
	string "CFLAGS: C compiler flags"

config PK_PAGING_MODE_LDFLAGS
	string "LDFLAGS: Linker flags"

config PK_PAGING_MODE_CXXFLAGS
	string "CXXFLAGS: C++ compiler flags"

config PK_PAGING_MODE_ASFLAGS
	string "CCASFLAGS: assembler compiler flags (defaults to CFLAGS)"

config PK_PAGING_MODE_BUILDARCH
	string "--host options on configure for Architecture"

endif # PK_PAGING_MODE
```

## package/paging/paging_userspace/Kconfig
```kconfig
menuconfig PK_PAGING_USERSPACE
	bool "Paging on Userspace"

if PK_PAGING_USERSPACE

config PK_PAGING_USERSPACE_VERSION
	default "0.0.1"
	string "verstion"

config PK_PAGING_USERSPACE_TAR
	default "tar.gz"
	string "tar type"

config PK_PAGING_USERSPACE_URL
	default "https://gitee.com/BiscuitOS_team/HardStack/raw/Gitee/Memory-Allocator/Paging/Paging_userspace"
	string "url"

config PK_PAGING_USERSPACE_GITHUB
	string "GitHub"

config PK_PAGING_USERSPACE_SRCFILE
	default "README.md Makefile main.c mm/memblock.c mm/page_table.c include/linux/biscuitos.h include/linux/memblock.h include/linux/mm.h"
	string "Source code list"

config PK_PAGING_USERSPACE_CSRCFILE
	string "Compile source code list"

config PK_PAGING_USERSPACE_CONFIG
	string "CONFIG: Project Configure Options"

config PK_PAGING_USERSPACE_LIBPATH
	string "LIBS: Libraries to pass to the linker, e.g. -l<library>"

config PK_PAGING_USERSPACE_CPPFLAGS
	string "CPPFLAGS: C/C++ preprocessor flags, e.g. -I<include dir>"

config PK_PAGING_USERSPACE_DPKCONFIG
	string "PKG_CONFIG_PATH: Directories to add to pkg-config's search path"

config PK_PAGING_USERSPACE_CFLAGS
	string "CFLAGS: C compiler flags"

config PK_PAGING_USERSPACE_LDFLAGS
	string "LDFLAGS: Linker flags"

config PK_PAGING_USERSPACE_CXXFLAGS
	string "CXXFLAGS: C++ compiler flags"

config PK_PAGING_USERSPACE_ASFLAGS
	string "CCASFLAGS: assembler compiler flags (defaults to CFLAGS)"

config PK_PAGING_USERSPACE_BUILDARCH
	string "--host options on configure for Architecture"

endif # PK_PAGING_USERSPACE
```

## package/pango/Kconfig
```kconfig
menuconfig PK_PANGO
	bool "pango"

if PK_PANGO

config PK_PANGO_VERSION
	default "1.40.6"
	string "verstion"

config PK_PANGO_TAR
	default "tar.xz"
	string "tar type"

config PK_PANGO_URL
	default "http://ftp.gnome.org/pub/gnome/sources/pango/1.40/"
	string "url"

config PK_PANGO_GITHUB
	string "GitHub"

config PK_PANGO_SRCFILE
	string "Source code list"

config PK_PANGO_CONFIG
	default "--enable-silent-rules --enable-introspection --disable-gtk-doc --disable-debug --disable-static --with-xft --enable-installed-tests"
	string "CONFIG: Project Configure Options"

config PK_PANGO_LIBPATH
	string "LIBS: Libraries to pass to the linker, e.g. -l<library>"

config PK_PANGO_CPPFLAGS
	string "CPPFLAGS: C/C++ preprocessor flags, e.g. -I<include dir>"

config PK_PANGO_DPKCONFIG
	string "PKG_CONFIG_PATH: Directories to add to pkg-config's search path"

config PK_PANGO_CFLAGS
	string "CFLAGS: C compiler flags"

config PK_PANGO_LDFLAGS
	string "LDFLAGS: Linker flags"

config PK_PANGO_CXXFLAGS
	string "CXXFLAGS: C++ compiler flags"

config PK_PANGO_ASFLAGS
	string "CCASFLAGS: assembler compiler flags (defaults to CFLAGS)"

config PK_PANGO_BUILDARCH
	default "x86_64-unknown-linux-gnu"
	string "--host options on configure for Architecture"

endif # PK_PANGO
```

## package/pci/BiscuitOS-PCI-DMA-BUF-QEMU-DEVICE/Kconfig
```kconfig
menuconfig PK_PCI_DMABUF_QEMU_DEV
	bool "QEMU PCI DEVICE: PCI DMA-BUF (BiscuitOS-DMA-BUF-*)"

if PK_PCI_DMABUF_QEMU_DEV

config PK_PCI_DMABUF_QEMU_DEV_VERSION
	default "default"
	string "verstion"

config PK_PCI_DMABUF_QEMU_DEV_TAR
	default "tar.gz"
	string "tar type"

config PK_PCI_DMABUF_QEMU_DEV_URL
	default "https://gitee.com/BiscuitOS_team/HardStack/raw/Gitee/Device-Driver/PCIe/BiscuitOS-PCI-DMA-BUF-QEMU-DEVICE"
	string "url"

config PK_PCI_DMABUF_QEMU_DEV_GITHUB
	string "GitHub"

config PK_PCI_DMABUF_QEMU_DEV_SRCFILE
	default "DMABUF-Export-Capture.c DMABUF-Import-GPUB.c DMABUF-Import-GPUA.c Kconfig Makefile.objs README.md"
	string "Source code list"

config PK_PCI_DMABUF_QEMU_DEV_CSRCFILE
	string "Compile source code list"

config PK_PCI_DMABUF_QEMU_DEV_CONFIG
	string "CONFIG: Project Configure Options"

config PK_PCI_DMABUF_QEMU_DEV_LIBPATH
	string "LIBS: Libraries to pass to the linker, e.g. -l<library>"

config PK_PCI_DMABUF_QEMU_DEV_CPPFLAGS
	string "CPPFLAGS: C/C++ preprocessor flags, e.g. -I<include dir>"

config PK_PCI_DMABUF_QEMU_DEV_DPKCONFIG
	string "PKG_CONFIG_PATH: Directories to add to pkg-config's search path"

config PK_PCI_DMABUF_QEMU_DEV_CFLAGS
	string "CFLAGS: C compiler flags"

config PK_PCI_DMABUF_QEMU_DEV_LDFLAGS
	string "LDFLAGS: Linker flags"

config PK_PCI_DMABUF_QEMU_DEV_CXXFLAGS
	string "CXXFLAGS: C++ compiler flags"

config PK_PCI_DMABUF_QEMU_DEV_ASFLAGS
	string "CCASFLAGS: assembler compiler flags (defaults to CFLAGS)"

config PK_PCI_DMABUF_QEMU_DEV_BUILDARCH
	string "--host options on configure for Architecture"

endif # PK_PCI_DMABUF_QEMU_DEV
```

## package/pci/BiscuitOS-PCI-DMA-QEMU-DEVICE-MSI/Kconfig
```kconfig
menuconfig PK_PCI_DMA_QEMU_DEV_MSI
	bool "QEMU PCI DEVICE: PCI DMA MSI (BiscuitOS-PCI-DMA-MSI)"

if PK_PCI_DMA_QEMU_DEV_MSI

config PK_PCI_DMA_QEMU_DEV_MSI_VERSION
	default "default"
	string "verstion"

config PK_PCI_DMA_QEMU_DEV_MSI_TAR
	default "tar.gz"
	string "tar type"

config PK_PCI_DMA_QEMU_DEV_MSI_URL
	default "https://gitee.com/BiscuitOS_team/HardStack/raw/Gitee/Device-Driver/PCIe/BiscuitOS-PCI-DMA-QEMU-DEVICE-MSI"
	string "url"

config PK_PCI_DMA_QEMU_DEV_MSI_GITHUB
	string "GitHub"

config PK_PCI_DMA_QEMU_DEV_MSI_SRCFILE
	default "main.c Kconfig Makefile.objs README.md"
	string "Source code list"

config PK_PCI_DMA_QEMU_DEV_MSI_CSRCFILE
	string "Compile source code list"

config PK_PCI_DMA_QEMU_DEV_MSI_CONFIG
	string "CONFIG: Project Configure Options"

config PK_PCI_DMA_QEMU_DEV_MSI_LIBPATH
	string "LIBS: Libraries to pass to the linker, e.g. -l<library>"

config PK_PCI_DMA_QEMU_DEV_MSI_CPPFLAGS
	string "CPPFLAGS: C/C++ preprocessor flags, e.g. -I<include dir>"

config PK_PCI_DMA_QEMU_DEV_MSI_DPKCONFIG
	string "PKG_CONFIG_PATH: Directories to add to pkg-config's search path"

config PK_PCI_DMA_QEMU_DEV_MSI_CFLAGS
	string "CFLAGS: C compiler flags"

config PK_PCI_DMA_QEMU_DEV_MSI_LDFLAGS
	string "LDFLAGS: Linker flags"

config PK_PCI_DMA_QEMU_DEV_MSI_CXXFLAGS
	string "CXXFLAGS: C++ compiler flags"

config PK_PCI_DMA_QEMU_DEV_MSI_ASFLAGS
	string "CCASFLAGS: assembler compiler flags (defaults to CFLAGS)"

config PK_PCI_DMA_QEMU_DEV_MSI_BUILDARCH
	string "--host options on configure for Architecture"

endif # PK_PCI_DMA_QEMU_DEV_MSI
```

## package/pci/BiscuitOS-PCI-Express-Configuration-IO/Kconfig
```kconfig
menuconfig PK_PCI_CFG_IO
	bool "PCI Express Configuration via IO"

if PK_PCI_CFG_IO

config PK_PCI_CFG_IO_VERSION
	default "default"
	string "verstion"

config PK_PCI_CFG_IO_TAR
	default "tar.gz"
	string "tar type"

config PK_PCI_CFG_IO_URL
	default "https://gitee.com/BiscuitOS_team/HardStack/raw/Gitee/Device-Driver/PCIe/BiscuitOS-PCI-Express-Configuration-IO"
	string "url"

config PK_PCI_CFG_IO_GITHUB
	string "GitHub"

config PK_PCI_CFG_IO_SRCFILE
	default "main.c Kconfig Makefile"
	string "Source code list"

config PK_PCI_CFG_IO_CSRCFILE
	string "Compile source code list"

config PK_PCI_CFG_IO_CONFIG
	string "CONFIG: Project Configure Options"

config PK_PCI_CFG_IO_LIBPATH
	string "LIBS: Libraries to pass to the linker, e.g. -l<library>"

config PK_PCI_CFG_IO_CPPFLAGS
	string "CPPFLAGS: C/C++ preprocessor flags, e.g. -I<include dir>"

config PK_PCI_CFG_IO_DPKCONFIG
	string "PKG_CONFIG_PATH: Directories to add to pkg-config's search path"

config PK_PCI_CFG_IO_CFLAGS
	string "CFLAGS: C compiler flags"

config PK_PCI_CFG_IO_LDFLAGS
	string "LDFLAGS: Linker flags"

config PK_PCI_CFG_IO_CXXFLAGS
	string "CXXFLAGS: C++ compiler flags"

config PK_PCI_CFG_IO_ASFLAGS
	string "CCASFLAGS: assembler compiler flags (defaults to CFLAGS)"

config PK_PCI_CFG_IO_BUILDARCH
	string "--host options on configure for Architecture"

endif # PK_PCI_CFG_IO
```

## package/pci/BiscuitOS-PCI-QEMU-DEVICE-BAR/Kconfig
```kconfig
menuconfig PK_PCI_QEMU_DEV_BAR
	bool "QEMU PCI DEVICE: PCI BAR (BiscuitOS-PCI-BAR)"

if PK_PCI_QEMU_DEV_BAR

config PK_PCI_QEMU_DEV_BAR_VERSION
	default "default"
	string "verstion"

config PK_PCI_QEMU_DEV_BAR_TAR
	default "tar.gz"
	string "tar type"

config PK_PCI_QEMU_DEV_BAR_URL
	default "https://gitee.com/BiscuitOS_team/HardStack/raw/Gitee/Device-Driver/PCIe/BiscuitOS-PCI-QEMU-DEVICE-BAR"
	string "url"

config PK_PCI_QEMU_DEV_BAR_GITHUB
	string "GitHub"

config PK_PCI_QEMU_DEV_BAR_SRCFILE
	default "main.c Kconfig Makefile.objs README.md"
	string "Source code list"

config PK_PCI_QEMU_DEV_BAR_CSRCFILE
	string "Compile source code list"

config PK_PCI_QEMU_DEV_BAR_CONFIG
	string "CONFIG: Project Configure Options"

config PK_PCI_QEMU_DEV_BAR_LIBPATH
	string "LIBS: Libraries to pass to the linker, e.g. -l<library>"

config PK_PCI_QEMU_DEV_BAR_CPPFLAGS
	string "CPPFLAGS: C/C++ preprocessor flags, e.g. -I<include dir>"

config PK_PCI_QEMU_DEV_BAR_DPKCONFIG
	string "PKG_CONFIG_PATH: Directories to add to pkg-config's search path"

config PK_PCI_QEMU_DEV_BAR_CFLAGS
	string "CFLAGS: C compiler flags"

config PK_PCI_QEMU_DEV_BAR_LDFLAGS
	string "LDFLAGS: Linker flags"

config PK_PCI_QEMU_DEV_BAR_CXXFLAGS
	string "CXXFLAGS: C++ compiler flags"

config PK_PCI_QEMU_DEV_BAR_ASFLAGS
	string "CCASFLAGS: assembler compiler flags (defaults to CFLAGS)"

config PK_PCI_QEMU_DEV_BAR_BUILDARCH
	string "--host options on configure for Architecture"

endif # PK_PCI_QEMU_DEV_BAR
```
