## package/paging/Kconfig
```kconfig
menuconfig PK_PAGING
	bool "Paging Mechanism"

if PK_PAGING

# Paging userspace address (kernel)
source package/paging/BiscuitOS-Paging-userspace-address-kernel/Kconfig

# Paging userspace address (userspace)
source package/paging/BiscuitOS-Paging-userspace-address-userspace/Kconfig

# Paging kernel address
source package/paging/BiscuitOS-Paging-kernel-address/Kconfig

# Paging 4KB (kernel)
source package/paging/BiscuitOS-Paging-4K-Page-kernel/Kconfig

# Paging 4KB (userspace)
source package/paging/BiscuitOS-Paging-4K-Page-userspace/Kconfig

# Paging mode
source package/paging/Paging-mode/Kconfig

# 32-bit Paging mode
source package/paging/Paging-mode-32bit/Kconfig

# PAE Paging mode
source package/paging/Paging-mode-PAE/Kconfig

# 4-level Paging mode
source package/paging/Paging-mode-4level/Kconfig

# SWAP (kernel)
source package/paging/BiscuitOS-SWAP-kernel/Kconfig

# SWAP (userspace)
source package/paging/BiscuitOS-SWAP-userspace/Kconfig

# Compact (kernel)
source package/paging/BiscuitOS-Compact-kernel/Kconfig

# Compact (userspace)
source package/paging/BiscuitOS-Compact-userspace/Kconfig

# userfaultfd
source package/paging/BiscuitOS-userfaultfd/Kconfig

# PTE PAGE_PRESENT kernel
source package/paging/PTE-PAGE_PRESENT-kernel/Kconfig

# PTE PAGE_PRESENT userspace
source package/paging/PTE-PAGE_PRESENT-userspace/Kconfig

# PTE PAGE_RW kernel
source package/paging/PTE-PAGE_RW-kernel/Kconfig

# PTE PAGE_RW userspace rw
source package/paging/PTE-PAGE_RW-userspace-rw/Kconfig

# PTE PAGE_RW userspace ro
source package/paging/PTE-PAGE_RW-userspace-ro/Kconfig

# PTE PAGE_RW userspace wo
source package/paging/PTE-PAGE_RW-userspace-wo/Kconfig

# PTE PAGE_RW userspace none
source package/paging/PTE-PAGE_RW-userspace-none/Kconfig

# PTE PAGE_USER U userspace
source package/paging/PTE-PAGE_USER-U-userspace/Kconfig

# PTE PAGE_USER U kernel
source package/paging/PTE-PAGE_USER-U-kernel/Kconfig

# PTE PAGE_USER S
source package/paging/PTE-PAGE_USER-S/Kconfig

# PTE PAGE_ACCESSED userspace
source package/paging/PTE-PAGE_ACCESSED-userspace/Kconfig

# PTE PAGE_ACCESSED kernel
source package/paging/PTE-PAGE_ACCESSED-kernel/Kconfig

# PTE PAGE_DIRTY userspace
source package/paging/PTE-PAGE_DIRTY-userspace/Kconfig

# PTE PAGE_DIRTY kernel
source package/paging/PTE-PAGE_DIRTY-kernel/Kconfig

endif # PK_PAGING
```

## package/paging/PTE-PAGE_ACCESSED-kernel/Kconfig
```kconfig
menuconfig PK_PTE_PAGE_ACCESSED_KERNEL
	bool "PTE PAGE_ACCESSED Bit-5 (Kernel+)"

if PK_PTE_PAGE_ACCESSED_KERNEL

config PK_PTE_PAGE_ACCESSED_KERNEL_VERSION
	default "default"
	string "verstion"

config PK_PTE_PAGE_ACCESSED_KERNEL_TAR
	default "tar.gz"
	string "tar type"

config PK_PTE_PAGE_ACCESSED_KERNEL_URL
	default "https://gitee.com/BiscuitOS_team/HardStack/raw/Gitee/Memory-Allocator/Paging/PAGE_ACCESSED/kernel"
	string "url"

config PK_PTE_PAGE_ACCESSED_KERNEL_GITHUB
	string "GitHub"

config PK_PTE_PAGE_ACCESSED_KERNEL_SRCFILE
	default "main.c Kconfig Makefile"
	string "Source code list"

config PK_PTE_PAGE_ACCESSED_KERNEL_CSRCFILE
	string "Compile source code list"

config PK_PTE_PAGE_ACCESSED_KERNEL_CONFIG
	string "CONFIG: Project Configure Options"

config PK_PTE_PAGE_ACCESSED_KERNEL_LIBPATH
	string "LIBS: Libraries to pass to the linker, e.g. -l<library>"

config PK_PTE_PAGE_ACCESSED_KERNEL_CPPFLAGS
	string "CPPFLAGS: C/C++ preprocessor flags, e.g. -I<include dir>"

config PK_PTE_PAGE_ACCESSED_KERNEL_DPKCONFIG
	string "PKG_CONFIG_PATH: Directories to add to pkg-config's search path"

config PK_PTE_PAGE_ACCESSED_KERNEL_CFLAGS
	string "CFLAGS: C compiler flags"

config PK_PTE_PAGE_ACCESSED_KERNEL_LDFLAGS
	string "LDFLAGS: Linker flags"

config PK_PTE_PAGE_ACCESSED_KERNEL_CXXFLAGS
	string "CXXFLAGS: C++ compiler flags"

config PK_PTE_PAGE_ACCESSED_KERNEL_ASFLAGS
	string "CCASFLAGS: assembler compiler flags (defaults to CFLAGS)"

config PK_PTE_PAGE_ACCESSED_KERNEL_BUILDARCH
	string "--host options on configure for Architecture"

endif # PK_PTE_PAGE_ACCESSED_KERNEL
```

## package/paging/PTE-PAGE_DIRTY-kernel/Kconfig
```kconfig
menuconfig PK_PTE_PAGE_DIRTY_KERNEL
	bool "PTE PAGE_DIRTY Bit-6 (Kernel+)"

if PK_PTE_PAGE_DIRTY_KERNEL

config PK_PTE_PAGE_DIRTY_KERNEL_VERSION
	default "default"
	string "verstion"

config PK_PTE_PAGE_DIRTY_KERNEL_TAR
	default "tar.gz"
	string "tar type"

config PK_PTE_PAGE_DIRTY_KERNEL_URL
	default "https://gitee.com/BiscuitOS_team/HardStack/raw/Gitee/Memory-Allocator/Paging/PAGE_DIRTY/kernel"
	string "url"

config PK_PTE_PAGE_DIRTY_KERNEL_GITHUB
	string "GitHub"

config PK_PTE_PAGE_DIRTY_KERNEL_SRCFILE
	default "main.c Kconfig Makefile"
	string "Source code list"

config PK_PTE_PAGE_DIRTY_KERNEL_CSRCFILE
	string "Compile source code list"

config PK_PTE_PAGE_DIRTY_KERNEL_CONFIG
	string "CONFIG: Project Configure Options"

config PK_PTE_PAGE_DIRTY_KERNEL_LIBPATH
	string "LIBS: Libraries to pass to the linker, e.g. -l<library>"

config PK_PTE_PAGE_DIRTY_KERNEL_CPPFLAGS
	string "CPPFLAGS: C/C++ preprocessor flags, e.g. -I<include dir>"

config PK_PTE_PAGE_DIRTY_KERNEL_DPKCONFIG
	string "PKG_CONFIG_PATH: Directories to add to pkg-config's search path"

config PK_PTE_PAGE_DIRTY_KERNEL_CFLAGS
	string "CFLAGS: C compiler flags"

config PK_PTE_PAGE_DIRTY_KERNEL_LDFLAGS
	string "LDFLAGS: Linker flags"

config PK_PTE_PAGE_DIRTY_KERNEL_CXXFLAGS
	string "CXXFLAGS: C++ compiler flags"

config PK_PTE_PAGE_DIRTY_KERNEL_ASFLAGS
	string "CCASFLAGS: assembler compiler flags (defaults to CFLAGS)"

config PK_PTE_PAGE_DIRTY_KERNEL_BUILDARCH
	string "--host options on configure for Architecture"

endif # PK_PTE_PAGE_DIRTY_KERNEL
```

## package/paging/PTE-PAGE_DIRTY-userspace/Kconfig
```kconfig
menuconfig PK_PTE_PAGE_DIRTY_USERSPACE
	select PK_PTE_PAGE_DIRTY_KERNEL
	bool "PTE PAGE_DIRTY Bit-6 (Userspace+)"

if PK_PTE_PAGE_DIRTY_USERSPACE

config PK_PTE_PAGE_DIRTY_USERSPACE_VERSION
	default "default"
	string "verstion"

config PK_PTE_PAGE_DIRTY_USERSPACE_TAR
	default "tar.gz"
	string "tar type"

config PK_PTE_PAGE_DIRTY_USERSPACE_URL
	default "https://gitee.com/BiscuitOS_team/HardStack/raw/Gitee/Memory-Allocator/Paging/PAGE_DIRTY/userspace"
	string "url"

config PK_PTE_PAGE_DIRTY_USERSPACE_GITHUB
	string "GitHub"

config PK_PTE_PAGE_DIRTY_USERSPACE_SRCFILE
	default "main.c Makefile"
	string "Source code list"

config PK_PTE_PAGE_DIRTY_USERSPACE_CSRCFILE
	string "Compile source code list"

config PK_PTE_PAGE_DIRTY_USERSPACE_CONFIG
	string "CONFIG: Project Configure Options"

config PK_PTE_PAGE_DIRTY_USERSPACE_LIBPATH
	string "LIBS: Libraries to pass to the linker, e.g. -l<library>"

config PK_PTE_PAGE_DIRTY_USERSPACE_CPPFLAGS
	string "CPPFLAGS: C/C++ preprocessor flags, e.g. -I<include dir>"

config PK_PTE_PAGE_DIRTY_USERSPACE_DPKCONFIG
	string "PKG_CONFIG_PATH: Directories to add to pkg-config's search path"

config PK_PTE_PAGE_DIRTY_USERSPACE_CFLAGS
	string "CFLAGS: C compiler flags"

config PK_PTE_PAGE_DIRTY_USERSPACE_LDFLAGS
	string "LDFLAGS: Linker flags"

config PK_PTE_PAGE_DIRTY_USERSPACE_CXXFLAGS
	string "CXXFLAGS: C++ compiler flags"

config PK_PTE_PAGE_DIRTY_USERSPACE_ASFLAGS
	string "CCASFLAGS: assembler compiler flags (defaults to CFLAGS)"

config PK_PTE_PAGE_DIRTY_USERSPACE_BUILDARCH
	string "--host options on configure for Architecture"

endif # PK_PTE_PAGE_DIRTY_USERSPACE
```

## package/paging/PTE-PAGE_PRESENT-kernel/Kconfig
```kconfig
menuconfig PK_PTE_PAGE_PRESENT_KERNEL
	bool "PTE PAGE_PRESENT Bit-0 (Kernel+)"

if PK_PTE_PAGE_PRESENT_KERNEL

config PK_PTE_PAGE_PRESENT_KERNEL_VERSION
	default "default"
	string "verstion"

config PK_PTE_PAGE_PRESENT_KERNEL_TAR
	default "tar.gz"
	string "tar type"

config PK_PTE_PAGE_PRESENT_KERNEL_URL
	default "https://gitee.com/BiscuitOS_team/HardStack/raw/Gitee/Memory-Allocator/Paging/PAGE_PRESENT/kernel"
	string "url"

config PK_PTE_PAGE_PRESENT_KERNEL_GITHUB
	string "GitHub"

config PK_PTE_PAGE_PRESENT_KERNEL_SRCFILE
	default "main.c Kconfig Makefile RunBiscuitOS.sh"
	string "Source code list"

config PK_PTE_PAGE_PRESENT_KERNEL_CSRCFILE
	string "Compile source code list"

config PK_PTE_PAGE_PRESENT_KERNEL_CONFIG
	string "CONFIG: Project Configure Options"

config PK_PTE_PAGE_PRESENT_KERNEL_LIBPATH
	string "LIBS: Libraries to pass to the linker, e.g. -l<library>"

config PK_PTE_PAGE_PRESENT_KERNEL_CPPFLAGS
	string "CPPFLAGS: C/C++ preprocessor flags, e.g. -I<include dir>"

config PK_PTE_PAGE_PRESENT_KERNEL_DPKCONFIG
	string "PKG_CONFIG_PATH: Directories to add to pkg-config's search path"

config PK_PTE_PAGE_PRESENT_KERNEL_CFLAGS
	string "CFLAGS: C compiler flags"

config PK_PTE_PAGE_PRESENT_KERNEL_LDFLAGS
	string "LDFLAGS: Linker flags"

config PK_PTE_PAGE_PRESENT_KERNEL_CXXFLAGS
	string "CXXFLAGS: C++ compiler flags"

config PK_PTE_PAGE_PRESENT_KERNEL_ASFLAGS
	string "CCASFLAGS: assembler compiler flags (defaults to CFLAGS)"

config PK_PTE_PAGE_PRESENT_KERNEL_BUILDARCH
	string "--host options on configure for Architecture"

endif # PK_PTE_PAGE_PRESENT_KERNEL
```

## package/paging/PTE-PAGE_PRESENT-userspace/Kconfig
```kconfig
menuconfig PK_PTE_PAGE_PRESENT_USERSPACE
	select PK_PTE_PAGE_PRESENT_KERNEL
	bool "PTE PAGE_PRESENT Bit-0 (Userspace+)"

if PK_PTE_PAGE_PRESENT_USERSPACE

config PK_PTE_PAGE_PRESENT_USERSPACE_VERSION
	default "default"
	string "verstion"

config PK_PTE_PAGE_PRESENT_USERSPACE_TAR
	default "tar.gz"
	string "tar type"

config PK_PTE_PAGE_PRESENT_USERSPACE_URL
	default "https://gitee.com/BiscuitOS_team/HardStack/raw/Gitee/Memory-Allocator/Paging/PAGE_PRESENT/userspace"
	string "url"

config PK_PTE_PAGE_PRESENT_USERSPACE_GITHUB
	string "GitHub"

config PK_PTE_PAGE_PRESENT_USERSPACE_SRCFILE
	default "main.c Makefile"
	string "Source code list"

config PK_PTE_PAGE_PRESENT_USERSPACE_CSRCFILE
	string "Compile source code list"

config PK_PTE_PAGE_PRESENT_USERSPACE_CONFIG
	string "CONFIG: Project Configure Options"

config PK_PTE_PAGE_PRESENT_USERSPACE_LIBPATH
	string "LIBS: Libraries to pass to the linker, e.g. -l<library>"

config PK_PTE_PAGE_PRESENT_USERSPACE_CPPFLAGS
	string "CPPFLAGS: C/C++ preprocessor flags, e.g. -I<include dir>"

config PK_PTE_PAGE_PRESENT_USERSPACE_DPKCONFIG
	string "PKG_CONFIG_PATH: Directories to add to pkg-config's search path"

config PK_PTE_PAGE_PRESENT_USERSPACE_CFLAGS
	string "CFLAGS: C compiler flags"

config PK_PTE_PAGE_PRESENT_USERSPACE_LDFLAGS
	string "LDFLAGS: Linker flags"

config PK_PTE_PAGE_PRESENT_USERSPACE_CXXFLAGS
	string "CXXFLAGS: C++ compiler flags"

config PK_PTE_PAGE_PRESENT_USERSPACE_ASFLAGS
	string "CCASFLAGS: assembler compiler flags (defaults to CFLAGS)"

config PK_PTE_PAGE_PRESENT_USERSPACE_BUILDARCH
	string "--host options on configure for Architecture"

endif # PK_PTE_PAGE_PRESENT_USERSPACE
```

## package/paging/PTE-PAGE_RW-kernel/Kconfig
```kconfig
menuconfig PK_PTE_PAGE_RW_KERNEL
	bool "PTE PAGE_RW Bit-1 (Kernel+)"

if PK_PTE_PAGE_RW_KERNEL

config PK_PTE_PAGE_RW_KERNEL_VERSION
	default "default"
	string "verstion"

config PK_PTE_PAGE_RW_KERNEL_TAR
	default "tar.gz"
	string "tar type"

config PK_PTE_PAGE_RW_KERNEL_URL
	default "https://gitee.com/BiscuitOS_team/HardStack/raw/Gitee/Memory-Allocator/Paging/PAGE_RW/kernel"
	string "url"

config PK_PTE_PAGE_RW_KERNEL_GITHUB
	string "GitHub"

config PK_PTE_PAGE_RW_KERNEL_SRCFILE
	default "main.c Kconfig Makefile"
	string "Source code list"

config PK_PTE_PAGE_RW_KERNEL_CSRCFILE
	string "Compile source code list"

config PK_PTE_PAGE_RW_KERNEL_CONFIG
	string "CONFIG: Project Configure Options"

config PK_PTE_PAGE_RW_KERNEL_LIBPATH
	string "LIBS: Libraries to pass to the linker, e.g. -l<library>"

config PK_PTE_PAGE_RW_KERNEL_CPPFLAGS
	string "CPPFLAGS: C/C++ preprocessor flags, e.g. -I<include dir>"

config PK_PTE_PAGE_RW_KERNEL_DPKCONFIG
	string "PKG_CONFIG_PATH: Directories to add to pkg-config's search path"

config PK_PTE_PAGE_RW_KERNEL_CFLAGS
	string "CFLAGS: C compiler flags"

config PK_PTE_PAGE_RW_KERNEL_LDFLAGS
	string "LDFLAGS: Linker flags"

config PK_PTE_PAGE_RW_KERNEL_CXXFLAGS
	string "CXXFLAGS: C++ compiler flags"

config PK_PTE_PAGE_RW_KERNEL_ASFLAGS
	string "CCASFLAGS: assembler compiler flags (defaults to CFLAGS)"

config PK_PTE_PAGE_RW_KERNEL_BUILDARCH
	string "--host options on configure for Architecture"

endif # PK_PTE_PAGE_RW_KERNEL
```

## package/paging/PTE-PAGE_RW-userspace-none/Kconfig
```kconfig
menuconfig PK_PTE_PAGE_RW_USERSPACE_NONE
	select PK_PTE_PAGE_RW_KERNEL
	bool "PTE PAGE_RW Bit-1: Forbid Read/Write (Userspace+)"

if PK_PTE_PAGE_RW_USERSPACE_NONE

config PK_PTE_PAGE_RW_USERSPACE_NONE_VERSION
	default "default"
	string "verstion"

config PK_PTE_PAGE_RW_USERSPACE_NONE_TAR
	default "tar.gz"
	string "tar type"

config PK_PTE_PAGE_RW_USERSPACE_NONE_URL
	default "https://gitee.com/BiscuitOS_team/HardStack/raw/Gitee/Memory-Allocator/Paging/PAGE_RW/userspace-none"
	string "url"

config PK_PTE_PAGE_RW_USERSPACE_NONE_GITHUB
	string "GitHub"

config PK_PTE_PAGE_RW_USERSPACE_NONE_SRCFILE
	default "main.c Makefile RunBiscuitOS.sh"
	string "Source code list"

config PK_PTE_PAGE_RW_USERSPACE_NONE_CSRCFILE
	string "Compile source code list"

config PK_PTE_PAGE_RW_USERSPACE_NONE_CONFIG
	string "CONFIG: Project Configure Options"

config PK_PTE_PAGE_RW_USERSPACE_NONE_LIBPATH
	string "LIBS: Libraries to pass to the linker, e.g. -l<library>"

config PK_PTE_PAGE_RW_USERSPACE_NONE_CPPFLAGS
	string "CPPFLAGS: C/C++ preprocessor flags, e.g. -I<include dir>"

config PK_PTE_PAGE_RW_USERSPACE_NONE_DPKCONFIG
	string "PKG_CONFIG_PATH: Directories to add to pkg-config's search path"

config PK_PTE_PAGE_RW_USERSPACE_NONE_CFLAGS
	string "CFLAGS: C compiler flags"

config PK_PTE_PAGE_RW_USERSPACE_NONE_LDFLAGS
	string "LDFLAGS: Linker flags"

config PK_PTE_PAGE_RW_USERSPACE_NONE_CXXFLAGS
	string "CXXFLAGS: C++ compiler flags"

config PK_PTE_PAGE_RW_USERSPACE_NONE_ASFLAGS
	string "CCASFLAGS: assembler compiler flags (defaults to CFLAGS)"

config PK_PTE_PAGE_RW_USERSPACE_NONE_BUILDARCH
	string "--host options on configure for Architecture"

endif # PK_PTE_PAGE_RW_USERSPACE_NONE
```

## package/paging/PTE-PAGE_RW-userspace-wo/Kconfig
```kconfig
menuconfig PK_PTE_PAGE_RW_USERSPACE_WO
	select PK_PTE_PAGE_RW_KERNEL
	bool "PTE PAGE_RW Bit-1: Write only (Userspace+)"

if PK_PTE_PAGE_RW_USERSPACE_WO

config PK_PTE_PAGE_RW_USERSPACE_WO_VERSION
	default "default"
	string "verstion"

config PK_PTE_PAGE_RW_USERSPACE_WO_TAR
	default "tar.gz"
	string "tar type"

config PK_PTE_PAGE_RW_USERSPACE_WO_URL
	default "https://gitee.com/BiscuitOS_team/HardStack/raw/Gitee/Memory-Allocator/Paging/PAGE_RW/userspace-wo"
	string "url"

config PK_PTE_PAGE_RW_USERSPACE_WO_GITHUB
	string "GitHub"

config PK_PTE_PAGE_RW_USERSPACE_WO_SRCFILE
	default "main.c Makefile RunBiscuitOS.sh"
	string "Source code list"

config PK_PTE_PAGE_RW_USERSPACE_WO_CSRCFILE
	string "Compile source code list"

config PK_PTE_PAGE_RW_USERSPACE_WO_CONFIG
	string "CONFIG: Project Configure Options"

config PK_PTE_PAGE_RW_USERSPACE_WO_LIBPATH
	string "LIBS: Libraries to pass to the linker, e.g. -l<library>"

config PK_PTE_PAGE_RW_USERSPACE_WO_CPPFLAGS
	string "CPPFLAGS: C/C++ preprocessor flags, e.g. -I<include dir>"

config PK_PTE_PAGE_RW_USERSPACE_WO_DPKCONFIG
	string "PKG_CONFIG_PATH: Directories to add to pkg-config's search path"

config PK_PTE_PAGE_RW_USERSPACE_WO_CFLAGS
	string "CFLAGS: C compiler flags"

config PK_PTE_PAGE_RW_USERSPACE_WO_LDFLAGS
	string "LDFLAGS: Linker flags"

config PK_PTE_PAGE_RW_USERSPACE_WO_CXXFLAGS
	string "CXXFLAGS: C++ compiler flags"

config PK_PTE_PAGE_RW_USERSPACE_WO_ASFLAGS
	string "CCASFLAGS: assembler compiler flags (defaults to CFLAGS)"

config PK_PTE_PAGE_RW_USERSPACE_WO_BUILDARCH
	string "--host options on configure for Architecture"

endif # PK_PTE_PAGE_RW_USERSPACE_WO
```
