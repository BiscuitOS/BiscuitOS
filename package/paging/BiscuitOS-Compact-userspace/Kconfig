## package/paging/PTE-PAGE_USER-U-kernel/Kconfig
```kconfig
menuconfig PK_PTE_PAGE_USER_U_KERNEL
	bool "PTE PAGE_USER Bit-2 Userspace address (Kernel+)"

if PK_PTE_PAGE_USER_U_KERNEL

config PK_PTE_PAGE_USER_U_KERNEL_VERSION
	default "default"
	string "verstion"

config PK_PTE_PAGE_USER_U_KERNEL_TAR
	default "tar.gz"
	string "tar type"

config PK_PTE_PAGE_USER_U_KERNEL_URL
	default "https://gitee.com/BiscuitOS_team/HardStack/raw/Gitee/Memory-Allocator/Paging/PAGE_USER/U/kernel"
	string "url"

config PK_PTE_PAGE_USER_U_KERNEL_GITHUB
	string "GitHub"

config PK_PTE_PAGE_USER_U_KERNEL_SRCFILE
	default "main.c Kconfig Makefile"
	string "Source code list"

config PK_PTE_PAGE_USER_U_KERNEL_CSRCFILE
	string "Compile source code list"

config PK_PTE_PAGE_USER_U_KERNEL_CONFIG
	string "CONFIG: Project Configure Options"

config PK_PTE_PAGE_USER_U_KERNEL_LIBPATH
	string "LIBS: Libraries to pass to the linker, e.g. -l<library>"

config PK_PTE_PAGE_USER_U_KERNEL_CPPFLAGS
	string "CPPFLAGS: C/C++ preprocessor flags, e.g. -I<include dir>"

config PK_PTE_PAGE_USER_U_KERNEL_DPKCONFIG
	string "PKG_CONFIG_PATH: Directories to add to pkg-config's search path"

config PK_PTE_PAGE_USER_U_KERNEL_CFLAGS
	string "CFLAGS: C compiler flags"

config PK_PTE_PAGE_USER_U_KERNEL_LDFLAGS
	string "LDFLAGS: Linker flags"

config PK_PTE_PAGE_USER_U_KERNEL_CXXFLAGS
	string "CXXFLAGS: C++ compiler flags"

config PK_PTE_PAGE_USER_U_KERNEL_ASFLAGS
	string "CCASFLAGS: assembler compiler flags (defaults to CFLAGS)"

config PK_PTE_PAGE_USER_U_KERNEL_BUILDARCH
	string "--host options on configure for Architecture"

endif # PK_PTE_PAGE_USER_U_KERNEL
```

## package/paging/Paging-mode-32bit/Kconfig
```kconfig
menuconfig PK_PAGING_MODE_32BIT
	bool "X86 32bit Paging mode"

if PK_PAGING_MODE_32BIT

# Detect Paging 32bit mode
source "package/paging/Paging-mode-32bit/Paging-32bit-Detect/Kconfig"

# 4K Page With 32-Bit Paging (U+)
source "package/paging/Paging-mode-32bit/Paging-32bit-4K-Page-userspace/Kconfig"

# 4K Page With 32-Bit Paging (K+)
source "package/paging/Paging-mode-32bit/Paging-32bit-4K-Page-kernel/Kconfig"

# 4M Page With 32-Bit Paging (U+)
source "package/paging/Paging-mode-32bit/Paging-32bit-4M-Page-userspace/Kconfig"

# 4M Page With 32-Bit Paging (K+)
source "package/paging/Paging-mode-32bit/Paging-32bit-4M-Page-kernel/Kconfig"

# Kernel address 4K Page With 32-Bit Paging 
source "package/paging/Paging-mode-32bit/Paging-32bit-Kernel-4K-Page/Kconfig"

# Kernel address 4M Page With 32-Bit Paging 
source "package/paging/Paging-mode-32bit/Paging-32bit-Kernel-4M-Page/Kconfig"

# VMALLOC With 32-Bit Paging 
source "package/paging/Paging-mode-32bit/Paging-32bit-VMALLOC/Kconfig"

# KMAP With 32-Bit Paging 
source "package/paging/Paging-mode-32bit/Paging-32bit-KMAP/Kconfig"

# PKMAP With 32-Bit Paging 
source "package/paging/Paging-mode-32bit/Paging-32bit-PKMAP/Kconfig"

# FIXMAP With 32-Bit Paging 
source "package/paging/Paging-mode-32bit/Paging-32bit-FIXMAP/Kconfig"

# IO With 32-Bit Paging 
source "package/paging/Paging-mode-32bit/Paging-32bit-IO/Kconfig"

# PFN Direct Mapping With 32-Bit Paging 
source "package/paging/Paging-mode-32bit/Paging-32bit-PFN/Kconfig"

# Linear Mapping With 32-Bit Paging 
source "package/paging/Paging-mode-32bit/Paging-32bit-Linear/Kconfig"

# CR3 on 32bit Paging (U+)
source "package/paging/Paging-mode-32bit/Paging-32bit-CR3-userspace/Kconfig"

# CR3 on 32bit Paging (K+)
source "package/paging/Paging-mode-32bit/Paging-32bit-CR3-kernel/Kconfig"

# PGD on 32bit Paging (U+)
source "package/paging/Paging-mode-32bit/Paging-32bit-PGD-userspace/Kconfig"

# PGD on 32bit Paging (K+)
source "package/paging/Paging-mode-32bit/Paging-32bit-PGD-kernel/Kconfig"

endif # PK_REGISTER_X86
```

## package/paging/Paging-mode-32bit/Paging-32bit-4K-Page-userspace/Kconfig
```kconfig
menuconfig PK_PAGING_32BIT_4K_PAGE_U
	select PK_PAGING_32BIT_4K_PAGE_K
	bool "Translate Userspace Address With 4K Page (Userspace+)"

if PK_PAGING_32BIT_4K_PAGE_U

config PK_PAGING_32BIT_4K_PAGE_U_VERSION
	default "default"
	string "verstion"

config PK_PAGING_32BIT_4K_PAGE_U_TAR
	default "tar.gz"
	string "tar type"

config PK_PAGING_32BIT_4K_PAGE_U_URL
	default "https://gitee.com/BiscuitOS_team/HardStack/raw/Gitee/Memory-Allocator/Paging/paging_mode_32bit/Paging-32bit-4KB-Page/userspace"
	string "url"

config PK_PAGING_32BIT_4K_PAGE_U_GITHUB
	string "GitHub"

config PK_PAGING_32BIT_4K_PAGE_U_SRCFILE
	default "main.c Makefile"
	string "Source code list"

config PK_PAGING_32BIT_4K_PAGE_U_CSRCFILE
	string "Compile source code list"

config PK_PAGING_32BIT_4K_PAGE_U_CONFIG
	string "CONFIG: Project Configure Options"

config PK_PAGING_32BIT_4K_PAGE_U_LIBPATH
	string "LIBS: Libraries to pass to the linker, e.g. -l<library>"

config PK_PAGING_32BIT_4K_PAGE_U_CPPFLAGS
	string "CPPFLAGS: C/C++ preprocessor flags, e.g. -I<include dir>"

config PK_PAGING_32BIT_4K_PAGE_U_DPKCONFIG
	string "PKG_CONFIG_PATH: Directories to add to pkg-config's search path"

config PK_PAGING_32BIT_4K_PAGE_U_CFLAGS
	string "CFLAGS: C compiler flags"

config PK_PAGING_32BIT_4K_PAGE_U_LDFLAGS
	string "LDFLAGS: Linker flags"

config PK_PAGING_32BIT_4K_PAGE_U_CXXFLAGS
	string "CXXFLAGS: C++ compiler flags"

config PK_PAGING_32BIT_4K_PAGE_U_ASFLAGS
	string "CCASFLAGS: assembler compiler flags (defaults to CFLAGS)"

config PK_PAGING_32BIT_4K_PAGE_U_BUILDARCH
	string "--host options on configure for Architecture"

endif # PK_PAGING_32BIT_4K_PAGE_U
```

## package/paging/Paging-mode-32bit/Paging-32bit-4M-Page-kernel/Kconfig
```kconfig
menuconfig PK_PAGING_32BIT_4M_PAGE_K
	bool "Translate Userspace Address With 4M Page (Kernel+)"

if PK_PAGING_32BIT_4M_PAGE_K

config PK_PAGING_32BIT_4M_PAGE_K_VERSION
	default "default"
	string "verstion"

config PK_PAGING_32BIT_4M_PAGE_K_TAR
	default "tar.gz"
	string "tar type"

config PK_PAGING_32BIT_4M_PAGE_K_URL
	default "https://gitee.com/BiscuitOS_team/HardStack/raw/Gitee/Memory-Allocator/Paging/paging_mode_32bit/Paging-32bit-4MB-Page/kernel"
	string "url"

config PK_PAGING_32BIT_4M_PAGE_K_GITHUB
	string "GitHub"

config PK_PAGING_32BIT_4M_PAGE_K_SRCFILE
	default "main.c Kconfig Makefile RunBiscuitOS.sh"
	string "Source code list"

config PK_PAGING_32BIT_4M_PAGE_K_CSRCFILE
	string "Compile source code list"

config PK_PAGING_32BIT_4M_PAGE_K_CONFIG
	string "CONFIG: Project Configure Options"

config PK_PAGING_32BIT_4M_PAGE_K_LIBPATH
	string "LIBS: Libraries to pass to the linker, e.g. -l<library>"

config PK_PAGING_32BIT_4M_PAGE_K_CPPFLAGS
	string "CPPFLAGS: C/C++ preprocessor flags, e.g. -I<include dir>"

config PK_PAGING_32BIT_4M_PAGE_K_DPKCONFIG
	string "PKG_CONFIG_PATH: Directories to add to pkg-config's search path"

config PK_PAGING_32BIT_4M_PAGE_K_CFLAGS
	string "CFLAGS: C compiler flags"

config PK_PAGING_32BIT_4M_PAGE_K_LDFLAGS
	string "LDFLAGS: Linker flags"

config PK_PAGING_32BIT_4M_PAGE_K_CXXFLAGS
	string "CXXFLAGS: C++ compiler flags"

config PK_PAGING_32BIT_4M_PAGE_K_ASFLAGS
	string "CCASFLAGS: assembler compiler flags (defaults to CFLAGS)"

config PK_PAGING_32BIT_4M_PAGE_K_BUILDARCH
	string "--host options on configure for Architecture"

endif # PK_PAGING_32BIT_4M_PAGE_K
```

## package/paging/Paging-mode-32bit/Paging-32bit-CR3-kernel/Kconfig
```kconfig
menuconfig PK_PAGING_32BIT_CR3_K
	bool "CR3 on Paging 32bit mode (Kernel+)"

if PK_PAGING_32BIT_CR3_K

config PK_PAGING_32BIT_CR3_K_VERSION
	default "default"
	string "verstion"

config PK_PAGING_32BIT_CR3_K_TAR
	default "tar.gz"
	string "tar type"

config PK_PAGING_32BIT_CR3_K_URL
	default "https://gitee.com/BiscuitOS_team/HardStack/raw/Gitee/Memory-Allocator/Paging/paging_mode_32bit/Paging-32bit-CR3/kernel"
	string "url"

config PK_PAGING_32BIT_CR3_K_GITHUB
	string "GitHub"

config PK_PAGING_32BIT_CR3_K_SRCFILE
	default "main.c Kconfig Makefile"
	string "Source code list"

config PK_PAGING_32BIT_CR3_K_CSRCFILE
	string "Compile source code list"

config PK_PAGING_32BIT_CR3_K_CONFIG
	string "CONFIG: Project Configure Options"

config PK_PAGING_32BIT_CR3_K_LIBPATH
	string "LIBS: Libraries to pass to the linker, e.g. -l<library>"

config PK_PAGING_32BIT_CR3_K_CPPFLAGS
	string "CPPFLAGS: C/C++ preprocessor flags, e.g. -I<include dir>"

config PK_PAGING_32BIT_CR3_K_DPKCONFIG
	string "PKG_CONFIG_PATH: Directories to add to pkg-config's search path"

config PK_PAGING_32BIT_CR3_K_CFLAGS
	string "CFLAGS: C compiler flags"

config PK_PAGING_32BIT_CR3_K_LDFLAGS
	string "LDFLAGS: Linker flags"

config PK_PAGING_32BIT_CR3_K_CXXFLAGS
	string "CXXFLAGS: C++ compiler flags"

config PK_PAGING_32BIT_CR3_K_ASFLAGS
	string "CCASFLAGS: assembler compiler flags (defaults to CFLAGS)"

config PK_PAGING_32BIT_CR3_K_BUILDARCH
	string "--host options on configure for Architecture"

endif # PK_PAGING_32BIT_CR3_K
```

## package/paging/Paging-mode-32bit/Paging-32bit-CR3-userspace/Kconfig
```kconfig
menuconfig PK_PAGING_32BIT_CR3_U
	select PK_PAGING_32BIT_CR3_K
	bool "CR3 on Paing 32bit (Userspace+)"

if PK_PAGING_32BIT_CR3_U

config PK_PAGING_32BIT_CR3_U_VERSION
	default "default"
	string "verstion"

config PK_PAGING_32BIT_CR3_U_TAR
	default "tar.gz"
	string "tar type"

config PK_PAGING_32BIT_CR3_U_URL
	default "https://gitee.com/BiscuitOS_team/HardStack/raw/Gitee/Memory-Allocator/Paging/paging_mode_32bit/Paging-32bit-CR3/userspace"
	string "url"

config PK_PAGING_32BIT_CR3_U_GITHUB
	string "GitHub"

config PK_PAGING_32BIT_CR3_U_SRCFILE
	default "main.c Makefile"
	string "Source code list"

config PK_PAGING_32BIT_CR3_U_CSRCFILE
	string "Compile source code list"

config PK_PAGING_32BIT_CR3_U_CONFIG
	string "CONFIG: Project Configure Options"

config PK_PAGING_32BIT_CR3_U_LIBPATH
	string "LIBS: Libraries to pass to the linker, e.g. -l<library>"

config PK_PAGING_32BIT_CR3_U_CPPFLAGS
	string "CPPFLAGS: C/C++ preprocessor flags, e.g. -I<include dir>"

config PK_PAGING_32BIT_CR3_U_DPKCONFIG
	string "PKG_CONFIG_PATH: Directories to add to pkg-config's search path"

config PK_PAGING_32BIT_CR3_U_CFLAGS
	string "CFLAGS: C compiler flags"

config PK_PAGING_32BIT_CR3_U_LDFLAGS
	string "LDFLAGS: Linker flags"

config PK_PAGING_32BIT_CR3_U_CXXFLAGS
	string "CXXFLAGS: C++ compiler flags"

config PK_PAGING_32BIT_CR3_U_ASFLAGS
	string "CCASFLAGS: assembler compiler flags (defaults to CFLAGS)"

config PK_PAGING_32BIT_CR3_U_BUILDARCH
	string "--host options on configure for Architecture"

endif # PK_PAGING_32BIT_CR3_U
```
