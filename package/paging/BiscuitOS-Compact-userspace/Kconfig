## package/paging/BiscuitOS-Compact-userspace/Kconfig
```kconfig
menuconfig PK_COMPACT_USERSPACE
	select PK_COMPACT_KERNEL
	bool "Memory Compact Mechanism on BiscuitOS (Userspace+)"

if PK_COMPACT_USERSPACE

config PK_COMPACT_USERSPACE_VERSION
	default "default"
	string "verstion"

config PK_COMPACT_USERSPACE_TAR
	default "tar.gz"
	string "tar type"

config PK_COMPACT_USERSPACE_URL
	default "https://gitee.com/BiscuitOS_team/HardStack/raw/Gitee/Memory-Allocator/Paging/BiscuitOS-Compact/userspace"
	string "url"

config PK_COMPACT_USERSPACE_GITHUB
	string "GitHub"

config PK_COMPACT_USERSPACE_SRCFILE
	default "main.c Makefile"
	string "Source code list"

config PK_COMPACT_USERSPACE_CSRCFILE
	string "Compile source code list"

config PK_COMPACT_USERSPACE_CONFIG
	string "CONFIG: Project Configure Options"

config PK_COMPACT_USERSPACE_LIBPATH
	string "LIBS: Libraries to pass to the linker, e.g. -l<library>"

config PK_COMPACT_USERSPACE_CPPFLAGS
	string "CPPFLAGS: C/C++ preprocessor flags, e.g. -I<include dir>"

config PK_COMPACT_USERSPACE_DPKCONFIG
	string "PKG_CONFIG_PATH: Directories to add to pkg-config's search path"

config PK_COMPACT_USERSPACE_CFLAGS
	string "CFLAGS: C compiler flags"

config PK_COMPACT_USERSPACE_LDFLAGS
	string "LDFLAGS: Linker flags"

config PK_COMPACT_USERSPACE_CXXFLAGS
	string "CXXFLAGS: C++ compiler flags"

config PK_COMPACT_USERSPACE_ASFLAGS
	string "CCASFLAGS: assembler compiler flags (defaults to CFLAGS)"

config PK_COMPACT_USERSPACE_BUILDARCH
	string "--host options on configure for Architecture"

endif # PK_COMPACT_USERSPACE
```

## package/paging/BiscuitOS-PAGING-Base/Kconfig
```kconfig
menuconfig PK_PAGING_BASE
	bool "Paing Mechanism: Base Usage"

if PK_PAGING_BASE

config PK_PAGING_BASE_VERSION
	default "default"
	string "verstion"

config PK_PAGING_BASE_TAR
	default "tar.gz"
	string "tar type"

config PK_PAGING_BASE_URL
	default "https://gitee.com/BiscuitOS_team/HardStack/raw/Gitee/Memory-Allocator/PAGING-MECH/BiscuitOS-PAGING-Base"
	string "url"

config PK_PAGING_BASE_GITHUB
	string "GitHub"

config PK_PAGING_BASE_SRCFILE
	default "main.c Kconfig Makefile Makefile.host RunBiscuitOS.sh app.c"
	string "Source code list"

config PK_PAGING_BASE_CSRCFILE
	string "Compile source code list"

config PK_PAGING_BASE_CONFIG
	string "CONFIG: Project Configure Options"

config PK_PAGING_BASE_LIBPATH
	string "LIBS: Libraries to pass to the linker, e.g. -l<library>"

config PK_PAGING_BASE_CPPFLAGS
	string "CPPFLAGS: C/C++ preprocessor flags, e.g. -I<include dir>"

config PK_PAGING_BASE_DPKCONFIG
	string "PKG_CONFIG_PATH: Directories to add to pkg-config's search path"

config PK_PAGING_BASE_CFLAGS
	string "CFLAGS: C compiler flags"

config PK_PAGING_BASE_LDFLAGS
	string "LDFLAGS: Linker flags"

config PK_PAGING_BASE_CXXFLAGS
	string "CXXFLAGS: C++ compiler flags"

config PK_PAGING_BASE_ASFLAGS
	string "CCASFLAGS: assembler compiler flags (defaults to CFLAGS)"

config PK_PAGING_BASE_BUILDARCH
	string "--host options on configure for Architecture"

endif # PK_PAGING_BASE
```

## package/paging/BiscuitOS-PAGING-TimeCost/Kconfig
```kconfig
menuconfig PK_PAGING_TIMECOST
	bool "Paing Mechanism: Time Cost"

if PK_PAGING_TIMECOST

config PK_PAGING_TIMECOST_VERSION
	default "default"
	string "verstion"

config PK_PAGING_TIMECOST_TAR
	default "tar.gz"
	string "tar type"

config PK_PAGING_TIMECOST_URL
	default "https://gitee.com/BiscuitOS_team/HardStack/raw/Gitee/Memory-Allocator/PAGING-MECH/BiscuitOS-PAGING-TimeCost"
	string "url"

config PK_PAGING_TIMECOST_GITHUB
	string "GitHub"

config PK_PAGING_TIMECOST_SRCFILE
	default "main.c Kconfig Makefile Makefile.host RunBiscuitOS.sh app.c"
	string "Source code list"

config PK_PAGING_TIMECOST_CSRCFILE
	string "Compile source code list"

config PK_PAGING_TIMECOST_CONFIG
	string "CONFIG: Project Configure Options"

config PK_PAGING_TIMECOST_LIBPATH
	string "LIBS: Libraries to pass to the linker, e.g. -l<library>"

config PK_PAGING_TIMECOST_CPPFLAGS
	string "CPPFLAGS: C/C++ preprocessor flags, e.g. -I<include dir>"

config PK_PAGING_TIMECOST_DPKCONFIG
	string "PKG_CONFIG_PATH: Directories to add to pkg-config's search path"

config PK_PAGING_TIMECOST_CFLAGS
	string "CFLAGS: C compiler flags"

config PK_PAGING_TIMECOST_LDFLAGS
	string "LDFLAGS: Linker flags"

config PK_PAGING_TIMECOST_CXXFLAGS
	string "CXXFLAGS: C++ compiler flags"

config PK_PAGING_TIMECOST_ASFLAGS
	string "CCASFLAGS: assembler compiler flags (defaults to CFLAGS)"

config PK_PAGING_TIMECOST_BUILDARCH
	string "--host options on configure for Architecture"

endif # PK_PAGING_TIMECOST
```

## package/paging/BiscuitOS-Paging-4K-Page-kernel/Kconfig
```kconfig
menuconfig PK_PAGING_4K_PAGE_KERNEL
	bool "Paging Mapping 4KiB Page (Kernel+)"

if PK_PAGING_4K_PAGE_KERNEL

config PK_PAGING_4K_PAGE_KERNEL_VERSION
	default "default"
	string "verstion"

config PK_PAGING_4K_PAGE_KERNEL_TAR
	default "tar.gz"
	string "tar type"

config PK_PAGING_4K_PAGE_KERNEL_URL
	default "https://gitee.com/BiscuitOS_team/HardStack/raw/Gitee/Memory-Allocator/Paging/BiscuitOS-Paging-4K-Page/kernel/"
	string "url"

config PK_PAGING_4K_PAGE_KERNEL_GITHUB
	string "GitHub"

config PK_PAGING_4K_PAGE_KERNEL_SRCFILE
	default "main.c Kconfig Makefile RunBiscuitOS.sh"
	string "Source code list"

config PK_PAGING_4K_PAGE_KERNEL_CSRCFILE
	string "Compile source code list"

config PK_PAGING_4K_PAGE_KERNEL_CONFIG
	string "CONFIG: Project Configure Options"

config PK_PAGING_4K_PAGE_KERNEL_LIBPATH
	string "LIBS: Libraries to pass to the linker, e.g. -l<library>"

config PK_PAGING_4K_PAGE_KERNEL_CPPFLAGS
	string "CPPFLAGS: C/C++ preprocessor flags, e.g. -I<include dir>"

config PK_PAGING_4K_PAGE_KERNEL_DPKCONFIG
	string "PKG_CONFIG_PATH: Directories to add to pkg-config's search path"

config PK_PAGING_4K_PAGE_KERNEL_CFLAGS
	string "CFLAGS: C compiler flags"

config PK_PAGING_4K_PAGE_KERNEL_LDFLAGS
	string "LDFLAGS: Linker flags"

config PK_PAGING_4K_PAGE_KERNEL_CXXFLAGS
	string "CXXFLAGS: C++ compiler flags"

config PK_PAGING_4K_PAGE_KERNEL_ASFLAGS
	string "CCASFLAGS: assembler compiler flags (defaults to CFLAGS)"

config PK_PAGING_4K_PAGE_KERNEL_BUILDARCH
	string "--host options on configure for Architecture"

endif # PK_PAGING_4K_PAGE_KERNEL
```

## package/paging/BiscuitOS-Paging-4K-Page-userspace/Kconfig
```kconfig
menuconfig PK_PAGING_4K_PAGE_USERSPACE
	select PK_PAGING_4K_PAGE_KERNEL
	bool "Paging Mapping 4KiB Page (Userspace+)"

if PK_PAGING_4K_PAGE_USERSPACE

config PK_PAGING_4K_PAGE_USERSPACE_VERSION
	default "default"
	string "verstion"

config PK_PAGING_4K_PAGE_USERSPACE_TAR
	default "tar.gz"
	string "tar type"

config PK_PAGING_4K_PAGE_USERSPACE_URL
	default "https://gitee.com/BiscuitOS_team/HardStack/raw/Gitee/Memory-Allocator/Paging/BiscuitOS-Paging-4K-Page/userspace/"
	string "url"

config PK_PAGING_4K_PAGE_USERSPACE_GITHUB
	string "GitHub"

config PK_PAGING_4K_PAGE_USERSPACE_SRCFILE
	default "main.c Makefile"
	string "Source code list"

config PK_PAGING_4K_PAGE_USERSPACE_CSRCFILE
	string "Compile source code list"

config PK_PAGING_4K_PAGE_USERSPACE_CONFIG
	string "CONFIG: Project Configure Options"

config PK_PAGING_4K_PAGE_USERSPACE_LIBPATH
	string "LIBS: Libraries to pass to the linker, e.g. -l<library>"

config PK_PAGING_4K_PAGE_USERSPACE_CPPFLAGS
	string "CPPFLAGS: C/C++ preprocessor flags, e.g. -I<include dir>"

config PK_PAGING_4K_PAGE_USERSPACE_DPKCONFIG
	string "PKG_CONFIG_PATH: Directories to add to pkg-config's search path"

config PK_PAGING_4K_PAGE_USERSPACE_CFLAGS
	string "CFLAGS: C compiler flags"

config PK_PAGING_4K_PAGE_USERSPACE_LDFLAGS
	string "LDFLAGS: Linker flags"

config PK_PAGING_4K_PAGE_USERSPACE_CXXFLAGS
	string "CXXFLAGS: C++ compiler flags"

config PK_PAGING_4K_PAGE_USERSPACE_ASFLAGS
	string "CCASFLAGS: assembler compiler flags (defaults to CFLAGS)"

config PK_PAGING_4K_PAGE_USERSPACE_BUILDARCH
	string "--host options on configure for Architecture"

endif # PK_PAGING_4K_PAGE_USERSPACE
```

## package/paging/BiscuitOS-Paging-kernel-address/Kconfig
```kconfig
menuconfig PK_PAGING_KERNEL_ADDR
	bool "Paging kernel address"

if PK_PAGING_KERNEL_ADDR

config PK_PAGING_KERNEL_ADDR_VERSION
	default "default"
	string "verstion"

config PK_PAGING_KERNEL_ADDR_TAR
	default "tar.gz"
	string "tar type"

config PK_PAGING_KERNEL_ADDR_URL
	default "https://gitee.com/BiscuitOS_team/HardStack/raw/Gitee/Memory-Allocator/Paging/BiscuitOS-Paging-kernel-address"
	string "url"

config PK_PAGING_KERNEL_ADDR_GITHUB
	string "GitHub"

config PK_PAGING_KERNEL_ADDR_SRCFILE
	default "main.c Kconfig Makefile"
	string "Source code list"

config PK_PAGING_KERNEL_ADDR_CSRCFILE
	string "Compile source code list"

config PK_PAGING_KERNEL_ADDR_CONFIG
	string "CONFIG: Project Configure Options"

config PK_PAGING_KERNEL_ADDR_LIBPATH
	string "LIBS: Libraries to pass to the linker, e.g. -l<library>"

config PK_PAGING_KERNEL_ADDR_CPPFLAGS
	string "CPPFLAGS: C/C++ preprocessor flags, e.g. -I<include dir>"

config PK_PAGING_KERNEL_ADDR_DPKCONFIG
	string "PKG_CONFIG_PATH: Directories to add to pkg-config's search path"

config PK_PAGING_KERNEL_ADDR_CFLAGS
	string "CFLAGS: C compiler flags"

config PK_PAGING_KERNEL_ADDR_LDFLAGS
	string "LDFLAGS: Linker flags"

config PK_PAGING_KERNEL_ADDR_CXXFLAGS
	string "CXXFLAGS: C++ compiler flags"

config PK_PAGING_KERNEL_ADDR_ASFLAGS
	string "CCASFLAGS: assembler compiler flags (defaults to CFLAGS)"

config PK_PAGING_KERNEL_ADDR_BUILDARCH
	string "--host options on configure for Architecture"

endif # PK_PAGING_KERNEL_ADDR
```

## package/paging/BiscuitOS-Paging-userspace-address-kernel/Kconfig
```kconfig
menuconfig PK_PAGING_USER_ADDR_KERNEL
	bool "Paging userspace address (Kernel+)"

if PK_PAGING_USER_ADDR_KERNEL

config PK_PAGING_USER_ADDR_KERNEL_VERSION
	default "default"
	string "verstion"

config PK_PAGING_USER_ADDR_KERNEL_TAR
	default "tar.gz"
	string "tar type"

config PK_PAGING_USER_ADDR_KERNEL_URL
	default "https://gitee.com/BiscuitOS_team/HardStack/raw/Gitee/Memory-Allocator/Paging/BiscuitOS-Paging-userspace-address/kernel"
	string "url"

config PK_PAGING_USER_ADDR_KERNEL_GITHUB
	string "GitHub"

config PK_PAGING_USER_ADDR_KERNEL_SRCFILE
	default "main.c Kconfig Makefile"
	string "Source code list"

config PK_PAGING_USER_ADDR_KERNEL_CSRCFILE
	string "Compile source code list"

config PK_PAGING_USER_ADDR_KERNEL_CONFIG
	string "CONFIG: Project Configure Options"

config PK_PAGING_USER_ADDR_KERNEL_LIBPATH
	string "LIBS: Libraries to pass to the linker, e.g. -l<library>"

config PK_PAGING_USER_ADDR_KERNEL_CPPFLAGS
	string "CPPFLAGS: C/C++ preprocessor flags, e.g. -I<include dir>"

config PK_PAGING_USER_ADDR_KERNEL_DPKCONFIG
	string "PKG_CONFIG_PATH: Directories to add to pkg-config's search path"

config PK_PAGING_USER_ADDR_KERNEL_CFLAGS
	string "CFLAGS: C compiler flags"

config PK_PAGING_USER_ADDR_KERNEL_LDFLAGS
	string "LDFLAGS: Linker flags"

config PK_PAGING_USER_ADDR_KERNEL_CXXFLAGS
	string "CXXFLAGS: C++ compiler flags"

config PK_PAGING_USER_ADDR_KERNEL_ASFLAGS
	string "CCASFLAGS: assembler compiler flags (defaults to CFLAGS)"

config PK_PAGING_USER_ADDR_KERNEL_BUILDARCH
	string "--host options on configure for Architecture"

endif # PK_PAGING_USER_ADDR_KERNEL
```

## package/paging/BiscuitOS-Paging-userspace-address-userspace/Kconfig
```kconfig
menuconfig PK_PAGING_USER_ADDR_USERSPACE
	select PK_PAGING_USER_ADDR_KERNEL
	bool "Paging userspace address (Userspace+)"

if PK_PAGING_USER_ADDR_USERSPACE

config PK_PAGING_USER_ADDR_USERSPACE_VERSION
	default "default"
	string "verstion"

config PK_PAGING_USER_ADDR_USERSPACE_TAR
	default "tar.gz"
	string "tar type"

config PK_PAGING_USER_ADDR_USERSPACE_URL
	default "https://gitee.com/BiscuitOS_team/HardStack/raw/Gitee/Memory-Allocator/Paging/BiscuitOS-Paging-userspace-address/userspace"
	string "url"

config PK_PAGING_USER_ADDR_USERSPACE_GITHUB
	string "GitHub"

config PK_PAGING_USER_ADDR_USERSPACE_SRCFILE
	default "main.c Makefile"
	string "Source code list"

config PK_PAGING_USER_ADDR_USERSPACE_CSRCFILE
	string "Compile source code list"

config PK_PAGING_USER_ADDR_USERSPACE_CONFIG
	string "CONFIG: Project Configure Options"

config PK_PAGING_USER_ADDR_USERSPACE_LIBPATH
	string "LIBS: Libraries to pass to the linker, e.g. -l<library>"

config PK_PAGING_USER_ADDR_USERSPACE_CPPFLAGS
	string "CPPFLAGS: C/C++ preprocessor flags, e.g. -I<include dir>"

config PK_PAGING_USER_ADDR_USERSPACE_DPKCONFIG
	string "PKG_CONFIG_PATH: Directories to add to pkg-config's search path"

config PK_PAGING_USER_ADDR_USERSPACE_CFLAGS
	string "CFLAGS: C compiler flags"

config PK_PAGING_USER_ADDR_USERSPACE_LDFLAGS
	string "LDFLAGS: Linker flags"

config PK_PAGING_USER_ADDR_USERSPACE_CXXFLAGS
	string "CXXFLAGS: C++ compiler flags"

config PK_PAGING_USER_ADDR_USERSPACE_ASFLAGS
	string "CCASFLAGS: assembler compiler flags (defaults to CFLAGS)"

config PK_PAGING_USER_ADDR_USERSPACE_BUILDARCH
	string "--host options on configure for Architecture"

endif # PK_PAGING_USER_ADDR_USERSPACE
```

## package/paging/BiscuitOS-SWAP-kernel/Kconfig
```kconfig
menuconfig PK_SWAP_KERNEL
	bool "SWAP Mechanism on BiscuitOS (Kernel+)"

if PK_SWAP_KERNEL

config PK_SWAP_KERNEL_VERSION
	default "default"
	string "verstion"

config PK_SWAP_KERNEL_TAR
	default "tar.gz"
	string "tar type"

config PK_SWAP_KERNEL_URL
	default "https://gitee.com/BiscuitOS_team/HardStack/raw/Gitee/Memory-Allocator/Paging/BiscuitOS-SWAP/kernel"
	string "url"

config PK_SWAP_KERNEL_GITHUB
	string "GitHub"

config PK_SWAP_KERNEL_SRCFILE
	default "main.c Kconfig Makefile RunBiscuitOS.sh"
	string "Source code list"

config PK_SWAP_KERNEL_CSRCFILE
	string "Compile source code list"

config PK_SWAP_KERNEL_CONFIG
	string "CONFIG: Project Configure Options"

config PK_SWAP_KERNEL_LIBPATH
	string "LIBS: Libraries to pass to the linker, e.g. -l<library>"

config PK_SWAP_KERNEL_CPPFLAGS
	string "CPPFLAGS: C/C++ preprocessor flags, e.g. -I<include dir>"

config PK_SWAP_KERNEL_DPKCONFIG
	string "PKG_CONFIG_PATH: Directories to add to pkg-config's search path"

config PK_SWAP_KERNEL_CFLAGS
	string "CFLAGS: C compiler flags"

config PK_SWAP_KERNEL_LDFLAGS
	string "LDFLAGS: Linker flags"

config PK_SWAP_KERNEL_CXXFLAGS
	string "CXXFLAGS: C++ compiler flags"

config PK_SWAP_KERNEL_ASFLAGS
	string "CCASFLAGS: assembler compiler flags (defaults to CFLAGS)"

config PK_SWAP_KERNEL_BUILDARCH
	string "--host options on configure for Architecture"

endif # PK_SWAP_KERNEL
```

## package/paging/BiscuitOS-userfaultfd/Kconfig
```kconfig
menuconfig PK_USERFAULTFD
	bool "userfaultfd on BiscuitOS"

if PK_USERFAULTFD

config PK_USERFAULTFD_VERSION
	default "default"
	string "verstion"

config PK_USERFAULTFD_TAR
	default "tar.gz"
	string "tar type"

config PK_USERFAULTFD_URL
	default "https://gitee.com/BiscuitOS_team/HardStack/raw/Gitee/Memory-Allocator/Paging/userfaultfd"
	string "url"

config PK_USERFAULTFD_GITHUB
	string "GitHub"

config PK_USERFAULTFD_SRCFILE
	default "main.c Makefile"
	string "Source code list"

config PK_USERFAULTFD_CSRCFILE
	string "Compile source code list"

config PK_USERFAULTFD_CONFIG
	string "CONFIG: Project Configure Options"

config PK_USERFAULTFD_LIBPATH
	string "LIBS: Libraries to pass to the linker, e.g. -l<library>"

config PK_USERFAULTFD_CPPFLAGS
	string "CPPFLAGS: C/C++ preprocessor flags, e.g. -I<include dir>"

config PK_USERFAULTFD_DPKCONFIG
	string "PKG_CONFIG_PATH: Directories to add to pkg-config's search path"

config PK_USERFAULTFD_CFLAGS
	string "CFLAGS: C compiler flags"

config PK_USERFAULTFD_LDFLAGS
	string "LDFLAGS: Linker flags"

config PK_USERFAULTFD_CXXFLAGS
	string "CXXFLAGS: C++ compiler flags"

config PK_USERFAULTFD_ASFLAGS
	string "CCASFLAGS: assembler compiler flags (defaults to CFLAGS)"

config PK_USERFAULTFD_BUILDARCH
	string "--host options on configure for Architecture"

endif # PK_USERFAULTFD
```
