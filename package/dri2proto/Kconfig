## package/filesystem/kernfs/kernfs_module/Kconfig
```kconfig
menuconfig PK_FS_KERNFS_MOD
	bool "kernfs module"

if PK_FS_KERNFS_MOD

config PK_FS_KERNFS_MOD_VERSION
	default "0.0.1"
	string "verstion"

config PK_FS_KERNFS_MOD_TAR
	default "tar.gz"
	string "tar type"

config PK_FS_KERNFS_MOD_URL
	default "https://gitee.com/BiscuitOS_team/HardStack/raw/Gitee/fs/kernfs/module"
	string "url"

config PK_FS_KERNFS_MOD_GITHUB
	string "GitHub"

config PK_FS_KERNFS_MOD_SRCFILE
	default "bsfs/dir.c bsfs/file.c bsfs/symlink.c bsfs/inode.c bsfs/mount.c core.c include/linux/bsfs.h Kconfig Makefile"
	string "Source code list"

config PK_FS_KERNFS_MOD_CSRCFILE
	string "Compile source code list"

config PK_FS_KERNFS_MOD_CONFIG
	string "CONFIG: Project Configure Options"

config PK_FS_KERNFS_MOD_LIBPATH
	string "LIBS: Libraries to pass to the linker, e.g. -l<library>"

config PK_FS_KERNFS_MOD_CPPFLAGS
	string "CPPFLAGS: C/C++ preprocessor flags, e.g. -I<include dir>"

config PK_FS_KERNFS_MOD_DPKCONFIG
	string "PKG_CONFIG_PATH: Directories to add to pkg-config's search path"

config PK_FS_KERNFS_MOD_CFLAGS
	string "CFLAGS: C compiler flags"

config PK_FS_KERNFS_MOD_LDFLAGS
	string "LDFLAGS: Linker flags"

config PK_FS_KERNFS_MOD_CXXFLAGS
	string "CXXFLAGS: C++ compiler flags"

config PK_FS_KERNFS_MOD_ASFLAGS
	string "CCASFLAGS: assembler compiler flags (defaults to CFLAGS)"

config PK_FS_KERNFS_MOD_BUILDARCH
	string "--host options on configure for Architecture"

endif # PK_FS_KERNFS_MOD
```

## package/filesystem/minix/Kconfig
```kconfig
menuconfig PK_FS_MINIX
	bool "minix"

if PK_FS_MINIX

# minix_bs
source "package/filesystem/minix/minix_bs/Kconfig"

endif # PK_FS_MINIX
```

## package/filesystem/minix/minix_bs/Kconfig
```kconfig
menuconfig PK_MINIX_BS
	select PK_STRACE
	select PK_SYSCALL
	select PK_SYS_OPEN
	select PK_SYS_OPEN_C
	select PK_SYS_OPEN_GETNAME
	select PK_SYS_OPEN_NUMBER
	select PK_SYS_CLOSE
	select PK_SYS_CLOSE_C
	select PK_SYS_MOUNT
	select PK_SYS_MOUNT_C
	bool "minix (BiscuitOS Tracking)"

if PK_MINIX_BS

config PK_MINIX_BS_VERSION
	default "0.0.1"
	string "verstion"

config PK_MINIX_BS_TAR
	default "tar.gz"
	string "tar type"

config PK_MINIX_BS_URL
	default "https://gitee.com/BiscuitOS_team/HardStack/raw/Gitee/fs/minix/minix_bs"
	string "url"

config PK_MINIX_BS_GITHUB
	string "GitHub"

config PK_MINIX_BS_SRCFILE
	default "README.md RunBiscuitOS_minix.sh Makefile bitmap.c dir.c inode.c internal.h"
	string "Source code list"

config PK_MINIX_BS_CSRCFILE
	string "Compile source code list"

config PK_MINIX_BS_CONFIG
	string "CONFIG: Project Configure Options"

config PK_MINIX_BS_LIBPATH
	string "LIBS: Libraries to pass to the linker, e.g. -l<library>"

config PK_MINIX_BS_CPPFLAGS
	string "CPPFLAGS: C/C++ preprocessor flags, e.g. -I<include dir>"

config PK_MINIX_BS_DPKCONFIG
	string "PKG_CONFIG_PATH: Directories to add to pkg-config's search path"

config PK_MINIX_BS_CFLAGS
	string "CFLAGS: C compiler flags"

config PK_MINIX_BS_LDFLAGS
	string "LDFLAGS: Linker flags"

config PK_MINIX_BS_CXXFLAGS
	string "CXXFLAGS: C++ compiler flags"

config PK_MINIX_BS_ASFLAGS
	string "CCASFLAGS: assembler compiler flags (defaults to CFLAGS)"

config PK_MINIX_BS_BUILDARCH
	string "--host options on configure for Architecture"

endif # PK_MINIX_BS
```

## package/filesystem/proc/Kconfig
```kconfig
menuconfig PK_FS_PROC
	bool "proc"

if PK_FS_PROC

# proc_bs
source "package/filesystem/proc/proc_bs/Kconfig"

endif # PK_FS_PROC
```

## package/filesystem/proc/proc_bs/Kconfig
```kconfig
menuconfig PK_PROC_BS
	select PK_STRACE
	select PK_SYSCALL
	select PK_SYS_OPEN
	select PK_SYS_OPEN_C
	select PK_SYS_OPEN_GETNAME
	select PK_SYS_OPEN_NUMBER
	select PK_SYS_CLOSE
	select PK_SYS_CLOSE_C
	select PK_SYS_MOUNT
	select PK_SYS_MOUNT_C
	bool "proc (BiscuitOS Tracking)"

if PK_PROC_BS

config PK_PROC_BS_VERSION
	default "0.0.1"
	string "verstion"

config PK_PROC_BS_TAR
	default "tar.gz"
	string "tar type"

config PK_PROC_BS_URL
	default "https://gitee.com/BiscuitOS_team/HardStack/raw/Gitee/fs/proc/proc_bs"
	string "url"

config PK_PROC_BS_GITHUB
	string "GitHub"

config PK_PROC_BS_SRCFILE
	default "README.md RunBiscuitOS_proc.sh Makefile internal.h base.c fd.c generic.c inode.c proc_sysctl.c root.c self.c sysctl.c thread_self.c util.c"
	string "Source code list"

config PK_PROC_BS_CSRCFILE
	string "Compile source code list"

config PK_PROC_BS_CONFIG
	string "CONFIG: Project Configure Options"

config PK_PROC_BS_LIBPATH
	string "LIBS: Libraries to pass to the linker, e.g. -l<library>"

config PK_PROC_BS_CPPFLAGS
	string "CPPFLAGS: C/C++ preprocessor flags, e.g. -I<include dir>"

config PK_PROC_BS_DPKCONFIG
	string "PKG_CONFIG_PATH: Directories to add to pkg-config's search path"

config PK_PROC_BS_CFLAGS
	string "CFLAGS: C compiler flags"

config PK_PROC_BS_LDFLAGS
	string "LDFLAGS: Linker flags"

config PK_PROC_BS_CXXFLAGS
	string "CXXFLAGS: C++ compiler flags"

config PK_PROC_BS_ASFLAGS
	string "CCASFLAGS: assembler compiler flags (defaults to CFLAGS)"

config PK_PROC_BS_BUILDARCH
	string "--host options on configure for Architecture"

endif # PK_PROC_BS
```

## package/filesystem/ramfs/Kconfig
```kconfig
menuconfig PK_FS_RAMFS
	bool "ramfs"

if PK_FS_RAMFS

# ramfs_bs
source "package/filesystem/ramfs/ramfs_bs/Kconfig"

endif # PK_FS_RAMFS
```

## package/filesystem/ramfs/ramfs_bs/Kconfig
```kconfig
menuconfig PK_RAMFS_BS
	select PK_STRACE
	select PK_SYSCALL
	select PK_SYS_OPEN
	select PK_SYS_OPEN_C
	select PK_SYS_OPEN_GETNAME
	select PK_SYS_OPEN_NUMBER
	select PK_SYS_CLOSE
	select PK_SYS_CLOSE_C
	select PK_SYS_MOUNT
	select PK_SYS_MOUNT_C
	bool "ramfs (BiscuitOS Tracking)"

if PK_RAMFS_BS

config PK_RAMFS_BS_VERSION
	default "0.0.1"
	string "verstion"

config PK_RAMFS_BS_TAR
	default "tar.gz"
	string "tar type"

config PK_RAMFS_BS_URL
	default "https://gitee.com/BiscuitOS_team/HardStack/raw/Gitee/fs/ramfs/ramfs_bs"
	string "url"

config PK_RAMFS_BS_GITHUB
	string "GitHub"

config PK_RAMFS_BS_SRCFILE
	default "README.md RunBiscuitOS_ramfs.sh Makefile file-mmu.c inode.c internal.h"
	string "Source code list"

config PK_RAMFS_BS_CSRCFILE
	string "Compile source code list"

config PK_RAMFS_BS_CONFIG
	string "CONFIG: Project Configure Options"

config PK_RAMFS_BS_LIBPATH
	string "LIBS: Libraries to pass to the linker, e.g. -l<library>"

config PK_RAMFS_BS_CPPFLAGS
	string "CPPFLAGS: C/C++ preprocessor flags, e.g. -I<include dir>"

config PK_RAMFS_BS_DPKCONFIG
	string "PKG_CONFIG_PATH: Directories to add to pkg-config's search path"

config PK_RAMFS_BS_CFLAGS
	string "CFLAGS: C compiler flags"

config PK_RAMFS_BS_LDFLAGS
	string "LDFLAGS: Linker flags"

config PK_RAMFS_BS_CXXFLAGS
	string "CXXFLAGS: C++ compiler flags"

config PK_RAMFS_BS_ASFLAGS
	string "CCASFLAGS: assembler compiler flags (defaults to CFLAGS)"

config PK_RAMFS_BS_BUILDARCH
	string "--host options on configure for Architecture"

endif # PK_RAMFS_BS
```

## package/filesystem/sysfs/Kconfig
```kconfig
menuconfig PK_FS_SYSFS
	bool "sysfs"

if PK_FS_SYSFS

# sysfs_bs
source "package/filesystem/sysfs/sysfs_bs/Kconfig"

endif # PK_FS_SYSFS
```
