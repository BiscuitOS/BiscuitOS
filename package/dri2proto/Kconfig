## package/dri2proto/Kconfig
```kconfig
menuconfig PK_DRI2PROTO
	bool "dri2proto"

if PK_DRI2PROTO

config PK_DRI2PROTO_VERSION
	default "2.8"
	string "verstion"

config PK_DRI2PROTO_TAR
	default "tar.gz"
	string "tar type"

config PK_DRI2PROTO_URL
	default "https://www.x.org/releases/individual/proto/"
	string "url"

config PK_DRI2PROTO_GITHUB
	string "GitHub"

config PK_DRI2PROTO_SRCFILE
	string "Source code list"

config PK_DRI2PROTO_CONFIG
	default "--enable-silent-rules --disable-static"
	string "CONFIG: Project Configure Options"

config PK_DRI2PROTO_LIBPATH
	string "LIBS: Libraries to pass to the linker, e.g. -l<library>"

config PK_DRI2PROTO_CPPFLAGS
	string "CPPFLAGS: C/C++ preprocessor flags, e.g. -I<include dir>"

config PK_DRI2PROTO_DPKCONFIG
	string "PKG_CONFIG_PATH: Directories to add to pkg-config's search path"

config PK_DRI2PROTO_CFLAGS
	string "CFLAGS: C compiler flags"

config PK_DRI2PROTO_LDFLAGS
	string "LDFLAGS: Linker flags"

config PK_DRI2PROTO_CXXFLAGS
	string "CXXFLAGS: C++ compiler flags"

config PK_DRI2PROTO_ASFLAGS
	string "CCASFLAGS: assembler compiler flags (defaults to CFLAGS)"

config PK_DRI2PROTO_BUILDARCH
	default "x86_64-unknown-linux-gnu"
	string "--host options on configure for Architecture"

endif # PK_DRI2PROTO
```

## package/dri3proto/Kconfig
```kconfig
menuconfig PK_DRI3PROTO
	bool "dri3proto"

if PK_DRI3PROTO

config PK_DRI3PROTO_VERSION
	default "1.0"
	string "verstion"

config PK_DRI3PROTO_TAR
	default "tar.gz"
	string "tar type"

config PK_DRI3PROTO_URL
	default "https://www.x.org/releases/individual/proto/"
	string "url"

config PK_DRI3PROTO_GITHUB
	string "GitHub"

config PK_DRI3PROTO_SRCFILE
	string "Source code list"

config PK_DRI3PROTO_CONFIG
	default "--enable-silent-rules --disable-static"
	string "CONFIG: Project Configure Options"

config PK_DRI3PROTO_LIBPATH
	string "LIBS: Libraries to pass to the linker, e.g. -l<library>"

config PK_DRI3PROTO_CPPFLAGS
	string "CPPFLAGS: C/C++ preprocessor flags, e.g. -I<include dir>"

config PK_DRI3PROTO_DPKCONFIG
	string "PKG_CONFIG_PATH: Directories to add to pkg-config's search path"

config PK_DRI3PROTO_CFLAGS
	string "CFLAGS: C compiler flags"

config PK_DRI3PROTO_LDFLAGS
	string "LDFLAGS: Linker flags"

config PK_DRI3PROTO_CXXFLAGS
	string "CXXFLAGS: C++ compiler flags"

config PK_DRI3PROTO_ASFLAGS
	string "CCASFLAGS: assembler compiler flags (defaults to CFLAGS)"

config PK_DRI3PROTO_BUILDARCH
	default "x86_64-unknown-linux-gnu"
	string "--host options on configure for Architecture"

endif # PK_DRI3PROTO
```

## package/e2fsprogs/Kconfig
```kconfig
menuconfig PK_E2FSPROGS
	bool "e2fsprogs: mkfs.ext2,3,4"

if PK_E2FSPROGS

config PK_E2FSPROGS_VERSION
	default "gitee"
	string "verstion"

config PK_E2FSPROGS_TAR
	default "tar.gz"
	string "tar type"

config PK_E2FSPROGS_URL
	default ""
	string "url"

config PK_E2FSPROGS_GITHUB
	default "https://gitee.com/mashoo/e2fsprogs.git"
	string "Github"

config PK_E2FSPROGS_SRCFILE
	string "Source code list"

config PK_E2FSPROGS_CONFIG
	default "--enable-silent-rules --disable-static"
	string "CONFIG: Project Configure Options"

config PK_E2FSPROGS_LIBPATH
	string "LIBS: Libraries to pass to the linker, e.g. -l<library>"

config PK_E2FSPROGS_CPPFLAGS
	string "CPPFLAGS: C/C++ preprocessor flags, e.g. -I<include dir>"

config PK_E2FSPROGS_DPKCONFIG
	string "PKG_CONFIG_PATH: Directories to add to pkg-config's search path"

config PK_E2FSPROGS_CFLAGS
	string "CFLAGS: C compiler flags"

config PK_E2FSPROGS_LDFLAGS
	string "LDFLAGS: Linker flags"

config PK_E2FSPROGS_CXXFLAGS
	string "CXXFLAGS: C++ compiler flags"

config PK_E2FSPROGS_ASFLAGS
	string "CCASFLAGS: assembler compiler flags (defaults to CFLAGS)"

config PK_E2FSPROGS_BUILDARCH
	default "x86_64-unknown-linux-gnu"
	string "--host options on configure for Architecture"

endif # PK_E2FSPROGS
```

## package/expat/Kconfig
```kconfig
menuconfig PK_EXPAT
	bool "expat"

if PK_EXPAT

config PK_EXPAT_VERSION
	default "2.2.4"
	string "verstion"

config PK_EXPAT_TAR
	default "tar.bz2"
	string "tar type"

config PK_EXPAT_URL
	        default "http://repository.timesys.com/buildsources/e/expat/expat-2.2.4/"
	string "url"

config PK_EXPAT_GITHUB
	string "GitHub"

config PK_EXPAT_SRCFILE
	string "Source code list"

config PK_EXPAT_CONFIG
	default "--enable-silent-rules --disable-static"
	string "CONFIG: Project Configure Options"

config PK_EXPAT_LIBPATH
	string "LIBS: Libraries to pass to the linker, e.g. -l<library>"

config PK_EXPAT_CPPFLAGS
	string "CPPFLAGS: C/C++ preprocessor flags, e.g. -I<include dir>"

config PK_EXPAT_DPKCONFIG
	string "PKG_CONFIG_PATH: Directories to add to pkg-config's search path"

config PK_EXPAT_CFLAGS
	string "CFLAGS: C compiler flags"

config PK_EXPAT_LDFLAGS
	string "LDFLAGS: Linker flags"

config PK_EXPAT_CXXFLAGS
	string "CXXFLAGS: C++ compiler flags"

config PK_EXPAT_ASFLAGS
	string "CCASFLAGS: assembler compiler flags (defaults to CFLAGS)"

config PK_EXPAT_BUILDARCH
	default "x86_64-unknown-linux-gnu"
	string "--host options on configure for Architecture"

endif # PK_EXPAT
```

## package/filesystem/9p/Kconfig
```kconfig
menuconfig PK_FS_9P
	bool "9p"

if PK_FS_9P

# 9p_bs
source "package/filesystem/9p/9p_bs/Kconfig"

endif # PK_FS_9P
```

## package/filesystem/Kconfig
```kconfig
menuconfig PK_FS
	bool "filesystem"

if PK_FS

# 9p
source "package/filesystem/9p/Kconfig"

# adfs
source "package/filesystem/adfs/Kconfig"

# affs
source "package/filesystem/affs/Kconfig"

# bdev
source "package/filesystem/bdev/Kconfig"

# debugfs
source "package/filesystem/debugfs/Kconfig"

# minix
source "package/filesystem/minix/Kconfig"

# proc
source "package/filesystem/proc/Kconfig"

# ramfs
source "package/filesystem/ramfs/Kconfig"

# sysfs
source "package/filesystem/sysfs/Kconfig"

# tmpfs
source "package/filesystem/tmpfs/Kconfig"

endif # PK_FS
```

## package/filesystem/adfs/Kconfig
```kconfig
menuconfig PK_FS_ADFS
	bool "adfs"

if PK_FS_ADFS

# adfs_bs
source "package/filesystem/adfs/adfs_bs/Kconfig"

endif # PK_FS_ADFS
```

## package/filesystem/adfs/adfs_bs/Kconfig
```kconfig
menuconfig PK_ADFS_BS
	select PK_STRACE
	select PK_SYSCALL
	select PK_SYS_OPEN
	select PK_SYS_OPEN_C
	select PK_SYS_OPEN_GETNAME
	select PK_SYS_OPEN_NUMBER
	select PK_SYS_CLOSE
	select PK_SYS_CLOSE_C
	select PK_SYS_MOUNT
	select PK_SYS_MOUNT_C
	bool "adfs (BiscuitOS Tracking)"

if PK_ADFS_BS

config PK_ADFS_BS_VERSION
	default "0.0.1"
	string "verstion"

config PK_ADFS_BS_TAR
	default "tar.gz"
	string "tar type"

config PK_ADFS_BS_URL
	default "https://gitee.com/BiscuitOS_team/HardStack/raw/Gitee/fs/adfs/adfs_bs"
	string "url"

config PK_ADFS_BS_GITHUB
	string "GitHub"

config PK_ADFS_BS_SRCFILE
	default "README.md RunBiscuitOS_adfs.sh Makefile internal.h super.c"
	string "Source code list"

config PK_ADFS_BS_CSRCFILE
	string "Compile source code list"

config PK_ADFS_BS_CONFIG
	string "CONFIG: Project Configure Options"

config PK_ADFS_BS_LIBPATH
	string "LIBS: Libraries to pass to the linker, e.g. -l<library>"

config PK_ADFS_BS_CPPFLAGS
	string "CPPFLAGS: C/C++ preprocessor flags, e.g. -I<include dir>"

config PK_ADFS_BS_DPKCONFIG
	string "PKG_CONFIG_PATH: Directories to add to pkg-config's search path"

config PK_ADFS_BS_CFLAGS
	string "CFLAGS: C compiler flags"

config PK_ADFS_BS_LDFLAGS
	string "LDFLAGS: Linker flags"

config PK_ADFS_BS_CXXFLAGS
	string "CXXFLAGS: C++ compiler flags"

config PK_ADFS_BS_ASFLAGS
	string "CCASFLAGS: assembler compiler flags (defaults to CFLAGS)"

config PK_ADFS_BS_BUILDARCH
	string "--host options on configure for Architecture"

endif # PK_ADFS_BS
```

## package/filesystem/affs/Kconfig
```kconfig
menuconfig PK_FS_AFFS
	bool "affs"

if PK_FS_AFFS

# affs_bs
source "package/filesystem/affs/affs_bs/Kconfig"

endif # PK_FS_AFFS
```

## package/filesystem/affs/affs_bs/Kconfig
```kconfig
menuconfig PK_AFFS_BS
	select PK_STRACE
	select PK_SYSCALL
	select PK_SYS_OPEN
	select PK_SYS_OPEN_C
	select PK_SYS_OPEN_GETNAME
	select PK_SYS_OPEN_NUMBER
	select PK_SYS_CLOSE
	select PK_SYS_CLOSE_C
	select PK_SYS_MOUNT
	select PK_SYS_MOUNT_C
	bool "affs (BiscuitOS Tracking)"

if PK_AFFS_BS

config PK_AFFS_BS_VERSION
	default "0.0.1"
	string "verstion"

config PK_AFFS_BS_TAR
	default "tar.gz"
	string "tar type"

config PK_AFFS_BS_URL
	default "https://gitee.com/BiscuitOS_team/HardStack/raw/Gitee/fs/affs/affs_bs"
	string "url"

config PK_AFFS_BS_GITHUB
	string "GitHub"

config PK_AFFS_BS_SRCFILE
	default "README.md RunBiscuitOS_affs.sh Makefile super.c internal.h"
	string "Source code list"

config PK_AFFS_BS_CSRCFILE
	string "Compile source code list"

config PK_AFFS_BS_CONFIG
	string "CONFIG: Project Configure Options"

config PK_AFFS_BS_LIBPATH
	string "LIBS: Libraries to pass to the linker, e.g. -l<library>"

config PK_AFFS_BS_CPPFLAGS
	string "CPPFLAGS: C/C++ preprocessor flags, e.g. -I<include dir>"

config PK_AFFS_BS_DPKCONFIG
	string "PKG_CONFIG_PATH: Directories to add to pkg-config's search path"

config PK_AFFS_BS_CFLAGS
	string "CFLAGS: C compiler flags"

config PK_AFFS_BS_LDFLAGS
	string "LDFLAGS: Linker flags"

config PK_AFFS_BS_CXXFLAGS
	string "CXXFLAGS: C++ compiler flags"

config PK_AFFS_BS_ASFLAGS
	string "CCASFLAGS: assembler compiler flags (defaults to CFLAGS)"

config PK_AFFS_BS_BUILDARCH
	string "--host options on configure for Architecture"

endif # PK_AFFS_BS
```

## package/filesystem/bdev/Kconfig
```kconfig
menuconfig PK_FS_BDEV
	bool "bdev"

if PK_FS_BDEV

# bdev_bs
source "package/filesystem/bdev/bdev_bs/Kconfig"

endif # PK_FS_BDEV
```

## package/filesystem/bdev/bdev_bs/Kconfig
```kconfig
menuconfig PK_BDEV_BS
	select PK_STRACE
	select PK_SYSCALL
	select PK_SYS_OPEN
	select PK_SYS_OPEN_C
	select PK_SYS_OPEN_GETNAME
	select PK_SYS_OPEN_NUMBER
	select PK_SYS_CLOSE
	select PK_SYS_CLOSE_C
	select PK_SYS_MOUNT
	select PK_SYS_MOUNT_C
	bool "bdev (BiscuitOS Tracking)"

if PK_BDEV_BS

config PK_BDEV_BS_VERSION
	default "0.0.1"
	string "verstion"

config PK_BDEV_BS_TAR
	default "tar.gz"
	string "tar type"

config PK_BDEV_BS_URL
	default "https://gitee.com/BiscuitOS_team/HardStack/raw/Gitee/fs/bdev/bdev_bs"
	string "url"

config PK_BDEV_BS_GITHUB
	string "GitHub"

config PK_BDEV_BS_SRCFILE
	default "README.md RunBiscuitOS_bdev.sh Makefile internal.h mount.c"
	string "Source code list"

config PK_BDEV_BS_CSRCFILE
	string "Compile source code list"

config PK_BDEV_BS_CONFIG
	string "CONFIG: Project Configure Options"

config PK_BDEV_BS_LIBPATH
	string "LIBS: Libraries to pass to the linker, e.g. -l<library>"

config PK_BDEV_BS_CPPFLAGS
	string "CPPFLAGS: C/C++ preprocessor flags, e.g. -I<include dir>"

config PK_BDEV_BS_DPKCONFIG
	string "PKG_CONFIG_PATH: Directories to add to pkg-config's search path"

config PK_BDEV_BS_CFLAGS
	string "CFLAGS: C compiler flags"

config PK_BDEV_BS_LDFLAGS
	string "LDFLAGS: Linker flags"

config PK_BDEV_BS_CXXFLAGS
	string "CXXFLAGS: C++ compiler flags"

config PK_BDEV_BS_ASFLAGS
	string "CCASFLAGS: assembler compiler flags (defaults to CFLAGS)"

config PK_BDEV_BS_BUILDARCH
	string "--host options on configure for Architecture"

endif # PK_BDEV_BS
```

## package/filesystem/bsvfs/Kconfig
```kconfig
menuconfig PK_BISCUITOS_VFS
	bool "BiscuitOS Virtual Filesystem"

if PK_BISCUITOS_VFS

# Basic BiscuitOS filesystem
source "package/filesystem/bsvfs/basic/Kconfig"

endif # PK_BISCUITOS_VFS
```

## package/filesystem/bsvfs/basic/Kconfig
```kconfig
menuconfig PK_BSVFS_BASE
	bool "bsvfs: basic"

if PK_BSVFS_BASE

config PK_BSVFS_BASE_VERSION
	default "0.0.1"
	string "verstion"

config PK_BSVFS_BASE_TAR
	default "tar.gz"
	string "tar type"

config PK_BSVFS_BASE_URL
	default "https://gitee.com/BiscuitOS_team/HardStack/raw/Gitee/fs/bsvfs/base"
	string "url"

config PK_BSVFS_BASE_GITHUB
	string "GitHub"

config PK_BSVFS_BASE_SRCFILE
	default "bsvfs.c Kconfig Makefile"
	string "Source code list"

config PK_BSVFS_BASE_CSRCFILE
	string "Compile source code list"

config PK_BSVFS_BASE_CONFIG
	string "CONFIG: Project Configure Options"

config PK_BSVFS_BASE_LIBPATH
	string "LIBS: Libraries to pass to the linker, e.g. -l<library>"

config PK_BSVFS_BASE_CPPFLAGS
	string "CPPFLAGS: C/C++ preprocessor flags, e.g. -I<include dir>"

config PK_BSVFS_BASE_DPKCONFIG
	string "PKG_CONFIG_PATH: Directories to add to pkg-config's search path"

config PK_BSVFS_BASE_CFLAGS
	string "CFLAGS: C compiler flags"

config PK_BSVFS_BASE_LDFLAGS
	string "LDFLAGS: Linker flags"

config PK_BSVFS_BASE_CXXFLAGS
	string "CXXFLAGS: C++ compiler flags"

config PK_BSVFS_BASE_ASFLAGS
	string "CCASFLAGS: assembler compiler flags (defaults to CFLAGS)"

config PK_BSVFS_BASE_BUILDARCH
	string "--host options on configure for Architecture"

endif # PK_BSVFS_BASE
```

## package/filesystem/debugfs/Kconfig
```kconfig
menuconfig PK_FS_DEBUGFS
	bool "debugfs"

if PK_FS_DEBUGFS

# debugfs_bs
source "package/filesystem/debugfs/debugfs_bs/Kconfig"

endif # PK_FS_DEBUGFS
```

## package/filesystem/debugfs/debugfs_bs/Kconfig
```kconfig
menuconfig PK_DEBUGFS_BS
	select PK_STRACE
	select PK_SYSCALL
	select PK_SYS_OPEN
	select PK_SYS_OPEN_C
	select PK_SYS_OPEN_GETNAME
	select PK_SYS_OPEN_NUMBER
	select PK_SYS_CLOSE
	select PK_SYS_CLOSE_C
	select PK_SYS_MOUNT
	select PK_SYS_MOUNT_C
	bool "debugfs (BiscuitOS Tracking)"

if PK_DEBUGFS_BS

config PK_DEBUGFS_BS_VERSION
	default "0.0.1"
	string "verstion"

config PK_DEBUGFS_BS_TAR
	default "tar.gz"
	string "tar type"

config PK_DEBUGFS_BS_URL
	default "https://gitee.com/BiscuitOS_team/HardStack/raw/Gitee/fs/debugfs/debugfs_bs"
	string "url"

config PK_DEBUGFS_BS_GITHUB
	string "GitHub"

config PK_DEBUGFS_BS_SRCFILE
	default "README.md RunBiscuitOS_debugfs.sh Makefile inode.c internal.h"
	string "Source code list"

config PK_DEBUGFS_BS_CSRCFILE
	string "Compile source code list"

config PK_DEBUGFS_BS_CONFIG
	string "CONFIG: Project Configure Options"

config PK_DEBUGFS_BS_LIBPATH
	string "LIBS: Libraries to pass to the linker, e.g. -l<library>"

config PK_DEBUGFS_BS_CPPFLAGS
	string "CPPFLAGS: C/C++ preprocessor flags, e.g. -I<include dir>"

config PK_DEBUGFS_BS_DPKCONFIG
	string "PKG_CONFIG_PATH: Directories to add to pkg-config's search path"

config PK_DEBUGFS_BS_CFLAGS
	string "CFLAGS: C compiler flags"

config PK_DEBUGFS_BS_LDFLAGS
	string "LDFLAGS: Linker flags"

config PK_DEBUGFS_BS_CXXFLAGS
	string "CXXFLAGS: C++ compiler flags"

config PK_DEBUGFS_BS_ASFLAGS
	string "CCASFLAGS: assembler compiler flags (defaults to CFLAGS)"

config PK_DEBUGFS_BS_BUILDARCH
	string "--host options on configure for Architecture"

endif # PK_DEBUGFS_BS
```

## package/filesystem/kernfs/Kconfig
```kconfig
menuconfig PK_FS_KERNFS
	bool "kernfs"

if PK_FS_KERNFS

# kernfs module
source "package/filesystem/kernfs/kernfs_module/Kconfig"

endif # PK_FS_KERNFS
```
