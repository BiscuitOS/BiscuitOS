## package/gnu_binutils/Kconfig
```kconfig
menuconfig PK_GNU_BINUTILS
	bool "GNU - binutils"

if PK_GNU_BINUTILS

config GNU_BINUTILS_VERSION
	default "2.32"
	string "verstion"

config GNU_BINUTILS_TAR
	default "tar.gz"
	string "tar type"

config GNU_BINUTILS_URL
	default "http://ftp.gnu.org/pub/gnu/binutils/"
	string "url"

config GNU_BINUTILS_LDFLAGS
	string "LDFLAGS"

config GNU_BINUTILS_CFLAGS
	string "CFLAGS"

config GNU_BINUTILS_CONFIG
	string "configure"

endif # PK_GNU_BINUTILS
```

## package/gnu_git/Kconfig
```kconfig
menuconfig PK_GNU_GIT
	bool "GNU - git"

if PK_GNU_GIT

config GNU_GIT_VERSION
	default "4.9.5"
	string "verstion"

config GNU_GIT_TAR
	default "tar.gz"
	string "tar type"

config GNU_GIT_URL
	default "http://ftp.gnu.org/pub/gnu/git/"
	string "url"

config GNU_GIT_LDFLAGS
	string "LDFLAGS"

config GNU_GIT_CFLAGS
	string "CFLAGS"

config GNU_GIT_CONFIG
	string "configure"

endif # PK_GNU_GIT
```

## package/gnu_hello/Kconfig
```kconfig
menuconfig PK_GNU_HELLO
	bool "GNU - hello"

if PK_GNU_HELLO

config GNU_HELLO_VERSION
	default "2.4"
	string "verstion"

config GNU_HELLO_TAR
	default "tar.gz"
	string "tar type"

config GNU_HELLO_URL
	default "http://ftp.gnu.org/pub/gnu/hello/"
	string "url"

config GNU_HELLO_CONFIG
	string "configure"

endif # PK_GNU_HELLO
```

## package/gnu_ncurses/Kconfig
```kconfig
menuconfig PK_GNU_NCURSES
	bool "GNU - ncurses"

if PK_GNU_NCURSES

config GNU_NCURSES_VERSION
	default "6.1"
	string "verstion"

config GNU_NCURSES_TAR
	default "tar.gz"
	string "tar type"

config GNU_NCURSES_URL
	default "http://ftp.gnu.org/pub/gnu/ncurses/"
	string "url"

config GNU_NCURSES_CONFIG
	default "--disable-stripping --with-shared"
	string "configure"

endif # PK_GNU_NCURSES
```

## package/gnu_sed/Kconfig
```kconfig
menuconfig PK_GNU_SED
	bool "GNU - sed"

if PK_GNU_SED

config GNU_SED_VERSION
	default "4.2"
	string "verstion"

config GNU_SED_TAR
	default "tar.gz"
	string "tar type"

config GNU_SED_URL
	default "http://ftp.gnu.org/pub/gnu/sed/"
	string "url"

config GNU_SED_LDFLAGS
	string "LDFLAGS"

config GNU_SED_CFLAGS
	string "CFLAGS"

config GNU_SED_CONFIG
	string "configure"

endif # PK_GNU_SED
```

## package/gnutls/Kconfig
```kconfig
menuconfig PK_GNUTLS
	bool "gnutls"
	select PK_NETTLE

if PK_GNUTLS

config PK_GNUTLS_VERSION
	default "3.5.9"
	string "verstion"

config PK_GNUTLS_TAR
	default "tar.xz"
	string "tar type"

config PK_GNUTLS_URL
	default "ftp://ftp.gnutls.org/gcrypt/gnutls/v3.5"
	string "url"

config PK_GNUTLS_GITHUB
	string "GitHub"

config PK_GNUTLS_SRCFILE
	string "Source code list"

config PK_GNUTLS_CONFIG
	default "--enable-silent-rules --with-included-libtasn1 --with-included-unistring --without-p11-kit"
	string "CONFIG: Project Configure Options"

config PK_GNUTLS_LIBPATH
	string "LIBS: Libraries to pass to the linker, e.g. -l<library>"

config PK_GNUTLS_CPPFLAGS
	string "CPPFLAGS: C/C++ preprocessor flags, e.g. -I<include dir>"

config PK_GNUTLS_DPKCONFIG
	string "PKG_CONFIG_PATH: Directories to add to pkg-config's search path"

config PK_GNUTLS_CFLAGS
	string "CFLAGS: C compiler flags"

config PK_GNUTLS_LDFLAGS
	string "LDFLAGS: Linker flags"

config PK_GNUTLS_CXXFLAGS
	string "CXXFLAGS: C++ compiler flags"

config PK_GNUTLS_ASFLAGS
	string "CCASFLAGS: assembler compiler flags (defaults to CFLAGS)"

config PK_GNUTLS_BUILDARCH
	default "x86_64-unknown-linux-gnu"
	string "--host options on configure for Architecture"

endif # PK_GNUTLS
```

## package/gobject-introspection/Kconfig
```kconfig
menuconfig PK_GOBJECT_INTROSPECTION
	bool "gobject-introspection"

if PK_GOBJECT_INTROSPECTION

config PK_GOBJECT_INTROSPECTION_VERSION
	default "1.52.1"
	string "verstion"

config PK_GOBJECT_INTROSPECTION_TAR
	default "tar.xz"
	string "tar type"

config PK_GOBJECT_INTROSPECTION_URL
	default "https://download.gnome.org/sources/gobject-introspection/1.52/"
	string "url"

config PK_GOBJECT_INTROSPECTION_GITHUB
	string "GitHub"

config PK_GOBJECT_INTROSPECTION_SRCFILE
	string "Source code list"

config PK_GOBJECT_INTROSPECTION_CONFIG
	default "--enable-silent-rules --disable-static"
	string "CONFIG: Project Configure Options"

config PK_GOBJECT_INTROSPECTION_LIBPATH
	string "LIBS: Libraries to pass to the linker, e.g. -l<library>"

config PK_GOBJECT_INTROSPECTION_CPPFLAGS
	string "CPPFLAGS: C/C++ preprocessor flags, e.g. -I<include dir>"

config PK_GOBJECT_INTROSPECTION_DPKCONFIG
	string "PKG_CONFIG_PATH: Directories to add to pkg-config's search path"

config PK_GOBJECT_INTROSPECTION_CFLAGS
	string "CFLAGS: C compiler flags"

config PK_GOBJECT_INTROSPECTION_LDFLAGS
	string "LDFLAGS: Linker flags"

config PK_GOBJECT_INTROSPECTION_CXXFLAGS
	string "CXXFLAGS: C++ compiler flags"

config PK_GOBJECT_INTROSPECTION_ASFLAGS
	string "CCASFLAGS: assembler compiler flags (defaults to CFLAGS)"

config PK_GOBJECT_INTROSPECTION_BUILDARCH
	default "x86_64-unknown-linux-gnu"
	string "--host options on configure for Architecture"

endif # PK_GOBJECT_INTROSPECTION
```

## package/gtk/Kconfig
```kconfig
menuconfig PK_GTKP
	select PK_ATK
	bool "gtk+"

if PK_GTKP

config PK_GTKP_VERSION
	default "3.22.17"
	string "verstion"

config PK_GTKP_TAR
	default "tar.xz"
	string "tar type"

config PK_GTKP_URL
	default "http://ftp.gnome.org/pub/gnome/sources/gtk+/3.22/"
	string "url"

config PK_GTKP_GITHUB
	string "GitHub"

config PK_GTKP_SRCFILE
	string "Source code list"

config PK_GTKP_CONFIG
	default "--enable-silent-rules --disable-static --enable-introspection --disable-gtk-doc --disable-glibtest --disable-xinerama --enable-modules --disable-cups --disable-colord --disable-static --disable-wayland-backend --enable-x11-backend --enable-nls"
	string "CONFIG: Project Configure Options"

config PK_GTKP_LIBPATH
	string "LIBS: Libraries to pass to the linker, e.g. -l<library>"

config PK_GTKP_CPPFLAGS
	string "CPPFLAGS: C/C++ preprocessor flags, e.g. -I<include dir>"

config PK_GTKP_DPKCONFIG
	string "PKG_CONFIG_PATH: Directories to add to pkg-config's search path"

config PK_GTKP_CFLAGS
	string "CFLAGS: C compiler flags"

config PK_GTKP_LDFLAGS
	string "LDFLAGS: Linker flags"

config PK_GTKP_CXXFLAGS
	string "CXXFLAGS: C++ compiler flags"

config PK_GTKP_ASFLAGS
	string "CCASFLAGS: assembler compiler flags (defaults to CFLAGS)"

config PK_GTKP_BUILDARCH
	default "x86_64-unknown-linux-gnu"
	string "--host options on configure for Architecture"

endif # PK_GTKP
```

## package/harfbuzz/Kconfig
```kconfig
menuconfig PK_HARFBUZZ
	bool "harfbuzz"

if PK_HARFBUZZ

config PK_HARFBUZZ_VERSION
	default "1.4.8"
	string "verstion"

config PK_HARFBUZZ_TAR
	default "tar.bz2"
	string "tar type"

config PK_HARFBUZZ_URL
	default "https://www.freedesktop.org/software/harfbuzz/release/"
	string "url"

config PK_HARFBUZZ_GITHUB
	string "GitHub"

config PK_HARFBUZZ_SRCFILE
	string "Source code list"

config PK_HARFBUZZ_CONFIG
	default "--enable-silent-rules --disable-static --disable-gtk-doc --with-cairo --with-fontconfig --with-freetype --with-glib --without-graphite2 --with-icu"
	string "CONFIG: Project Configure Options"

config PK_HARFBUZZ_LIBPATH
	string "LIBS: Libraries to pass to the linker, e.g. -l<library>"

config PK_HARFBUZZ_CPPFLAGS
	string "CPPFLAGS: C/C++ preprocessor flags, e.g. -I<include dir>"

config PK_HARFBUZZ_DPKCONFIG
	string "PKG_CONFIG_PATH: Directories to add to pkg-config's search path"

config PK_HARFBUZZ_CFLAGS
	string "CFLAGS: C compiler flags"

config PK_HARFBUZZ_LDFLAGS
	string "LDFLAGS: Linker flags"

config PK_HARFBUZZ_CXXFLAGS
	string "CXXFLAGS: C++ compiler flags"

config PK_HARFBUZZ_ASFLAGS
	string "CCASFLAGS: assembler compiler flags (defaults to CFLAGS)"

config PK_HARFBUZZ_BUILDARCH
	default "x86_64-unknown-linux-gnu"
	string "--host options on configure for Architecture"

endif # PK_HARFBUZZ
```

## package/hash/HASH_MIX/Kconfig
```kconfig
menuconfig PK_HASH_MIX
	bool "HASH_MIX()"

if PK_HASH_MIX

config PK_HASH_MIX_VERSION
	default "0.0.1"
	string "verstion"

config PK_HASH_MIX_TAR
	default "tar.gz"
	string "tar type"

config PK_HASH_MIX_URL
	default "https://gitee.com/BiscuitOS_team/HardStack/raw/Gitee/Algorithem/hash/API/HASH_MIX"
	string "url"

config PK_HASH_MIX_GITHUB
	string "GitHub"

config PK_HASH_MIX_SRCFILE
	default "core.c Kconfig Makefile"
	string "Source code list"

config PK_HASH_MIX_CSRCFILE
	string "Compile source code list"

config PK_HASH_MIX_CONFIG
	string "CONFIG: Project Configure Options"

config PK_HASH_MIX_LIBPATH
	string "LIBS: Libraries to pass to the linker, e.g. -l<library>"

config PK_HASH_MIX_CPPFLAGS
	string "CPPFLAGS: C/C++ preprocessor flags, e.g. -I<include dir>"

config PK_HASH_MIX_DPKCONFIG
	string "PKG_CONFIG_PATH: Directories to add to pkg-config's search path"

config PK_HASH_MIX_CFLAGS
	string "CFLAGS: C compiler flags"

config PK_HASH_MIX_LDFLAGS
	string "LDFLAGS: Linker flags"

config PK_HASH_MIX_CXXFLAGS
	string "CXXFLAGS: C++ compiler flags"

config PK_HASH_MIX_ASFLAGS
	string "CCASFLAGS: assembler compiler flags (defaults to CFLAGS)"

config PK_HASH_MIX_BUILDARCH
	string "--host options on configure for Architecture"

endif # PK_HASH_MIX
```

## package/hash/Kconfig
```kconfig
menuconfig PK_HASH
	bool "Hash"

if PK_HASH

# hashlist
source "package/hash/hashlist/Kconfig"

# HASH_MIX
source "package/hash/HASH_MIX/Kconfig"

# load_unaligned_zeropad
source "package/hash/load_unaligned_zeropad/Kconfig"

# REPEAT_BYTE
source "package/hash/REPEAT_BYTE/Kconfig"

endif # PK_HASH
```

## package/hash/REPEAT_BYTE/Kconfig
```kconfig
menuconfig PK_REPEAT_BYTE
	bool "REPEAT_BYTE()"

if PK_REPEAT_BYTE

config PK_REPEAT_BYTE_VERSION
	default "0.0.1"
	string "verstion"

config PK_REPEAT_BYTE_TAR
	default "tar.gz"
	string "tar type"

config PK_REPEAT_BYTE_URL
	default "https://gitee.com/BiscuitOS_team/HardStack/raw/Gitee/Algorithem/hash/API/REPEAT_BYTE"
	string "url"

config PK_REPEAT_BYTE_GITHUB
	string "GitHub"

config PK_REPEAT_BYTE_SRCFILE
	default "core.c Kconfig Makefile"
	string "Source code list"

config PK_REPEAT_BYTE_CSRCFILE
	string "Compile source code list"

config PK_REPEAT_BYTE_CONFIG
	string "CONFIG: Project Configure Options"

config PK_REPEAT_BYTE_LIBPATH
	string "LIBS: Libraries to pass to the linker, e.g. -l<library>"

config PK_REPEAT_BYTE_CPPFLAGS
	string "CPPFLAGS: C/C++ preprocessor flags, e.g. -I<include dir>"

config PK_REPEAT_BYTE_DPKCONFIG
	string "PKG_CONFIG_PATH: Directories to add to pkg-config's search path"

config PK_REPEAT_BYTE_CFLAGS
	string "CFLAGS: C compiler flags"

config PK_REPEAT_BYTE_LDFLAGS
	string "LDFLAGS: Linker flags"

config PK_REPEAT_BYTE_CXXFLAGS
	string "CXXFLAGS: C++ compiler flags"

config PK_REPEAT_BYTE_ASFLAGS
	string "CCASFLAGS: assembler compiler flags (defaults to CFLAGS)"

config PK_REPEAT_BYTE_BUILDARCH
	string "--host options on configure for Architecture"

endif # PK_REPEAT_BYTE
```

## package/hash/hashlist/Kconfig
```kconfig
menuconfig PK_HLIST
	bool "Hash list"

if PK_HLIST

source "package/hash/hashlist/hlist_bl/Kconfig"

endif # PK_HLIST
```

## package/hash/hashlist/hlist_bl/Kconfig
```kconfig
menuconfig PK_HLIST_BL
	bool "hlist_bl hash table"

if PK_HLIST_BL

# alloc_large_system_hash
source "package/hash/hashlist/hlist_bl/alloc_large_system_hash/Kconfig"

# Hlist_bl Base
source "package/hash/hashlist/hlist_bl/hlist_bl_base/Kconfig"

endif # PK_HLIST_BL
```

## package/hash/hashlist/hlist_bl/alloc_large_system_hash/Kconfig
```kconfig
menuconfig PK_HLIST_BL_ALLOC_SYS_HASH
	bool "alloc_large_system_hash()"

if PK_HLIST_BL_ALLOC_SYS_HASH

config PK_HLIST_BL_ALLOC_SYS_HASH_VERSION
	default "0.0.1"
	string "verstion"

config PK_HLIST_BL_ALLOC_SYS_HASH_TAR
	default "tar.gz"
	string "tar type"

config PK_HLIST_BL_ALLOC_SYS_HASH_URL
	default "https://gitee.com/BiscuitOS_team/HardStack/raw/Gitee/Algorithem/list/hlist_bl/API/alloc_large_system_hash"
	string "url"

config PK_HLIST_BL_ALLOC_SYS_HASH_GITHUB
	string "GitHub"

config PK_HLIST_BL_ALLOC_SYS_HASH_SRCFILE
	default "core.c Makefile"
	string "Source code list"

config PK_HLIST_BL_ALLOC_SYS_HASH_CSRCFILE
	string "Compile source code list"

config PK_HLIST_BL_ALLOC_SYS_HASH_CONFIG
	string "CONFIG: Project Configure Options"

config PK_HLIST_BL_ALLOC_SYS_HASH_LIBPATH
	string "LIBS: Libraries to pass to the linker, e.g. -l<library>"

config PK_HLIST_BL_ALLOC_SYS_HASH_CPPFLAGS
	string "CPPFLAGS: C/C++ preprocessor flags, e.g. -I<include dir>"

config PK_HLIST_BL_ALLOC_SYS_HASH_DPKCONFIG
	string "PKG_CONFIG_PATH: Directories to add to pkg-config's search path"

config PK_HLIST_BL_ALLOC_SYS_HASH_CFLAGS
	string "CFLAGS: C compiler flags"

config PK_HLIST_BL_ALLOC_SYS_HASH_LDFLAGS
	string "LDFLAGS: Linker flags"

config PK_HLIST_BL_ALLOC_SYS_HASH_CXXFLAGS
	string "CXXFLAGS: C++ compiler flags"

config PK_HLIST_BL_ALLOC_SYS_HASH_ASFLAGS
	string "CCASFLAGS: assembler compiler flags (defaults to CFLAGS)"

config PK_HLIST_BL_ALLOC_SYS_HASH_BUILDARCH
	string "--host options on configure for Architecture"

endif # PK_HLIST_BL_ALLOC_SYS_HASH
```

## package/hash/hashlist/hlist_bl/hlist_bl_base/Kconfig
```kconfig
menuconfig PK_HLIST_BL_BASE
	bool "hlist_list base usage"

if PK_HLIST_BL_BASE

config PK_HLIST_BL_BASE_VERSION
	default "0.0.1"
	string "verstion"

config PK_HLIST_BL_BASE_TAR
	default "tar.gz"
	string "tar type"

config PK_HLIST_BL_BASE_URL
	default "https://gitee.com/BiscuitOS_team/HardStack/raw/Gitee/Algorithem/list/hlist_bl/base"
	string "url"

config PK_HLIST_BL_BASE_GITHUB
	string "GitHub"

config PK_HLIST_BL_BASE_SRCFILE
	default "core.c Kconfig Makefile"
	string "Source code list"

config PK_HLIST_BL_BASE_CSRCFILE
	string "Compile source code list"

config PK_HLIST_BL_BASE_CONFIG
	string "CONFIG: Project Configure Options"

config PK_HLIST_BL_BASE_LIBPATH
	string "LIBS: Libraries to pass to the linker, e.g. -l<library>"

config PK_HLIST_BL_BASE_CPPFLAGS
	string "CPPFLAGS: C/C++ preprocessor flags, e.g. -I<include dir>"

config PK_HLIST_BL_BASE_DPKCONFIG
	string "PKG_CONFIG_PATH: Directories to add to pkg-config's search path"

config PK_HLIST_BL_BASE_CFLAGS
	string "CFLAGS: C compiler flags"

config PK_HLIST_BL_BASE_LDFLAGS
	string "LDFLAGS: Linker flags"

config PK_HLIST_BL_BASE_CXXFLAGS
	string "CXXFLAGS: C++ compiler flags"

config PK_HLIST_BL_BASE_ASFLAGS
	string "CCASFLAGS: assembler compiler flags (defaults to CFLAGS)"

config PK_HLIST_BL_BASE_BUILDARCH
	string "--host options on configure for Architecture"

endif # PK_HLIST_BL_BASE
```

## package/hash/load_unaligned_zeropad/Kconfig
```kconfig
menuconfig PK_HASH_LOAD_UNALIGN
	bool "load_unaligned_zeropad()"

if PK_HASH_LOAD_UNALIGN

config PK_HASH_LOAD_UNALIGN_VERSION
	default "0.0.1"
	string "verstion"

config PK_HASH_LOAD_UNALIGN_TAR
	default "tar.gz"
	string "tar type"

config PK_HASH_LOAD_UNALIGN_URL
	default "https://gitee.com/BiscuitOS_team/HardStack/raw/Gitee/Algorithem/hash/API/load_unaligned_zeropad"
	string "url"

config PK_HASH_LOAD_UNALIGN_GITHUB
	string "GitHub"

config PK_HASH_LOAD_UNALIGN_SRCFILE
	default "core.c Kconfig Makefile"
	string "Source code list"

config PK_HASH_LOAD_UNALIGN_CSRCFILE
	string "Compile source code list"

config PK_HASH_LOAD_UNALIGN_CONFIG
	string "CONFIG: Project Configure Options"

config PK_HASH_LOAD_UNALIGN_LIBPATH
	string "LIBS: Libraries to pass to the linker, e.g. -l<library>"

config PK_HASH_LOAD_UNALIGN_CPPFLAGS
	string "CPPFLAGS: C/C++ preprocessor flags, e.g. -I<include dir>"

config PK_HASH_LOAD_UNALIGN_DPKCONFIG
	string "PKG_CONFIG_PATH: Directories to add to pkg-config's search path"

config PK_HASH_LOAD_UNALIGN_CFLAGS
	string "CFLAGS: C compiler flags"

config PK_HASH_LOAD_UNALIGN_LDFLAGS
	string "LDFLAGS: Linker flags"

config PK_HASH_LOAD_UNALIGN_CXXFLAGS
	string "CXXFLAGS: C++ compiler flags"

config PK_HASH_LOAD_UNALIGN_ASFLAGS
	string "CCASFLAGS: assembler compiler flags (defaults to CFLAGS)"

config PK_HASH_LOAD_UNALIGN_BUILDARCH
	string "--host options on configure for Architecture"

endif # PK_HASH_LOAD_UNALIGN
```
