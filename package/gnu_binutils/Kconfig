## package/hashlist/Kconfig
```kconfig
menuconfig PK_HLIST
	bool "Hash list"

if PK_HLIST

source "package/hashlist/hlist_bl/Kconfig"

endif # PK_HLIST
```

## package/hashlist/hlist_bl/Kconfig
```kconfig
menuconfig PK_HLIST_BL
	bool "hlist_bl hash table"

if PK_HLIST_BL

# Hlist_bl Base
source "package/hashlist/hlist_bl/hlist_bl_base/Kconfig"

endif # PK_HLIST_BL
```

## package/hello/Kconfig
```kconfig
menuconfig PK_HELLO
	bool "hello"

if PK_HELLO

config PK_HELLO_VERSION
	default "2.4"
	string "verstion"

config PK_HELLO_TAR
	default "tar.gz"
	string "tar type"

config PK_HELLO_URL
	default "http://ftp.gnu.org/pub/gnu/hello/"
	string "url"

config PK_HELLO_GITHUB
	string "GitHub"

config PK_HELLO_SRCFILE
	string "Source code list"

config PK_HELLO_CONFIG
	default "--enable-silent-rules --disable-static"
	string "CONFIG: Project Configure Options"

config PK_HELLO_LIBPATH
	string "LIBS: Libraries to pass to the linker, e.g. -l<library>"

config PK_HELLO_CPPFLAGS
	string "CPPFLAGS: C/C++ preprocessor flags, e.g. -I<include dir>"

config PK_HELLO_DPKCONFIG
	string "PKG_CONFIG_PATH: Directories to add to pkg-config's search path"

config PK_HELLO_CFLAGS
	string "CFLAGS: C compiler flags"

config PK_HELLO_LDFLAGS
	string "LDFLAGS: Linker flags"

config PK_HELLO_CXXFLAGS
	string "CXXFLAGS: C++ compiler flags"

config PK_HELLO_ASFLAGS
	string "CCASFLAGS: assembler compiler flags (defaults to CFLAGS)"

config PK_HELLO_BUILDARCH
	default "x86_64-unknown-linux-gnu"
	string "--host options on configure for Architecture"

endif # PK_HELLO
```

## package/highmem/Kconfig
```kconfig
menuconfig PK_HIGHMEM
	bool "High-Memory Zone"

if PK_HIGHMEM

# highmem on userspace
source package/highmem/highmem_userspace/Kconfig

endif # PK_HIGHMEM
```

## package/history/Kconfig
```kconfig
menuconfig PK_HISTORY
	bool "kernel history"

if PK_HISTORY

config PK_HISTORY_BUILD_NEW
	bool "Build new split subdir"

if PK_HISTORY_BUILD_NEW

config PK_HISTORY_SRC_DIR
	string "The subdir for spliting"

config PK_HISTORY_DEST_DIR
	string "The new directory/branch name"

config PK_HISTORY_KERNEL_TAG
	string "Kernel tag"
	default "normal"

endif # PK_HISTORY_BUILD_NEW

endif # PK_HISTORY
```

## package/hugetlb/BiscuitOS-hugetlb-anonymous-share-mapping-libhugetlbfs/Kconfig
```kconfig
menuconfig PK_BISCUITOS_HUGETLB_ANON_SHARE_LIBHUGE
	bool "hugetlb: Anon-Shared on libhugetlbfs (Default-Size Hugepages+)"

if PK_BISCUITOS_HUGETLB_ANON_SHARE_LIBHUGE

config PK_BISCUITOS_HUGETLB_ANON_SHARE_LIBHUGE_VERSION
	default "default"
	string "verstion"

config PK_BISCUITOS_HUGETLB_ANON_SHARE_LIBHUGE_TAR
	default "tar.gz"
	string "tar type"

config PK_BISCUITOS_HUGETLB_ANON_SHARE_LIBHUGE_URL
	default "https://gitee.com/BiscuitOS_team/HardStack/raw/Gitee/Memory-Allocator/Hugetlb/BiscuitOS-hugetlb-anonymous-share-mapping-libhugetlbfs"
	string "url"

config PK_BISCUITOS_HUGETLB_ANON_SHARE_LIBHUGE_GITHUB
	string "GitHub"

config PK_BISCUITOS_HUGETLB_ANON_SHARE_LIBHUGE_SRCFILE
	default "main.c Makefile RunBiscuitOS.sh"
	string "Source code list"

config PK_BISCUITOS_HUGETLB_ANON_SHARE_LIBHUGE_CSRCFILE
	string "Compile source code list"

config PK_BISCUITOS_HUGETLB_ANON_SHARE_LIBHUGE_CONFIG
	string "CONFIG: Project Configure Options"

config PK_BISCUITOS_HUGETLB_ANON_SHARE_LIBHUGE_LIBPATH
	string "LIBS: Libraries to pass to the linker, e.g. -l<library>"

config PK_BISCUITOS_HUGETLB_ANON_SHARE_LIBHUGE_CPPFLAGS
	string "CPPFLAGS: C/C++ preprocessor flags, e.g. -I<include dir>"

config PK_BISCUITOS_HUGETLB_ANON_SHARE_LIBHUGE_DPKCONFIG
	string "PKG_CONFIG_PATH: Directories to add to pkg-config's search path"

config PK_BISCUITOS_HUGETLB_ANON_SHARE_LIBHUGE_CFLAGS
	string "CFLAGS: C compiler flags"

config PK_BISCUITOS_HUGETLB_ANON_SHARE_LIBHUGE_LDFLAGS
	string "LDFLAGS: Linker flags"

config PK_BISCUITOS_HUGETLB_ANON_SHARE_LIBHUGE_CXXFLAGS
	string "CXXFLAGS: C++ compiler flags"

config PK_BISCUITOS_HUGETLB_ANON_SHARE_LIBHUGE_ASFLAGS
	string "CCASFLAGS: assembler compiler flags (defaults to CFLAGS)"

config PK_BISCUITOS_HUGETLB_ANON_SHARE_LIBHUGE_BUILDARCH
	string "--host options on configure for Architecture"

endif # PK_BISCUITOS_HUGETLB_ANON_SHARE_LIBHUGE
```

## package/hugetlb/BiscuitOS-hugetlb-anonymous-share-mapping-migration-32MiB/Kconfig
```kconfig
menuconfig PK_BISCUITOS_HUGETLB_ANON_SHARE_MIGRATE_32M
	bool "hugetlb: Anon-Shared on Migration (32MiB Hugepages+)"

if PK_BISCUITOS_HUGETLB_ANON_SHARE_MIGRATE_32M

config PK_BISCUITOS_HUGETLB_ANON_SHARE_MIGRATE_32M_VERSION
	default "default"
	string "verstion"

config PK_BISCUITOS_HUGETLB_ANON_SHARE_MIGRATE_32M_TAR
	default "tar.gz"
	string "tar type"

config PK_BISCUITOS_HUGETLB_ANON_SHARE_MIGRATE_32M_URL
	default "https://gitee.com/BiscuitOS_team/HardStack/raw/Gitee/Memory-Allocator/Hugetlb/BiscuitOS-hugetlb-anonymous-share-mapping-migration-32MiB"
	string "url"

config PK_BISCUITOS_HUGETLB_ANON_SHARE_MIGRATE_32M_GITHUB
	string "GitHub"

config PK_BISCUITOS_HUGETLB_ANON_SHARE_MIGRATE_32M_SRCFILE
	default "main.c Makefile RunBiscuitOS.sh"
	string "Source code list"

config PK_BISCUITOS_HUGETLB_ANON_SHARE_MIGRATE_32M_CSRCFILE
	string "Compile source code list"

config PK_BISCUITOS_HUGETLB_ANON_SHARE_MIGRATE_32M_CONFIG
	string "CONFIG: Project Configure Options"

config PK_BISCUITOS_HUGETLB_ANON_SHARE_MIGRATE_32M_LIBPATH
	string "LIBS: Libraries to pass to the linker, e.g. -l<library>"

config PK_BISCUITOS_HUGETLB_ANON_SHARE_MIGRATE_32M_CPPFLAGS
	string "CPPFLAGS: C/C++ preprocessor flags, e.g. -I<include dir>"

config PK_BISCUITOS_HUGETLB_ANON_SHARE_MIGRATE_32M_DPKCONFIG
	string "PKG_CONFIG_PATH: Directories to add to pkg-config's search path"

config PK_BISCUITOS_HUGETLB_ANON_SHARE_MIGRATE_32M_CFLAGS
	string "CFLAGS: C compiler flags"

config PK_BISCUITOS_HUGETLB_ANON_SHARE_MIGRATE_32M_LDFLAGS
	string "LDFLAGS: Linker flags"

config PK_BISCUITOS_HUGETLB_ANON_SHARE_MIGRATE_32M_CXXFLAGS
	string "CXXFLAGS: C++ compiler flags"

config PK_BISCUITOS_HUGETLB_ANON_SHARE_MIGRATE_32M_ASFLAGS
	string "CCASFLAGS: assembler compiler flags (defaults to CFLAGS)"

config PK_BISCUITOS_HUGETLB_ANON_SHARE_MIGRATE_32M_BUILDARCH
	string "--host options on configure for Architecture"

endif # PK_BISCUITOS_HUGETLB_ANON_SHARE_MIGRATE_32M
```

## package/hugetlb/BiscuitOS-hugetlb-anonymous-share-mapping-migration-64KiB/Kconfig
```kconfig
menuconfig PK_BISCUITOS_HUGETLB_ANON_SHARE_MIGRATE_64K
	bool "hugetlb: Anon-Shared on Migration (64KiB Hugepages+)"

if PK_BISCUITOS_HUGETLB_ANON_SHARE_MIGRATE_64K

config PK_BISCUITOS_HUGETLB_ANON_SHARE_MIGRATE_64K_VERSION
	default "default"
	string "verstion"

config PK_BISCUITOS_HUGETLB_ANON_SHARE_MIGRATE_64K_TAR
	default "tar.gz"
	string "tar type"

config PK_BISCUITOS_HUGETLB_ANON_SHARE_MIGRATE_64K_URL
	default "https://gitee.com/BiscuitOS_team/HardStack/raw/Gitee/Memory-Allocator/Hugetlb/BiscuitOS-hugetlb-anonymous-share-mapping-migration-64KiB"
	string "url"

config PK_BISCUITOS_HUGETLB_ANON_SHARE_MIGRATE_64K_GITHUB
	string "GitHub"

config PK_BISCUITOS_HUGETLB_ANON_SHARE_MIGRATE_64K_SRCFILE
	default "main.c Makefile RunBiscuitOS.sh"
	string "Source code list"

config PK_BISCUITOS_HUGETLB_ANON_SHARE_MIGRATE_64K_CSRCFILE
	string "Compile source code list"

config PK_BISCUITOS_HUGETLB_ANON_SHARE_MIGRATE_64K_CONFIG
	string "CONFIG: Project Configure Options"

config PK_BISCUITOS_HUGETLB_ANON_SHARE_MIGRATE_64K_LIBPATH
	string "LIBS: Libraries to pass to the linker, e.g. -l<library>"

config PK_BISCUITOS_HUGETLB_ANON_SHARE_MIGRATE_64K_CPPFLAGS
	string "CPPFLAGS: C/C++ preprocessor flags, e.g. -I<include dir>"

config PK_BISCUITOS_HUGETLB_ANON_SHARE_MIGRATE_64K_DPKCONFIG
	string "PKG_CONFIG_PATH: Directories to add to pkg-config's search path"

config PK_BISCUITOS_HUGETLB_ANON_SHARE_MIGRATE_64K_CFLAGS
	string "CFLAGS: C compiler flags"

config PK_BISCUITOS_HUGETLB_ANON_SHARE_MIGRATE_64K_LDFLAGS
	string "LDFLAGS: Linker flags"

config PK_BISCUITOS_HUGETLB_ANON_SHARE_MIGRATE_64K_CXXFLAGS
	string "CXXFLAGS: C++ compiler flags"

config PK_BISCUITOS_HUGETLB_ANON_SHARE_MIGRATE_64K_ASFLAGS
	string "CCASFLAGS: assembler compiler flags (defaults to CFLAGS)"

config PK_BISCUITOS_HUGETLB_ANON_SHARE_MIGRATE_64K_BUILDARCH
	string "--host options on configure for Architecture"

endif # PK_BISCUITOS_HUGETLB_ANON_SHARE_MIGRATE_64K
```
