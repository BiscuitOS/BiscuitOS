## package/libpng/Kconfig
```kconfig
menuconfig PK_LIBPNG
	select PK_GLIB
	bool "libpng"

if PK_LIBPNG

config PK_LIBPNG_VERSION
	default "1.6.31"
	string "verstion"

config PK_LIBPNG_TAR
	default "tar.gz"
	string "tar type"

config PK_LIBPNG_URL
	default "ftp://ftp-osl.osuosl.org/pub/libpng/src/archive/gz/libpng16/"
	string "url"

config PK_LIBPNG_GITHUB
	string "GitHub"

config PK_LIBPNG_SRCFILE
	string "Source code list"

config PK_LIBPNG_CONFIG
	default "--enable-silent-rules --disable-static"
	string "CONFIG: Project Configure Options"

config PK_LIBPNG_LIBPATH
	string "LIBS: Libraries to pass to the linker, e.g. -l<library>"

config PK_LIBPNG_CPPFLAGS
	string "CPPFLAGS: C/C++ preprocessor flags, e.g. -I<include dir>"

config PK_LIBPNG_DPKCONFIG
	string "PKG_CONFIG_PATH: Directories to add to pkg-config's search path"

config PK_LIBPNG_CFLAGS
	string "CFLAGS: C compiler flags"

config PK_LIBPNG_LDFLAGS
	string "LDFLAGS: Linker flags"

config PK_LIBPNG_CXXFLAGS
	string "CXXFLAGS: C++ compiler flags"

config PK_LIBPNG_ASFLAGS
	string "CCASFLAGS: assembler compiler flags (defaults to CFLAGS)"

config PK_LIBPNG_BUILDARCH
	default "x86_64-unknown-linux-gnu"
	string "--host options on configure for Architecture"

endif # PK_LIBPNG
```

## package/libpthread-stubs/Kconfig
```kconfig
menuconfig PK_LIBPTHREAD_STUBS
	bool "libpthread-stubs"

if PK_LIBPTHREAD_STUBS

config LIBPTHREAD_STUBS_VERSION
	default "0.3" if X11R7_7
	#default "0.1"
	string "verstion"

config LIBPTHREAD_STUBS_TAR
	default "tar.gz"
	string "tar type"

config LIBPTHREAD_STUBS_URL
	default "https://www.x.org/releases/X11R7.7/src/xcb/" if X11R7_7
	#default "https://www.x.org/releases/individual/lib/"
	string "url"

config LIBPTHREAD_STUBS_SRC
	string "source code list"

config LIBPTHREAD_STUBS_LDFLAGS
	string "LDFLAGS"

config LIBPTHREAD_STUBS_CFLAGS
	string "CFLAGS"

config LIBPTHREAD_STUBS_CONFIG
	string "configure"

endif # PK_LIBPTHREAD_STUBS
```

## package/libtiff/Kconfig
```kconfig
menuconfig PK_LIBTIFF
	select PK_ZLIB
	bool "libtiff"

if PK_LIBTIFF

config LIB_LIBTIFF_VERSION
	default "4.0.8"
	string "verstion"

config LIB_LIBTIFF_TAR
	default "tar.gz"
	string "tar type"

config LIB_LIBTIFF_URL
	default "https://ftp.osuosl.org/pub/blfs/conglomeration/tiff/"
	string "url"

config LIB_LIBTIFF_SRC
	string "source code list"

config LIB_LIBTIFF_LDFLAGS
	string "LDFLAGS"

config LIB_LIBTIFF_CFLAGS
	string "CFLAGS"

config LIB_LIBTIFF_CONFIG
	string "configure"

endif # PK_LIBTIFF
```

## package/libvirt/Kconfig
```kconfig
menuconfig PK_LIBVIRT
	bool "libvirt"
	select PK_GNUTLS
	select PK_LIBNL
	select PK_LIBXML2

if PK_LIBVIRT

config PK_LIBVIRT_VERSION
	default "6.0.0"
	string "verstion"

config PK_LIBVIRT_TAR
	default "tar.xz"
	string "tar type"

config PK_LIBVIRT_URL
	default "https://libvirt.org/sources"
	string "url"

config PK_LIBVIRT_GITHUB
	string "GitHub"

config PK_LIBVIRT_SRCFILE
	string "Source code list"

config PK_LIBVIRT_CONFIG
	default "--enable-silent-rules"
	string "CONFIG: Project Configure Options"

config PK_LIBVIRT_LIBPATH
	string "LIBS: Libraries to pass to the linker, e.g. -l<library>"

config PK_LIBVIRT_CPPFLAGS
	string "CPPFLAGS: C/C++ preprocessor flags, e.g. -I<include dir>"

config PK_LIBVIRT_DPKCONFIG
	string "PKG_CONFIG_PATH: Directories to add to pkg-config's search path"

config PK_LIBVIRT_CFLAGS
	string "CFLAGS: C compiler flags"

config PK_LIBVIRT_LDFLAGS
	string "LDFLAGS: Linker flags"

config PK_LIBVIRT_CXXFLAGS
	string "CXXFLAGS: C++ compiler flags"

config PK_LIBVIRT_ASFLAGS
	string "CCASFLAGS: assembler compiler flags (defaults to CFLAGS)"

config PK_LIBVIRT_BUILDARCH
	default "x86_64-unknown-linux-gnu"
	string "--host options on configure for Architecture"

endif # PK_LIBVIRT
```

## package/libxcb-proto/Kconfig
```kconfig
menuconfig PK_LIBXCB_PROTO
	bool "libxcb-proto"

if PK_LIBXCB_PROTO

config LIB_LIBXCB_PROTO_VERSION
	default "1.12"
	string "verstion"

config LIB_LIBXCB_PROTO_TAR
	default "tar.gz"
	string "tar type"

config LIB_LIBXCB_PROTO_URL
	default "https://www.x.org/releases/individual/xcb/"
	string "url"

config LIB_LIBXCB_PROTO_SRC
	string "source code list"

config LIB_LIBXCB_PROTO_LDFLAGS
	string "LDFLAGS"

config LIB_LIBXCB_PROTO_CFLAGS
	string "CFLAGS"

config LIB_LIBXCB_PROTO_CONFIG
	string "configure"

endif # PK_LIBXCB_PROTO
```

## package/libxcb/Kconfig
```kconfig
menuconfig PK_LIBXCB
	select PK_XCB_PROTO
	select PK_LIBXAU
	bool "libxcb"

if PK_LIBXCB

config PK_LIBXCB_VERSION
	default "1.12"
	string "verstion"

config PK_LIBXCB_TAR
	default "tar.gz"
	string "tar type"

config PK_LIBXCB_URL
	default "https://www.x.org/releases/individual/xcb/"
	string "url"

config PK_LIBXCB_GITHUB
	string "GitHub"

config PK_LIBXCB_SRCFILE
	string "Source code list"

config PK_LIBXCB_CONFIG
	default "--enable-silent-rules --disable-static"
	string "CONFIG: Project Configure Options"

config PK_LIBXCB_LIBPATH
	string "LIBS: Libraries to pass to the linker, e.g. -l<library>"

config PK_LIBXCB_CPPFLAGS
	string "CPPFLAGS: C/C++ preprocessor flags, e.g. -I<include dir>"

config PK_LIBXCB_DPKCONFIG
	string "PKG_CONFIG_PATH: Directories to add to pkg-config's search path"

config PK_LIBXCB_CFLAGS
	string "CFLAGS: C compiler flags"

config PK_LIBXCB_LDFLAGS
	string "LDFLAGS: Linker flags"

config PK_LIBXCB_CXXFLAGS
	string "CXXFLAGS: C++ compiler flags"

config PK_LIBXCB_ASFLAGS
	string "CCASFLAGS: assembler compiler flags (defaults to CFLAGS)"

config PK_LIBXCB_BUILDARCH
	default "x86_64-unknown-linux-gnu"
	string "--host options on configure for Architecture"

endif # PK_LIBXCB
```

## package/libxfce4util/Kconfig
```kconfig
menuconfig PK_LIBXFCE4UTIL
	bool "libxfce4util"

if PK_LIBXFCE4UTIL

config LIB_LIBXFCE4UTIL_VERSION
	default "4.12.1" if XFCER4
	string "verstion"

config LIB_LIBXFCE4UTIL_TAR
	default "tar.bz2"
	string "tar type"

config LIB_LIBXFCE4UTIL_URL
	default "http://archive.xfce.org/src/xfce/libxfce4util/4.12" if XFCER4
	string "url"

config LIB_LIBXFCE4UTIL_SRC
	string "source code list"

config LIB_LIBXFCE4UTIL_LDFLAGS
	string "LDFLAGS"

config LIB_LIBXFCE4UTIL_CFLAGS
	string "CFLAGS"

config LIB_LIBXFCE4UTIL_CONFIG
	string "configure"

endif # PK_LIBXFCE4UTIL
```

## package/libxkbfile/Kconfig
```kconfig
menuconfig PK_LIBXKBFILE
	select PK_LIBXFONT2
	bool "libxkbfile"

if PK_LIBXKBFILE

config PK_LIBXKBFILE_VERSION
	default "1.0.9"
	string "verstion"

config PK_LIBXKBFILE_TAR
	default "tar.gz"
	string "tar type"

config PK_LIBXKBFILE_URL
	default "https://www.x.org/releases/individual/lib/"
	string "url"

config PK_LIBXKBFILE_GITHUB
	string "GitHub"

config PK_LIBXKBFILE_SRCFILE
	string "Source code list"

config PK_LIBXKBFILE_CONFIG
	default "--enable-silent-rules --disable-static"
	string "CONFIG: Project Configure Options"

config PK_LIBXKBFILE_LIBPATH
	string "LIBS: Libraries to pass to the linker, e.g. -l<library>"

config PK_LIBXKBFILE_CPPFLAGS
	string "CPPFLAGS: C/C++ preprocessor flags, e.g. -I<include dir>"

config PK_LIBXKBFILE_DPKCONFIG
	string "PKG_CONFIG_PATH: Directories to add to pkg-config's search path"

config PK_LIBXKBFILE_CFLAGS
	string "CFLAGS: C compiler flags"

config PK_LIBXKBFILE_LDFLAGS
	string "LDFLAGS: Linker flags"

config PK_LIBXKBFILE_CXXFLAGS
	string "CXXFLAGS: C++ compiler flags"

config PK_LIBXKBFILE_ASFLAGS
	string "CCASFLAGS: assembler compiler flags (defaults to CFLAGS)"

config PK_LIBXKBFILE_BUILDARCH
	default "x86_64-unknown-linux-gnu"
	string "--host options on configure for Architecture"

endif # PK_LIBXKBFILE
```

## package/libxml2/Kconfig
```kconfig
menuconfig PK_LIBXML2
	bool "libxml2"

if PK_LIBXML2

config PK_LIBXML2_VERSION
	default "2.9.5"
	string "verstion"

config PK_LIBXML2_TAR
	default "tar.gz"
	string "tar type"

config PK_LIBXML2_URL
	default "ftp://xmlsoft.org/libxml2/"
	string "url"

config PK_LIBXML2_GITHUB
	string "GitHub"

config PK_LIBXML2_SRCFILE
	string "Source code list"

config PK_LIBXML2_CONFIG
	default "--enable-silent-rules --disable-static"
	string "CONFIG: Project Configure Options"

config PK_LIBXML2_LIBPATH
	string "LIBS: Libraries to pass to the linker, e.g. -l<library>"

config PK_LIBXML2_CPPFLAGS
	string "CPPFLAGS: C/C++ preprocessor flags, e.g. -I<include dir>"

config PK_LIBXML2_DPKCONFIG
	string "PKG_CONFIG_PATH: Directories to add to pkg-config's search path"

config PK_LIBXML2_CFLAGS
	string "CFLAGS: C compiler flags"

config PK_LIBXML2_LDFLAGS
	string "LDFLAGS: Linker flags"

config PK_LIBXML2_CXXFLAGS
	string "CXXFLAGS: C++ compiler flags"

config PK_LIBXML2_ASFLAGS
	string "CCASFLAGS: assembler compiler flags (defaults to CFLAGS)"

config PK_LIBXML2_BUILDARCH
	default "x86_64-unknown-linux-gnu"
	string "--host options on configure for Architecture"

endif # PK_LIBXML2
```

## package/libxproto/Kconfig
```kconfig
menuconfig PK_LIBXPROTO
	bool "libxproto"

if PK_LIBXPROTO

config LIB_LIBXPROTO_VERSION
	default "7.0.25"
	string "verstion"

config LIB_LIBXPROTO_TAR
	default "tar.gz"
	string "tar type"

config LIB_LIBXPROTO_URL
	default "https://www.x.org/releases/individual/proto/"
	string "url"

config LIB_LIBXPROTO_SRC
	string "source code list"

config LIB_LIBXPROTO_LDFLAGS
	string "LDFLAGS"

config LIB_LIBXPROTO_CFLAGS
	string "CFLAGS"

config LIB_LIBXPROTO_CONFIG
	string "configure"

endif # PK_LIBXPROTO
```

## package/libxshmfence/Kconfig
```kconfig
menuconfig PK_LIBXSHMFENCE
	select PK_LIBEPOXY
	bool "libxshmfence"

if PK_LIBXSHMFENCE

config PK_LIBXSHMFENCE_VERSION
	default "1.3"
	string "verstion"

config PK_LIBXSHMFENCE_TAR
	default "tar.gz"
	string "tar type"

config PK_LIBXSHMFENCE_URL
	default "https://www.x.org/releases/individual/lib/"
	string "url"

config PK_LIBXSHMFENCE_GITHUB
	string "GitHub"

config PK_LIBXSHMFENCE_SRCFILE
	string "Source code list"

config PK_LIBXSHMFENCE_CONFIG
	default "--enable-silent-rules --disable-static"
	string "CONFIG: Project Configure Options"

config PK_LIBXSHMFENCE_LIBPATH
	string "LIBS: Libraries to pass to the linker, e.g. -l<library>"

config PK_LIBXSHMFENCE_CPPFLAGS
	string "CPPFLAGS: C/C++ preprocessor flags, e.g. -I<include dir>"

config PK_LIBXSHMFENCE_DPKCONFIG
	string "PKG_CONFIG_PATH: Directories to add to pkg-config's search path"

config PK_LIBXSHMFENCE_CFLAGS
	string "CFLAGS: C compiler flags"

config PK_LIBXSHMFENCE_LDFLAGS
	string "LDFLAGS: Linker flags"

config PK_LIBXSHMFENCE_CXXFLAGS
	string "CXXFLAGS: C++ compiler flags"

config PK_LIBXSHMFENCE_ASFLAGS
	string "CCASFLAGS: assembler compiler flags (defaults to CFLAGS)"

config PK_LIBXSHMFENCE_BUILDARCH
	default "x86_64-unknown-linux-gnu"
	string "--host options on configure for Architecture"

endif # PK_LIBXSHMFENCE
```

## package/libxtrans/Kconfig
```kconfig
menuconfig PK_LIBXTRANS
	bool "libxtrans"

if PK_LIBXTRANS

config LIB_LIBXTRANS_VERSION
	default "1.3.0"
	string "verstion"

config LIB_LIBXTRANS_TAR
	default "tar.gz"
	string "tar type"

config LIB_LIBXTRANS_URL
	default "https://www.x.org/releases/individual/lib/"
	string "url"

config LIB_LIBXTRANS_SRC
	string "source code list"

config LIB_LIBXTRANS_LDFLAGS
	string "LDFLAGS"

config LIB_LIBXTRANS_CFLAGS
	string "CFLAGS"

config LIB_LIBXTRANS_CONFIG
	string "configure"

endif # PK_LIBXTRANS
```
