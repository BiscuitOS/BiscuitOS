## package/libXfixes/Kconfig
```kconfig
menuconfig PK_LIBXFIXES
	select PK_FIXESPROTO
	select PK_LIBXXF86VM
	bool "libXfixes"

if PK_LIBXFIXES

config PK_LIBXFIXES_VERSION
	default "5.0.3"
	string "verstion"

config PK_LIBXFIXES_TAR
	default "tar.gz"
	string "tar type"

config PK_LIBXFIXES_URL
	default "https://www.x.org/releases/individual/lib/"
	string "url"

config PK_LIBXFIXES_GITHUB
	string "GitHub"

config PK_LIBXFIXES_SRCFILE
	string "Source code list"

config PK_LIBXFIXES_CONFIG
	default "--enable-silent-rules --disable-static"
	string "CONFIG: Project Configure Options"

config PK_LIBXFIXES_LIBPATH
	string "LIBS: Libraries to pass to the linker, e.g. -l<library>"

config PK_LIBXFIXES_CPPFLAGS
	string "CPPFLAGS: C/C++ preprocessor flags, e.g. -I<include dir>"

config PK_LIBXFIXES_DPKCONFIG
	string "PKG_CONFIG_PATH: Directories to add to pkg-config's search path"

config PK_LIBXFIXES_CFLAGS
	string "CFLAGS: C compiler flags"

config PK_LIBXFIXES_LDFLAGS
	string "LDFLAGS: Linker flags"

config PK_LIBXFIXES_CXXFLAGS
	string "CXXFLAGS: C++ compiler flags"

config PK_LIBXFIXES_ASFLAGS
	string "CCASFLAGS: assembler compiler flags (defaults to CFLAGS)"

config PK_LIBXFIXES_BUILDARCH
	default "x86_64-unknown-linux-gnu"
	string "--host options on configure for Architecture"

endif # PK_LIBXFIXES
```

## package/libXfont2/Kconfig
```kconfig
menuconfig PK_LIBXFONT2
	select PK_FREETYPE
	select PK_FONTSPROTO
	select PK_LIBFONTENC
	select PK_LIBX11
	bool "libXfont2"

if PK_LIBXFONT2

config PK_LIBXFONT2_VERSION
	default "2.0.1"
	string "verstion"

config PK_LIBXFONT2_TAR
	default "tar.gz"
	string "tar type"

config PK_LIBXFONT2_URL
	default "https://www.x.org/releases/individual/lib/"
	string "url"

config PK_LIBXFONT2_GITHUB
	string "GitHub"

config PK_LIBXFONT2_SRCFILE
	string "Source code list"

config PK_LIBXFONT2_CONFIG
	default "--enable-silent-rules --disable-static"
	string "CONFIG: Project Configure Options"

config PK_LIBXFONT2_LIBPATH
	string "LIBS: Libraries to pass to the linker, e.g. -l<library>"

config PK_LIBXFONT2_CPPFLAGS
	string "CPPFLAGS: C/C++ preprocessor flags, e.g. -I<include dir>"

config PK_LIBXFONT2_DPKCONFIG
	string "PKG_CONFIG_PATH: Directories to add to pkg-config's search path"

config PK_LIBXFONT2_CFLAGS
	string "CFLAGS: C compiler flags"

config PK_LIBXFONT2_LDFLAGS
	string "LDFLAGS: Linker flags"

config PK_LIBXFONT2_CXXFLAGS
	string "CXXFLAGS: C++ compiler flags"

config PK_LIBXFONT2_ASFLAGS
	string "CCASFLAGS: assembler compiler flags (defaults to CFLAGS)"

config PK_LIBXFONT2_BUILDARCH
	default "x86_64-unknown-linux-gnu"
	string "--host options on configure for Architecture"

endif # PK_LIBXFONT2
```

## package/libXrender/Kconfig
```kconfig
menuconfig PK_LIBXRENDER
	select PK_LIBXEXT
	select PK_RENDERPROTO
	bool "libXrender"

if PK_LIBXRENDER

config PK_LIBXRENDER_VERSION
	default "0.9.10"
	string "verstion"

config PK_LIBXRENDER_TAR
	default "tar.gz"
	string "tar type"

config PK_LIBXRENDER_URL
	default "https://www.x.org/releases/individual/lib/"
	string "url"

config PK_LIBXRENDER_GITHUB
	string "GitHub"

config PK_LIBXRENDER_SRCFILE
	string "Source code list"

config PK_LIBXRENDER_CONFIG
	default "--enable-silent-rules --disable-static --enable-malloc0returnsnull"
	string "CONFIG: Project Configure Options"

config PK_LIBXRENDER_LIBPATH
	string "LIBS: Libraries to pass to the linker, e.g. -l<library>"

config PK_LIBXRENDER_CPPFLAGS
	string "CPPFLAGS: C/C++ preprocessor flags, e.g. -I<include dir>"

config PK_LIBXRENDER_DPKCONFIG
	string "PKG_CONFIG_PATH: Directories to add to pkg-config's search path"

config PK_LIBXRENDER_CFLAGS
	string "CFLAGS: C compiler flags"

config PK_LIBXRENDER_LDFLAGS
	string "LDFLAGS: Linker flags"

config PK_LIBXRENDER_CXXFLAGS
	string "CXXFLAGS: C++ compiler flags"

config PK_LIBXRENDER_ASFLAGS
	string "CCASFLAGS: assembler compiler flags (defaults to CFLAGS)"

config PK_LIBXRENDER_BUILDARCH
	default "x86_64-unknown-linux-gnu"
	string "--host options on configure for Architecture"

endif # PK_LIBXRENDER
```

## package/libXxf86vm/Kconfig
```kconfig
menuconfig PK_LIBXXF86VM
	select PK_XF86VIDMODEPROTO
	select PK_LIBXEXT
	bool "libXxf86vm"

if PK_LIBXXF86VM

config PK_LIBXXF86VM_VERSION
	default "1.1.4"
	string "verstion"

config PK_LIBXXF86VM_TAR
	default "tar.gz"
	string "tar type"

config PK_LIBXXF86VM_URL
	default "https://www.x.org/releases/individual/lib/"
	string "url"

config PK_LIBXXF86VM_GITHUB
	string "GitHub"

config PK_LIBXXF86VM_SRCFILE
	string "Source code list"

config PK_LIBXXF86VM_CONFIG
	default "--enable-silent-rules --disable-static --enable-malloc0returnsnull"
	string "CONFIG: Project Configure Options"

config PK_LIBXXF86VM_LIBPATH
	string "LIBS: Libraries to pass to the linker, e.g. -l<library>"

config PK_LIBXXF86VM_CPPFLAGS
	string "CPPFLAGS: C/C++ preprocessor flags, e.g. -I<include dir>"

config PK_LIBXXF86VM_DPKCONFIG
	string "PKG_CONFIG_PATH: Directories to add to pkg-config's search path"

config PK_LIBXXF86VM_CFLAGS
	string "CFLAGS: C compiler flags"

config PK_LIBXXF86VM_LDFLAGS
	string "LDFLAGS: Linker flags"

config PK_LIBXXF86VM_CXXFLAGS
	string "CXXFLAGS: C++ compiler flags"

config PK_LIBXXF86VM_ASFLAGS
	string "CCASFLAGS: assembler compiler flags (defaults to CFLAGS)"

config PK_LIBXXF86VM_BUILDARCH
	default "x86_64-unknown-linux-gnu"
	string "--host options on configure for Architecture"

endif # PK_LIBXXF86VM
```

## package/libdrm/Kconfig
```kconfig
menuconfig PK_LIBDRM
	bool "libdrm"

if PK_LIBDRM

config PK_LIBDRM_VERSION
	default "2.4.88"
	string "verstion"

config PK_LIBDRM_TAR
	default "tar.xz"
	string "tar type"

config PK_LIBDRM_URL
	default "http://ftp.pieskovisko.sk/slackware/slackware64-current/source/x/libdrm/"
	string "url"

config PK_LIBDRM_GITHUB
	string "GitHub"

config PK_LIBDRM_SRCFILE
	string "Source code list"

config PK_LIBDRM_CONFIG
	default "--enable-silent-rules --disable-static"
	string "CONFIG: Project Configure Options"

config PK_LIBDRM_LIBPATH
	string "LIBS: Libraries to pass to the linker, e.g. -l<library>"

config PK_LIBDRM_CPPFLAGS
	string "CPPFLAGS: C/C++ preprocessor flags, e.g. -I<include dir>"

config PK_LIBDRM_DPKCONFIG
	string "PKG_CONFIG_PATH: Directories to add to pkg-config's search path"

config PK_LIBDRM_CFLAGS
	string "CFLAGS: C compiler flags"

config PK_LIBDRM_LDFLAGS
	string "LDFLAGS: Linker flags"

config PK_LIBDRM_CXXFLAGS
	string "CXXFLAGS: C++ compiler flags"

config PK_LIBDRM_ASFLAGS
	string "CCASFLAGS: assembler compiler flags (defaults to CFLAGS)"

config PK_LIBDRM_BUILDARCH
	default "x86_64-unknown-linux-gnu"
	string "--host options on configure for Architecture"

endif # PK_LIBDRM
```

## package/libelf/Kconfig
```kconfig
menuconfig PK_LIBELF
	bool "libelf"

if PK_LIBELF

config PK_LIBELF_VERSION
	default "0.8.13"
	string "verstion"

config PK_LIBELF_TAR
	default "tar.gz"
	string "tar type"

config PK_LIBELF_URL
	default "http://repository.timesys.com/buildsources/l/libelf/libelf-0.8.13/"
	string "url"

config PK_LIBELF_GITHUB
	string "GitHub"

config PK_LIBELF_SRCFILE
	string "Source code list"

config PK_LIBELF_CONFIG
	string "CONFIG: Project Configure Options"

config PK_LIBELF_LIBPATH
	string "LIBS: Libraries to pass to the linker, e.g. -l<library>"

config PK_LIBELF_CPPFLAGS
	string "CPPFLAGS: C/C++ preprocessor flags, e.g. -I<include dir>"

config PK_LIBELF_DPKCONFIG
	string "PKG_CONFIG_PATH: Directories to add to pkg-config's search path"

config PK_LIBELF_CFLAGS
	string "CFLAGS: C compiler flags"

config PK_LIBELF_LDFLAGS
	string "LDFLAGS: Linker flags"

config PK_LIBELF_CXXFLAGS
	string "CXXFLAGS: C++ compiler flags"

config PK_LIBELF_ASFLAGS
	string "CCASFLAGS: assembler compiler flags (defaults to CFLAGS)"

config PK_LIBELF_BUILDARCH
	default "x86_64-unknown-linux-gnu"
	string "--host options on configure for Architecture"

endif # PK_LIBELF
```

## package/libepoxy/Kconfig
```kconfig
menuconfig PK_LIBEPOXY
	select PK_LIBXKBFILE
	bool "libepoxy"

if PK_LIBEPOXY

config PK_LIBEPOXY_VERSION
	default "1.4.3"
	string "verstion"

config PK_LIBEPOXY_TAR
	default "tar.xz"
	string "tar type"

config PK_LIBEPOXY_URL
	default "https://download.gnome.org/sources/libepoxy/1.4/"
	string "url"

config PK_LIBEPOXY_GITHUB
	string "GitHub"

config PK_LIBEPOXY_SRCFILE
	string "Source code list"

config PK_LIBEPOXY_CONFIG
	default "--enable-silent-rules --enable-egl=no --disable-static"
	string "CONFIG: Project Configure Options"

config PK_LIBEPOXY_LIBPATH
	string "LIBS: Libraries to pass to the linker, e.g. -l<library>"

config PK_LIBEPOXY_CPPFLAGS
	string "CPPFLAGS: C/C++ preprocessor flags, e.g. -I<include dir>"

config PK_LIBEPOXY_DPKCONFIG
	string "PKG_CONFIG_PATH: Directories to add to pkg-config's search path"

config PK_LIBEPOXY_CFLAGS
	string "CFLAGS: C compiler flags"

config PK_LIBEPOXY_LDFLAGS
	string "LDFLAGS: Linker flags"

config PK_LIBEPOXY_CXXFLAGS
	string "CXXFLAGS: C++ compiler flags"

config PK_LIBEPOXY_ASFLAGS
	string "CCASFLAGS: assembler compiler flags (defaults to CFLAGS)"

config PK_LIBEPOXY_BUILDARCH
	default "x86_64-unknown-linux-gnu"
	string "--host options on configure for Architecture"

endif # PK_LIBEPOXY
```

## package/libffi/Kconfig
```kconfig
menuconfig PK_LIB_LIBFFI
	bool "libffi"

if PK_LIB_LIBFFI

config PK_LIB_LIBFFI_VERSION
	default "3.2.1"
	string "verstion"

config PK_LIB_LIBFFI_TAR
	default "tar.gz"
	string "tar type"

config PK_LIB_LIBFFI_URL
	default "https://www.mirrorservice.org/sites/sourceware.org/pub/libffi/"
	string "url"

config PK_LIB_LIBFFI_GITHUB
	string "GitHub"

config PK_LIB_LIBFFI_SRCFILE
	string "Source code list"

config PK_LIB_LIBFFI_CONFIG
	default "--enable-silent-rules --disable-static"
	string "CONFIG: Project Configure Options"

config PK_LIB_LIBFFI_LIBPATH
	string "LIBS: Libraries to pass to the linker, e.g. -l<library>"

config PK_LIB_LIBFFI_CPPFLAGS
	string "CPPFLAGS: C/C++ preprocessor flags, e.g. -I<include dir>"

config PK_LIB_LIBFFI_DPKCONFIG
	string "PKG_CONFIG_PATH: Directories to add to pkg-config's search path"

config PK_LIB_LIBFFI_CFLAGS
	string "CFLAGS: C compiler flags"

config PK_LIB_LIBFFI_LDFLAGS
	string "LDFLAGS: Linker flags"

config PK_LIB_LIBFFI_CXXFLAGS
	string "CXXFLAGS: C++ compiler flags"

config PK_LIB_LIBFFI_ASFLAGS
	string "CCASFLAGS: assembler compiler flags (defaults to CFLAGS)"

config PK_LIB_LIBFFI_BUILDARCH
	default "x86_64-unknown-linux-gnu"
	string "--host options on configure for Architecture"

endif # PK_LIB_LIBFFI
```

## package/libfontenc/Kconfig
```kconfig
menuconfig PK_LIBFONTENC
	bool "libfontenc"

if PK_LIBFONTENC

config PK_LIBFONTENC_VERSION
	default "1.1.3"
	string "verstion"

config PK_LIBFONTENC_TAR
	default "tar.bz2"
	string "tar type"

config PK_LIBFONTENC_URL
	default "http://repository.timesys.com/buildsources/l/libfontenc/libfontenc-1.1.3/"
	string "url"

config PK_LIBFONTENC_GITHUB
	string "GitHub"

config PK_LIBFONTENC_SRCFILE
	string "Source code list"

config PK_LIBFONTENC_CONFIG
	default "--enable-silent-rules --disable-static"
	string "CONFIG: Project Configure Options"

config PK_LIBFONTENC_LIBPATH
	string "LIBS: Libraries to pass to the linker, e.g. -l<library>"

config PK_LIBFONTENC_CPPFLAGS
	string "CPPFLAGS: C/C++ preprocessor flags, e.g. -I<include dir>"

config PK_LIBFONTENC_DPKCONFIG
	string "PKG_CONFIG_PATH: Directories to add to pkg-config's search path"

config PK_LIBFONTENC_CFLAGS
	string "CFLAGS: C compiler flags"

config PK_LIBFONTENC_LDFLAGS
	string "LDFLAGS: Linker flags"

config PK_LIBFONTENC_CXXFLAGS
	string "CXXFLAGS: C++ compiler flags"

config PK_LIBFONTENC_ASFLAGS
	string "CCASFLAGS: assembler compiler flags (defaults to CFLAGS)"

config PK_LIBFONTENC_BUILDARCH
	default "x86_64-unknown-linux-gnu"
	string "--host options on configure for Architecture"

endif # PK_LIBFONTENC
```

## package/libinputproto/Kconfig
```kconfig
menuconfig PK_LIBINPUTPROTO
	bool "libinputproto"

if PK_LIBINPUTPROTO

config LIB_LIBINPUTPROTO_VERSION
	default "2.2" if X11R7_7
	default "1.4.4" if X11R7_4
	#default "2.3"
	string "verstion"

config LIB_LIBINPUTPROTO_TAR
	default "tar.gz"
	string "tar type"

config LIB_LIBINPUTPROTO_URL
	default "https://www.x.org/releases/X11R7.7/src/proto/" if X11R7_7
	default "https://www.x.org/releases/X11R7.4/src/proto/" if X11R7_4
	#default "https://www.x.org/releases/individual/proto/"
	string "url"

config LIB_LIBINPUTPROTO_SRC
	string "source code list"

config LIB_LIBINPUTPROTO_LDFLAGS
	string "LDFLAGS"

config LIB_LIBINPUTPROTO_CFLAGS
	string "CFLAGS"

config LIB_LIBINPUTPROTO_CONFIG
	string "configure"

endif # PK_LIBINPUTPROTO
```

## package/libkbproto/Kconfig
```kconfig
menuconfig PK_LIBKBPROTO
	bool "libkbproto"

if PK_LIBKBPROTO

config LIB_LIBKBPROTO_VERSION
	default "1.0.6"
	string "verstion"

config LIB_LIBKBPROTO_TAR
	default "tar.gz"
	string "tar type"

config LIB_LIBKBPROTO_URL
	default "https://www.x.org/releases/individual/proto/"
	string "url"

config LIB_LIBKBPROTO_SRC
	string "source code list"

config LIB_LIBKBPROTO_LDFLAGS
	string "LDFLAGS"

config LIB_LIBKBPROTO_CFLAGS
	string "CFLAGS"

config LIB_LIBKBPROTO_CONFIG
	string "configure"

endif # PK_LIBKBPROTO
```

## package/libnl/Kconfig
```kconfig
menuconfig PK_LIBNL
	bool "libnl"
	select PK_GNUTLS

if PK_LIBNL

config PK_LIBNL_VERSION
	default "3.5.0"
	string "verstion"

config PK_LIBNL_TAR
	default "tar.gz"
	string "tar type"

config PK_LIBNL_URL
	default "https://github.com/thom311/libnl/releases/download/libnl3_5_0"
	string "url"

config PK_LIBNL_GITHUB
	string "GitHub"

config PK_LIBNL_SRCFILE
	string "Source code list"

config PK_LIBNL_CONFIG
	default "--enable-silent-rules"
	string "CONFIG: Project Configure Options"

config PK_LIBNL_LIBPATH
	string "LIBS: Libraries to pass to the linker, e.g. -l<library>"

config PK_LIBNL_CPPFLAGS
	string "CPPFLAGS: C/C++ preprocessor flags, e.g. -I<include dir>"

config PK_LIBNL_DPKCONFIG
	string "PKG_CONFIG_PATH: Directories to add to pkg-config's search path"

config PK_LIBNL_CFLAGS
	string "CFLAGS: C compiler flags"

config PK_LIBNL_LDFLAGS
	string "LDFLAGS: Linker flags"

config PK_LIBNL_CXXFLAGS
	string "CXXFLAGS: C++ compiler flags"

config PK_LIBNL_ASFLAGS
	string "CCASFLAGS: assembler compiler flags (defaults to CFLAGS)"

config PK_LIBNL_BUILDARCH
	default "x86_64-unknown-linux-gnu"
	string "--host options on configure for Architecture"

endif # PK_LIBNL
```

## package/libpciaccess/Kconfig
```kconfig
menuconfig PK_LIBPCIACCESS
	bool "libpciaccess"

if PK_LIBPCIACCESS

config PK_LIBPCIACCESS_VERSION
	default "0.13.5"
	string "verstion"

config PK_LIBPCIACCESS_TAR
	default "tar.gz"
	string "tar type"

config PK_LIBPCIACCESS_URL
	default "https://www.x.org/releases/individual/lib/"
	string "url"

config PK_LIBPCIACCESS_GITHUB
	string "GitHub"

config PK_LIBPCIACCESS_SRCFILE
	string "Source code list"

config PK_LIBPCIACCESS_CONFIG
	default "--enable-silent-rules --disable-static"
	string "CONFIG: Project Configure Options"

config PK_LIBPCIACCESS_LIBPATH
	string "LIBS: Libraries to pass to the linker, e.g. -l<library>"

config PK_LIBPCIACCESS_CPPFLAGS
	string "CPPFLAGS: C/C++ preprocessor flags, e.g. -I<include dir>"

config PK_LIBPCIACCESS_DPKCONFIG
	string "PKG_CONFIG_PATH: Directories to add to pkg-config's search path"

config PK_LIBPCIACCESS_CFLAGS
	string "CFLAGS: C compiler flags"

config PK_LIBPCIACCESS_LDFLAGS
	string "LDFLAGS: Linker flags"

config PK_LIBPCIACCESS_CXXFLAGS
	string "CXXFLAGS: C++ compiler flags"

config PK_LIBPCIACCESS_ASFLAGS
	string "CCASFLAGS: assembler compiler flags (defaults to CFLAGS)"

config PK_LIBPCIACCESS_BUILDARCH
	default "x86_64-unknown-linux-gnu"
	string "--host options on configure for Architecture"

endif # PK_LIBPCIACCESS
```
