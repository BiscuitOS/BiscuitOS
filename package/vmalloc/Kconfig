## package/xextproto/Kconfig
```kconfig
menuconfig PK_XEXTPROTO
	bool "xextproto"

if PK_XEXTPROTO

config PK_XEXTPROTO_VERSION
	default "7.3.0"
	string "verstion"

config PK_XEXTPROTO_TAR
	default "tar.gz"
	string "tar type"

config PK_XEXTPROTO_URL
	default "https://www.x.org/releases/individual/proto/"
	string "url"

config PK_XEXTPROTO_GITHUB
	string "GitHub"

config PK_XEXTPROTO_SRCFILE
	string "Source code list"

config PK_XEXTPROTO_CONFIG
	default "--enable-silent-rules --disable-static"
	string "CONFIG: Project Configure Options"

config PK_XEXTPROTO_LIBPATH
	string "LIBS: Libraries to pass to the linker, e.g. -l<library>"

config PK_XEXTPROTO_CPPFLAGS
	string "CPPFLAGS: C/C++ preprocessor flags, e.g. -I<include dir>"

config PK_XEXTPROTO_DPKCONFIG
	string "PKG_CONFIG_PATH: Directories to add to pkg-config's search path"

config PK_XEXTPROTO_CFLAGS
	string "CFLAGS: C compiler flags"

config PK_XEXTPROTO_LDFLAGS
	string "LDFLAGS: Linker flags"

config PK_XEXTPROTO_CXXFLAGS
	string "CXXFLAGS: C++ compiler flags"

config PK_XEXTPROTO_ASFLAGS
	string "CCASFLAGS: assembler compiler flags (defaults to CFLAGS)"

config PK_XEXTPROTO_BUILDARCH
	default "x86_64-unknown-linux-gnu"
	string "--host options on configure for Architecture"

endif # PK_XEXTPROTO
```

## package/xf86driproto/Kconfig
```kconfig
menuconfig PK_XF86DRIPROTO
	bool "xf86driproto"

if PK_XF86DRIPROTO

config PK_XF86DRIPROTO_VERSION
	default "2.1.1"
	string "verstion"

config PK_XF86DRIPROTO_TAR
	default "tar.gz"
	string "tar type"

config PK_XF86DRIPROTO_URL
	default "https://www.x.org/releases/individual/proto/"
	string "url"

config PK_XF86DRIPROTO_GITHUB
	string "GitHub"

config PK_XF86DRIPROTO_SRCFILE
	string "Source code list"

config PK_XF86DRIPROTO_CONFIG
	default "--enable-silent-rules --disable-static"
	string "CONFIG: Project Configure Options"

config PK_XF86DRIPROTO_LIBPATH
	string "LIBS: Libraries to pass to the linker, e.g. -l<library>"

config PK_XF86DRIPROTO_CPPFLAGS
	string "CPPFLAGS: C/C++ preprocessor flags, e.g. -I<include dir>"

config PK_XF86DRIPROTO_DPKCONFIG
	string "PKG_CONFIG_PATH: Directories to add to pkg-config's search path"

config PK_XF86DRIPROTO_CFLAGS
	string "CFLAGS: C compiler flags"

config PK_XF86DRIPROTO_LDFLAGS
	string "LDFLAGS: Linker flags"

config PK_XF86DRIPROTO_CXXFLAGS
	string "CXXFLAGS: C++ compiler flags"

config PK_XF86DRIPROTO_ASFLAGS
	string "CCASFLAGS: assembler compiler flags (defaults to CFLAGS)"

config PK_XF86DRIPROTO_BUILDARCH
	default "x86_64-unknown-linux-gnu"
	string "--host options on configure for Architecture"

endif # PK_XF86DRIPROTO
```

## package/xf86vidmodeproto/Kconfig
```kconfig
menuconfig PK_XF86VIDMODEPROTO
	bool "xf86vidmodeproto"

if PK_XF86VIDMODEPROTO

config PK_XF86VIDMODEPROTO_VERSION
	default "2.3.1"
	string "verstion"

config PK_XF86VIDMODEPROTO_TAR
	default "tar.gz"
	string "tar type"

config PK_XF86VIDMODEPROTO_URL
	default "https://www.x.org/releases/individual/proto/"
	string "url"

config PK_XF86VIDMODEPROTO_GITHUB
	string "GitHub"

config PK_XF86VIDMODEPROTO_SRCFILE
	string "Source code list"

config PK_XF86VIDMODEPROTO_CONFIG
	default "--enable-silent-rules --disable-static"
	string "CONFIG: Project Configure Options"

config PK_XF86VIDMODEPROTO_LIBPATH
	string "LIBS: Libraries to pass to the linker, e.g. -l<library>"

config PK_XF86VIDMODEPROTO_CPPFLAGS
	string "CPPFLAGS: C/C++ preprocessor flags, e.g. -I<include dir>"

config PK_XF86VIDMODEPROTO_DPKCONFIG
	string "PKG_CONFIG_PATH: Directories to add to pkg-config's search path"

config PK_XF86VIDMODEPROTO_CFLAGS
	string "CFLAGS: C compiler flags"

config PK_XF86VIDMODEPROTO_LDFLAGS
	string "LDFLAGS: Linker flags"

config PK_XF86VIDMODEPROTO_CXXFLAGS
	string "CXXFLAGS: C++ compiler flags"

config PK_XF86VIDMODEPROTO_ASFLAGS
	string "CCASFLAGS: assembler compiler flags (defaults to CFLAGS)"

config PK_XF86VIDMODEPROTO_BUILDARCH
	default "x86_64-unknown-linux-gnu"
	string "--host options on configure for Architecture"

endif # PK_XF86VIDMODEPROTO
```

## package/xfce4-exo/Kconfig
```kconfig
menuconfig PK_XFCE4_EXO
	bool "xfce4-exo"

if PK_XFCE4_EXO

config XFCE4_EXO_VERSION
	default "0.10.3" if XFCER4
	string "verstion"

config XFCE4_EXO_TAR
	default "tar.bz2"
	string "tar type"

config XFCE4_EXO_URL
	default "http://archive.xfce.org/src/xfce/exo/0.10" if XFCER4
	string "url"

config XFCE4_EXO_SRC
	string "source code list"

config XFCE4_EXO_LDFLAGS
	string "LDFLAGS"

config XFCE4_EXO_CFLAGS
	string "CFLAGS"

config XFCE4_EXO_CONFIG
	string "configure"

endif # PK_XFCE4_EXO
```

## package/xfce4-panel/Kconfig
```kconfig
menuconfig PK_XFCE4_PANEL
	bool "xfce4-panel"

if PK_XFCE4_PANEL

config XFCE4_PANEL_VERSION
	default "4.12.0" if XFCER4
	string "verstion"

config XFCE4_PANEL_TAR
	default "tar.bz2" if XFCER4
	string "tar type"

config XFCE4_PANEL_URL
	default "http://archive.xfce.org/src/xfce/xfce4-panel/4.12/" if XFCER4
	string "url"

config XFCE4_PANEL_SRC
	string "source code list"

config XFCE4_PANEL_LDFLAGS
	string "LDFLAGS"

config XFCE4_PANEL_CFLAGS
	string "CFLAGS"

config XFCE4_PANEL_CONFIG
	string "configure"

endif # PK_XFCE4_PANEL
```

## package/xineramaproto/Kconfig
```kconfig
menuconfig PK_XINERAMAPROTO
	bool "xineramaproto"

if PK_XINERAMAPROTO

config PK_XINERAMAPROTO_VERSION
	default "1.2.1"
	string "verstion"

config PK_XINERAMAPROTO_TAR
	default "tar.gz"
	string "tar type"

config PK_XINERAMAPROTO_URL
	default "https://www.x.org/releases/individual/proto/"
	string "url"

config PK_XINERAMAPROTO_GITHUB
	string "GitHub"

config PK_XINERAMAPROTO_SRCFILE
	string "Source code list"

config PK_XINERAMAPROTO_CONFIG
	default "--enable-silent-rules --disable-static"
	string "CONFIG: Project Configure Options"

config PK_XINERAMAPROTO_LIBPATH
	string "LIBS: Libraries to pass to the linker, e.g. -l<library>"

config PK_XINERAMAPROTO_CPPFLAGS
	string "CPPFLAGS: C/C++ preprocessor flags, e.g. -I<include dir>"

config PK_XINERAMAPROTO_DPKCONFIG
	string "PKG_CONFIG_PATH: Directories to add to pkg-config's search path"

config PK_XINERAMAPROTO_CFLAGS
	string "CFLAGS: C compiler flags"

config PK_XINERAMAPROTO_LDFLAGS
	string "LDFLAGS: Linker flags"

config PK_XINERAMAPROTO_CXXFLAGS
	string "CXXFLAGS: C++ compiler flags"

config PK_XINERAMAPROTO_ASFLAGS
	string "CCASFLAGS: assembler compiler flags (defaults to CFLAGS)"

config PK_XINERAMAPROTO_BUILDARCH
	default "x86_64-unknown-linux-gnu"
	string "--host options on configure for Architecture"

endif # PK_XINERAMAPROTO
```

## package/xorg-server/Kconfig
```kconfig
menuconfig PK_XORG_SERVER
	select PK_XINERAMAPROTO
	select PK_XCMISCPROTO
	select PK_VIDEOPROTO
	select PK_PRESENTPROTO
	select PK_XF86DRIPROTO
	select PK_RESOURCEPROTO
	select PK_SCRNSAVERPROTO
	select PK_RECORDPROTO
	select PK_COMPOSITEPROTO
	select PK_RANDRPROTO
	select PK_BIGREQSPROTO
	select PK_LIBPCIACCESS
	select PK_LIBXDMCP
	select PK_DRI3PROTO
	select PK_XEXTPROTO
	select PK_RENDERPROTO
	select PK_OPENSSL
	select PK_MESA
	select PK_PIXMAN
	bool "xorg-server"

if PK_XORG_SERVER

config PK_XORG_SERVER_VERSION
	default "1.19.3"
	string "verstion"

config PK_XORG_SERVER_TAR
	default "tar.gz"
	string "tar type"

config PK_XORG_SERVER_URL
	default "https://www.x.org/releases/individual/xserver/"
	string "url"

config PK_XORG_SERVER_GITHUB
	string "GitHub"

config PK_XORG_SERVER_SRCFILE
	string "Source code list"

config PK_XORG_SERVER_CONFIG
	default "--with-fop=no --with-pic --disable-static --disable-dmx --disable-xnest --enable-xvfb --enable-composite --without-dtrace --enable-dri --enable-dri2 --enable-dri3 --disable-glamor --enable-glx --disable-libunwind --without-xmlto --enable-xshmfence --disable-xwayland"
	string "CONFIG: Project Configure Options"

config PK_XORG_SERVER_LIBPATH
	string "LIBS: Libraries to pass to the linker, e.g. -l<library>"

config PK_XORG_SERVER_CPPFLAGS
	string "CPPFLAGS: C/C++ preprocessor flags, e.g. -I<include dir>"

config PK_XORG_SERVER_DPKCONFIG
	string "PKG_CONFIG_PATH: Directories to add to pkg-config's search path"

config PK_XORG_SERVER_CFLAGS
	string "CFLAGS: C compiler flags"

config PK_XORG_SERVER_LDFLAGS
	string "LDFLAGS: Linker flags"

config PK_XORG_SERVER_CXXFLAGS
	string "CXXFLAGS: C++ compiler flags"

config PK_XORG_SERVER_ASFLAGS
	string "CCASFLAGS: assembler compiler flags (defaults to CFLAGS)"

config PK_XORG_SERVER_BUILDARCH
	default "x86_64-unknown-linux-gnu"
	string "--host options on configure for Architecture"

endif # PK_XORG_SERVER
```

## package/xproto/Kconfig
```kconfig
menuconfig PK_XPROTO
	bool "xproto"

if PK_XPROTO

config PK_XPROTO_VERSION
	default "7.0.31"
	string "verstion"

config PK_XPROTO_TAR
	default "tar.gz"
	string "tar type"

config PK_XPROTO_URL
	default "https://www.x.org/releases/individual/proto/"
	string "url"

config PK_XPROTO_GITHUB
	string "GitHub"

config PK_XPROTO_SRCFILE
	string "Source code list"

config PK_XPROTO_CONFIG
	default "--enable-silent-rules --disable-static"
	string "CONFIG: Project Configure Options"

config PK_XPROTO_LIBPATH
	string "LIBS: Libraries to pass to the linker, e.g. -l<library>"

config PK_XPROTO_CPPFLAGS
	string "CPPFLAGS: C/C++ preprocessor flags, e.g. -I<include dir>"

config PK_XPROTO_DPKCONFIG
	string "PKG_CONFIG_PATH: Directories to add to pkg-config's search path"

config PK_XPROTO_CFLAGS
	string "CFLAGS: C compiler flags"

config PK_XPROTO_LDFLAGS
	string "LDFLAGS: Linker flags"

config PK_XPROTO_CXXFLAGS
	string "CXXFLAGS: C++ compiler flags"

config PK_XPROTO_ASFLAGS
	string "CCASFLAGS: assembler compiler flags (defaults to CFLAGS)"

config PK_XPROTO_BUILDARCH
	default "x86_64-unknown-linux-gnu"
	string "--host options on configure for Architecture"

endif # PK_XPROTO
```

## package/xtrans/Kconfig
```kconfig
menuconfig PK_XTRANS
	bool "xtrans"

if PK_XTRANS

config PK_XTRANS_VERSION
	default "1.3.5"
	string "verstion"

config PK_XTRANS_TAR
	default "tar.gz"
	string "tar type"

config PK_XTRANS_URL
	default "https://www.x.org/releases/individual/lib/"
	string "url"

config PK_XTRANS_GITHUB
	string "GitHub"

config PK_XTRANS_SRCFILE
	string "Source code list"

config PK_XTRANS_CONFIG
	default "--enable-silent-rules --disable-static"
	string "CONFIG: Project Configure Options"

config PK_XTRANS_LIBPATH
	string "LIBS: Libraries to pass to the linker, e.g. -l<library>"

config PK_XTRANS_CPPFLAGS
	string "CPPFLAGS: C/C++ preprocessor flags, e.g. -I<include dir>"

config PK_XTRANS_DPKCONFIG
	string "PKG_CONFIG_PATH: Directories to add to pkg-config's search path"

config PK_XTRANS_CFLAGS
	string "CFLAGS: C compiler flags"

config PK_XTRANS_LDFLAGS
	string "LDFLAGS: Linker flags"

config PK_XTRANS_CXXFLAGS
	string "CXXFLAGS: C++ compiler flags"

config PK_XTRANS_ASFLAGS
	string "CCASFLAGS: assembler compiler flags (defaults to CFLAGS)"

config PK_XTRANS_BUILDARCH
	default "x86_64-unknown-linux-gnu"
	string "--host options on configure for Architecture"

endif # PK_XTRANS
```

## package/zlib/Kconfig
```kconfig
menuconfig PK_ZLIB
	bool "zlib"

if PK_ZLIB

config PK_ZLIB_VERSION
	default "1.2.11"
	string "verstion"

config PK_ZLIB_TAR
	default "tar.gz"
	string "tar type"

config PK_ZLIB_URL
	default "https://www.zlib.net/fossils/"
	string "url"

config PK_ZLIB_GITHUB
	string "GitHub"

config PK_ZLIB_SRCFILE
	string "Source code list"

config PK_ZLIB_CONFIG
	default "--shared"
	string "CONFIG: Project Configure Options"

config PK_ZLIB_LIBPATH
	string "LIBS: Libraries to pass to the linker, e.g. -l<library>"

config PK_ZLIB_CPPFLAGS
	string "CPPFLAGS: C/C++ preprocessor flags, e.g. -I<include dir>"

config PK_ZLIB_DPKCONFIG
	string "PKG_CONFIG_PATH: Directories to add to pkg-config's search path"

config PK_ZLIB_CFLAGS
	string "CFLAGS: C compiler flags"

config PK_ZLIB_LDFLAGS
	string "LDFLAGS: Linker flags"

config PK_ZLIB_CXXFLAGS
	string "CXXFLAGS: C++ compiler flags"

config PK_ZLIB_ASFLAGS
	string "CCASFLAGS: assembler compiler flags (defaults to CFLAGS)"

config PK_ZLIB_BUILDARCH
	default "x86_64-unknown-linux-gnu"
	string "--host options on configure for Architecture"

endif # PK_ZLIB
```

## package/zsmalloc/BiscuitOS-zsmalloc-kernel/Kconfig
```kconfig
menuconfig PK_ZSMALLOC_KERNEL
	bool "Zsmalloc base usage on kernel"

if PK_ZSMALLOC_KERNEL

config PK_ZSMALLOC_KERNEL_VERSION
	default "default"
	string "verstion"

config PK_ZSMALLOC_KERNEL_TAR
	default "tar.gz"
	string "tar type"

config PK_ZSMALLOC_KERNEL_URL
	default "https://gitee.com/BiscuitOS_team/HardStack/raw/Gitee/Memory-Allocator/zsmalloc/BiscuitOS-zsmalloc-kernel"
	string "url"

config PK_ZSMALLOC_KERNEL_GITHUB
	string "GitHub"

config PK_ZSMALLOC_KERNEL_SRCFILE
	default "main.c Kconfig Makefile"
	string "Source code list"

config PK_ZSMALLOC_KERNEL_CSRCFILE
	string "Compile source code list"

config PK_ZSMALLOC_KERNEL_CONFIG
	string "CONFIG: Project Configure Options"

config PK_ZSMALLOC_KERNEL_LIBPATH
	string "LIBS: Libraries to pass to the linker, e.g. -l<library>"

config PK_ZSMALLOC_KERNEL_CPPFLAGS
	string "CPPFLAGS: C/C++ preprocessor flags, e.g. -I<include dir>"

config PK_ZSMALLOC_KERNEL_DPKCONFIG
	string "PKG_CONFIG_PATH: Directories to add to pkg-config's search path"

config PK_ZSMALLOC_KERNEL_CFLAGS
	string "CFLAGS: C compiler flags"

config PK_ZSMALLOC_KERNEL_LDFLAGS
	string "LDFLAGS: Linker flags"

config PK_ZSMALLOC_KERNEL_CXXFLAGS
	string "CXXFLAGS: C++ compiler flags"

config PK_ZSMALLOC_KERNEL_ASFLAGS
	string "CCASFLAGS: assembler compiler flags (defaults to CFLAGS)"

config PK_ZSMALLOC_KERNEL_BUILDARCH
	string "--host options on configure for Architecture"

endif # PK_ZSMALLOC_KERNEL
```

## package/zsmalloc/Kconfig
```kconfig
menuconfig PK_ZSMALLOC
	bool "Zsmalloc Memory Allocator"

if PK_ZSMALLOC

# ZSMALLOC Use on kernel
source package/zsmalloc/BiscuitOS-zsmalloc-kernel/Kconfig

endif # PK_ZSMALLOC
```
