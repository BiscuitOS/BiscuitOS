## package/vmalloc/Kconfig
```kconfig
menuconfig PK_VMALLOC
	bool "Vmalloc Memory Allocator"

if PK_VMALLOC

# vfree
source package/vmalloc/vfree/Kconfig

# vmalloc
source package/vmalloc/vmalloc/Kconfig

# vmalloc_to_page
source package/vmalloc/vmalloc_to_page/Kconfig

# vmalloc_to_pfn
source package/vmalloc/vmalloc_to_pfn/Kconfig

# vmalloc on userspace
source package/vmalloc/vmalloc_userspace/Kconfig

endif # PK_VMALLOC
```

## package/vmalloc/vfree/Kconfig
```kconfig
menuconfig PK_VFREE
	bool "vfree()"

if PK_VFREE

config PK_VFREE_VERSION
	default "0.0.1"
	string "verstion"

config PK_VFREE_TAR
	default "tar.gz"
	string "tar type"

config PK_VFREE_URL
	default "https://gitee.com/BiscuitOS_team/HardStack/raw/Gitee/Memory-Allocator/vmalloc/vfree"
	string "url"

config PK_VFREE_GITHUB
	string "GitHub"

config PK_VFREE_SRCFILE
	default "core.c Makefile Kconfig"
	string "Source code list"

config PK_VFREE_CSRCFILE
	string "Compile source code list"

config PK_VFREE_CONFIG
	string "CONFIG: Project Configure Options"

config PK_VFREE_LIBPATH
	string "LIBS: Libraries to pass to the linker, e.g. -l<library>"

config PK_VFREE_CPPFLAGS
	string "CPPFLAGS: C/C++ preprocessor flags, e.g. -I<include dir>"

config PK_VFREE_DPKCONFIG
	string "PKG_CONFIG_PATH: Directories to add to pkg-config's search path"

config PK_VFREE_CFLAGS
	string "CFLAGS: C compiler flags"

config PK_VFREE_LDFLAGS
	string "LDFLAGS: Linker flags"

config PK_VFREE_CXXFLAGS
	string "CXXFLAGS: C++ compiler flags"

config PK_VFREE_ASFLAGS
	string "CCASFLAGS: assembler compiler flags (defaults to CFLAGS)"

config PK_VFREE_BUILDARCH
	string "--host options on configure for Architecture"

endif # PK_VFREE
```

## package/vmalloc/vmalloc/Kconfig
```kconfig
menuconfig PK_VMALLOC_F
	bool "vmalloc()"

if PK_VMALLOC_F

config PK_VMALLOC_F_VERSION
	default "0.0.1"
	string "verstion"

config PK_VMALLOC_F_TAR
	default "tar.gz"
	string "tar type"

config PK_VMALLOC_F_URL
	default "https://gitee.com/BiscuitOS_team/HardStack/raw/Gitee/Memory-Allocator/vmalloc/vmalloc"
	string "url"

config PK_VMALLOC_F_GITHUB
	string "GitHub"

config PK_VMALLOC_F_SRCFILE
	default "core.c Makefile Kconfig"
	string "Source code list"

config PK_VMALLOC_F_CSRCFILE
	string "Compile source code list"

config PK_VMALLOC_F_CONFIG
	string "CONFIG: Project Configure Options"

config PK_VMALLOC_F_LIBPATH
	string "LIBS: Libraries to pass to the linker, e.g. -l<library>"

config PK_VMALLOC_F_CPPFLAGS
	string "CPPFLAGS: C/C++ preprocessor flags, e.g. -I<include dir>"

config PK_VMALLOC_F_DPKCONFIG
	string "PKG_CONFIG_PATH: Directories to add to pkg-config's search path"

config PK_VMALLOC_F_CFLAGS
	string "CFLAGS: C compiler flags"

config PK_VMALLOC_F_LDFLAGS
	string "LDFLAGS: Linker flags"

config PK_VMALLOC_F_CXXFLAGS
	string "CXXFLAGS: C++ compiler flags"

config PK_VMALLOC_F_ASFLAGS
	string "CCASFLAGS: assembler compiler flags (defaults to CFLAGS)"

config PK_VMALLOC_F_BUILDARCH
	string "--host options on configure for Architecture"

endif # PK_VMALLOC_F
```

## package/vmalloc/vmalloc_to_page/Kconfig
```kconfig
menuconfig PK_VMALLOC_TO_PAGE
	bool "vmalloc_to_page()"

if PK_VMALLOC_TO_PAGE

config PK_VMALLOC_TO_PAGE_VERSION
	default "0.0.1"
	string "verstion"

config PK_VMALLOC_TO_PAGE_TAR
	default "tar.gz"
	string "tar type"

config PK_VMALLOC_TO_PAGE_URL
	default "https://gitee.com/BiscuitOS_team/HardStack/raw/Gitee/Memory-Allocator/vmalloc/vmalloc_to_page"
	string "url"

config PK_VMALLOC_TO_PAGE_GITHUB
	string "GitHub"

config PK_VMALLOC_TO_PAGE_SRCFILE
	default "core.c Makefile Kconfig"
	string "Source code list"

config PK_VMALLOC_TO_PAGE_CSRCFILE
	string "Compile source code list"

config PK_VMALLOC_TO_PAGE_CONFIG
	string "CONFIG: Project Configure Options"

config PK_VMALLOC_TO_PAGE_LIBPATH
	string "LIBS: Libraries to pass to the linker, e.g. -l<library>"

config PK_VMALLOC_TO_PAGE_CPPFLAGS
	string "CPPFLAGS: C/C++ preprocessor flags, e.g. -I<include dir>"

config PK_VMALLOC_TO_PAGE_DPKCONFIG
	string "PKG_CONFIG_PATH: Directories to add to pkg-config's search path"

config PK_VMALLOC_TO_PAGE_CFLAGS
	string "CFLAGS: C compiler flags"

config PK_VMALLOC_TO_PAGE_LDFLAGS
	string "LDFLAGS: Linker flags"

config PK_VMALLOC_TO_PAGE_CXXFLAGS
	string "CXXFLAGS: C++ compiler flags"

config PK_VMALLOC_TO_PAGE_ASFLAGS
	string "CCASFLAGS: assembler compiler flags (defaults to CFLAGS)"

config PK_VMALLOC_TO_PAGE_BUILDARCH
	string "--host options on configure for Architecture"

endif # PK_VMALLOC_TO_PAGE
```

## package/vmalloc/vmalloc_to_pfn/Kconfig
```kconfig
menuconfig PK_VMALLOC_TO_PFN
	bool "vmalloc_to_pfn()"

if PK_VMALLOC_TO_PFN

config PK_VMALLOC_TO_PFN_VERSION
	default "0.0.1"
	string "verstion"

config PK_VMALLOC_TO_PFN_TAR
	default "tar.gz"
	string "tar type"

config PK_VMALLOC_TO_PFN_URL
	default "https://gitee.com/BiscuitOS_team/HardStack/raw/Gitee/Memory-Allocator/vmalloc/vmalloc_to_pfn"
	string "url"

config PK_VMALLOC_TO_PFN_GITHUB
	string "GitHub"

config PK_VMALLOC_TO_PFN_SRCFILE
	default "core.c Makefile Kconfig"
	string "Source code list"

config PK_VMALLOC_TO_PFN_CSRCFILE
	string "Compile source code list"

config PK_VMALLOC_TO_PFN_CONFIG
	string "CONFIG: Project Configure Options"

config PK_VMALLOC_TO_PFN_LIBPATH
	string "LIBS: Libraries to pass to the linker, e.g. -l<library>"

config PK_VMALLOC_TO_PFN_CPPFLAGS
	string "CPPFLAGS: C/C++ preprocessor flags, e.g. -I<include dir>"

config PK_VMALLOC_TO_PFN_DPKCONFIG
	string "PKG_CONFIG_PATH: Directories to add to pkg-config's search path"

config PK_VMALLOC_TO_PFN_CFLAGS
	string "CFLAGS: C compiler flags"

config PK_VMALLOC_TO_PFN_LDFLAGS
	string "LDFLAGS: Linker flags"

config PK_VMALLOC_TO_PFN_CXXFLAGS
	string "CXXFLAGS: C++ compiler flags"

config PK_VMALLOC_TO_PFN_ASFLAGS
	string "CCASFLAGS: assembler compiler flags (defaults to CFLAGS)"

config PK_VMALLOC_TO_PFN_BUILDARCH
	string "--host options on configure for Architecture"

endif # PK_VMALLOC_TO_PFN
```

## package/vmalloc/vmalloc_userspace/Kconfig
```kconfig
menuconfig PK_VMALLOC_USERSPACE
	bool "VMALLOC Allocator on Userspace"

if PK_VMALLOC_USERSPACE

config PK_VMALLOC_USERSPACE_VERSION
	default "0.0.1"
	string "verstion"

config PK_VMALLOC_USERSPACE_TAR
	default "tar.gz"
	string "tar type"

config PK_VMALLOC_USERSPACE_URL
	default "https://gitee.com/BiscuitOS_team/HardStack/raw/Gitee/Memory-Allocator/vmalloc/vmalloc_userspace"
	string "url"

config PK_VMALLOC_USERSPACE_GITHUB
	string "GitHub"

config PK_VMALLOC_USERSPACE_SRCFILE
	default "main.c include/linux/buddy.h include/linux/list.h include/linux/bitmap.h include/linux/getorder.h include/linux/biscuitos.h mm/kasprintf.c README.md include/linux/gfp.h include/linux/slub.h mm/buddy.c mm/rbtree.c mm/vmalloc.c include/linux/rbtree.h include/linux/vmalloc.h Makefile mm/slub.c"
	string "Source code list"

config PK_VMALLOC_USERSPACE_CSRCFILE
	string "Compile source code list"

config PK_VMALLOC_USERSPACE_CONFIG
	string "CONFIG: Project Configure Options"

config PK_VMALLOC_USERSPACE_LIBPATH
	string "LIBS: Libraries to pass to the linker, e.g. -l<library>"

config PK_VMALLOC_USERSPACE_CPPFLAGS
	string "CPPFLAGS: C/C++ preprocessor flags, e.g. -I<include dir>"

config PK_VMALLOC_USERSPACE_DPKCONFIG
	string "PKG_CONFIG_PATH: Directories to add to pkg-config's search path"

config PK_VMALLOC_USERSPACE_CFLAGS
	string "CFLAGS: C compiler flags"

config PK_VMALLOC_USERSPACE_LDFLAGS
	string "LDFLAGS: Linker flags"

config PK_VMALLOC_USERSPACE_CXXFLAGS
	string "CXXFLAGS: C++ compiler flags"

config PK_VMALLOC_USERSPACE_ASFLAGS
	string "CCASFLAGS: assembler compiler flags (defaults to CFLAGS)"

config PK_VMALLOC_USERSPACE_BUILDARCH
	string "--host options on configure for Architecture"

endif # PK_VMALLOC_USERSPACE
```

## package/workqueue/Kconfig
```kconfig
menuconfig PK_WQ
	bool "Workqueue: Device Driver and Application"

if PK_WQ

# Work Queue Device Driver module
source package/workqueue/workqueue_module/Kconfig

endif # PK_WQ
```

## package/workqueue/workqueue_module/Kconfig
```kconfig
menuconfig PK_WQ_MOD
	bool "Work Queue Device Driver Module"

if PK_WQ_MOD

config PK_WQ_MOD_VERSION
	default "0.0.1"
	string "verstion"

config PK_WQ_MOD_TAR
	default "tar.gz"
	string "tar type"

config PK_WQ_MOD_URL
	default "https://gitee.com/BiscuitOS_team/HardStack/raw/Gitee/Device-Driver/workqueue/base/kernel"
	string "url"

config PK_WQ_MOD_GITHUB
	string "GitHub"

config PK_WQ_MOD_SRCFILE
	default "work.c Kconfig Makefile"
	string "Source code list"

config PK_WQ_MOD_CSRCFILE
	string "Compile source code list"

config PK_WQ_MOD_CONFIG
	string "CONFIG: Project Configure Options"

config PK_WQ_MOD_LIBPATH
	string "LIBS: Libraries to pass to the linker, e.g. -l<library>"

config PK_WQ_MOD_CPPFLAGS
	string "CPPFLAGS: C/C++ preprocessor flags, e.g. -I<include dir>"

config PK_WQ_MOD_DPKCONFIG
	string "PKG_CONFIG_PATH: Directories to add to pkg-config's search path"

config PK_WQ_MOD_CFLAGS
	string "CFLAGS: C compiler flags"

config PK_WQ_MOD_LDFLAGS
	string "LDFLAGS: Linker flags"

config PK_WQ_MOD_CXXFLAGS
	string "CXXFLAGS: C++ compiler flags"

config PK_WQ_MOD_ASFLAGS
	string "CCASFLAGS: assembler compiler flags (defaults to CFLAGS)"

config PK_WQ_MOD_BUILDARCH
	string "--host options on configure for Architecture"

endif # PK_WQ_MOD
```

## package/xarray/Kconfig
```kconfig
menuconfig PK_XARRAY
	bool "xarray"

if PK_XARRAY

# xarray base
source "package/xarray/xarray_base/Kconfig"

# xa_init_flags
source "package/xarray/xa_init_flags/Kconfig"

endif # PK_XARRAY
```

## package/xarray/xa_init_flags/Kconfig
```kconfig
menuconfig PK_XA_INIT_FLAGS
	bool "xa_init_flags"

if PK_XA_INIT_FLAGS

config PK_XA_INIT_FLAGS_VERSION
	default "default"
	string "verstion"

config PK_XA_INIT_FLAGS_TAR
	default "tar.gz"
	string "tar type"

config PK_XA_INIT_FLAGS_URL
	default "https://gitee.com/BiscuitOS_team/HardStack/raw/Gitee/Algorithem/xarray/API/xa_init_flags"
	string "url"

config PK_XA_INIT_FLAGS_GITHUB
	string "GitHub"

config PK_XA_INIT_FLAGS_SRCFILE
	default "main.c Kconfig Makefile"
	string "Source code list"

config PK_XA_INIT_FLAGS_CSRCFILE
	string "Compile source code list"

config PK_XA_INIT_FLAGS_CONFIG
	string "CONFIG: Project Configure Options"

config PK_XA_INIT_FLAGS_LIBPATH
	string "LIBS: Libraries to pass to the linker, e.g. -l<library>"

config PK_XA_INIT_FLAGS_CPPFLAGS
	string "CPPFLAGS: C/C++ preprocessor flags, e.g. -I<include dir>"

config PK_XA_INIT_FLAGS_DPKCONFIG
	string "PKG_CONFIG_PATH: Directories to add to pkg-config's search path"

config PK_XA_INIT_FLAGS_CFLAGS
	string "CFLAGS: C compiler flags"

config PK_XA_INIT_FLAGS_LDFLAGS
	string "LDFLAGS: Linker flags"

config PK_XA_INIT_FLAGS_CXXFLAGS
	string "CXXFLAGS: C++ compiler flags"

config PK_XA_INIT_FLAGS_ASFLAGS
	string "CCASFLAGS: assembler compiler flags (defaults to CFLAGS)"

config PK_XA_INIT_FLAGS_BUILDARCH
	string "--host options on configure for Architecture"

endif # PK_XA_INIT_FLAGS
```

## package/xarray/xarray_base/Kconfig
```kconfig
menuconfig PK_XARRAY_BASE
	bool "xarray base"

if PK_XARRAY_BASE

config PK_XARRAY_BASE_VERSION
	default "0.0.1"
	string "verstion"

config PK_XARRAY_BASE_TAR
	default "tar.gz"
	string "tar type"

config PK_XARRAY_BASE_URL
	default "https://gitee.com/BiscuitOS_team/HardStack/raw/Gitee/Algorithem/xarray/API/xarray_base"
	string "url"

config PK_XARRAY_BASE_GITHUB
	string "GitHub"

config PK_XARRAY_BASE_SRCFILE
	default "core.c Kconfig Makefile"
	string "Source code list"

config PK_XARRAY_BASE_CSRCFILE
	string "Compile source code list"

config PK_XARRAY_BASE_CONFIG
	string "CONFIG: Project Configure Options"

config PK_XARRAY_BASE_LIBPATH
	string "LIBS: Libraries to pass to the linker, e.g. -l<library>"

config PK_XARRAY_BASE_CPPFLAGS
	string "CPPFLAGS: C/C++ preprocessor flags, e.g. -I<include dir>"

config PK_XARRAY_BASE_DPKCONFIG
	string "PKG_CONFIG_PATH: Directories to add to pkg-config's search path"

config PK_XARRAY_BASE_CFLAGS
	string "CFLAGS: C compiler flags"

config PK_XARRAY_BASE_LDFLAGS
	string "LDFLAGS: Linker flags"

config PK_XARRAY_BASE_CXXFLAGS
	string "CXXFLAGS: C++ compiler flags"

config PK_XARRAY_BASE_ASFLAGS
	string "CCASFLAGS: assembler compiler flags (defaults to CFLAGS)"

config PK_XARRAY_BASE_BUILDARCH
	string "--host options on configure for Architecture"

endif # PK_XARRAY_BASE
```

## package/xcb-proto/Kconfig
```kconfig
menuconfig PK_XCB_PROTO
	bool "xcb-proto"

if PK_XCB_PROTO

config PK_XCB_PROTO_VERSION
	default "1.12"
	string "verstion"

config PK_XCB_PROTO_TAR
	default "tar.gz"
	string "tar type"

config PK_XCB_PROTO_URL
	default "https://www.x.org/releases/individual/xcb/"
	string "url"

config PK_XCB_PROTO_GITHUB
	string "GitHub"

config PK_XCB_PROTO_SRCFILE
	string "Source code list"

config PK_XCB_PROTO_CONFIG
	default "--enable-silent-rules --disable-static"
	string "CONFIG: Project Configure Options"

config PK_XCB_PROTO_LIBPATH
	string "LIBS: Libraries to pass to the linker, e.g. -l<library>"

config PK_XCB_PROTO_CPPFLAGS
	string "CPPFLAGS: C/C++ preprocessor flags, e.g. -I<include dir>"

config PK_XCB_PROTO_DPKCONFIG
	string "PKG_CONFIG_PATH: Directories to add to pkg-config's search path"

config PK_XCB_PROTO_CFLAGS
	string "CFLAGS: C compiler flags"

config PK_XCB_PROTO_LDFLAGS
	string "LDFLAGS: Linker flags"

config PK_XCB_PROTO_CXXFLAGS
	string "CXXFLAGS: C++ compiler flags"

config PK_XCB_PROTO_ASFLAGS
	string "CCASFLAGS: assembler compiler flags (defaults to CFLAGS)"

config PK_XCB_PROTO_BUILDARCH
	default "x86_64-unknown-linux-gnu"
	string "--host options on configure for Architecture"

endif # PK_XCB_PROTO
```

## package/xcmiscproto/Kconfig
```kconfig
menuconfig PK_XCMISCPROTO
	bool "xcmiscproto"

if PK_XCMISCPROTO

config PK_XCMISCPROTO_VERSION
	default "1.2.2"
	string "verstion"

config PK_XCMISCPROTO_TAR
	default "tar.gz"
	string "tar type"

config PK_XCMISCPROTO_URL
	default "https://www.x.org/releases/individual/proto/"
	string "url"

config PK_XCMISCPROTO_GITHUB
	string "GitHub"

config PK_XCMISCPROTO_SRCFILE
	string "Source code list"

config PK_XCMISCPROTO_CONFIG
	default "--enable-silent-rules --disable-static"
	string "CONFIG: Project Configure Options"

config PK_XCMISCPROTO_LIBPATH
	string "LIBS: Libraries to pass to the linker, e.g. -l<library>"

config PK_XCMISCPROTO_CPPFLAGS
	string "CPPFLAGS: C/C++ preprocessor flags, e.g. -I<include dir>"

config PK_XCMISCPROTO_DPKCONFIG
	string "PKG_CONFIG_PATH: Directories to add to pkg-config's search path"

config PK_XCMISCPROTO_CFLAGS
	string "CFLAGS: C compiler flags"

config PK_XCMISCPROTO_LDFLAGS
	string "LDFLAGS: Linker flags"

config PK_XCMISCPROTO_CXXFLAGS
	string "CXXFLAGS: C++ compiler flags"

config PK_XCMISCPROTO_ASFLAGS
	string "CCASFLAGS: assembler compiler flags (defaults to CFLAGS)"

config PK_XCMISCPROTO_BUILDARCH
	default "x86_64-unknown-linux-gnu"
	string "--host options on configure for Architecture"

endif # PK_XCMISCPROTO
```
