## package/crash/BiscuitOS-crash-vtop-pid-user-address/Kconfig
```kconfig
menuconfig PK_CRASH_VTOP_U_PID
	bool "Example: vtop translate user address with PID"

if PK_CRASH_VTOP_U_PID

config PK_CRASH_VTOP_U_PID_VERSION
	default "default"
	string "verstion"

config PK_CRASH_VTOP_U_PID_TAR
	default "tar.gz"
	string "tar type"

config PK_CRASH_VTOP_U_PID_URL
	default "https://gitee.com/BiscuitOS_team/HardStack/raw/Gitee/Tools/Crash/BiscuitOS-crash-vtop-pid-user-address"
	string "url"

config PK_CRASH_VTOP_U_PID_GITHUB
	string "GitHub"

config PK_CRASH_VTOP_U_PID_SRCFILE
	default "main.c Makefile"
	string "Source code list"

config PK_CRASH_VTOP_U_PID_CSRCFILE
	string "Compile source code list"

config PK_CRASH_VTOP_U_PID_CONFIG
	string "CONFIG: Project Configure Options"

config PK_CRASH_VTOP_U_PID_LIBPATH
	string "LIBS: Libraries to pass to the linker, e.g. -l<library>"

config PK_CRASH_VTOP_U_PID_CPPFLAGS
	string "CPPFLAGS: C/C++ preprocessor flags, e.g. -I<include dir>"

config PK_CRASH_VTOP_U_PID_DPKCONFIG
	string "PKG_CONFIG_PATH: Directories to add to pkg-config's search path"

config PK_CRASH_VTOP_U_PID_CFLAGS
	string "CFLAGS: C compiler flags"

config PK_CRASH_VTOP_U_PID_LDFLAGS
	string "LDFLAGS: Linker flags"

config PK_CRASH_VTOP_U_PID_CXXFLAGS
	string "CXXFLAGS: C++ compiler flags"

config PK_CRASH_VTOP_U_PID_ASFLAGS
	string "CCASFLAGS: assembler compiler flags (defaults to CFLAGS)"

config PK_CRASH_VTOP_U_PID_BUILDARCH
	string "--host options on configure for Architecture"

endif # PK_CRASH_VTOP_U_PID
```

## package/crash/BiscuitOS-crash-vtop-user-address/Kconfig
```kconfig
menuconfig PK_CRASH_VTOP_U
	bool "Example: vtop translate user address"

if PK_CRASH_VTOP_U

config PK_CRASH_VTOP_U_VERSION
	default "default"
	string "verstion"

config PK_CRASH_VTOP_U_TAR
	default "tar.gz"
	string "tar type"

config PK_CRASH_VTOP_U_URL
	default "https://gitee.com/BiscuitOS_team/HardStack/raw/Gitee/Tools/Crash/BiscuitOS-crash-vtop-user-address"
	string "url"

config PK_CRASH_VTOP_U_GITHUB
	string "GitHub"

config PK_CRASH_VTOP_U_SRCFILE
	default "main.c Makefile"
	string "Source code list"

config PK_CRASH_VTOP_U_CSRCFILE
	string "Compile source code list"

config PK_CRASH_VTOP_U_CONFIG
	string "CONFIG: Project Configure Options"

config PK_CRASH_VTOP_U_LIBPATH
	string "LIBS: Libraries to pass to the linker, e.g. -l<library>"

config PK_CRASH_VTOP_U_CPPFLAGS
	string "CPPFLAGS: C/C++ preprocessor flags, e.g. -I<include dir>"

config PK_CRASH_VTOP_U_DPKCONFIG
	string "PKG_CONFIG_PATH: Directories to add to pkg-config's search path"

config PK_CRASH_VTOP_U_CFLAGS
	string "CFLAGS: C compiler flags"

config PK_CRASH_VTOP_U_LDFLAGS
	string "LDFLAGS: Linker flags"

config PK_CRASH_VTOP_U_CXXFLAGS
	string "CXXFLAGS: C++ compiler flags"

config PK_CRASH_VTOP_U_ASFLAGS
	string "CCASFLAGS: assembler compiler flags (defaults to CFLAGS)"

config PK_CRASH_VTOP_U_BUILDARCH
	string "--host options on configure for Architecture"

endif # PK_CRASH_VTOP_U
```

## package/crash/Kconfig
```kconfig
menuconfig PK_CRASH
	bool "CRASH and BUG Example"

if PK_CRASH

# CRASH
source package/crash/crash/Kconfig

# CRASH: Function arguments
source package/crash/BiscuitOS-crash-register-with-func-argument/Kconfig

# CRASH: btop
source package/crash/BiscuitOS-crash-btop/Kconfig

# CRASH: list
source package/crash/BiscuitOS-crash-list-common/Kconfig

# CRASH: module
source package/crash/BiscuitOS-crash-module-common/Kconfig

# CRASH: ptob
source package/crash/BiscuitOS-crash-ptob/Kconfig

# CRASH: ptov
source package/crash/BiscuitOS-crash-ptov/Kconfig

# CRASH: vtop user address
source package/crash/BiscuitOS-crash-vtop-user-address/Kconfig

# CRASH: vtop kernel address
source package/crash/BiscuitOS-crash-vtop-kernel-address/Kconfig

# CRASH: vtop user address with pid
source package/crash/BiscuitOS-crash-vtop-pid-user-address/Kconfig

endif # PK_CRASH
```

## package/crash/crash/Kconfig
```kconfig
menuconfig PK_CRASH_TOOLS
	bool "crash tools"

if PK_CRASH_TOOLS

config PK_CRASH_TOOLS_VERSION
	default "default"
	string "verstion"

config PK_CRASH_TOOLS_TAR
	default "tar.xz"
	string "tar type"

config PK_CRASH_TOOLS_URL
	default ""
	string "url"

config PK_CRASH_TOOLS_GITHUB
	default "https://gitee.com/mirrors/crash.git"
	string "GitHub"

config PK_CRASH_TOOLS_SRCFILE
	string "Source code list"

config PK_CRASH_TOOLS_CONFIG
	default "--enable-silent-rules"
	string "CONFIG: Project Configure Options"

config PK_CRASH_TOOLS_LIBPATH
	string "LIBS: Libraries to pass to the linker, e.g. -l<library>"

config PK_CRASH_TOOLS_CPPFLAGS
	string "CPPFLAGS: C/C++ preprocessor flags, e.g. -I<include dir>"

config PK_CRASH_TOOLS_DPKCONFIG
	string "PKG_CONFIG_PATH: Directories to add to pkg-config's search path"

config PK_CRASH_TOOLS_CFLAGS
	string "CFLAGS: C compiler flags"

config PK_CRASH_TOOLS_LDFLAGS
	string "LDFLAGS: Linker flags"

config PK_CRASH_TOOLS_CXXFLAGS
	string "CXXFLAGS: C++ compiler flags"

config PK_CRASH_TOOLS_ASFLAGS
	string "CCASFLAGS: assembler compiler flags (defaults to CFLAGS)"

config PK_CRASH_TOOLS_BUILDARCH
	default "x86_64-unknown-linux-gnu"
	string "--host options on configure for Architecture"

endif # PK_CRASH_TOOLS
```

## package/damageproto/Kconfig
```kconfig
menuconfig PK_DAMAGEPROTO
	bool "damageproto"

if PK_DAMAGEPROTO

config PK_DAMAGEPROTO_VERSION
	default "1.2.1"
	string "verstion"

config PK_DAMAGEPROTO_TAR
	default "tar.gz"
	string "tar type"

config PK_DAMAGEPROTO_URL
	default "https://www.x.org/releases/individual/proto/"
	string "url"

config PK_DAMAGEPROTO_GITHUB
	string "GitHub"

config PK_DAMAGEPROTO_SRCFILE
	string "Source code list"

config PK_DAMAGEPROTO_CONFIG
	default "--enable-silent-rules --disable-static"
	string "CONFIG: Project Configure Options"

config PK_DAMAGEPROTO_LIBPATH
	string "LIBS: Libraries to pass to the linker, e.g. -l<library>"

config PK_DAMAGEPROTO_CPPFLAGS
	string "CPPFLAGS: C/C++ preprocessor flags, e.g. -I<include dir>"

config PK_DAMAGEPROTO_DPKCONFIG
	string "PKG_CONFIG_PATH: Directories to add to pkg-config's search path"

config PK_DAMAGEPROTO_CFLAGS
	string "CFLAGS: C compiler flags"

config PK_DAMAGEPROTO_LDFLAGS
	string "LDFLAGS: Linker flags"

config PK_DAMAGEPROTO_CXXFLAGS
	string "CXXFLAGS: C++ compiler flags"

config PK_DAMAGEPROTO_ASFLAGS
	string "CCASFLAGS: assembler compiler flags (defaults to CFLAGS)"

config PK_DAMAGEPROTO_BUILDARCH
	default "x86_64-unknown-linux-gnu"
	string "--host options on configure for Architecture"

endif # PK_DAMAGEPROTO
```

## package/demo/Kconfig
```kconfig
#
# kconfig for demo
#
config PACKAGE_DEMO
	bool "demo utilise"
	help
	  binutilise for demo
```

## package/demo_app/Kconfig
```kconfig
menuconfig PK_DEMO_APP
	bool "Demo  Application"

if PK_DEMO_APP

config DEMO_APP_VERSION
	default "0.11"
	string "verstion"

config DEMO_APP_TAR
	string "tar type"

config DEMO_APP_URL
	default "https://raw.githubusercontent.com/BiscuitOS/HardStack/master/CodeSegment/demo/"
	string "url"

config DEMO_APP_LDFLAGS
	string "LDFLAGS"

config DEMO_APP_CFLAGS
	string "CFLAGS"

config DEMO_APP_CONFIG
	string "configure"

config DEMO_APP_SRC
	default "demo.c"
	string "source code list"

endif # PK_DEMO_APP
```

## package/device-tree/Kconfig
```kconfig
menuconfig PK_DTS
	bool "DTS: Device Tree"

if PK_DTS

# of_address_to_resource
source package/device-tree/of_address_to_resource/Kconfig

endif # PK_DTS
```

## package/device-tree/of_address_to_resource/Kconfig
```kconfig
menuconfig PK_OF_ADDRESS_TO_RES
	bool "of_address_to_resource()"

if PK_OF_ADDRESS_TO_RES

config PK_OF_ADDRESS_TO_RES_VERSION
	default "0.0.1"
	string "verstion"

config PK_OF_ADDRESS_TO_RES_TAR
	default "tar.gz"
	string "tar type"

config PK_OF_ADDRESS_TO_RES_URL
	default "https://gitee.com/BiscuitOS_team/HardStack/raw/Gitee/Device-Tree/kernel/API/of_address_to_resource"
	string "url"

config PK_OF_ADDRESS_TO_RES_GITHUB
	string "GitHub"

config PK_OF_ADDRESS_TO_RES_SRCFILE
	default "dts.c Kconfig Makefile default.dts"
	string "Source code list"

config PK_OF_ADDRESS_TO_RES_CSRCFILE
	string "Compile source code list"

config PK_OF_ADDRESS_TO_RES_CONFIG
	string "CONFIG: Project Configure Options"

config PK_OF_ADDRESS_TO_RES_LIBPATH
	string "LIBS: Libraries to pass to the linker, e.g. -l<library>"

config PK_OF_ADDRESS_TO_RES_CPPFLAGS
	string "CPPFLAGS: C/C++ preprocessor flags, e.g. -I<include dir>"

config PK_OF_ADDRESS_TO_RES_DPKCONFIG
	string "PKG_CONFIG_PATH: Directories to add to pkg-config's search path"

config PK_OF_ADDRESS_TO_RES_CFLAGS
	string "CFLAGS: C compiler flags"

config PK_OF_ADDRESS_TO_RES_LDFLAGS
	string "LDFLAGS: Linker flags"

config PK_OF_ADDRESS_TO_RES_CXXFLAGS
	string "CXXFLAGS: C++ compiler flags"

config PK_OF_ADDRESS_TO_RES_ASFLAGS
	string "CCASFLAGS: assembler compiler flags (defaults to CFLAGS)"

config PK_OF_ADDRESS_TO_RES_BUILDARCH
	string "--host options on configure for Architecture"

endif # PK_OF_ADDRESS_TO_RES
```

## package/dr/Kconfig
```kconfig
menuconfig PK_DR
	bool "dr: Device resource manager"

if PK_DR

# devres_alloc
source package/dr/devres_alloc/Kconfig

# devres_free
source package/dr/devres_free/Kconfig

endif # PK_DR
```

## package/dr/devres_alloc/Kconfig
```kconfig
menuconfig PK_DEVRES_ALLOC
	bool "devres_alloc()"

if PK_DEVRES_ALLOC

config PK_DEVRES_ALLOC_VERSION
	default "0.0.1"
	string "verstion"

config PK_DEVRES_ALLOC_TAR
	default "tar.gz"
	string "tar type"

config PK_DEVRES_ALLOC_URL
	default "https://gitee.com/BiscuitOS_team/HardStack/raw/Gitee/Memory-Allocator/DR/API/devres_alloc"
	string "url"

config PK_DEVRES_ALLOC_GITHUB
	string "GitHub"

config PK_DEVRES_ALLOC_SRCFILE
	default "dr.c Kconfig Makefile"
	string "Source code list"

config PK_DEVRES_ALLOC_CSRCFILE
	string "Compile source code list"

config PK_DEVRES_ALLOC_CONFIG
	string "CONFIG: Project Configure Options"

config PK_DEVRES_ALLOC_LIBPATH
	string "LIBS: Libraries to pass to the linker, e.g. -l<library>"

config PK_DEVRES_ALLOC_CPPFLAGS
	string "CPPFLAGS: C/C++ preprocessor flags, e.g. -I<include dir>"

config PK_DEVRES_ALLOC_DPKCONFIG
	string "PKG_CONFIG_PATH: Directories to add to pkg-config's search path"

config PK_DEVRES_ALLOC_CFLAGS
	string "CFLAGS: C compiler flags"

config PK_DEVRES_ALLOC_LDFLAGS
	string "LDFLAGS: Linker flags"

config PK_DEVRES_ALLOC_CXXFLAGS
	string "CXXFLAGS: C++ compiler flags"

config PK_DEVRES_ALLOC_ASFLAGS
	string "CCASFLAGS: assembler compiler flags (defaults to CFLAGS)"

config PK_DEVRES_ALLOC_BUILDARCH
	string "--host options on configure for Architecture"

endif # PK_DEVRES_ALLOC
```

## package/dr/devres_free/Kconfig
```kconfig
menuconfig PK_DEVRES_FREE
	bool "devres_free()"

if PK_DEVRES_FREE

config PK_DEVRES_FREE_VERSION
	default "0.0.1"
	string "verstion"

config PK_DEVRES_FREE_TAR
	default "tar.gz"
	string "tar type"

config PK_DEVRES_FREE_URL
	default "https://gitee.com/BiscuitOS_team/HardStack/raw/Gitee/Memory-Allocator/DR/API/devres_free"
	string "url"

config PK_DEVRES_FREE_GITHUB
	string "GitHub"

config PK_DEVRES_FREE_SRCFILE
	default "dr.c Kconfig Makefile"
	string "Source code list"

config PK_DEVRES_FREE_CSRCFILE
	string "Compile source code list"

config PK_DEVRES_FREE_CONFIG
	string "CONFIG: Project Configure Options"

config PK_DEVRES_FREE_LIBPATH
	string "LIBS: Libraries to pass to the linker, e.g. -l<library>"

config PK_DEVRES_FREE_CPPFLAGS
	string "CPPFLAGS: C/C++ preprocessor flags, e.g. -I<include dir>"

config PK_DEVRES_FREE_DPKCONFIG
	string "PKG_CONFIG_PATH: Directories to add to pkg-config's search path"

config PK_DEVRES_FREE_CFLAGS
	string "CFLAGS: C compiler flags"

config PK_DEVRES_FREE_LDFLAGS
	string "LDFLAGS: Linker flags"

config PK_DEVRES_FREE_CXXFLAGS
	string "CXXFLAGS: C++ compiler flags"

config PK_DEVRES_FREE_ASFLAGS
	string "CCASFLAGS: assembler compiler flags (defaults to CFLAGS)"

config PK_DEVRES_FREE_BUILDARCH
	string "--host options on configure for Architecture"

endif # PK_DEVRES_FREE
```
