## package/busybox/Kconfig
```kconfig
menuconfig PK_BUSYBOX
	bool "busybox"

if PK_BUSYBOX

choice
	prompt "Source of Busybox source code"

config BUSYBOX_GITHUB
	bool "Busybox source code from github"

config BUSYBOX_DL
	bool "Busybox source code from external file"

config BUSYBOX_WGET
	bool "Busybox source code from wget"

endchoice

if BUSYBOX_DL

config BUSYBOX_DL_NAME
	string "External Busybox absolute path"

endif # BUSYBOX_DL

config BUSYBOX_VERSION
	string "busybox verstion"

config BUSYBOX_SRC
	int 
	default 1 if BUSYBOX_GITHUB
	default 2 if BUSYBOX_DL
	default 3 if BUSYBOX_WGET

endif # PK_BUSYBOX
```

## package/cairo/Kconfig
```kconfig
menuconfig PK_CAIRO
	select PK_LIBPNG
	select PK_LIBXRENDER
	select PK_PIXMAN
	bool "cairo"

if PK_CAIRO

config PK_CAIRO_VERSION
	default "1.14.10"
	string "verstion"

config PK_CAIRO_TAR
	default "tar.xz"
	string "tar type"

config PK_CAIRO_URL
	default "https://cairographics.org/releases/"
	string "url"

config PK_CAIRO_GITHUB
	string "GitHub"

config PK_CAIRO_SRCFILE
	string "Source code list"

config PK_CAIRO_CONFIG
	default "--enable-silent-rules --disable-static --disable-gtk-doc --enable-tee --disable-static --disable-egl --disable-glesv2 --disable-gl --disable-valgrind --with-x=yes --enable-xlib --enable-xlib-xrender=no"
	string "CONFIG: Project Configure Options"

config PK_CAIRO_LIBPATH
	string "LIBS: Libraries to pass to the linker, e.g. -l<library>"

config PK_CAIRO_CPPFLAGS
	string "CPPFLAGS: C/C++ preprocessor flags, e.g. -I<include dir>"

config PK_CAIRO_DPKCONFIG
	string "PKG_CONFIG_PATH: Directories to add to pkg-config's search path"

config PK_CAIRO_CFLAGS
	string "CFLAGS: C compiler flags"

config PK_CAIRO_LDFLAGS
	string "LDFLAGS: Linker flags"

config PK_CAIRO_CXXFLAGS
	string "CXXFLAGS: C++ compiler flags"

config PK_CAIRO_ASFLAGS
	string "CCASFLAGS: assembler compiler flags (defaults to CFLAGS)"

config PK_CAIRO_BUILDARCH
	default "x86_64-unknown-linux-gnu"
	string "--host options on configure for Architecture"

endif # PK_CAIRO
```

## package/char/Kconfig
```kconfig
menuconfig PK_CHAR
	bool "Character Device Driver and Application"

if PK_CHAR

# Character application
source package/char/char_app/Kconfig

# Character Module
source package/char/char_module/Kconfig

endif # PK_CHAR
```

## package/char/char_app/Kconfig
```kconfig
menuconfig PK_CHAR_APP
	select PK_CHAR_MOD
	bool "Character Device Driver Application"

if PK_CHAR_APP

config PK_CHAR_APP_VERSION
	default "0.0.1"
	string "verstion"

config PK_CHAR_APP_TAR
	default "tar.gz"
	string "tar type"

config PK_CHAR_APP_URL
	default "https://gitee.com/BiscuitOS_team/HardStack/raw/Gitee/Device-Driver/char/Base/userland"
	string "url"

config PK_CHAR_APP_GITHUB
	string "GitHub"

config PK_CHAR_APP_SRCFILE
	default "char.c char.sh Makefile"
	string "Source code list"

config PK_CHAR_APP_CSRCFILE
	string "Compile source code list"

config PK_CHAR_APP_CONFIG
	string "CONFIG: Project Configure Options"

config PK_CHAR_APP_LIBPATH
	string "LIBS: Libraries to pass to the linker, e.g. -l<library>"

config PK_CHAR_APP_CPPFLAGS
	string "CPPFLAGS: C/C++ preprocessor flags, e.g. -I<include dir>"

config PK_CHAR_APP_DPKCONFIG
	string "PKG_CONFIG_PATH: Directories to add to pkg-config's search path"

config PK_CHAR_APP_CFLAGS
	string "CFLAGS: C compiler flags"

config PK_CHAR_APP_LDFLAGS
	string "LDFLAGS: Linker flags"

config PK_CHAR_APP_CXXFLAGS
	string "CXXFLAGS: C++ compiler flags"

config PK_CHAR_APP_ASFLAGS
	string "CCASFLAGS: assembler compiler flags (defaults to CFLAGS)"

config PK_CHAR_APP_BUILDARCH
	string "--host options on configure for Architecture"

endif # PK_CHAR_APP
```

## package/cmake/Kconfig
```kconfig
menuconfig PK_CMAKE
	bool "cmake"

if PK_CMAKE

config PK_CMAKE_VERSION
	default "3.16.0"
	string "verstion"

config PK_CMAKE_TAR
	default "tar.gz"
	string "tar type"

config PK_CMAKE_URL
	default "https://cmake.org/files/v3.16/"
	string "url"

config PK_CMAKE_GITHUB
	string "GitHub"

config PK_CMAKE_SRCFILE
	string "Source code list"

config PK_CMAKE_CONFIG
	default ""
	string "CONFIG: Project Configure Options"

config PK_CMAKE_LIBPATH
	string "LIBS: Libraries to pass to the linker, e.g. -l<library>"

config PK_CMAKE_CPPFLAGS
	string "CPPFLAGS: C/C++ preprocessor flags, e.g. -I<include dir>"

config PK_CMAKE_DPKCONFIG
	string "PKG_CONFIG_PATH: Directories to add to pkg-config's search path"

config PK_CMAKE_CFLAGS
	string "CFLAGS: C compiler flags"

config PK_CMAKE_LDFLAGS
	string "LDFLAGS: Linker flags"

config PK_CMAKE_CXXFLAGS
	string "CXXFLAGS: C++ compiler flags"

config PK_CMAKE_ASFLAGS
	string "CCASFLAGS: assembler compiler flags (defaults to CFLAGS)"

config PK_CMAKE_BUILDARCH
	default "x86_64-unknown-linux-gnu"
	string "--host options on configure for Architecture"

endif # PK_CMAKE
```

## package/compositeproto/Kconfig
```kconfig
menuconfig PK_COMPOSITEPROTO
	bool "compositeproto"

if PK_COMPOSITEPROTO

config PK_COMPOSITEPROTO_VERSION
	default "0.4.2"
	string "verstion"

config PK_COMPOSITEPROTO_TAR
	default "tar.gz"
	string "tar type"

config PK_COMPOSITEPROTO_URL
	default "https://www.x.org/releases/individual/proto/"
	string "url"

config PK_COMPOSITEPROTO_GITHUB
	string "GitHub"

config PK_COMPOSITEPROTO_SRCFILE
	string "Source code list"

config PK_COMPOSITEPROTO_CONFIG
	default "--enable-silent-rules --disable-static"
	string "CONFIG: Project Configure Options"

config PK_COMPOSITEPROTO_LIBPATH
	string "LIBS: Libraries to pass to the linker, e.g. -l<library>"

config PK_COMPOSITEPROTO_CPPFLAGS
	string "CPPFLAGS: C/C++ preprocessor flags, e.g. -I<include dir>"

config PK_COMPOSITEPROTO_DPKCONFIG
	string "PKG_CONFIG_PATH: Directories to add to pkg-config's search path"

config PK_COMPOSITEPROTO_CFLAGS
	string "CFLAGS: C compiler flags"

config PK_COMPOSITEPROTO_LDFLAGS
	string "LDFLAGS: Linker flags"

config PK_COMPOSITEPROTO_CXXFLAGS
	string "CXXFLAGS: C++ compiler flags"

config PK_COMPOSITEPROTO_ASFLAGS
	string "CCASFLAGS: assembler compiler flags (defaults to CFLAGS)"

config PK_COMPOSITEPROTO_BUILDARCH
	default "x86_64-unknown-linux-gnu"
	string "--host options on configure for Architecture"

endif # PK_COMPOSITEPROTO
```

## package/cpumask/Kconfig
```kconfig
menuconfig PK_KERNEL_CPUMASK
	bool "CPUMASK mechanism on Kernel"

if PK_KERNEL_CPUMASK

# Base 
source package/cpumask/kernel-cpumask-base/Kconfig

endif # PK_KERNEL_CPUMASK
```

## package/cpumask/kernel-cpumask-base/Kconfig
```kconfig
menuconfig PK_CPUMASK_BASE
	bool "Kernel cpumask Base Demo"

if PK_CPUMASK_BASE

config PK_CPUMASK_BASE_VERSION
	default "0.0.1"
	string "verstion"

config PK_CPUMASK_BASE_TAR
	default "tar.gz"
	string "tar type"

config PK_CPUMASK_BASE_URL
	default "https://gitee.com/BiscuitOS_team/HardStack/raw/Gitee/SubSystem/cpumask/base"
	string "url"

config PK_CPUMASK_BASE_GITHUB
	string "GitHub"

config PK_CPUMASK_BASE_SRCFILE
	default "main.c Kconfig Makefile"
	string "Source code list"

config PK_CPUMASK_BASE_CSRCFILE
	string "Compile source code list"

config PK_CPUMASK_BASE_CONFIG
	string "CONFIG: Project Configure Options"

config PK_CPUMASK_BASE_LIBPATH
	string "LIBS: Libraries to pass to the linker, e.g. -l<library>"

config PK_CPUMASK_BASE_CPPFLAGS
	string "CPPFLAGS: C/C++ preprocessor flags, e.g. -I<include dir>"

config PK_CPUMASK_BASE_DPKCONFIG
	string "PKG_CONFIG_PATH: Directories to add to pkg-config's search path"

config PK_CPUMASK_BASE_CFLAGS
	string "CFLAGS: C compiler flags"

config PK_CPUMASK_BASE_LDFLAGS
	string "LDFLAGS: Linker flags"

config PK_CPUMASK_BASE_CXXFLAGS
	string "CXXFLAGS: C++ compiler flags"

config PK_CPUMASK_BASE_ASFLAGS
	string "CCASFLAGS: assembler compiler flags (defaults to CFLAGS)"

config PK_CPUMASK_BASE_BUILDARCH
	string "--host options on configure for Architecture"

endif # PK_CPUMASK_BASE
```

## package/crash/BiscuitOS-crash-btop/Kconfig
```kconfig
menuconfig PK_CRASH_BTOP
	bool "Example: btop"

if PK_CRASH_BTOP

config PK_CRASH_BTOP_VERSION
	default "default"
	string "verstion"

config PK_CRASH_BTOP_TAR
	default "tar.gz"
	string "tar type"

config PK_CRASH_BTOP_URL
	default "https://gitee.com/BiscuitOS_team/HardStack/raw/Gitee/Tools/Crash/BiscuitOS-crash-btop"
	string "url"

config PK_CRASH_BTOP_GITHUB
	string "GitHub"

config PK_CRASH_BTOP_SRCFILE
	default "main.c Kconfig Makefile"
	string "Source code list"

config PK_CRASH_BTOP_CSRCFILE
	string "Compile source code list"

config PK_CRASH_BTOP_CONFIG
	string "CONFIG: Project Configure Options"

config PK_CRASH_BTOP_LIBPATH
	string "LIBS: Libraries to pass to the linker, e.g. -l<library>"

config PK_CRASH_BTOP_CPPFLAGS
	string "CPPFLAGS: C/C++ preprocessor flags, e.g. -I<include dir>"

config PK_CRASH_BTOP_DPKCONFIG
	string "PKG_CONFIG_PATH: Directories to add to pkg-config's search path"

config PK_CRASH_BTOP_CFLAGS
	string "CFLAGS: C compiler flags"

config PK_CRASH_BTOP_LDFLAGS
	string "LDFLAGS: Linker flags"

config PK_CRASH_BTOP_CXXFLAGS
	string "CXXFLAGS: C++ compiler flags"

config PK_CRASH_BTOP_ASFLAGS
	string "CCASFLAGS: assembler compiler flags (defaults to CFLAGS)"

config PK_CRASH_BTOP_BUILDARCH
	string "--host options on configure for Architecture"

endif # PK_CRASH_BTOP
```

## package/crash/BiscuitOS-crash-list-common/Kconfig
```kconfig
menuconfig PK_CRASH_LIST
	bool "Example: list Common"

if PK_CRASH_LIST

config PK_CRASH_LIST_VERSION
	default "default"
	string "verstion"

config PK_CRASH_LIST_TAR
	default "tar.gz"
	string "tar type"

config PK_CRASH_LIST_URL
	default "https://gitee.com/BiscuitOS_team/HardStack/raw/Gitee/Tools/Crash/BiscuitOS-crash-list-common"
	string "url"

config PK_CRASH_LIST_GITHUB
	string "GitHub"

config PK_CRASH_LIST_SRCFILE
	default "main.c Kconfig Makefile"
	string "Source code list"

config PK_CRASH_LIST_CSRCFILE
	string "Compile source code list"

config PK_CRASH_LIST_CONFIG
	string "CONFIG: Project Configure Options"

config PK_CRASH_LIST_LIBPATH
	string "LIBS: Libraries to pass to the linker, e.g. -l<library>"

config PK_CRASH_LIST_CPPFLAGS
	string "CPPFLAGS: C/C++ preprocessor flags, e.g. -I<include dir>"

config PK_CRASH_LIST_DPKCONFIG
	string "PKG_CONFIG_PATH: Directories to add to pkg-config's search path"

config PK_CRASH_LIST_CFLAGS
	string "CFLAGS: C compiler flags"

config PK_CRASH_LIST_LDFLAGS
	string "LDFLAGS: Linker flags"

config PK_CRASH_LIST_CXXFLAGS
	string "CXXFLAGS: C++ compiler flags"

config PK_CRASH_LIST_ASFLAGS
	string "CCASFLAGS: assembler compiler flags (defaults to CFLAGS)"

config PK_CRASH_LIST_BUILDARCH
	string "--host options on configure for Architecture"

endif # PK_CRASH_LIST
```

## package/crash/BiscuitOS-crash-ptov/Kconfig
```kconfig
menuconfig PK_CRASH_PTOV
	bool "Example: ptov"

if PK_CRASH_PTOV

config PK_CRASH_PTOV_VERSION
	default "default"
	string "verstion"

config PK_CRASH_PTOV_TAR
	default "tar.gz"
	string "tar type"

config PK_CRASH_PTOV_URL
	default "https://gitee.com/BiscuitOS_team/HardStack/raw/Gitee/Tools/Crash/BiscuitOS-crash-ptov"
	string "url"

config PK_CRASH_PTOV_GITHUB
	string "GitHub"

config PK_CRASH_PTOV_SRCFILE
	default "main.c Kconfig Makefile"
	string "Source code list"

config PK_CRASH_PTOV_CSRCFILE
	string "Compile source code list"

config PK_CRASH_PTOV_CONFIG
	string "CONFIG: Project Configure Options"

config PK_CRASH_PTOV_LIBPATH
	string "LIBS: Libraries to pass to the linker, e.g. -l<library>"

config PK_CRASH_PTOV_CPPFLAGS
	string "CPPFLAGS: C/C++ preprocessor flags, e.g. -I<include dir>"

config PK_CRASH_PTOV_DPKCONFIG
	string "PKG_CONFIG_PATH: Directories to add to pkg-config's search path"

config PK_CRASH_PTOV_CFLAGS
	string "CFLAGS: C compiler flags"

config PK_CRASH_PTOV_LDFLAGS
	string "LDFLAGS: Linker flags"

config PK_CRASH_PTOV_CXXFLAGS
	string "CXXFLAGS: C++ compiler flags"

config PK_CRASH_PTOV_ASFLAGS
	string "CCASFLAGS: assembler compiler flags (defaults to CFLAGS)"

config PK_CRASH_PTOV_BUILDARCH
	string "--host options on configure for Architecture"

endif # PK_CRASH_PTOV
```

## package/crash/BiscuitOS-crash-register-with-func-argument/Kconfig
```kconfig
menuconfig PK_CRASH_FUNC_ARGS
	bool "Example: Function arguments"

if PK_CRASH_FUNC_ARGS

config PK_CRASH_FUNC_ARGS_VERSION
	default "default"
	string "verstion"

config PK_CRASH_FUNC_ARGS_TAR
	default "tar.gz"
	string "tar type"

config PK_CRASH_FUNC_ARGS_URL
	default "https://gitee.com/BiscuitOS_team/HardStack/raw/Gitee/Tools/Crash/BiscuitOS-crash-register-with-func-argument"
	string "url"

config PK_CRASH_FUNC_ARGS_GITHUB
	string "GitHub"

config PK_CRASH_FUNC_ARGS_SRCFILE
	default "main.c Kconfig Makefile"
	string "Source code list"

config PK_CRASH_FUNC_ARGS_CSRCFILE
	string "Compile source code list"

config PK_CRASH_FUNC_ARGS_CONFIG
	string "CONFIG: Project Configure Options"

config PK_CRASH_FUNC_ARGS_LIBPATH
	string "LIBS: Libraries to pass to the linker, e.g. -l<library>"

config PK_CRASH_FUNC_ARGS_CPPFLAGS
	string "CPPFLAGS: C/C++ preprocessor flags, e.g. -I<include dir>"

config PK_CRASH_FUNC_ARGS_DPKCONFIG
	string "PKG_CONFIG_PATH: Directories to add to pkg-config's search path"

config PK_CRASH_FUNC_ARGS_CFLAGS
	string "CFLAGS: C compiler flags"

config PK_CRASH_FUNC_ARGS_LDFLAGS
	string "LDFLAGS: Linker flags"

config PK_CRASH_FUNC_ARGS_CXXFLAGS
	string "CXXFLAGS: C++ compiler flags"

config PK_CRASH_FUNC_ARGS_ASFLAGS
	string "CCASFLAGS: assembler compiler flags (defaults to CFLAGS)"

config PK_CRASH_FUNC_ARGS_BUILDARCH
	string "--host options on configure for Architecture"

endif # PK_CRASH_FUNC_ARGS
```

## package/crash/BiscuitOS-crash-vtop-kernel-address/Kconfig
```kconfig
menuconfig PK_CRASH_VTOP_K
	bool "Example: vtop translate kernel address"

if PK_CRASH_VTOP_K

config PK_CRASH_VTOP_K_VERSION
	default "default"
	string "verstion"

config PK_CRASH_VTOP_K_TAR
	default "tar.gz"
	string "tar type"

config PK_CRASH_VTOP_K_URL
	default "https://gitee.com/BiscuitOS_team/HardStack/raw/Gitee/Tools/Crash/BiscuitOS-crash-vtop-kernel-address"
	string "url"

config PK_CRASH_VTOP_K_GITHUB
	string "GitHub"

config PK_CRASH_VTOP_K_SRCFILE
	default "main.c Kconfig Makefile"
	string "Source code list"

config PK_CRASH_VTOP_K_CSRCFILE
	string "Compile source code list"

config PK_CRASH_VTOP_K_CONFIG
	string "CONFIG: Project Configure Options"

config PK_CRASH_VTOP_K_LIBPATH
	string "LIBS: Libraries to pass to the linker, e.g. -l<library>"

config PK_CRASH_VTOP_K_CPPFLAGS
	string "CPPFLAGS: C/C++ preprocessor flags, e.g. -I<include dir>"

config PK_CRASH_VTOP_K_DPKCONFIG
	string "PKG_CONFIG_PATH: Directories to add to pkg-config's search path"

config PK_CRASH_VTOP_K_CFLAGS
	string "CFLAGS: C compiler flags"

config PK_CRASH_VTOP_K_LDFLAGS
	string "LDFLAGS: Linker flags"

config PK_CRASH_VTOP_K_CXXFLAGS
	string "CXXFLAGS: C++ compiler flags"

config PK_CRASH_VTOP_K_ASFLAGS
	string "CCASFLAGS: assembler compiler flags (defaults to CFLAGS)"

config PK_CRASH_VTOP_K_BUILDARCH
	string "--host options on configure for Architecture"

endif # PK_CRASH_VTOP_K
```
