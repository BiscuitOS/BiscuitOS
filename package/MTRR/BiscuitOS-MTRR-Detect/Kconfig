## package/PAGING/BiscuitOS-PAGING-4level-Paging-MMAP-2MiB/Kconfig
```kconfig
menuconfig PK_PAGING_4L_PAGING_MMAP_2M
	bool "4-level Paging mmap 2MiB Physical Memory"

if PK_PAGING_4L_PAGING_MMAP_2M

config PK_PAGING_4L_PAGING_MMAP_2M_VERSION
	default "default"
	string "verstion"

config PK_PAGING_4L_PAGING_MMAP_2M_TAR
	default "tar.gz"
	string "tar type"

config PK_PAGING_4L_PAGING_MMAP_2M_URL
	default "https://gitee.com/BiscuitOS_team/HardStack/raw/Gitee/Memory-Allocator/PAGING-MECH/BiscuitOS-PAGING-4level-Paging-MMAP-2MiB"
	string "url"

config PK_PAGING_4L_PAGING_MMAP_2M_GITHUB
	string "GitHub"

config PK_PAGING_4L_PAGING_MMAP_2M_SRCFILE
	default "main.c Makefile Kconfig Makefile.app RunBiscuitOS.sh app.c"
	string "Source code list"

config PK_PAGING_4L_PAGING_MMAP_2M_CSRCFILE
	string "Compile source code list"

config PK_PAGING_4L_PAGING_MMAP_2M_CONFIG
	string "CONFIG: Project Configure Options"

config PK_PAGING_4L_PAGING_MMAP_2M_LIBPATH
	string "LIBS: Libraries to pass to the linker, e.g. -l<library>"

config PK_PAGING_4L_PAGING_MMAP_2M_CPPFLAGS
	string "CPPFLAGS: C/C++ preprocessor flags, e.g. -I<include dir>"

config PK_PAGING_4L_PAGING_MMAP_2M_DPKCONFIG
	string "PKG_CONFIG_PATH: Directories to add to pkg-config's search path"

config PK_PAGING_4L_PAGING_MMAP_2M_CFLAGS
	string "CFLAGS: C compiler flags"

config PK_PAGING_4L_PAGING_MMAP_2M_LDFLAGS
	string "LDFLAGS: Linker flags"

config PK_PAGING_4L_PAGING_MMAP_2M_CXXFLAGS
	string "CXXFLAGS: C++ compiler flags"

config PK_PAGING_4L_PAGING_MMAP_2M_ASFLAGS
	string "CCASFLAGS: assembler compiler flags (defaults to CFLAGS)"

config PK_PAGING_4L_PAGING_MMAP_2M_BUILDARCH
	string "--host options on configure for Architecture"

endif # PK_PAGING_4L_PAGING_MMAP_2M
```

## package/PAGING/BiscuitOS-PAGING-ATPR-CONSULT/Kconfig
```kconfig
menuconfig PK_PAGING_ATPR_CONSULT
	bool "ATPR(Apply to page range): Consult Pagetable"

if PK_PAGING_ATPR_CONSULT

config PK_PAGING_ATPR_CONSULT_VERSION
	default "default"
	string "verstion"

config PK_PAGING_ATPR_CONSULT_TAR
	default "tar.gz"
	string "tar type"

config PK_PAGING_ATPR_CONSULT_URL
	default "https://gitee.com/BiscuitOS_team/HardStack/raw/Gitee/Memory-Allocator/PAGING-MECH/BiscuitOS-PAGING-ATPR-CONSULT"
	string "url"

config PK_PAGING_ATPR_CONSULT_GITHUB
	string "GitHub"

config PK_PAGING_ATPR_CONSULT_SRCFILE
	default "app.c Kconfig main.c Makefile Makefile.host RunBiscuitOS.sh"
	string "Source code list"

config PK_PAGING_ATPR_CONSULT_CSRCFILE
	string "Compile source code list"

config PK_PAGING_ATPR_CONSULT_CONFIG
	string "CONFIG: Project Configure Options"

config PK_PAGING_ATPR_CONSULT_LIBPATH
	string "LIBS: Libraries to pass to the linker, e.g. -l<library>"

config PK_PAGING_ATPR_CONSULT_CPPFLAGS
	string "CPPFLAGS: C/C++ preprocessor flags, e.g. -I<include dir>"

config PK_PAGING_ATPR_CONSULT_DPKCONFIG
	string "PKG_CONFIG_PATH: Directories to add to pkg-config's search path"

config PK_PAGING_ATPR_CONSULT_CFLAGS
	string "CFLAGS: C compiler flags"

config PK_PAGING_ATPR_CONSULT_LDFLAGS
	string "LDFLAGS: Linker flags"

config PK_PAGING_ATPR_CONSULT_CXXFLAGS
	string "CXXFLAGS: C++ compiler flags"

config PK_PAGING_ATPR_CONSULT_ASFLAGS
	string "CCASFLAGS: assembler compiler flags (defaults to CFLAGS)"

config PK_PAGING_ATPR_CONSULT_BUILDARCH
	string "--host options on configure for Architecture"

endif # PK_PAGING_ATPR_CONSULT
```

## package/PAGING/BiscuitOS-PAGING-ATPR-LAZY/Kconfig
```kconfig
menuconfig PK_PAGING_ATPR_LAZY
	bool "ATPR(Apply to page range): LazyAlloc"

if PK_PAGING_ATPR_LAZY

config PK_PAGING_ATPR_LAZY_VERSION
	default "default"
	string "verstion"

config PK_PAGING_ATPR_LAZY_TAR
	default "tar.gz"
	string "tar type"

config PK_PAGING_ATPR_LAZY_URL
	default "https://gitee.com/BiscuitOS_team/HardStack/raw/Gitee/Memory-Allocator/PAGING-MECH/BiscuitOS-PAGING-ATPR-LAZY"
	string "url"

config PK_PAGING_ATPR_LAZY_GITHUB
	string "GitHub"

config PK_PAGING_ATPR_LAZY_SRCFILE
	default "app.c Kconfig main.c Makefile Makefile.host RunBiscuitOS.sh"
	string "Source code list"

config PK_PAGING_ATPR_LAZY_CSRCFILE
	string "Compile source code list"

config PK_PAGING_ATPR_LAZY_CONFIG
	string "CONFIG: Project Configure Options"

config PK_PAGING_ATPR_LAZY_LIBPATH
	string "LIBS: Libraries to pass to the linker, e.g. -l<library>"

config PK_PAGING_ATPR_LAZY_CPPFLAGS
	string "CPPFLAGS: C/C++ preprocessor flags, e.g. -I<include dir>"

config PK_PAGING_ATPR_LAZY_DPKCONFIG
	string "PKG_CONFIG_PATH: Directories to add to pkg-config's search path"

config PK_PAGING_ATPR_LAZY_CFLAGS
	string "CFLAGS: C compiler flags"

config PK_PAGING_ATPR_LAZY_LDFLAGS
	string "LDFLAGS: Linker flags"

config PK_PAGING_ATPR_LAZY_CXXFLAGS
	string "CXXFLAGS: C++ compiler flags"

config PK_PAGING_ATPR_LAZY_ASFLAGS
	string "CCASFLAGS: assembler compiler flags (defaults to CFLAGS)"

config PK_PAGING_ATPR_LAZY_BUILDARCH
	string "--host options on configure for Architecture"

endif # PK_PAGING_ATPR_LAZY
```
