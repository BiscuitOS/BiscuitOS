## package/MTRR/BiscuitOS-MTRR-Detect/Kconfig
```kconfig
menuconfig PK_MTRR_DETECT
	bool "Detect MTRR Special Register"

if PK_MTRR_DETECT

config PK_MTRR_DETECT_VERSION
	default "default"
	string "verstion"

config PK_MTRR_DETECT_TAR
	default "tar.gz"
	string "tar type"

config PK_MTRR_DETECT_URL
	default "https://gitee.com/BiscuitOS_team/HardStack/raw/Gitee/Memory-Allocator/MTRR-MECH/BiscuitOS-MTRR-Detect/"
	string "url"

config PK_MTRR_DETECT_GITHUB
	string "GitHub"

config PK_MTRR_DETECT_SRCFILE
	default "main.c Kconfig Makefile RunBiscuitOS.sh Makefile.host"
	string "Source code list"

config PK_MTRR_DETECT_CSRCFILE
	string "Compile source code list"

config PK_MTRR_DETECT_CONFIG
	string "CONFIG: Project Configure Options"

config PK_MTRR_DETECT_LIBPATH
	string "LIBS: Libraries to pass to the linker, e.g. -l<library>"

config PK_MTRR_DETECT_CPPFLAGS
	string "CPPFLAGS: C/C++ preprocessor flags, e.g. -I<include dir>"

config PK_MTRR_DETECT_DPKCONFIG
	string "PKG_CONFIG_PATH: Directories to add to pkg-config's search path"

config PK_MTRR_DETECT_CFLAGS
	string "CFLAGS: C compiler flags"

config PK_MTRR_DETECT_LDFLAGS
	string "LDFLAGS: Linker flags"

config PK_MTRR_DETECT_CXXFLAGS
	string "CXXFLAGS: C++ compiler flags"

config PK_MTRR_DETECT_ASFLAGS
	string "CCASFLAGS: assembler compiler flags (defaults to CFLAGS)"

config PK_MTRR_DETECT_BUILDARCH
	string "--host options on configure for Architecture"

endif # PK_MTRR_DETECT
```

## package/MTRR/BiscuitOS-MTRR-PageTable-Level-MTRR-PAT-application/Kconfig
```kconfig
menuconfig PK_MTRR_PAGETABLE_PAT_APP
	select PK_MTRR_PAGETABLE_PAT
	bool "MTRR and PAT on PageTable-Level application"

if PK_MTRR_PAGETABLE_PAT_APP

config PK_MTRR_PAGETABLE_PAT_APP_VERSION
	default "default"
	string "verstion"

config PK_MTRR_PAGETABLE_PAT_APP_TAR
	default "tar.gz"
	string "tar type"

config PK_MTRR_PAGETABLE_PAT_APP_URL
	default "https://gitee.com/BiscuitOS_team/HardStack/raw/Gitee/Memory-Allocator/MTRR-MECH/BiscuitOS-MTRR-PageTable-Level-MTRR-PAT-application"
	string "url"

config PK_MTRR_PAGETABLE_PAT_APP_GITHUB
	string "GitHub"

config PK_MTRR_PAGETABLE_PAT_APP_SRCFILE
	default "main.c Makefile"
	string "Source code list"

config PK_MTRR_PAGETABLE_PAT_APP_CSRCFILE
	string "Compile source code list"

config PK_MTRR_PAGETABLE_PAT_APP_CONFIG
	string "CONFIG: Project Configure Options"

config PK_MTRR_PAGETABLE_PAT_APP_LIBPATH
	string "LIBS: Libraries to pass to the linker, e.g. -l<library>"

config PK_MTRR_PAGETABLE_PAT_APP_CPPFLAGS
	string "CPPFLAGS: C/C++ preprocessor flags, e.g. -I<include dir>"

config PK_MTRR_PAGETABLE_PAT_APP_DPKCONFIG
	string "PKG_CONFIG_PATH: Directories to add to pkg-config's search path"

config PK_MTRR_PAGETABLE_PAT_APP_CFLAGS
	string "CFLAGS: C compiler flags"

config PK_MTRR_PAGETABLE_PAT_APP_LDFLAGS
	string "LDFLAGS: Linker flags"

config PK_MTRR_PAGETABLE_PAT_APP_CXXFLAGS
	string "CXXFLAGS: C++ compiler flags"

config PK_MTRR_PAGETABLE_PAT_APP_ASFLAGS
	string "CCASFLAGS: assembler compiler flags (defaults to CFLAGS)"

config PK_MTRR_PAGETABLE_PAT_APP_BUILDARCH
	string "--host options on configure for Architecture"

endif # PK_MTRR_PAGETABLE_PAT_APP
```

## package/MTRR/BiscuitOS-MTRR-View-Cache-information/Kconfig
```kconfig
menuconfig PK_MTRR_VIEW_CACHE_INFO
	bool "View Cache information with PAT and MTRR"

if PK_MTRR_VIEW_CACHE_INFO

config PK_MTRR_VIEW_CACHE_INFO_VERSION
	default "default"
	string "verstion"

config PK_MTRR_VIEW_CACHE_INFO_TAR
	default "tar.gz"
	string "tar type"

config PK_MTRR_VIEW_CACHE_INFO_URL
	default "https://gitee.com/BiscuitOS_team/HardStack/raw/Gitee/Memory-Allocator/MTRR-MECH/BiscuitOS-MTRR-View-Cache-information/"
	string "url"

config PK_MTRR_VIEW_CACHE_INFO_GITHUB
	string "GitHub"

config PK_MTRR_VIEW_CACHE_INFO_SRCFILE
	default "main.c Kconfig Makefile RunBiscuitOS.sh Makefile.host"
	string "Source code list"

config PK_MTRR_VIEW_CACHE_INFO_CSRCFILE
	string "Compile source code list"

config PK_MTRR_VIEW_CACHE_INFO_CONFIG
	string "CONFIG: Project Configure Options"

config PK_MTRR_VIEW_CACHE_INFO_LIBPATH
	string "LIBS: Libraries to pass to the linker, e.g. -l<library>"

config PK_MTRR_VIEW_CACHE_INFO_CPPFLAGS
	string "CPPFLAGS: C/C++ preprocessor flags, e.g. -I<include dir>"

config PK_MTRR_VIEW_CACHE_INFO_DPKCONFIG
	string "PKG_CONFIG_PATH: Directories to add to pkg-config's search path"

config PK_MTRR_VIEW_CACHE_INFO_CFLAGS
	string "CFLAGS: C compiler flags"

config PK_MTRR_VIEW_CACHE_INFO_LDFLAGS
	string "LDFLAGS: Linker flags"

config PK_MTRR_VIEW_CACHE_INFO_CXXFLAGS
	string "CXXFLAGS: C++ compiler flags"

config PK_MTRR_VIEW_CACHE_INFO_ASFLAGS
	string "CCASFLAGS: assembler compiler flags (defaults to CFLAGS)"

config PK_MTRR_VIEW_CACHE_INFO_BUILDARCH
	string "--host options on configure for Architecture"

endif # PK_MTRR_VIEW_CACHE_INFO
```

## package/MTRR/BiscuitOS-MTRR-with-PAT/Kconfig
```kconfig
menuconfig PK_MTRR_PAT
	bool "MTRR with PAT on Page-table Level"

if PK_MTRR_PAT

config PK_MTRR_PAT_VERSION
	default "default"
	string "verstion"

config PK_MTRR_PAT_TAR
	default "tar.gz"
	string "tar type"

config PK_MTRR_PAT_URL
	default "https://gitee.com/BiscuitOS_team/HardStack/raw/Gitee/Memory-Allocator/MTRR-MECH/BiscuitOS-MTRR-with-PAT/"
	string "url"

config PK_MTRR_PAT_GITHUB
	string "GitHub"

config PK_MTRR_PAT_SRCFILE
	default "main.c Kconfig Makefile RunBiscuitOS.sh Makefile.host app.c"
	string "Source code list"

config PK_MTRR_PAT_CSRCFILE
	string "Compile source code list"

config PK_MTRR_PAT_CONFIG
	string "CONFIG: Project Configure Options"

config PK_MTRR_PAT_LIBPATH
	string "LIBS: Libraries to pass to the linker, e.g. -l<library>"

config PK_MTRR_PAT_CPPFLAGS
	string "CPPFLAGS: C/C++ preprocessor flags, e.g. -I<include dir>"

config PK_MTRR_PAT_DPKCONFIG
	string "PKG_CONFIG_PATH: Directories to add to pkg-config's search path"

config PK_MTRR_PAT_CFLAGS
	string "CFLAGS: C compiler flags"

config PK_MTRR_PAT_LDFLAGS
	string "LDFLAGS: Linker flags"

config PK_MTRR_PAT_CXXFLAGS
	string "CXXFLAGS: C++ compiler flags"

config PK_MTRR_PAT_ASFLAGS
	string "CCASFLAGS: assembler compiler flags (defaults to CFLAGS)"

config PK_MTRR_PAT_BUILDARCH
	string "--host options on configure for Architecture"

endif # PK_MTRR_PAT
```

## package/MTRR/Kconfig
```kconfig
menuconfig PK_MTRR
	bool "MTRR: Memory Type Range Register Mechanism"

if PK_MTRR

# MTRR: Detect
source package/MTRR/BiscuitOS-MTRR-Detect/Kconfig

# MTRR: View Cache information
source package/MTRR/BiscuitOS-MTRR-View-Cache-information/Kconfig

# MTRR: with PAT
source package/MTRR/BiscuitOS-MTRR-with-PAT/Kconfig

# MTRR: with PAT pagetable level
source package/MTRR/BiscuitOS-MTRR-PageTable-Level-MTRR-PAT/Kconfig

# MTRR: with PAT pagetable level Application
source package/MTRR/BiscuitOS-MTRR-PageTable-Level-MTRR-PAT-application/Kconfig

endif # PK_MTRR
```

## package/NUMA/BiscuitOS-NUMA-MPOL-LOCAL/Kconfig
```kconfig
menuconfig PK_NUMA_MPOL_LOCAL
	select PK_NUMACTL_LIBNUMA
	bool "NUMA POLICY: LOCAL"

if PK_NUMA_MPOL_LOCAL

config PK_NUMA_MPOL_LOCAL_VERSION
	default "default"
	string "verstion"

config PK_NUMA_MPOL_LOCAL_TAR
	default "tar.gz"
	string "tar type"

config PK_NUMA_MPOL_LOCAL_URL
	default "https://gitee.com/BiscuitOS_team/HardStack/raw/Gitee/Memory-Allocator/NUMA/BiscuitOS-NUMA-MPOL-LOCAL"
	string "url"

config PK_NUMA_MPOL_LOCAL_GITHUB
	string "GitHub"

config PK_NUMA_MPOL_LOCAL_SRCFILE
	default "main.c Makefile RunBiscuitOS.sh"
	string "Source code list"

config PK_NUMA_MPOL_LOCAL_CSRCFILE
	string "Compile source code list"

config PK_NUMA_MPOL_LOCAL_CONFIG
	string "CONFIG: Project Configure Options"

config PK_NUMA_MPOL_LOCAL_LIBPATH
	string "LIBS: Libraries to pass to the linker, e.g. -l<library>"

config PK_NUMA_MPOL_LOCAL_CPPFLAGS
	string "CPPFLAGS: C/C++ preprocessor flags, e.g. -I<include dir>"

config PK_NUMA_MPOL_LOCAL_DPKCONFIG
	string "PKG_CONFIG_PATH: Directories to add to pkg-config's search path"

config PK_NUMA_MPOL_LOCAL_CFLAGS
	string "CFLAGS: C compiler flags"

config PK_NUMA_MPOL_LOCAL_LDFLAGS
	string "LDFLAGS: Linker flags"

config PK_NUMA_MPOL_LOCAL_CXXFLAGS
	string "CXXFLAGS: C++ compiler flags"

config PK_NUMA_MPOL_LOCAL_ASFLAGS
	string "CCASFLAGS: assembler compiler flags (defaults to CFLAGS)"

config PK_NUMA_MPOL_LOCAL_BUILDARCH
	string "--host options on configure for Architecture"

endif # PK_NUMA_MPOL_LOCAL
```

## package/NUMA/BiscuitOS-NUMA-MPOL-PREFERRED/Kconfig
```kconfig
menuconfig PK_NUMA_MPOL_PREFERRED
	select PK_NUMACTL_LIBNUMA
	bool "NUMA POLICY: PREFERRED"

if PK_NUMA_MPOL_PREFERRED

config PK_NUMA_MPOL_PREFERRED_VERSION
	default "default"
	string "verstion"

config PK_NUMA_MPOL_PREFERRED_TAR
	default "tar.gz"
	string "tar type"

config PK_NUMA_MPOL_PREFERRED_URL
	default "https://gitee.com/BiscuitOS_team/HardStack/raw/Gitee/Memory-Allocator/NUMA/BiscuitOS-NUMA-MPOL-PREFERRED"
	string "url"

config PK_NUMA_MPOL_PREFERRED_GITHUB
	string "GitHub"

config PK_NUMA_MPOL_PREFERRED_SRCFILE
	default "main.c Makefile RunBiscuitOS.sh"
	string "Source code list"

config PK_NUMA_MPOL_PREFERRED_CSRCFILE
	string "Compile source code list"

config PK_NUMA_MPOL_PREFERRED_CONFIG
	string "CONFIG: Project Configure Options"

config PK_NUMA_MPOL_PREFERRED_LIBPATH
	string "LIBS: Libraries to pass to the linker, e.g. -l<library>"

config PK_NUMA_MPOL_PREFERRED_CPPFLAGS
	string "CPPFLAGS: C/C++ preprocessor flags, e.g. -I<include dir>"

config PK_NUMA_MPOL_PREFERRED_DPKCONFIG
	string "PKG_CONFIG_PATH: Directories to add to pkg-config's search path"

config PK_NUMA_MPOL_PREFERRED_CFLAGS
	string "CFLAGS: C compiler flags"

config PK_NUMA_MPOL_PREFERRED_LDFLAGS
	string "LDFLAGS: Linker flags"

config PK_NUMA_MPOL_PREFERRED_CXXFLAGS
	string "CXXFLAGS: C++ compiler flags"

config PK_NUMA_MPOL_PREFERRED_ASFLAGS
	string "CCASFLAGS: assembler compiler flags (defaults to CFLAGS)"

config PK_NUMA_MPOL_PREFERRED_BUILDARCH
	string "--host options on configure for Architecture"

endif # PK_NUMA_MPOL_PREFERRED
```

## package/NUMA/BiscuitOS-NUMA-MPOL-WEIGHTED-INTERLEAVE/Kconfig
```kconfig
menuconfig PK_NUMA_MPOL_WEIGHTED_INTERLEAVE
	select PK_NUMACTL_LIBNUMA
	bool "NUMA POLICY: WEIGHTED INTERLEAVE"

if PK_NUMA_MPOL_WEIGHTED_INTERLEAVE

config PK_NUMA_MPOL_WEIGHTED_INTERLEAVE_VERSION
	default "default"
	string "verstion"

config PK_NUMA_MPOL_WEIGHTED_INTERLEAVE_TAR
	default "tar.gz"
	string "tar type"

config PK_NUMA_MPOL_WEIGHTED_INTERLEAVE_URL
	default "https://gitee.com/BiscuitOS_team/HardStack/raw/Gitee/Memory-Allocator/NUMA/BiscuitOS-NUMA-MPOL-WEIGHTED-INTERLEAVE"
	string "url"

config PK_NUMA_MPOL_WEIGHTED_INTERLEAVE_GITHUB
	string "GitHub"

config PK_NUMA_MPOL_WEIGHTED_INTERLEAVE_SRCFILE
	default "main.c Makefile RunBiscuitOS.sh"
	string "Source code list"

config PK_NUMA_MPOL_WEIGHTED_INTERLEAVE_CSRCFILE
	string "Compile source code list"

config PK_NUMA_MPOL_WEIGHTED_INTERLEAVE_CONFIG
	string "CONFIG: Project Configure Options"

config PK_NUMA_MPOL_WEIGHTED_INTERLEAVE_LIBPATH
	string "LIBS: Libraries to pass to the linker, e.g. -l<library>"

config PK_NUMA_MPOL_WEIGHTED_INTERLEAVE_CPPFLAGS
	string "CPPFLAGS: C/C++ preprocessor flags, e.g. -I<include dir>"

config PK_NUMA_MPOL_WEIGHTED_INTERLEAVE_DPKCONFIG
	string "PKG_CONFIG_PATH: Directories to add to pkg-config's search path"

config PK_NUMA_MPOL_WEIGHTED_INTERLEAVE_CFLAGS
	string "CFLAGS: C compiler flags"

config PK_NUMA_MPOL_WEIGHTED_INTERLEAVE_LDFLAGS
	string "LDFLAGS: Linker flags"

config PK_NUMA_MPOL_WEIGHTED_INTERLEAVE_CXXFLAGS
	string "CXXFLAGS: C++ compiler flags"

config PK_NUMA_MPOL_WEIGHTED_INTERLEAVE_ASFLAGS
	string "CCASFLAGS: assembler compiler flags (defaults to CFLAGS)"

config PK_NUMA_MPOL_WEIGHTED_INTERLEAVE_BUILDARCH
	string "--host options on configure for Architecture"

endif # PK_NUMA_MPOL_WEIGHTED_INTERLEAVE
```

## package/NUMA/BiscuitOS-NUMA-alloc-current-node/Kconfig
```kconfig
menuconfig PK_NUMA_ALLOC_CURNODE
	bool "Alloc page from current NUMA NODE"

if PK_NUMA_ALLOC_CURNODE

config PK_NUMA_ALLOC_CURNODE_VERSION
	default "default"
	string "verstion"

config PK_NUMA_ALLOC_CURNODE_TAR
	default "tar.gz"
	string "tar type"

config PK_NUMA_ALLOC_CURNODE_URL
	default "https://gitee.com/BiscuitOS_team/HardStack/raw/Gitee/Memory-Allocator/NUMA/BiscuitOS-NUMA-alloc-current-node"
	string "url"

config PK_NUMA_ALLOC_CURNODE_GITHUB
	string "GitHub"

config PK_NUMA_ALLOC_CURNODE_SRCFILE
	default "main.c Kconfig Makefile RunBiscuitOS.sh"
	string "Source code list"

config PK_NUMA_ALLOC_CURNODE_CSRCFILE
	string "Compile source code list"

config PK_NUMA_ALLOC_CURNODE_CONFIG
	string "CONFIG: Project Configure Options"

config PK_NUMA_ALLOC_CURNODE_LIBPATH
	string "LIBS: Libraries to pass to the linker, e.g. -l<library>"

config PK_NUMA_ALLOC_CURNODE_CPPFLAGS
	string "CPPFLAGS: C/C++ preprocessor flags, e.g. -I<include dir>"

config PK_NUMA_ALLOC_CURNODE_DPKCONFIG
	string "PKG_CONFIG_PATH: Directories to add to pkg-config's search path"

config PK_NUMA_ALLOC_CURNODE_CFLAGS
	string "CFLAGS: C compiler flags"

config PK_NUMA_ALLOC_CURNODE_LDFLAGS
	string "LDFLAGS: Linker flags"

config PK_NUMA_ALLOC_CURNODE_CXXFLAGS
	string "CXXFLAGS: C++ compiler flags"

config PK_NUMA_ALLOC_CURNODE_ASFLAGS
	string "CCASFLAGS: assembler compiler flags (defaults to CFLAGS)"

config PK_NUMA_ALLOC_CURNODE_BUILDARCH
	string "--host options on configure for Architecture"

endif # PK_NUMA_ALLOC_CURNODE
```

## package/NUMA/Kconfig
```kconfig
menuconfig PK_NUMA
	bool "NUMA(Non-Uniform Memory Access)"

if PK_NUMA

# numactl and libnuma
source package/NUMA/numactl-libnuma/Kconfig

# POLICY: PREFERRED
source package/NUMA/BiscuitOS-NUMA-MPOL-PREFERRED/Kconfig

# POLICY: PREFERRED-MANY
source package/NUMA/BiscuitOS-NUMA-MPOL-PREFERRED-MANY/Kconfig

# POLICY: BIND
source package/NUMA/BiscuitOS-NUMA-MPOL-BIND/Kconfig

# POLICY: LOCAL
source package/NUMA/BiscuitOS-NUMA-MPOL-LOCAL/Kconfig

# POLICY: INTERLEAVE
source package/NUMA/BiscuitOS-NUMA-MPOL-INTERLEAVE/Kconfig

# POLICY: WEIGHTED INTERLEAVE
source package/NUMA/BiscuitOS-NUMA-MPOL-WEIGHTED-INTERLEAVE/Kconfig

endif # PK_NUMA
```

## package/NUMA/libnuma-alloc-memory-current-memory/Kconfig
```kconfig
menuconfig PK_LIBNUMA_ALLOC_CUR
	bool "libnuma: Allocate memory on current NODE"

if PK_LIBNUMA_ALLOC_CUR

config PK_LIBNUMA_ALLOC_CUR_VERSION
	default "default"
	string "verstion"

config PK_LIBNUMA_ALLOC_CUR_TAR
	default "tar.gz"
	string "tar type"

config PK_LIBNUMA_ALLOC_CUR_URL
	default "https://gitee.com/BiscuitOS_team/HardStack/raw/Gitee/Memory-Allocator/NUMA/libnuma-alloc-memory-current-memory"
	string "url"

config PK_LIBNUMA_ALLOC_CUR_GITHUB
	string "GitHub"

config PK_LIBNUMA_ALLOC_CUR_SRCFILE
	default "main.c Makefile"
	string "Source code list"

config PK_LIBNUMA_ALLOC_CUR_CSRCFILE
	string "Compile source code list"

config PK_LIBNUMA_ALLOC_CUR_CONFIG
	string "CONFIG: Project Configure Options"

config PK_LIBNUMA_ALLOC_CUR_LIBPATH
	string "LIBS: Libraries to pass to the linker, e.g. -l<library>"

config PK_LIBNUMA_ALLOC_CUR_CPPFLAGS
	string "CPPFLAGS: C/C++ preprocessor flags, e.g. -I<include dir>"

config PK_LIBNUMA_ALLOC_CUR_DPKCONFIG
	string "PKG_CONFIG_PATH: Directories to add to pkg-config's search path"

config PK_LIBNUMA_ALLOC_CUR_CFLAGS
	string "CFLAGS: C compiler flags"

config PK_LIBNUMA_ALLOC_CUR_LDFLAGS
	string "LDFLAGS: Linker flags"

config PK_LIBNUMA_ALLOC_CUR_CXXFLAGS
	string "CXXFLAGS: C++ compiler flags"

config PK_LIBNUMA_ALLOC_CUR_ASFLAGS
	string "CCASFLAGS: assembler compiler flags (defaults to CFLAGS)"

config PK_LIBNUMA_ALLOC_CUR_BUILDARCH
	string "--host options on configure for Architecture"

endif # PK_LIBNUMA_ALLOC_CUR
```
