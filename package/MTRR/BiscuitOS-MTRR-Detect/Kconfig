## package/NUMA/libnuma-detect-vaddr-numa-node/Kconfig
```kconfig
menuconfig PK_LIBNUMA_DETECT_NODE
	bool "libnuma: Detect NUMA NODE for Virtual Address"

if PK_LIBNUMA_DETECT_NODE

config PK_LIBNUMA_DETECT_NODE_VERSION
	default "default"
	string "verstion"

config PK_LIBNUMA_DETECT_NODE_TAR
	default "tar.gz"
	string "tar type"

config PK_LIBNUMA_DETECT_NODE_URL
	default "https://gitee.com/BiscuitOS_team/HardStack/raw/Gitee/Memory-Allocator/NUMA/libnuma-detect-vaddr-numa-node"
	string "url"

config PK_LIBNUMA_DETECT_NODE_GITHUB
	string "GitHub"

config PK_LIBNUMA_DETECT_NODE_SRCFILE
	default "main.c Makefile"
	string "Source code list"

config PK_LIBNUMA_DETECT_NODE_CSRCFILE
	string "Compile source code list"

config PK_LIBNUMA_DETECT_NODE_CONFIG
	string "CONFIG: Project Configure Options"

config PK_LIBNUMA_DETECT_NODE_LIBPATH
	string "LIBS: Libraries to pass to the linker, e.g. -l<library>"

config PK_LIBNUMA_DETECT_NODE_CPPFLAGS
	string "CPPFLAGS: C/C++ preprocessor flags, e.g. -I<include dir>"

config PK_LIBNUMA_DETECT_NODE_DPKCONFIG
	string "PKG_CONFIG_PATH: Directories to add to pkg-config's search path"

config PK_LIBNUMA_DETECT_NODE_CFLAGS
	string "CFLAGS: C compiler flags"

config PK_LIBNUMA_DETECT_NODE_LDFLAGS
	string "LDFLAGS: Linker flags"

config PK_LIBNUMA_DETECT_NODE_CXXFLAGS
	string "CXXFLAGS: C++ compiler flags"

config PK_LIBNUMA_DETECT_NODE_ASFLAGS
	string "CCASFLAGS: assembler compiler flags (defaults to CFLAGS)"

config PK_LIBNUMA_DETECT_NODE_BUILDARCH
	string "--host options on configure for Architecture"

endif # PK_LIBNUMA_DETECT_NODE
```

## package/NUMA/libnuma-numa-move-page/Kconfig
```kconfig
menuconfig PK_LIBNUMA_MOVE_PAGE
	bool "libnuma: Move Page to another NUMA NODE"

if PK_LIBNUMA_MOVE_PAGE

config PK_LIBNUMA_MOVE_PAGE_VERSION
	default "default"
	string "verstion"

config PK_LIBNUMA_MOVE_PAGE_TAR
	default "tar.gz"
	string "tar type"

config PK_LIBNUMA_MOVE_PAGE_URL
	default "https://gitee.com/BiscuitOS_team/HardStack/raw/Gitee/Memory-Allocator/NUMA/libnuma-numa-move-page"
	string "url"

config PK_LIBNUMA_MOVE_PAGE_GITHUB
	string "GitHub"

config PK_LIBNUMA_MOVE_PAGE_SRCFILE
	default "main.c Makefile"
	string "Source code list"

config PK_LIBNUMA_MOVE_PAGE_CSRCFILE
	string "Compile source code list"

config PK_LIBNUMA_MOVE_PAGE_CONFIG
	string "CONFIG: Project Configure Options"

config PK_LIBNUMA_MOVE_PAGE_LIBPATH
	string "LIBS: Libraries to pass to the linker, e.g. -l<library>"

config PK_LIBNUMA_MOVE_PAGE_CPPFLAGS
	string "CPPFLAGS: C/C++ preprocessor flags, e.g. -I<include dir>"

config PK_LIBNUMA_MOVE_PAGE_DPKCONFIG
	string "PKG_CONFIG_PATH: Directories to add to pkg-config's search path"

config PK_LIBNUMA_MOVE_PAGE_CFLAGS
	string "CFLAGS: C compiler flags"

config PK_LIBNUMA_MOVE_PAGE_LDFLAGS
	string "LDFLAGS: Linker flags"

config PK_LIBNUMA_MOVE_PAGE_CXXFLAGS
	string "CXXFLAGS: C++ compiler flags"

config PK_LIBNUMA_MOVE_PAGE_ASFLAGS
	string "CCASFLAGS: assembler compiler flags (defaults to CFLAGS)"

config PK_LIBNUMA_MOVE_PAGE_BUILDARCH
	string "--host options on configure for Architecture"

endif # PK_LIBNUMA_MOVE_PAGE
```

## package/NUMA/numactl-libnuma/Kconfig
```kconfig
menuconfig PK_NUMACTL_LIBNUMA
	bool "Libnuma:numctl/numastat tools"

if PK_NUMACTL_LIBNUMA

config PK_NUMACTL_LIBNUMA_VERSION
	default "default"
	string "verstion"

config PK_NUMACTL_LIBNUMA_TAR
	default "tar.xz"
	string "tar type"

config PK_NUMACTL_LIBNUMA_URL
	default ""
	string "url"

config PK_NUMACTL_LIBNUMA_GITHUB
	default "https://github.com/numactl/numactl.git"
	string "GitHub"

config PK_NUMACTL_LIBNUMA_SRCFILE
	string "Source code list"

config PK_NUMACTL_LIBNUMA_CONFIG
	default "--enable-silent-rules"
	string "CONFIG: Project Configure Options"

config PK_NUMACTL_LIBNUMA_LIBPATH
	string "LIBS: Libraries to pass to the linker, e.g. -l<library>"

config PK_NUMACTL_LIBNUMA_CPPFLAGS
	string "CPPFLAGS: C/C++ preprocessor flags, e.g. -I<include dir>"

config PK_NUMACTL_LIBNUMA_DPKCONFIG
	string "PKG_CONFIG_PATH: Directories to add to pkg-config's search path"

config PK_NUMACTL_LIBNUMA_CFLAGS
	string "CFLAGS: C compiler flags"

config PK_NUMACTL_LIBNUMA_LDFLAGS
	string "LDFLAGS: Linker flags"

config PK_NUMACTL_LIBNUMA_CXXFLAGS
	string "CXXFLAGS: C++ compiler flags"

config PK_NUMACTL_LIBNUMA_ASFLAGS
	string "CCASFLAGS: assembler compiler flags (defaults to CFLAGS)"

config PK_NUMACTL_LIBNUMA_BUILDARCH
	default "x86_64-unknown-linux-gnu"
	string "--host options on configure for Architecture"

endif # PK_NUMACTL_LIBNUMA
```

## package/OOM/BiscuitOS-OOM-kernel/Kconfig
```kconfig
menuconfig PK_OOM_KERNEL
	bool "Trigger OOM on Kernel Space"

if PK_OOM_KERNEL

config PK_OOM_KERNEL_VERSION
	default "default"
	string "verstion"

config PK_OOM_KERNEL_TAR
	default "tar.gz"
	string "tar type"

config PK_OOM_KERNEL_URL
	default "https://gitee.com/BiscuitOS_team/HardStack/raw/Gitee/Memory-Allocator/OOM/BiscuitOS-OOM-kernel"
	string "url"

config PK_OOM_KERNEL_GITHUB
	string "GitHub"

config PK_OOM_KERNEL_SRCFILE
	default "main.c Kconfig Makefile RunBiscuitOS.sh"
	string "Source code list"

config PK_OOM_KERNEL_CSRCFILE
	string "Compile source code list"

config PK_OOM_KERNEL_CONFIG
	string "CONFIG: Project Configure Options"

config PK_OOM_KERNEL_LIBPATH
	string "LIBS: Libraries to pass to the linker, e.g. -l<library>"

config PK_OOM_KERNEL_CPPFLAGS
	string "CPPFLAGS: C/C++ preprocessor flags, e.g. -I<include dir>"

config PK_OOM_KERNEL_DPKCONFIG
	string "PKG_CONFIG_PATH: Directories to add to pkg-config's search path"

config PK_OOM_KERNEL_CFLAGS
	string "CFLAGS: C compiler flags"

config PK_OOM_KERNEL_LDFLAGS
	string "LDFLAGS: Linker flags"

config PK_OOM_KERNEL_CXXFLAGS
	string "CXXFLAGS: C++ compiler flags"

config PK_OOM_KERNEL_ASFLAGS
	string "CCASFLAGS: assembler compiler flags (defaults to CFLAGS)"

config PK_OOM_KERNEL_BUILDARCH
	string "--host options on configure for Architecture"

endif # PK_OOM_KERNEL
```

## package/OOM/BiscuitOS-OOM-userspace/Kconfig
```kconfig
menuconfig PK_OOM_USERSPACE
	bool "Trigger OOM on Userspace"

if PK_OOM_USERSPACE

config PK_OOM_USERSPACE_VERSION
	default "default"
	string "verstion"

config PK_OOM_USERSPACE_TAR
	default "tar.gz"
	string "tar type"

config PK_OOM_USERSPACE_URL
	default "https://gitee.com/BiscuitOS_team/HardStack/raw/Gitee/Memory-Allocator/OOM/BiscuitOS-OOM-userspace"
	string "url"

config PK_OOM_USERSPACE_GITHUB
	string "GitHub"

config PK_OOM_USERSPACE_SRCFILE
	default "main.c Makefile RunBiscuitOS.sh"
	string "Source code list"

config PK_OOM_USERSPACE_CSRCFILE
	string "Compile source code list"

config PK_OOM_USERSPACE_CONFIG
	string "CONFIG: Project Configure Options"

config PK_OOM_USERSPACE_LIBPATH
	string "LIBS: Libraries to pass to the linker, e.g. -l<library>"

config PK_OOM_USERSPACE_CPPFLAGS
	string "CPPFLAGS: C/C++ preprocessor flags, e.g. -I<include dir>"

config PK_OOM_USERSPACE_DPKCONFIG
	string "PKG_CONFIG_PATH: Directories to add to pkg-config's search path"

config PK_OOM_USERSPACE_CFLAGS
	string "CFLAGS: C compiler flags"

config PK_OOM_USERSPACE_LDFLAGS
	string "LDFLAGS: Linker flags"

config PK_OOM_USERSPACE_CXXFLAGS
	string "CXXFLAGS: C++ compiler flags"

config PK_OOM_USERSPACE_ASFLAGS
	string "CCASFLAGS: assembler compiler flags (defaults to CFLAGS)"

config PK_OOM_USERSPACE_BUILDARCH
	string "--host options on configure for Architecture"

endif # PK_OOM_USERSPACE
```

## package/OOM/Kconfig
```kconfig
menuconfig PK_OOM
	bool "OOM: Out-of-memory mechanism"

if PK_OOM

# OOM on kernel
source package/OOM/BiscuitOS-OOM-kernel/Kconfig

# OOM on userspace
source package/OOM/BiscuitOS-OOM-userspace/Kconfig

endif # PK_OOM
```

## package/PAGE/BiscuitOS-PAGE-kernel/Kconfig
```kconfig
menuconfig PK_PAGE_ALLOC_KERNEL
	bool "Alloc a physical page on kernel"

if PK_PAGE_ALLOC_KERNEL

config PK_PAGE_ALLOC_KERNEL_VERSION
	default "default"
	string "verstion"

config PK_PAGE_ALLOC_KERNEL_TAR
	default "tar.gz"
	string "tar type"

config PK_PAGE_ALLOC_KERNEL_URL
	default "https://gitee.com/BiscuitOS_team/HardStack/raw/Gitee/Memory-Allocator/PAGE/BiscuitOS-PAGE-kernel"
	string "url"

config PK_PAGE_ALLOC_KERNEL_GITHUB
	string "GitHub"

config PK_PAGE_ALLOC_KERNEL_SRCFILE
	default "main.c Kconfig Makefile RunBiscuitOS.sh"
	string "Source code list"

config PK_PAGE_ALLOC_KERNEL_CSRCFILE
	string "Compile source code list"

config PK_PAGE_ALLOC_KERNEL_CONFIG
	string "CONFIG: Project Configure Options"

config PK_PAGE_ALLOC_KERNEL_LIBPATH
	string "LIBS: Libraries to pass to the linker, e.g. -l<library>"

config PK_PAGE_ALLOC_KERNEL_CPPFLAGS
	string "CPPFLAGS: C/C++ preprocessor flags, e.g. -I<include dir>"

config PK_PAGE_ALLOC_KERNEL_DPKCONFIG
	string "PKG_CONFIG_PATH: Directories to add to pkg-config's search path"

config PK_PAGE_ALLOC_KERNEL_CFLAGS
	string "CFLAGS: C compiler flags"

config PK_PAGE_ALLOC_KERNEL_LDFLAGS
	string "LDFLAGS: Linker flags"

config PK_PAGE_ALLOC_KERNEL_CXXFLAGS
	string "CXXFLAGS: C++ compiler flags"

config PK_PAGE_ALLOC_KERNEL_ASFLAGS
	string "CCASFLAGS: assembler compiler flags (defaults to CFLAGS)"

config PK_PAGE_ALLOC_KERNEL_BUILDARCH
	string "--host options on configure for Architecture"

endif # PK_PAGE_ALLOC_KERNEL
```

## package/PAGE/BiscuitOS-PAGE-userspace/Kconfig
```kconfig
menuconfig PK_PAGE_ALLOC_USERSPACE
	bool "Alloc a physical page on userspace"

if PK_PAGE_ALLOC_USERSPACE

config PK_PAGE_ALLOC_USERSPACE_VERSION
	default "default"
	string "verstion"

config PK_PAGE_ALLOC_USERSPACE_TAR
	default "tar.gz"
	string "tar type"

config PK_PAGE_ALLOC_USERSPACE_URL
	default "https://gitee.com/BiscuitOS_team/HardStack/raw/Gitee/Memory-Allocator/PAGE/BiscuitOS-PAGE-userspace"
	string "url"

config PK_PAGE_ALLOC_USERSPACE_GITHUB
	string "GitHub"

config PK_PAGE_ALLOC_USERSPACE_SRCFILE
	default "main.c Makefile RunBiscuitOS.sh"
	string "Source code list"

config PK_PAGE_ALLOC_USERSPACE_CSRCFILE
	string "Compile source code list"

config PK_PAGE_ALLOC_USERSPACE_CONFIG
	string "CONFIG: Project Configure Options"

config PK_PAGE_ALLOC_USERSPACE_LIBPATH
	string "LIBS: Libraries to pass to the linker, e.g. -l<library>"

config PK_PAGE_ALLOC_USERSPACE_CPPFLAGS
	string "CPPFLAGS: C/C++ preprocessor flags, e.g. -I<include dir>"

config PK_PAGE_ALLOC_USERSPACE_DPKCONFIG
	string "PKG_CONFIG_PATH: Directories to add to pkg-config's search path"

config PK_PAGE_ALLOC_USERSPACE_CFLAGS
	string "CFLAGS: C compiler flags"

config PK_PAGE_ALLOC_USERSPACE_LDFLAGS
	string "LDFLAGS: Linker flags"

config PK_PAGE_ALLOC_USERSPACE_CXXFLAGS
	string "CXXFLAGS: C++ compiler flags"

config PK_PAGE_ALLOC_USERSPACE_ASFLAGS
	string "CCASFLAGS: assembler compiler flags (defaults to CFLAGS)"

config PK_PAGE_ALLOC_USERSPACE_BUILDARCH
	string "--host options on configure for Architecture"

endif # PK_PAGE_ALLOC_USERSPACE
```

## package/PAGE/Kconfig
```kconfig
menuconfig PK_PAGE
	bool "Physical Page"

if PK_PAGE

# Alloc a page on kernel
source package/PAGE/BiscuitOS-PAGE-kernel/Kconfig

# Alloc a page on userspace
source package/PAGE/BiscuitOS-PAGE-userspace/Kconfig

endif # PK_PAGE
```

## package/PAGING/BiscuitOS-PAGING-32Bit-Paging-MMAP-4MiB/Kconfig
```kconfig
menuconfig PK_PAGING_32BIT_PAGING_MMAP_4M
	bool "32-Bit Paging mmap 4MiB Physical Memory"

if PK_PAGING_32BIT_PAGING_MMAP_4M

config PK_PAGING_32BIT_PAGING_MMAP_4M_VERSION
	default "default"
	string "verstion"

config PK_PAGING_32BIT_PAGING_MMAP_4M_TAR
	default "tar.gz"
	string "tar type"

config PK_PAGING_32BIT_PAGING_MMAP_4M_URL
	default "https://gitee.com/BiscuitOS_team/HardStack/raw/Gitee/Memory-Allocator/PAGING-MECH/BiscuitOS-PAGING-32Bit-Paging-MMAP-4MiB"
	string "url"

config PK_PAGING_32BIT_PAGING_MMAP_4M_GITHUB
	string "GitHub"

config PK_PAGING_32BIT_PAGING_MMAP_4M_SRCFILE
	default "main.c Makefile Kconfig Makefile.app RunBiscuitOS.sh app.c"
	string "Source code list"

config PK_PAGING_32BIT_PAGING_MMAP_4M_CSRCFILE
	string "Compile source code list"

config PK_PAGING_32BIT_PAGING_MMAP_4M_CONFIG
	string "CONFIG: Project Configure Options"

config PK_PAGING_32BIT_PAGING_MMAP_4M_LIBPATH
	string "LIBS: Libraries to pass to the linker, e.g. -l<library>"

config PK_PAGING_32BIT_PAGING_MMAP_4M_CPPFLAGS
	string "CPPFLAGS: C/C++ preprocessor flags, e.g. -I<include dir>"

config PK_PAGING_32BIT_PAGING_MMAP_4M_DPKCONFIG
	string "PKG_CONFIG_PATH: Directories to add to pkg-config's search path"

config PK_PAGING_32BIT_PAGING_MMAP_4M_CFLAGS
	string "CFLAGS: C compiler flags"

config PK_PAGING_32BIT_PAGING_MMAP_4M_LDFLAGS
	string "LDFLAGS: Linker flags"

config PK_PAGING_32BIT_PAGING_MMAP_4M_CXXFLAGS
	string "CXXFLAGS: C++ compiler flags"

config PK_PAGING_32BIT_PAGING_MMAP_4M_ASFLAGS
	string "CCASFLAGS: assembler compiler flags (defaults to CFLAGS)"

config PK_PAGING_32BIT_PAGING_MMAP_4M_BUILDARCH
	string "--host options on configure for Architecture"

endif # PK_PAGING_32BIT_PAGING_MMAP_4M
```

## package/PAGING/BiscuitOS-PAGING-4level-Paging-MMAP-1Gig/Kconfig
```kconfig
menuconfig PK_PAGING_4L_PAGING_MMAP_1G
	bool "4-level Paging mmap 1Gig Physical Memory"

if PK_PAGING_4L_PAGING_MMAP_1G

config PK_PAGING_4L_PAGING_MMAP_1G_VERSION
	default "default"
	string "verstion"

config PK_PAGING_4L_PAGING_MMAP_1G_TAR
	default "tar.gz"
	string "tar type"

config PK_PAGING_4L_PAGING_MMAP_1G_URL
	default "https://gitee.com/BiscuitOS_team/HardStack/raw/Gitee/Memory-Allocator/PAGING-MECH/BiscuitOS-PAGING-4level-Paging-MMAP-1Gig"
	string "url"

config PK_PAGING_4L_PAGING_MMAP_1G_GITHUB
	string "GitHub"

config PK_PAGING_4L_PAGING_MMAP_1G_SRCFILE
	default "main.c Makefile Kconfig Mafile.app RunBiscuitOS.sh app.c"
	string "Source code list"

config PK_PAGING_4L_PAGING_MMAP_1G_CSRCFILE
	string "Compile source code list"

config PK_PAGING_4L_PAGING_MMAP_1G_CONFIG
	string "CONFIG: Project Configure Options"

config PK_PAGING_4L_PAGING_MMAP_1G_LIBPATH
	string "LIBS: Libraries to pass to the linker, e.g. -l<library>"

config PK_PAGING_4L_PAGING_MMAP_1G_CPPFLAGS
	string "CPPFLAGS: C/C++ preprocessor flags, e.g. -I<include dir>"

config PK_PAGING_4L_PAGING_MMAP_1G_DPKCONFIG
	string "PKG_CONFIG_PATH: Directories to add to pkg-config's search path"

config PK_PAGING_4L_PAGING_MMAP_1G_CFLAGS
	string "CFLAGS: C compiler flags"

config PK_PAGING_4L_PAGING_MMAP_1G_LDFLAGS
	string "LDFLAGS: Linker flags"

config PK_PAGING_4L_PAGING_MMAP_1G_CXXFLAGS
	string "CXXFLAGS: C++ compiler flags"

config PK_PAGING_4L_PAGING_MMAP_1G_ASFLAGS
	string "CCASFLAGS: assembler compiler flags (defaults to CFLAGS)"

config PK_PAGING_4L_PAGING_MMAP_1G_BUILDARCH
	string "--host options on configure for Architecture"

endif # PK_PAGING_4L_PAGING_MMAP_1G
```
